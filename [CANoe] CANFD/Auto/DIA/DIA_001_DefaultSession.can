/*@!Encoding:1252*/
includes
{
}

variables
{
  // Timeout for diagnostic response (ms)
  const long TIMEOUT_DIAG_RESPONSE = 2000;

  // Expected timing values according to OEM Specification
  const word EXPECTED_P2_SERVER_MAX_MS    = 50;   // 0x0032 = 50 ms
  const word EXPECTED_P2_STAR_SERVER_MAX_MS = 5000; // 0x01F4 (500) * 10 ms = 5000 ms
}

/*
 * Test case: Send UDS Request 10 01 (DiagnosticSessionControl - Default Session)
 * and strictly verify:
 * 1. Positive Response SID (0x50) & Session Type (0x01)
 * 2. P2server_max   == 50 ms (0x00 0x32)
 * 3. P2*server_max  == 5000 ms (0x01 0xF4)
 */
testcase TC_Diagnostic_DefaultSession_10_01()
{
  diagRequest DVRS.Default_Session_Start diagReq;
  diagResponse DVRS.Default_Session_Start diagResp;
  long waitResult;
  long nrc;
  long respSize;
  long i;
  byte respByte0;
  byte respByte1;
  word p2_max;
  word p2_star_max;
  char fullPayloadStr[100];
  char tempByte[10];

  testCaseTitle("TC_DIAG_01", "UDS Service 0x10 0x01 (Default Session) Verification");
  testCaseDescription("Send Request 10 01 to ECU DVRS and verify Positive Response 50 01 and P2/P2* Timing");

  write("=================================================");
  write("[DIAG] Starting test: UDS Request 10 01 -> 50 01 00 32 01 F4");
  write("=================================================");

  testStep("DIAG_TX", "1. Sending Diagnostic Request: 10 01 (Default Session)...");
  
  // Send diagnostic request to ECU DVRS
  diagSendRequest(diagReq);
  write("[DIAG] Sent Request: 10 01");

  // Wait for response from ECU within 2000 ms
  testStep("DIAG_WAIT", "2. Waiting for Response from ECU (Timeout = %d ms)...", TIMEOUT_DIAG_RESPONSE);
  waitResult = testWaitForDiagResponse(diagReq, TIMEOUT_DIAG_RESPONSE);

  if (waitResult == 1)
  {
    // Check response type: -1 indicates Positive Response, > 0 indicates NRC
    nrc = diagGetLastResponseCode(diagReq);

    if (nrc == -1)
    {
      // Retrieve the received response object into diagResp
      diagGetLastResponse(diagReq, diagResp);
      respSize = diagGetPrimitiveSize(diagResp);
      
      // Build full response payload string from response object
      fullPayloadStr[0] = '\0';
      for (i = 0; i < respSize && i < 20; i++)
      {
        snprintf(tempByte, elcount(tempByte), "%02X ", diagGetPrimitiveByte(diagResp, i));
        strncat(fullPayloadStr, tempByte, elcount(fullPayloadStr));
      }

      write("[DIAG] RX <- Full Payload (%d bytes): %s", respSize, fullPayloadStr);

      respByte0 = diagGetPrimitiveByte(diagResp, 0); // Expected: 0x50 (Positive SID)
      respByte1 = diagGetPrimitiveByte(diagResp, 1); // Expected: 0x01 (Session Type echo)

      // Step 3.1: Verify SID and Session Type
      if (respByte0 == 0x50 && respByte1 == 0x01)
      {
        testStepPass("VERIFY_SID_SESSION", "PASS: Correct Positive Response SID (0x50) and Default Session (0x01)");
        write("[DIAG] Step 1 PASS: SID=0x50, Session=0x01");
      }
      else
      {
        testStepFail("VERIFY_SID_SESSION", "FAIL: Unexpected SID/Session (Received: %02X %02X, Expected: 50 01)", respByte0, respByte1);
        write("[DIAG] Step 1 FAIL: Unexpected SID/Session");
      }

      // Step 3.2: Verify Payload Length (Expected at least 6 bytes for timing parameters)
      if (respSize >= 6)
      {
        p2_max      = (diagGetPrimitiveByte(diagResp, 2) << 8) | diagGetPrimitiveByte(diagResp, 3);
        p2_star_max = ((diagGetPrimitiveByte(diagResp, 4) << 8) | diagGetPrimitiveByte(diagResp, 5)) * 10;

        // Step 3.3: Verify P2server_max == 50 ms (0x0032)
        if (p2_max == EXPECTED_P2_SERVER_MAX_MS)
        {
          testStepPass("VERIFY_P2_MAX", "PASS: P2server_max is exactly %d ms (raw: 0x%02X 0x%02X)", 
                       p2_max, diagGetPrimitiveByte(diagResp, 2), diagGetPrimitiveByte(diagResp, 3));
          write("[DIAG] Step 2 PASS: P2server_max = %d ms", p2_max);
        }
        else
        {
          testStepFail("VERIFY_P2_MAX", "FAIL: P2server_max mismatch (Received: %d ms, Expected: %d ms)", 
                       p2_max, EXPECTED_P2_SERVER_MAX_MS);
          write("[DIAG] Step 2 FAIL: P2server_max mismatch (%d != %d)", p2_max, EXPECTED_P2_SERVER_MAX_MS);
        }

        // Step 3.4: Verify P2*server_max == 5000 ms (0x01F4 * 10)
        if (p2_star_max == EXPECTED_P2_STAR_SERVER_MAX_MS)
        {
          testStepPass("VERIFY_P2_STAR_MAX", "PASS: P2*server_max is exactly %d ms (raw: 0x%02X 0x%02X)", 
                       p2_star_max, diagGetPrimitiveByte(diagResp, 4), diagGetPrimitiveByte(diagResp, 5));
          write("[DIAG] Step 3 PASS: P2*server_max = %d ms", p2_star_max);
        }
        else
        {
          testStepFail("VERIFY_P2_STAR_MAX", "FAIL: P2*server_max mismatch (Received: %d ms, Expected: %d ms)", 
                       p2_star_max, EXPECTED_P2_STAR_SERVER_MAX_MS);
          write("[DIAG] Step 3 FAIL: P2*server_max mismatch (%d != %d)", p2_star_max, EXPECTED_P2_STAR_SERVER_MAX_MS);
        }
      }
      else
      {
        testStepFail("VERIFY_PAYLOAD_LEN", "FAIL: Response payload too short (%d bytes). Missing P2/P2* timing record!", respSize);
        write("[DIAG] FAIL: Payload has only %d bytes, expected >= 6 bytes", respSize);
      }
    }
    else
    {
      write("[DIAG] Received Negative Response (NRC = 0x%02X)", nrc);
      testStepFail("DIAG_VERIFY", "FAIL: ECU returned Negative Response (NRC: 0x%02X - 7F 10 %02X)", nrc, nrc);
    }
  }
  else if (waitResult == 0)
  {
    write("[DIAG] Error: Timeout waiting for response from ECU!");
    testStepFail("DIAG_TIMEOUT", "FAIL: Timeout after %d ms without response", TIMEOUT_DIAG_RESPONSE);
  }
  else
  {
    write("[DIAG] System error while waiting for response (Result = %d)", waitResult);
    testStepFail("DIAG_ERROR", "FAIL: System error during diag response wait");
  }

  write("=================================================");
  write("[DIAG] Finished testcase TC_Diagnostic_DefaultSession_10_01");
  write("=================================================");
}

/*
 * Test case Raw: Send raw primitive bytes 10 01 directly and strictly verify all 6 bytes:
 * 50 01 00 32 01 F4
 */
testcase TC_Diagnostic_Raw_10_01()
{
  diagRequest DVRS.* rawReq;
  diagResponse DVRS.* rawResp;
  long waitResult;
  long respSize;
  long i;
  byte b0, b1, b2, b3, b4, b5;
  char fullPayloadStr[100];
  char tempByte[10];

  testCaseTitle("TC_DIAG_RAW", "UDS Raw Byte 10 01 & Full Response 50 01 00 32 01 F4 Verification");
  testCaseDescription("Send raw bytes 10 01 and strictly verify 6-byte response 50 01 00 32 01 F4");

  // Set primitive size to 2 bytes and assign values: 0x10, 0x01
  diagResize(rawReq, 2);
  diagSetPrimitiveByte(rawReq, 0, 0x10);
  diagSetPrimitiveByte(rawReq, 1, 0x01);

  testStep("RAW_TX", "Sending Raw Diag Request: 10 01");
  diagSendRequest(rawReq);

  waitResult = testWaitForDiagResponse(rawReq, TIMEOUT_DIAG_RESPONSE);

  if (waitResult == 1)
  {
    // Retrieve the received response object into rawResp
    diagGetLastResponse(rawReq, rawResp);
    respSize = diagGetPrimitiveSize(rawResp);
    
    fullPayloadStr[0] = '\0';
    for (i = 0; i < respSize && i < 20; i++)
    {
      snprintf(tempByte, elcount(tempByte), "%02X ", diagGetPrimitiveByte(rawResp, i));
      strncat(fullPayloadStr, tempByte, elcount(fullPayloadStr));
    }

    write("[DIAG_RAW] RX <- Full Raw Response (%d bytes): %s", respSize, fullPayloadStr);

    if (respSize >= 6)
    {
      b0 = diagGetPrimitiveByte(rawResp, 0);
      b1 = diagGetPrimitiveByte(rawResp, 1);
      b2 = diagGetPrimitiveByte(rawResp, 2);
      b3 = diagGetPrimitiveByte(rawResp, 3);
      b4 = diagGetPrimitiveByte(rawResp, 4);
      b5 = diagGetPrimitiveByte(rawResp, 5);

      if (b0 == 0x50 && b1 == 0x01 && b2 == 0x00 && b3 == 0x32 && b4 == 0x01 && b5 == 0xF4)
      {
        testStepPass("RAW_VERIFY", "PASS: ECU returned exact expected 6 bytes: 50 01 00 32 01 F4");
        write("[DIAG_RAW] Result: PASS (Exact 50 01 00 32 01 F4)");
      }
      else
      {
        testStepFail("RAW_VERIFY", "FAIL: Payload mismatch (Received: %s, Expected: 50 01 00 32 01 F4)", fullPayloadStr);
        write("[DIAG_RAW] Result: FAIL (Data mismatch)");
      }
    }
    else
    {
      testStepFail("RAW_VERIFY", "FAIL: Response too short (%d bytes, expected 6 bytes)", respSize);
    }
  }
  else
  {
    testStepFail("RAW_TIMEOUT", "FAIL: Timeout waiting for response from ECU");
  }
}

/*
 * MainTest function executed when the Test Module starts
 */
void MainTest()
{
  // Run testcase using CDD-defined service with strict P2/P2* verification
  TC_Diagnostic_DefaultSession_10_01();
  
  testWaitForTimeout(1000);

  // Run testcase using Raw Bytes with exact 6-byte check
  TC_Diagnostic_Raw_10_01();
}
