/*@!Encoding:1252*/
includes
{
  #include "DeclarationFunction_Gen2.5.h"
}

/*
 * ==============================================================================
 * Test Module: DIA_002_SecurityAccess_Level1.can
 * 
 * Title: UDS Service 0x27 Security Access (0x27 11 RequestSeed / 0x27 12 SendKey)
 * Target ECU: DVRS (ES95486_02_BLTN_CAM_G13.65.cdd / ES95486_02_DVRS_v5.65.cdd)
 * Seed & Key Engine: oeuk_bridge.dll (HKMC Advanced Seed Key)
 *
 * Preconditions:
 *   1. In CANoe -> Diagnostics -> Diagnostic Configuration -> Target DVRS
 *      -> Under "Security Access" -> Configure Level 0x11 (or 17):
 *         Key Generation DLL = d:\Config_Canoe\CAN FD\CAN FD\[CANoe] CANFD\OEUK_CANoe_Portable\oeuk_bridge.dll
 *   2. Directory OEUK_CANoe_Portable must contain all required companion files:
 *      HKMC_AdvancedSeedKey_Win32.dll, HKMC_SACM_Win7.dll, LIB_UMT.dll,
 *      YOEUK_public.pem, msvcr120.dll, oeuk_bridge.ini
 * ==============================================================================
 */

variables
{
  // Timeout for diagnostic response (ms)
  const long TIMEOUT_DIAG_RESPONSE = 2000;

  // Security Level constant (Subfunction 0x11 = 17)
  const dword SEC_LEVEL_1 = 0x11;
}

/*
 * Helper function: Print byte array as hex string to CANoe Write window
 */
void PrintHexArray(char prefix[], byte data[], long length)
{
  long i;
  char lineBuffer[256];
  char byteHex[8];

  lineBuffer[0] = '\0';
  for (i = 0; i < length && i < 32; i++)
  {
    snprintf(byteHex, elcount(byteHex), "%02X ", data[i]);
    strncat(lineBuffer, byteHex, elcount(lineBuffer));
  }
  write("%s (%d bytes): %s", prefix, length, lineBuffer);
}

/*
 * ==============================================================================
 * Testcase 1: Unlock Security Access Level 1 (0x11 / 0x12) via CDD-defined Service
 * CDD Qualifiers:
 *   - Request: DVRS.RequestSeed_Unlock_Level_1  (Parameter: SecuritySeed)
 *   - SendKey: DVRS.SendKey_Unlock_Level_1      (Parameter: SecurityKey)
 * ==============================================================================
 */
testcase TC_SecurityAccess_CDD_Level_1()
{
  diagRequest  DVRS.RequestSeed_Unlock_Level_1_RequestSeed reqSeed;
  diagResponse DVRS.RequestSeed_Unlock_Level_1_RequestSeed respSeed;
  diagRequest  DVRS.SendKey_Unlock_Level_1_SendKey         reqKey;
  diagResponse DVRS.SendKey_Unlock_Level_1_SendKey         respKey;
  long waitResult;
  long nrc;
  long genKeyStatus;
  dword actualSeedLen;
  dword actualKeyLen;
  long i;
  int isZeroSeed;

  byte seed[256];
  byte key[256];

  testCaseTitle("TC_SEC_CDD_01", "Security Access Level 1 (27 11 -> 27 12) via CDD & oeuk_bridge.dll");
  testCaseDescription("Request Seed via CDD, generate Key via oeuk_bridge.dll, then send Key to unlock ECU");

  write("=================================================");
  write("[DIAG_SEC] START TC: Security Access Level 1 via CDD");
  write("=================================================");

  // -------------------------------------------------------------
  // STEP 1: Send Request Seed (27 11)
  // -------------------------------------------------------------
  testStep("STEP_1_REQ_SEED", "1. Sending RequestSeed (27 11) to ECU...");
  diagSendRequest(reqSeed);
  write("[DIAG_SEC] Sent Request: 27 11 (RequestSeed_Unlock_Level_1)");

  waitResult = testWaitForDiagResponse(reqSeed, TIMEOUT_DIAG_RESPONSE);
  if (waitResult != 1)
  {
    testStepFail("TIMEOUT_SEED", "FAIL: Timeout after %d ms waiting for Seed response from ECU!", TIMEOUT_DIAG_RESPONSE);
    write("[DIAG_SEC] ERROR: Timeout waiting for 27 11 response");
    return;
  }

  nrc = diagGetLastResponseCode(reqSeed);
  if (nrc != -1)
  {
    testStepFail("SEED_NRC", "FAIL: ECU returned Negative Response (NRC = 0x%02X - 7F 27 %02X)", nrc, nrc);
    write("[DIAG_SEC] FAIL: RequestSeed rejected with NRC 0x%02X (7F 27 %02X)", nrc, nrc);
    return;
  }

  // Retrieve received response object
  diagGetLastResponse(reqSeed, respSeed);

  // Retrieve Seed via CDD parameter "SecuritySeed"
  actualSeedLen = diagGetComplexParameterRaw(respSeed, "SecuritySeed", seed, elcount(seed));
  if (actualSeedLen <= 0)
  {
    // Fallback: extract directly from primitive bytes (Byte 0=0x67, Byte 1=0x11, Byte 2..=Seed)
    actualSeedLen = diagGetPrimitiveSize(respSeed) - 2;
    for (i = 0; i < actualSeedLen && i < elcount(seed); i++)
    {
      seed[i] = diagGetPrimitiveByte(respSeed, 2 + i);
    }
  }

  PrintHexArray("[DIAG_SEC] RX <- Received Seed", seed, actualSeedLen);
  testStepPass("SEED_RECEIVED", "PASS: Received Seed successfully (%d bytes)", actualSeedLen);

  // Check if Seed is all zeros -> ECU is already unlocked
  isZeroSeed = 1;
  for (i = 0; i < actualSeedLen; i++)
  {
    if (seed[i] != 0x00)
    {
      isZeroSeed = 0;
      break;
    }
  }

  if (isZeroSeed == 1)
  {
    testStepPass("ALREADY_UNLOCKED", "PASS: Received all-zero Seed -> ECU is already in UNLOCKED state!");
    write("[DIAG_SEC] Info: ECU already unlocked. Skipping SendKey step.");
    return;
  }

  // -------------------------------------------------------------
  // STEP 2: Call oeuk_bridge.dll to calculate Key from Seed
  // -------------------------------------------------------------
  testStep("STEP_2_CALC_KEY", "2. Calling oeuk_bridge.dll to generate Key from Seed...");
  write("[DIAG_SEC] Calling oeuk_bridge.dll via diagGenerateKeyFromSeed(Level=0x%02X)...", SEC_LEVEL_1);

  genKeyStatus = diagGenerateKeyFromSeed(
    reqSeed,          // Diagnostic Request context
    seed,             // Input Seed buffer
    actualSeedLen,    // Input Seed length
    SEC_LEVEL_1,      // Security Level = 0x11
    "",               // Variant
    "",               // Options
    key,              // Output Key buffer
    elcount(key),     // Maximum buffer capacity
    actualKeyLen      // Actual Key length returned by DLL
  );

  if (genKeyStatus != 0)
  {
    testStepFail("GEN_KEY_FAILED", "FAIL: oeuk_bridge.dll failed to generate Key! Error code = %d", genKeyStatus);
    write("[DIAG_SEC] ERROR: diagGenerateKeyFromSeed failed with error code %d", genKeyStatus);
    return;
  }

  PrintHexArray("[DIAG_SEC] CALC -> Key calculated by oeuk_bridge.dll", key, actualKeyLen);
  testStepPass("KEY_GENERATED", "PASS: oeuk_bridge.dll generated Key successfully (%d bytes)", actualKeyLen);

  // -------------------------------------------------------------
  // STEP 3: Assign Key into SendKey request and send to ECU
  // -------------------------------------------------------------
  testStep("STEP_3_SEND_KEY", "3. Setting Key parameter and sending SendKey (27 12) to ECU...");
  diagSetComplexParameterRaw(reqKey, "SecurityKey", key, actualKeyLen);
  
  diagSendRequest(reqKey);
  write("[DIAG_SEC] Sent Request: 27 12 (SendKey_Unlock_Level_1)");

  waitResult = testWaitForDiagResponse(reqKey, TIMEOUT_DIAG_RESPONSE);
  if (waitResult != 1)
  {
    testStepFail("TIMEOUT_KEY", "FAIL: Timeout after %d ms waiting for Key response from ECU!", TIMEOUT_DIAG_RESPONSE);
    write("[DIAG_SEC] ERROR: Timeout waiting for 27 12 response");
    return;
  }

  nrc = diagGetLastResponseCode(reqKey);
  if (nrc == -1)
  {
    diagGetLastResponse(reqKey, respKey);
    testStepPass("SEC_UNLOCKED", "PASS: Security Access Level 1 unlocked successfully (Positive Response: 67 12)!");
    write("[DIAG_SEC] SUCCESS: ECU Security Access Level 1 is UNLOCKED!");
  }
  else
  {
    testStepFail("KEY_REJECTED", "FAIL: ECU rejected Key! NRC = 0x%02X (7F 27 %02X)", nrc, nrc);
    write("[DIAG_SEC] FAIL: SendKey rejected by ECU with NRC = 0x%02X", nrc);
  }

  write("=================================================");
  write("[DIAG_SEC] FINISHED TC: Security Access Level 1 via CDD");
  write("=================================================");
}

/*
 * ==============================================================================
 * Testcase 2: Unlock Security Access Level 1 (27 11 / 27 12) via Raw Primitives
 * For running directly with raw bytes independent of CDD qualifier naming
 * ==============================================================================
 */
testcase TC_SecurityAccess_Raw_27_11_12()
{
  diagRequest  DVRS.* rawReqSeed;
  diagResponse DVRS.* rawRespSeed;
  diagRequest  DVRS.* rawReqKey;
  diagResponse DVRS.* rawRespKey;

  long waitResult;
  long nrc;
  long respSize;
  long genKeyStatus;
  dword seedLen;
  dword actualKeyLen;
  long i;
  int isZeroSeed;

  byte seed[256];
  byte key[256];

  testCaseTitle("TC_SEC_RAW_01", "Security Access Level 1 (27 11 -> 27 12) via Raw Bytes & oeuk_bridge.dll");
  testCaseDescription("Send Raw 27 11, calculate Key using oeuk_bridge.dll, then send Raw 27 12 [Key]");

  write("=================================================");
  write("[DIAG_RAW_SEC] START TC: Security Access Level 1 via Raw Bytes");
  write("=================================================");

  // 1. Send Raw Request: 27 11
  testStep("RAW_REQ_SEED", "1. Sending Raw UDS Request: 27 11 (RequestSeed)...");
  diagResize(rawReqSeed, 2);
  diagSetPrimitiveByte(rawReqSeed, 0, 0x27);
  diagSetPrimitiveByte(rawReqSeed, 1, 0x11);

  diagSendRequest(rawReqSeed);
  write("[DIAG_RAW_SEC] Sent Raw Request: 27 11");

  waitResult = testWaitForDiagResponse(rawReqSeed, TIMEOUT_DIAG_RESPONSE);
  if (waitResult != 1)
  {
    testStepFail("RAW_TIMEOUT_SEED", "FAIL: Timeout waiting for response to 27 11!");
    return;
  }

  nrc = diagGetLastResponseCode(rawReqSeed);
  if (nrc != -1)
  {
    testStepFail("RAW_SEED_NRC", "FAIL: ECU returned NRC = 0x%02X (7F 27 %02X)", nrc, nrc);
    return;
  }

  diagGetLastResponse(rawReqSeed, rawRespSeed);
  respSize = diagGetPrimitiveSize(rawRespSeed);

  // Validate SID 0x67 and Subfunction 0x11
  if (respSize < 3 || diagGetPrimitiveByte(rawRespSeed, 0) != 0x67 || diagGetPrimitiveByte(rawRespSeed, 1) != 0x11)
  {
    testStepFail("RAW_INVALID_RESP", "FAIL: Response format invalid for 67 11 (Size: %d)", respSize);
    return;
  }

  seedLen = respSize - 2;
  for (i = 0; i < seedLen && i < elcount(seed); i++)
  {
    seed[i] = diagGetPrimitiveByte(rawRespSeed, 2 + i);
  }

  PrintHexArray("[DIAG_RAW_SEC] RX <- Raw Seed", seed, seedLen);

  isZeroSeed = 1;
  for (i = 0; i < seedLen; i++)
  {
    if (seed[i] != 0x00)
    {
      isZeroSeed = 0;
      break;
    }
  }

  if (isZeroSeed == 1)
  {
    testStepPass("RAW_ALREADY_UNLOCKED", "PASS: Seed is all zeros -> ECU is already unlocked.");
    return;
  }

  // 2. Generate Key using oeuk_bridge.dll
  testStep("RAW_CALC_KEY", "2. Generating Key using oeuk_bridge.dll...");
  genKeyStatus = diagGenerateKeyFromSeed(
    rawReqSeed,
    seed,
    seedLen,
    SEC_LEVEL_1,
    "",
    "",
    key,
    elcount(key),
    actualKeyLen
  );

  if (genKeyStatus != 0)
  {
    testStepFail("RAW_GENKEY_FAIL", "FAIL: oeuk_bridge.dll failed to generate Key (Error code: %d)", genKeyStatus);
    return;
  }

  PrintHexArray("[DIAG_RAW_SEC] CALC -> Key from oeuk_bridge.dll", key, actualKeyLen);

  // 3. Send Raw Request: 27 12 [Key bytes]
  testStep("RAW_SEND_KEY", "3. Sending Raw UDS Request: 27 12 + Key...");
  diagResize(rawReqKey, 2 + actualKeyLen);
  diagSetPrimitiveByte(rawReqKey, 0, 0x27);
  diagSetPrimitiveByte(rawReqKey, 1, 0x12);
  for (i = 0; i < actualKeyLen; i++)
  {
    diagSetPrimitiveByte(rawReqKey, 2 + i, key[i]);
  }

  diagSendRequest(rawReqKey);
  write("[DIAG_RAW_SEC] Sent Raw Request: 27 12 [Key]");

  waitResult = testWaitForDiagResponse(rawReqKey, TIMEOUT_DIAG_RESPONSE);
  if (waitResult != 1)
  {
    testStepFail("RAW_TIMEOUT_KEY", "FAIL: Timeout waiting for response to 27 12!");
    return;
  }

  nrc = diagGetLastResponseCode(rawReqKey);
  if (nrc == -1)
  {
    diagGetLastResponse(rawReqKey, rawRespKey);
    if (diagGetPrimitiveByte(rawRespKey, 0) == 0x67 && diagGetPrimitiveByte(rawRespKey, 1) == 0x12)
    {
      testStepPass("RAW_SEC_PASS", "PASS: Raw Security Access 27 11/12 unlocked successfully (67 12)!");
      write("[DIAG_RAW_SEC] SUCCESS: Raw Security Access UNLOCKED!");
    }
  }
  else
  {
    testStepFail("RAW_KEY_REJECTED", "FAIL: ECU returned NRC = 0x%02X (7F 27 %02X)", nrc, nrc);
    write("[DIAG_RAW_SEC] FAIL: NRC = 0x%02X", nrc);
  }

  write("=================================================");
  write("[DIAG_RAW_SEC] FINISHED TC: Security Access Level 1 via Raw Bytes");
  write("=================================================");
}

/*
 * ==============================================================================
 * MainTest: Main execution function when the Test Module starts
 * ==============================================================================
 */
void MainTest()
{
  write("#################################################");
  write("# RUNNING TEST SUITE: SECURITY ACCESS LEVEL 1   #");
  write("#################################################");

  // Execute Testcase 1: Using CDD Service definitions
  TC_SecurityAccess_CDD_Level_1();

  testWaitForTimeout(1000);

  // Execute Testcase 2: Using Raw Primitive Bytes 27 11 / 27 12
  TC_SecurityAccess_Raw_27_11_12();

  write("#################################################");
  write("# COMPLETED TEST SUITE: SECURITY ACCESS LEVEL 1 #");
  write("#################################################");
}
