/*@!Encoding:65001*/
// Preconditions: - ACC and IGN and ccNC/ccIC switch OFF state, AVN mode
variables
{
  // Message Declaration
  // CAN
  message HU_CLOCK_PE_02 _HU_CLOCK_PE_02;
  message HU_BLTN_CAM_E_00 _HU_BLTN_CAM_E_00;
  message HU_BLTN_CAM_PE_00_200ms _HU_BLTN_CAM_PE_00_200ms;
  message HU_GW_PE_01 _HU_GW_PE_01;
  message IAU_16_200ms _IAU_16_200ms;
  message HU_BLTN_CAM_E_01 _HU_BLTN_CAM_E_01;
  message ICU_08_200ms _ICU_08_200ms;
  message SMK_13_200ms _SMK_13_200ms;
  // Global Variable Declaration
//  byte set_120h_value = 0x1; //If model type have 120h parking but I set it always OFF
  byte set_120h_value = 0x0;//If model type don't have 120h parking
  
  byte arr_RecSet[2] = {0x1,0x2};
  byte arr_OWPTime[19] = {0x2,0x3,0x4,0x5,0x6,0x7,0x8,0x9,0xA,0xB,0xC,0xD,0xE,0xF,0x10,0x11,0x12,0x13,0x14}; 
  int arr_EVtime[3] = {0x0,0x5,0xA};
  byte arr_TMLinterval[3] = {0x1,0x2,0x5};
  byte arr_CAMAngle[10] = {0x1,0x2,0x3,0x4,0x5,0x11,0x12,0x13,0x14,0x15};
  byte arr_EVSen[5] = {0x1,0x2,0x3,0x4,0x5};
 
  byte arr_random_setting[21];
  byte arr_get_setting[21];
  byte arr_Profile_Guest_setting[21];
  byte arr_Profile_Driver1_setting[21];
  byte arr_Profile_Driver2_setting[21];

  int ON_OFF_Option = 0;
  int index;
  int i;
  int flag = 0;
  int condition1, condition2, condition3;
  byte ProfileIDRValue;
  byte ProfileIDRVal;
}

void KEY_ON() {
    setSignal(SMK_TrmnlCtrlGrpStaBDC, 0x2); //IGN
}
  
void KEY_OFF() {
    setSignal(SMK_TrmnlCtrlGrpStaBDC, 0x0); //OFF
}

void Enter_BLTN_CAM(){
  // CAN
  _HU_BLTN_CAM_PE_00_200ms.HU_BLTN_CAM_UI_Mode=0x1;
  output(_HU_BLTN_CAM_PE_00_200ms); //Enter BLTN_CAM mode    
}

void Exit_BLTN_CAM(){
  // CAN
  _HU_BLTN_CAM_PE_00_200ms.HU_BLTN_CAM_UI_Mode=0x0;
  output(_HU_BLTN_CAM_PE_00_200ms);//Exit BLTN_CAM Mode      
}

void CaptureGraphics(){
  testReportAddWindowCapture("Graphics 2","CF_AVN_ProfileIDRValue;IAU_ProfileIDRVal","Sreenshot","./Husign.jpg");
}
 
void BLTN_CAM_Settings(){
  // CAN
  // Recording Settings
  _HU_BLTN_CAM_E_00.BLTN_CAM_Rec_OWD_NvalueSet = arr_random_setting[0];
  output(_HU_BLTN_CAM_E_00);
  testWaitForTimeout(200);  
  _HU_BLTN_CAM_E_00.BLTN_CAM_Rec_OWP_NvalueSet = arr_random_setting[1];
  output(_HU_BLTN_CAM_E_00);
  testWaitForTimeout(200);   
  _HU_BLTN_CAM_E_00.BLTN_CAM_Rec_DEV_NvalueSet = arr_random_setting[2];
  output(_HU_BLTN_CAM_E_00);
  testWaitForTimeout(200);   
  _HU_BLTN_CAM_E_00.BLTN_CAM_Rec_PEV_NvalueSet = arr_random_setting[3];
  output(_HU_BLTN_CAM_E_00);
  testWaitForTimeout(200);   
  _HU_BLTN_CAM_E_00.BLTN_CAM_EV_RecMaxTime_NvalueSet = arr_random_setting[4];
  output(_HU_BLTN_CAM_E_00);
  testWaitForTimeout(200);   
  // Time Settings
  _HU_BLTN_CAM_E_00.BLTN_CAM_PrkTime_NvalueSet = arr_random_setting[5];
  output(_HU_BLTN_CAM_E_00);
  testWaitForTimeout(200);   
  _HU_BLTN_CAM_E_00.BLTN_CAM_TML_Int_NvalueSet = arr_random_setting[6];
  output(_HU_BLTN_CAM_E_00);
  testWaitForTimeout(200);   
  _HU_BLTN_CAM_E_00.BLTN_CAM_EV_BfrTime_NvalueSet = arr_random_setting[7];
  output(_HU_BLTN_CAM_E_00);
  testWaitForTimeout(200);   
  _HU_BLTN_CAM_E_00.BLTN_CAM_EV_AftTime_NvalueSet = arr_random_setting[8];
  output(_HU_BLTN_CAM_E_00);
  testWaitForTimeout(200);   
  // Stamp Information Settings 
  _HU_BLTN_CAM_E_00.BLTN_CAM_EVSen_Stm_NvalueSet = arr_random_setting[9];
  output(_HU_BLTN_CAM_E_00);
  testWaitForTimeout(200);   
  _HU_BLTN_CAM_E_00.BLTN_CAM_GearPos_Stm_NvalueSet = arr_random_setting[10];
  output(_HU_BLTN_CAM_E_00);
  testWaitForTimeout(200);   
  _HU_BLTN_CAM_E_00.BLTN_CAM_Locatn_Stm_NvalueSet = arr_random_setting[11];
  output(_HU_BLTN_CAM_E_00);
  testWaitForTimeout(200);   
  _HU_BLTN_CAM_E_00.BLTN_CAM_Spd_Stm_NvalueSet = arr_random_setting[12];
  output(_HU_BLTN_CAM_E_00);
  testWaitForTimeout(200);   
  _HU_BLTN_CAM_E_00.BLTN_CAM_Time_Stm_NvalueSet = arr_random_setting[13];
  output(_HU_BLTN_CAM_E_00);
  testWaitForTimeout(200);   
  _HU_BLTN_CAM_E_00.BLTN_CAM_TrnSig_Stm_NvalueSet = arr_random_setting[14];
  output(_HU_BLTN_CAM_E_00);
  testWaitForTimeout(200);   
  _HU_BLTN_CAM_E_00.BLTN_CAM_AudRec_NvalueSet = arr_random_setting[15];
  output(_HU_BLTN_CAM_E_00);
  testWaitForTimeout(200);   
  // ETC Settings
  _HU_BLTN_CAM_E_01.BLTN_CAM_FR_VerPos_NvalueSet = arr_random_setting[16];
  output(_HU_BLTN_CAM_E_01);
  testWaitForTimeout(200);   
  _HU_BLTN_CAM_E_01.BLTN_CAM_RR_VerPos_NvalueSet = arr_random_setting[17];
  output(_HU_BLTN_CAM_E_01);
  testWaitForTimeout(200);     
  _HU_BLTN_CAM_E_00.BLTN_CAM_Sen_DEV_NvalueSet = arr_random_setting[18];
  output(_HU_BLTN_CAM_E_00);
  testWaitForTimeout(200);    
  _HU_BLTN_CAM_E_00.BLTN_CAM_Sen_PEV_NvalueSet = arr_random_setting[19];
  output(_HU_BLTN_CAM_E_00);
  testWaitForTimeout(200);    
  //App Notification
  if ((arr_random_setting[20] == 0x2 && getSignal(BLTN_CAM_Set_PEV_AppNoti) == 0x1) || (arr_random_setting[20] == 0x1 && getSignal(BLTN_CAM_Set_PEV_AppNoti) == 0x2)){
    @panel::Button_AppNoti_PEV = 1;
  }
}
void Get_setting(){
  arr_get_setting[0] = getSignal(BLTN_CAM_RecSet_OWD);
  arr_get_setting[1] = getSignal(BLTN_CAM_RecSet_OWP);
  arr_get_setting[2] = getSignal(BLTN_CAM_RecSet_DEV);
  arr_get_setting[3] = getSignal(BLTN_CAM_RecSet_PEV);
  arr_get_setting[4] = getSignal(BLTN_CAM_Set_EV_RecMaxTime);
  arr_get_setting[5] = getSignal(BLTN_CAM_Set_PrkTime);
  arr_get_setting[6] = getSignal(BLTN_CAM_Set_Drv_TML_Int);
  arr_get_setting[7] = getSignal(BLTN_CAM_Set_EV_BfrTime);
  arr_get_setting[8] = getSignal(BLTN_CAM_Set_EV_AftTime);
  arr_get_setting[9] = getSignal(BLTN_CAM_Set_EVSen_Stm);
  arr_get_setting[10] = getSignal(BLTN_CAM_Set_GearPos_Stm);
  arr_get_setting[11] = getSignal(BLTN_CAM_Set_Locatn_Stm);
  arr_get_setting[12] = getSignal(BLTN_CAM_Set_Spd_Stm);
  arr_get_setting[13] = getSignal(BLTN_CAM_Set_Tim_Stm);
  arr_get_setting[14] = getSignal(BLTN_CAM_Set_TrnSig_Stm);
  arr_get_setting[15] = getSignal(BLTN_CAM_AudRec_Set);
  arr_get_setting[16] = getSignal(BLTN_CAM_Set_FR_Ver_Pos);
  arr_get_setting[17] = getSignal(BLTN_CAM_Set_RR_Ver_Pos);
  arr_get_setting[18] = getSignal(BLTN_CAM_SenSet_DEV);
  arr_get_setting[19] = getSignal(BLTN_CAM_SenSet_PEV);
  arr_get_setting[20] = getSignal(BLTN_CAM_Set_PEV_AppNoti);
}

void Random_Settings(){
  for(i = 0; i <= 20; i++){
   if ((i <= 3) || (i >= 9 && i <= 15) || (i == 20)){
     index = random(2);
     arr_random_setting[i] = arr_RecSet[index];
   }
   else if (i == 4){
     arr_random_setting[4] = set_120h_value;
   }
   else if (i == 5){
     index = random(19);
     arr_random_setting[5] = arr_OWPTime[index];
   }
   else if (i == 6){
     index = random(3);
     arr_random_setting[6] = arr_TMLinterval[index];
   }
   else if (i == 7 || i == 8){
     index = random(3);
     arr_random_setting[i] = arr_EVtime[index];
   }
   else if (i == 16 || i == 17){
     index = random(10);
     arr_random_setting[i] = arr_CAMAngle[index];
   }
   else{
     index = random(5);
     arr_random_setting[i] = arr_EVSen[index];
   }
  }
}

void Set_Profile_Guest(){
  int same;
  int loop = 0;
  
  setSignal(IAU_ProfileIDRVal,0x1); //Profile Guest
  testWaitForTimeout(5000);
  
  Random_Settings();
  write("=== RANDOM SETTING ===");
  for (i = 0; i <= 20; i++){
   write("arr_random_setting[%d] = 0x%X", i, arr_random_setting[i]);
  }

  do {
    Enter_BLTN_CAM();
    testWaitForTimeout(4000);
    
    BLTN_CAM_Settings();
    
    Exit_BLTN_CAM();
    testWaitForTimeout(3000);
    Get_setting();
    
    same = 1;
    for (i = 0; i <= 20; i++) {
      if (arr_random_setting[i] != arr_get_setting[i]) {
        same = 0;
        switch(i){
          case(0): write("Mismatch >> OWD: random = 0x%X, get = 0x%X", arr_random_setting[i], arr_get_setting[i]); break;
          case(1): write("Mismatch >> OWP: random = 0x%X, get = 0x%X", arr_random_setting[i], arr_get_setting[i]); break;
          case(2): write("Mismatch >> DEV: random = 0x%X, get = 0x%X", arr_random_setting[i], arr_get_setting[i]); break;
          case(3): write("Mismatch >> PEV: random = 0x%X, get = 0x%X", arr_random_setting[i], arr_get_setting[i]); break;
          case(4): write("Mismatch >> 120h: random = 0x%X, get = 0x%X", arr_random_setting[i], arr_get_setting[i]); break;
          case(5): write("Mismatch >> Parking Time: random = 0x%X, get = 0x%X", arr_random_setting[i], arr_get_setting[i]); break;
          case(6): write("Mismatch >> TML Interval: random = 0x%X, get = 0x%X", arr_random_setting[i], arr_get_setting[i]); break;
          case(7): write("Mismatch >> Bfr Time: random = 0x%X, get = 0x%X", arr_random_setting[i], arr_get_setting[i]); break;
          case(8): write("Mismatch >> Aft Time: random = 0x%X, get = 0x%X", arr_random_setting[i], arr_get_setting[i]); break;
          case(9): write("Mismatch >> EV Sen Stamp: random = 0x%X, get = 0x%X", arr_random_setting[i], arr_get_setting[i]); break;
          case(10): write("Mismatch >> Gear Stamp: random = 0x%X, get = 0x%X", arr_random_setting[i], arr_get_setting[i]); break;
          case(11): write("Mismatch >> Location Stamp: random = 0x%X, get = 0x%X", arr_random_setting[i], arr_get_setting[i]); break;
          case(12): write("Mismatch >> Velocity Stamp: random = 0x%X, get = 0x%X", arr_random_setting[i], arr_get_setting[i]); break;
          case(13): write("Mismatch >> Time Stamp: random = 0x%X, get = 0x%X", arr_random_setting[i], arr_get_setting[i]); break;
          case(14): write("Mismatch >> Turn Signal Stamp: random = 0x%X, get = 0x%X", arr_random_setting[i], arr_get_setting[i]); break;
          case(15): write("Mismatch >> Audio: random = 0x%X, get = 0x%X", arr_random_setting[i], arr_get_setting[i]); break;
          case(16): write("Mismatch >> FCAM Angle: random = 0x%X, get = 0x%X", arr_random_setting[i], arr_get_setting[i]); break;
          case(17): write("Mismatch >> RCAM Angle: random = 0x%X, get = 0x%X", arr_random_setting[i], arr_get_setting[i]); break;
          case(18): write("Mismatch >> DEV Sen Level: random = 0x%X, get = 0x%X", arr_random_setting[i], arr_get_setting[i]); break;
          case(19): write("Mismatch >> PEV Sen Level: random = 0x%X, get = 0x%X", arr_random_setting[i], arr_get_setting[i]); break;
          case(20): write("Mismatch >> App Notification: random = 0x%X, get = 0x%X", arr_random_setting[i], arr_get_setting[i]); break;
        }
        break;
      }
    }
    loop++;
    
    if (loop == 2){
      switch(i){
        case(0): @panel::LED_Ctrl_SetOWP = 1; break;
        case(1): @panel::LED_Ctrl_SetOWD = 1; break;
        case(2): @panel::LED_Ctrl_SetPEV = 1; break;
        case(3): @panel::LED_Ctrl_SetDEV = 1; break;
        case(5): @panel::TrackBar_Timelaps_TIME = arr_random_setting[6]; break; 
        case(6): @panel::TrackBar_OWP_TIME = arr_random_setting[5]; break;
        case(7): @panel::TrackBar_EV_Time_Aft = arr_random_setting[8] + 10; break;
        case(8): if (arr_random_setting[7] == 0x0){@panel::TrackBar_EV_Time_Bfr = 1;}
                 else if (arr_random_setting[7] == 0x5){@panel::TrackBar_EV_Time_Bfr = 2;}
                 else {@panel::TrackBar_EV_Time_Bfr = 3;} break;
        case(9): @panel::LED_Ctrl_AudRec_Set = 1; break;  
        case(10): @panel::LED_Ctrl_Set_Locatn_Stm = 1; break;
        case(11): @panel::LED_Ctrl_Set_GearPos_Stm = 1; break;
        case(12): @panel::LED_Ctrl_Set_Tim_Stm = 1; break;           
        case(13): @panel::LED_Ctrl_Set_Spd_Stm = 1; break; 
        case(14): @panel::LED_Ctrl_Set_TrnSig_Stm = 1; break; 
        case(15): @panel::LED_Ctrl_Set_EVSen_Stm = 1; break; 
        case(16): @panel::TrackBar_RR_Ver_Pos = arr_random_setting[17]; break; 
        case(17): @panel::TrackBar_FR_Ver_Pos = arr_random_setting[16]; break;         
        case(18): @panel::TrackBar_PEV_Sen = arr_random_setting[19]; break; 
        case(19): @panel::TrackBar_DEV_Sen = arr_random_setting[19]; break; 
        case(20): @panel::Button_AppNoti_PEV = 1; break;          
      }
    } 
  } while (!same);
  
  loop = 0;
  
  write("=== PROFILE GUEST ===");  
  
  for (i = 0; i <= 20; i++){
   arr_Profile_Guest_setting[i] = arr_get_setting[i];
   write("Profile_Guest_setting[%d] = 0x%X", i, arr_Profile_Guest_setting[i]);
  }
  
  testReportAddWindowCapture("Profile Settings","","Profile Guest","./profile_setting.jpg");
  
}
void Set_Profile_Driver1() {  
  int same;
  int loop = 0;
  
  setSignal(IAU_ProfileIDRVal, 0x2); // Profile Driver 1 
  testWaitForTimeout(5000);
  
  Random_Settings();
  write("=== RANDOM SETTING ===");
  for (i = 0; i <= 20; i++){
   write("arr_random_setting[%d] = 0x%X", i, arr_random_setting[i]);
  }

  do {
    Enter_BLTN_CAM();
    testWaitForTimeout(4000);
    
    BLTN_CAM_Settings();

    Exit_BLTN_CAM();
    testWaitForTimeout(3000);
    Get_setting();
    
    same = 1;
    for (i = 0; i <= 20; i++) {
      if (arr_random_setting[i] != arr_get_setting[i]) {
        same = 0;
        switch(i){
          case(0): write("Mismatch >> OWD: random = 0x%X, get = 0x%X", arr_random_setting[i], arr_get_setting[i]); break;
          case(1): write("Mismatch >> OWP: random = 0x%X, get = 0x%X", arr_random_setting[i], arr_get_setting[i]); break;
          case(2): write("Mismatch >> DEV: random = 0x%X, get = 0x%X", arr_random_setting[i], arr_get_setting[i]); break;
          case(3): write("Mismatch >> PEV: random = 0x%X, get = 0x%X", arr_random_setting[i], arr_get_setting[i]); break;
          case(4): write("Mismatch >> 120h: random = 0x%X, get = 0x%X", arr_random_setting[i], arr_get_setting[i]); break;
          case(5): write("Mismatch >> Parking Time: random = 0x%X, get = 0x%X", arr_random_setting[i], arr_get_setting[i]); break;
          case(6): write("Mismatch >> TML Interval: random = 0x%X, get = 0x%X", arr_random_setting[i], arr_get_setting[i]); break;
          case(7): write("Mismatch >> Bfr Time: random = 0x%X, get = 0x%X", arr_random_setting[i], arr_get_setting[i]); break;
          case(8): write("Mismatch >> Aft Time: random = 0x%X, get = 0x%X", arr_random_setting[i], arr_get_setting[i]); break;
          case(9): write("Mismatch >> EV Sen Stamp: random = 0x%X, get = 0x%X", arr_random_setting[i], arr_get_setting[i]); break;
          case(10): write("Mismatch >> Gear Stamp: random = 0x%X, get = 0x%X", arr_random_setting[i], arr_get_setting[i]); break;
          case(11): write("Mismatch >> Location Stamp: random = 0x%X, get = 0x%X", arr_random_setting[i], arr_get_setting[i]); break;
          case(12): write("Mismatch >> Velocity Stamp: random = 0x%X, get = 0x%X", arr_random_setting[i], arr_get_setting[i]); break;
          case(13): write("Mismatch >> Time Stamp: random = 0x%X, get = 0x%X", arr_random_setting[i], arr_get_setting[i]); break;
          case(14): write("Mismatch >> Turn Signal Stamp: random = 0x%X, get = 0x%X", arr_random_setting[i], arr_get_setting[i]); break;
          case(15): write("Mismatch >> Audio: random = 0x%X, get = 0x%X", arr_random_setting[i], arr_get_setting[i]); break;
          case(16): write("Mismatch >> FCAM Angle: random = 0x%X, get = 0x%X", arr_random_setting[i], arr_get_setting[i]); break;
          case(17): write("Mismatch >> RCAM Angle: random = 0x%X, get = 0x%X", arr_random_setting[i], arr_get_setting[i]); break;
          case(18): write("Mismatch >> DEV Sen Level: random = 0x%X, get = 0x%X", arr_random_setting[i], arr_get_setting[i]); break;
          case(19): write("Mismatch >> PEV Sen Level: random = 0x%X, get = 0x%X", arr_random_setting[i], arr_get_setting[i]); break;
          case(20): write("Mismatch >> App Notification: random = 0x%X, get = 0x%X", arr_random_setting[i], arr_get_setting[i]); break;
        }
        break;
      }
    }
    loop++;
    
    if (loop == 2){
      switch(i){
        case(0): @panel::LED_Ctrl_SetOWP = 1; break;
        case(1): @panel::LED_Ctrl_SetOWD = 1; break;
        case(2): @panel::LED_Ctrl_SetPEV = 1; break;
        case(3): @panel::LED_Ctrl_SetDEV = 1; break;
        case(5): @panel::TrackBar_Timelaps_TIME = arr_random_setting[6]; break; 
        case(6): @panel::TrackBar_OWP_TIME = arr_random_setting[5]; break;
        case(7): @panel::TrackBar_EV_Time_Aft = arr_random_setting[8] + 10; break;
        case(8): if (arr_random_setting[7] == 0x0){@panel::TrackBar_EV_Time_Bfr = 1;}
                 else if (arr_random_setting[7] == 0x5){@panel::TrackBar_EV_Time_Bfr = 2;}
                 else {@panel::TrackBar_EV_Time_Bfr = 3;} break;
        case(9): @panel::LED_Ctrl_AudRec_Set = 1; break;  
        case(10): @panel::LED_Ctrl_Set_Locatn_Stm = 1; break;
        case(11): @panel::LED_Ctrl_Set_GearPos_Stm = 1; break;
        case(12): @panel::LED_Ctrl_Set_Tim_Stm = 1; break;           
        case(13): @panel::LED_Ctrl_Set_Spd_Stm = 1; break; 
        case(14): @panel::LED_Ctrl_Set_TrnSig_Stm = 1; break; 
        case(15): @panel::LED_Ctrl_Set_EVSen_Stm = 1; break; 
        case(16): @panel::TrackBar_RR_Ver_Pos = arr_random_setting[17]; break; 
        case(17): @panel::TrackBar_FR_Ver_Pos = arr_random_setting[16]; break;         
        case(18): @panel::TrackBar_PEV_Sen = arr_random_setting[19]; break; 
        case(19): @panel::TrackBar_DEV_Sen = arr_random_setting[19]; break; 
        case(20): @panel::Button_AppNoti_PEV = 1; break;      
      }
    }
  } while (!same);
  
  loop = 0;
  
  write("=== PROFILE DRIVER 1 ===");  
  
  for (i = 0; i <= 20; i++){
   arr_Profile_Driver1_setting[i] = arr_get_setting[i];
   write("Profile_Driver1_setting[%d] = 0x%X", i, arr_Profile_Driver1_setting[i]);
  }

  testReportAddWindowCapture("Profile Settings","","Profile Driver 1","./profile_setting.jpg");  
}

void Set_Profile_Driver2() {
  int same;
  int loop = 0;  
 
  setSignal(IAU_ProfileIDRVal, 0x3); // Profile Driver 2  
  testWaitForTimeout(5000);
  
  Random_Settings();
  write("=== RANDOM SETTING ===");
  for (i = 0; i <= 20; i++){
   write("arr_random_setting[%d] = 0x%X", i, arr_random_setting[i]);
  }

  do {
    Enter_BLTN_CAM();
    testWaitForTimeout(4000);
    
    BLTN_CAM_Settings();

    Exit_BLTN_CAM();
    testWaitForTimeout(3000);
    Get_setting();
    
    same = 1;
    for (i = 0; i <= 20; i++) {
      if (arr_random_setting[i] != arr_get_setting[i]) {
        same = 0;
        switch(i){
          case(0): write("Mismatch >> OWD: random = 0x%X, get = 0x%X", arr_random_setting[i], arr_get_setting[i]); break;
          case(1): write("Mismatch >> OWP: random = 0x%X, get = 0x%X", arr_random_setting[i], arr_get_setting[i]); break;
          case(2): write("Mismatch >> DEV: random = 0x%X, get = 0x%X", arr_random_setting[i], arr_get_setting[i]); break;
          case(3): write("Mismatch >> PEV: random = 0x%X, get = 0x%X", arr_random_setting[i], arr_get_setting[i]); break;
          case(4): write("Mismatch >> 120h: random = 0x%X, get = 0x%X", arr_random_setting[i], arr_get_setting[i]); break;
          case(5): write("Mismatch >> Parking Time: random = 0x%X, get = 0x%X", arr_random_setting[i], arr_get_setting[i]); break;
          case(6): write("Mismatch >> TML Interval: random = 0x%X, get = 0x%X", arr_random_setting[i], arr_get_setting[i]); break;
          case(7): write("Mismatch >> Bfr Time: random = 0x%X, get = 0x%X", arr_random_setting[i], arr_get_setting[i]); break;
          case(8): write("Mismatch >> Aft Time: random = 0x%X, get = 0x%X", arr_random_setting[i], arr_get_setting[i]); break;
          case(9): write("Mismatch >> EV Sen Stamp: random = 0x%X, get = 0x%X", arr_random_setting[i], arr_get_setting[i]); break;
          case(10): write("Mismatch >> Gear Stamp: random = 0x%X, get = 0x%X", arr_random_setting[i], arr_get_setting[i]); break;
          case(11): write("Mismatch >> Location Stamp: random = 0x%X, get = 0x%X", arr_random_setting[i], arr_get_setting[i]); break;
          case(12): write("Mismatch >> Velocity Stamp: random = 0x%X, get = 0x%X", arr_random_setting[i], arr_get_setting[i]); break;
          case(13): write("Mismatch >> Time Stamp: random = 0x%X, get = 0x%X", arr_random_setting[i], arr_get_setting[i]); break;
          case(14): write("Mismatch >> Turn Signal Stamp: random = 0x%X, get = 0x%X", arr_random_setting[i], arr_get_setting[i]); break;
          case(15): write("Mismatch >> Audio: random = 0x%X, get = 0x%X", arr_random_setting[i], arr_get_setting[i]); break;
          case(16): write("Mismatch >> FCAM Angle: random = 0x%X, get = 0x%X", arr_random_setting[i], arr_get_setting[i]); break;
          case(17): write("Mismatch >> RCAM Angle: random = 0x%X, get = 0x%X", arr_random_setting[i], arr_get_setting[i]); break;
          case(18): write("Mismatch >> DEV Sen Level: random = 0x%X, get = 0x%X", arr_random_setting[i], arr_get_setting[i]); break;
          case(19): write("Mismatch >> PEV Sen Level: random = 0x%X, get = 0x%X", arr_random_setting[i], arr_get_setting[i]); break;
          case(20): write("Mismatch >> App Notification: random = 0x%X, get = 0x%X", arr_random_setting[i], arr_get_setting[i]); break;
        }
        break;
      }
    }
    loop++;
    
    if (loop == 2){
      switch(i){
        case(0): @panel::LED_Ctrl_SetOWP = 1; break;
        case(1): @panel::LED_Ctrl_SetOWD = 1; break;
        case(2): @panel::LED_Ctrl_SetPEV = 1; break;
        case(3): @panel::LED_Ctrl_SetDEV = 1; break;
        case(5): @panel::TrackBar_Timelaps_TIME = arr_random_setting[6]; break; 
        case(6): @panel::TrackBar_OWP_TIME = arr_random_setting[5]; break;
        case(7): @panel::TrackBar_EV_Time_Aft = arr_random_setting[8] + 10; break;
        case(8): if (arr_random_setting[7] == 0x0){@panel::TrackBar_EV_Time_Bfr = 1;}
                 else if (arr_random_setting[7] == 0x5){@panel::TrackBar_EV_Time_Bfr = 2;}
                 else {@panel::TrackBar_EV_Time_Bfr = 3;} break;
        case(9): @panel::LED_Ctrl_AudRec_Set = 1; break;  
        case(10): @panel::LED_Ctrl_Set_Locatn_Stm = 1; break;
        case(11): @panel::LED_Ctrl_Set_GearPos_Stm = 1; break;
        case(12): @panel::LED_Ctrl_Set_Tim_Stm = 1; break;           
        case(13): @panel::LED_Ctrl_Set_Spd_Stm = 1; break; 
        case(14): @panel::LED_Ctrl_Set_TrnSig_Stm = 1; break; 
        case(15): @panel::LED_Ctrl_Set_EVSen_Stm = 1; break; 
        case(16): @panel::TrackBar_RR_Ver_Pos = arr_random_setting[17]; break; 
        case(17): @panel::TrackBar_FR_Ver_Pos = arr_random_setting[16]; break;         
        case(18): @panel::TrackBar_PEV_Sen = arr_random_setting[19]; break; 
        case(19): @panel::TrackBar_DEV_Sen = arr_random_setting[19]; break; 
        case(20): @panel::Button_AppNoti_PEV = 1; break;      
      }
    } 
  } while (!same);
  
  loop = 0;
  
  write("=== PROFILE DRIVER 2 ===");  
  
  for (i = 0; i <= 20; i++){
   arr_Profile_Driver2_setting[i] = arr_get_setting[i];
   write("Profile_Driver2_setting[%d] = 0x%X", i, arr_Profile_Driver2_setting[i]);
  }
  
  testReportAddWindowCapture("Profile Settings","","Profile Driver 2","./profile_setting.jpg");  
}

void Init(){
  @panel::Switch_CGWNM = 1;
  
  @panel::Switch_Clock = 1;
  
  write("KEY_ON()"); KEY_ON();

  testWaitForTimeout(3000);
  
  send_ICU_ModState_timer.set(200);

  while (getSignal(BLTN_CAM_SD_Format_Op_State) != 0x1){
    @panel::Button_RecReset = 1; 
    testWaitForSignalChange(BLTN_CAM_SD_Format_Op_State,500);
  }
  
  write("KEY_OFF"); KEY_OFF();
  
  @panel::Switch_CGWNM = 0;
  
  @panel::Switch_Clock = 0; 
}

testcase HU_026_1() {
  testStep("Notification","Start test HU_026_1");
  write("=== START HU_026_1 ===");
  
  @panel::Switch_CGWNM = 1;
  
  @panel::Switch_Clock = 1;  
  
  write("KEY_ON"); KEY_ON();
  testWaitForTimeout(3000);

  write("=== RESET PROFILES ===");
  
  write("Set Factory Mode"); setSignal(ICU_PowerAutoCutModSta, 0x0); // Factory Mode
  testWaitForTimeout(1000);
  
  write("Reset Guest");
  setSignal(IAU_ProfileIDRVal, 0x1); // Profile Guest
  testWaitForTimeout(5000);  
  @panel::Button_clu_USMReset = 1; // Clu_USMReset
  testWaitForTimeout(5000);
  
  write("Reset Profile 1");
  setSignal(IAU_ProfileIDRVal, 0x2); // Profile Driver 1
  testWaitForTimeout(5000);  
  @panel::Button_clu_USMReset = 1; // Clu_USMReset
  testWaitForTimeout(5000);  
  
  write("Reset Profile 2");
  setSignal(IAU_ProfileIDRVal, 0x3); // Profile Driver 2
  testWaitForTimeout(5000);  
  @panel::Button_clu_USMReset = 1; // Clu_USMReset
  testWaitForTimeout(5000);    
  
  write("=== FRS OPERATION ===");
  
  write("Set Customer Mode"); setSignal(ICU_PowerAutoCutModSta, 0x2); //Customer Mode
  testWaitForTimeout(1000);
  write("Set Profile Guest"); setSignal(IAU_ProfileIDRVal, 0x1); // Profile Guest
  testWaitForTimeout(5000);
  write("Send NvalueSet Value");
  
  _HU_BLTN_CAM_E_00.BLTN_CAM_Rec_OWD_NvalueSet = 0x2; // ON
  _HU_BLTN_CAM_E_00.BLTN_CAM_Rec_OWP_NvalueSet = 0x2; // ON
  _HU_BLTN_CAM_E_00.BLTN_CAM_Rec_DEV_NvalueSet = 0x2; // ON
  _HU_BLTN_CAM_E_00.BLTN_CAM_Rec_PEV_NvalueSet = 0x2; // ON
  
  write("Run Set_Profile_Guest()"); Set_Profile_Guest();
  
  write("=== CHANGE PROFILE ===");
  
  write("Change to Profile Driver 1");
  setSignal(IAU_ProfileIDRVal, 0x2); // Profile Driver 1
  testWaitForTimeout(5000);
  
  write("Run Get_setting()"); Get_setting(); 
  
  for( i = 0; i <= 20; i++){
    if(arr_Profile_Guest_setting[i] == arr_get_setting[i]){
      flag++;
    }
    else{
      write("Fail: Test-case is NG");
      switch(i){
          case(0): write("Mismatch >> OWD: guest = 0x%X, get = 0x%X", arr_Profile_Guest_setting[i], arr_get_setting[i]); break;
          case(1): write("Mismatch >> OWP: guest = 0x%X, get = 0x%X", arr_Profile_Guest_setting[i], arr_get_setting[i]); break;
          case(2): write("Mismatch >> DEV: guest = 0x%X, get = 0x%X", arr_Profile_Guest_setting[i], arr_get_setting[i]); break;
          case(3): write("Mismatch >> PEV: guest = 0x%X, get = 0x%X", arr_Profile_Guest_setting[i], arr_get_setting[i]); break;
          case(4): write("Mismatch >> 120h: guest = 0x%X, get = 0x%X", arr_Profile_Guest_setting[i], arr_get_setting[i]); break;
          case(5): write("Mismatch >> Parking Time: guest = 0x%X, get = 0x%X", arr_Profile_Guest_setting[i], arr_get_setting[i]); break;
          case(6): write("Mismatch >> TML Interval: guest = 0x%X, get = 0x%X", arr_Profile_Guest_setting[i], arr_get_setting[i]); break;
          case(7): write("Mismatch >> Bfr Time: guest = 0x%X, get = 0x%X", arr_Profile_Guest_setting[i], arr_get_setting[i]); break;
          case(8): write("Mismatch >> Aft Time: guest = 0x%X, get = 0x%X", arr_Profile_Guest_setting[i], arr_get_setting[i]); break;
          case(9): write("Mismatch >> EV Sen Stamp: guest = 0x%X, get = 0x%X", arr_Profile_Guest_setting[i], arr_get_setting[i]); break;
          case(10): write("Mismatch >> Gear Stamp: guest = 0x%X, get = 0x%X", arr_Profile_Guest_setting[i], arr_get_setting[i]); break;
          case(11): write("Mismatch >> Location Stamp: guest = 0x%X, get = 0x%X", arr_Profile_Guest_setting[i], arr_get_setting[i]); break;
          case(12): write("Mismatch >> Velocity Stamp: guest = 0x%X, get = 0x%X", arr_Profile_Guest_setting[i], arr_get_setting[i]); break;
          case(13): write("Mismatch >> Time Stamp: guest = 0x%X, get = 0x%X", arr_Profile_Guest_setting[i], arr_get_setting[i]); break;
          case(16): write("Mismatch >> FCAM Angle: guest = 0x%X, get = 0x%X", arr_Profile_Guest_setting[i], arr_get_setting[i]); break;
          case(17): write("Mismatch >> RCAM Angle: guest = 0x%X, get = 0x%X", arr_Profile_Guest_setting[i], arr_get_setting[i]); break;
          case(18): write("Mismatch >> DEV Sen Level: guest = 0x%X, get = 0x%X", arr_Profile_Guest_setting[i], arr_get_setting[i]); break;
          case(19): write("Mismatch >> PEV Sen Level: guest = 0x%X, get = 0x%X", arr_Profile_Guest_setting[i], arr_get_setting[i]); break;
          case(20): write("Mismatch >> App Notification: guest = 0x%X, get = 0x%X", arr_Profile_Guest_setting[i], arr_get_setting[i]); break;
      }
    }
  }
  if (flag == 21) {
    write("Profile 1 is copied from Guest Profile");
    condition1 = 1;
  }
  else {
    testStepFail("Fail", "Test-case is NG");
  }
  flag = 0;
  
  CaptureGraphics(); write("Run Capture Graphics()");
  testReportAddWindowCapture("Profile Settings","","Profile Driver 1","./profile_setting.jpg");  
  
  write("Change to Profile Driver 2");
  setSignal(IAU_ProfileIDRVal, 0x3); // Profile Driver 2
  testWaitForTimeout(5000);
  
  write("Run Get_setting()"); Get_setting();

  for( i = 0; i <= 20; i++){
    if(arr_Profile_Guest_setting[i] == arr_get_setting[i]){
      flag++;
    }
    else{
      write("Fail: Test-case is NG");
      switch(i){
          case(0): write("Mismatch >> OWD: guest = 0x%X, get = 0x%X", arr_Profile_Guest_setting[i], arr_get_setting[i]); break;
          case(1): write("Mismatch >> OWP: guest = 0x%X, get = 0x%X", arr_Profile_Guest_setting[i], arr_get_setting[i]); break;
          case(2): write("Mismatch >> DEV: guest = 0x%X, get = 0x%X", arr_Profile_Guest_setting[i], arr_get_setting[i]); break;
          case(3): write("Mismatch >> PEV: guest = 0x%X, get = 0x%X", arr_Profile_Guest_setting[i], arr_get_setting[i]); break;
          case(4): write("Mismatch >> 120h: guest = 0x%X, get = 0x%X", arr_Profile_Guest_setting[i], arr_get_setting[i]); break;
          case(5): write("Mismatch >> Parking Time: guest = 0x%X, get = 0x%X", arr_Profile_Guest_setting[i], arr_get_setting[i]); break;
          case(6): write("Mismatch >> TML Interval: guest = 0x%X, get = 0x%X", arr_Profile_Guest_setting[i], arr_get_setting[i]); break;
          case(7): write("Mismatch >> Bfr Time: guest = 0x%X, get = 0x%X", arr_Profile_Guest_setting[i], arr_get_setting[i]); break;
          case(8): write("Mismatch >> Aft Time: guest = 0x%X, get = 0x%X", arr_Profile_Guest_setting[i], arr_get_setting[i]); break;
          case(9): write("Mismatch >> EV Sen Stamp: guest = 0x%X, get = 0x%X", arr_Profile_Guest_setting[i], arr_get_setting[i]); break;
          case(10): write("Mismatch >> Gear Stamp: guest = 0x%X, get = 0x%X", arr_Profile_Guest_setting[i], arr_get_setting[i]); break;
          case(11): write("Mismatch >> Location Stamp: guest = 0x%X, get = 0x%X", arr_Profile_Guest_setting[i], arr_get_setting[i]); break;
          case(12): write("Mismatch >> Velocity Stamp: guest = 0x%X, get = 0x%X", arr_Profile_Guest_setting[i], arr_get_setting[i]); break;
          case(13): write("Mismatch >> Time Stamp: guest = 0x%X, get = 0x%X", arr_Profile_Guest_setting[i], arr_get_setting[i]); break;
          case(16): write("Mismatch >> FCAM Angle: guest = 0x%X, get = 0x%X", arr_Profile_Guest_setting[i], arr_get_setting[i]); break;
          case(17): write("Mismatch >> RCAM Angle: guest = 0x%X, get = 0x%X", arr_Profile_Guest_setting[i], arr_get_setting[i]); break;
          case(18): write("Mismatch >> DEV Sen Level: guest = 0x%X, get = 0x%X", arr_Profile_Guest_setting[i], arr_get_setting[i]); break;
          case(19): write("Mismatch >> PEV Sen Level: guest = 0x%X, get = 0x%X", arr_Profile_Guest_setting[i], arr_get_setting[i]); break;
          case(20): write("Mismatch >> App Notification: guest = 0x%X, get = 0x%X", arr_Profile_Guest_setting[i], arr_get_setting[i]); break;
      }
    }
  }
  if (flag == 21) {
    write("Profile 2 is copied from Guest Profile");
    condition2 = 1;
  }
  else {
    testStepFail("Fail", "Test-case is NG");
  }
  flag = 0;
  
  CaptureGraphics(); write("Run Capture Graphics()");
  testReportAddWindowCapture("Profile Settings","","Profile Driver 2","./profile_setting.jpg");    
  
  if (condition1 == 1 && condition2 == 1) {
    testStepPass("Pass","All conditions have met. Test-case is OK");
    write("Test-case is OK");
  }
  else {
    int arr[3];
    
    arr[0] = condition1;
    arr[1] = condition2;
    
    testStepFail("Fail","Condition hasn't met. Test-case is NG");
    
    for (i = 0; i < 2; i++){
      
      if (arr[i] != 1){
        
        write("Condition %d is not met", i+1);
        
      }   
    }
  }  
  
  write("KEY_OFF"); KEY_OFF();
  
  @panel::Switch_Clock = 0;
  @panel::Switch_CGWNM = 0; 
  
  write("=== FINISH HU_026_1 ===");  
}

testcase HU_026_2() {
  testStep("Notification","Start test HU_026_2");
  write("=== START HU_026_2 ===");
  
  @panel::Switch_CGWNM = 1;
  
  @panel::Switch_Clock = 1;  
  
  write("KEY_ON"); KEY_ON();
  testWaitForTimeout(3000);
  
  write("=== RANDOM PROFILE 1 & PROFILE 2");
  
  write("Run Set_Profile_Driver1()"); Set_Profile_Driver1();
  
  write("Run Set_Profile_Driver2()"); Set_Profile_Driver2();
  
  write("=== CHANGE SETTINGS PROFILE GUEST ===");
  
  write("Run Set_Profile_Guest()"); Set_Profile_Guest();
  
  write("=== CHANGE PROFILE ===");
  
  write("Change to Profile Driver 1");
  setSignal(IAU_ProfileIDRVal, 0x2); // Profile Driver 1
  testWaitForTimeout(5000);
  
  write("Run Get_setting()"); Get_setting(); 
  
  for( i = 0; i <= 20; i++){
    if(arr_Profile_Driver1_setting[i] == arr_get_setting[i]){
      flag++;
    }
    else{
      write("Fail: Test-case is NG");
      switch(i){
          case(0): write("Mismatch >> OWD: driver1 = 0x%X, get = 0x%X", arr_Profile_Driver1_setting[i], arr_get_setting[i]); break;
          case(1): write("Mismatch >> OWP: driver1 = 0x%X, get = 0x%X", arr_Profile_Driver1_setting[i], arr_get_setting[i]); break;
          case(2): write("Mismatch >> DEV: driver1 = 0x%X, get = 0x%X", arr_Profile_Driver1_setting[i], arr_get_setting[i]); break;
          case(3): write("Mismatch >> PEV: driver1 = 0x%X, get = 0x%X", arr_Profile_Driver1_setting[i], arr_get_setting[i]); break;
          case(4): write("Mismatch >> 120h: driver1 = 0x%X, get = 0x%X", arr_Profile_Driver1_setting[i], arr_get_setting[i]); break;
          case(5): write("Mismatch >> Parking Time: driver1 = 0x%X, get = 0x%X", arr_Profile_Driver1_setting[i], arr_get_setting[i]); break;
          case(6): write("Mismatch >> TML Interval: driver1 = 0x%X, get = 0x%X", arr_Profile_Driver1_setting[i], arr_get_setting[i]); break;
          case(7): write("Mismatch >> Bfr Time: driver1 = 0x%X, get = 0x%X", arr_Profile_Driver1_setting[i], arr_get_setting[i]); break;
          case(8): write("Mismatch >> Aft Time: driver1 = 0x%X, get = 0x%X", arr_Profile_Driver1_setting[i], arr_get_setting[i]); break;
          case(9): write("Mismatch >> EV Sen Stamp: driver1 = 0x%X, get = 0x%X", arr_Profile_Driver1_setting[i], arr_get_setting[i]); break;
          case(10): write("Mismatch >> Gear Stamp: driver1 = 0x%X, get = 0x%X", arr_Profile_Driver1_setting[i], arr_get_setting[i]); break;
          case(11): write("Mismatch >> Location Stamp: driver1 = 0x%X, get = 0x%X", arr_Profile_Driver1_setting[i], arr_get_setting[i]); break;
          case(12): write("Mismatch >> Velocity Stamp: driver1 = 0x%X, get = 0x%X", arr_Profile_Driver1_setting[i], arr_get_setting[i]); break;
          case(13): write("Mismatch >> Time Stamp: driver1 = 0x%X, get = 0x%X", arr_Profile_Driver1_setting[i], arr_get_setting[i]); break;
          case(16): write("Mismatch >> FCAM Angle: driver1 = 0x%X, get = 0x%X", arr_Profile_Driver1_setting[i], arr_get_setting[i]); break;
          case(17): write("Mismatch >> RCAM Angle: driver1 = 0x%X, get = 0x%X", arr_Profile_Driver1_setting[i], arr_get_setting[i]); break;
          case(18): write("Mismatch >> DEV Sen Level: driver1 = 0x%X, get = 0x%X", arr_Profile_Driver1_setting[i], arr_get_setting[i]); break;
          case(19): write("Mismatch >> PEV Sen Level: driver1 = 0x%X, get = 0x%X", arr_Profile_Driver1_setting[i], arr_get_setting[i]); break;
          case(20): write("Mismatch >> App Notification: driver1 = 0x%X, get = 0x%X", arr_Profile_Driver1_setting[i], arr_get_setting[i]); break;
      }
    }
  }
  if (flag == 21) {
    write("Profile 1 is not copied from Guest Profile");
    condition1 = 1;
  }
  else {
    testStepFail("Fail", "Test-case is NG");
  }
  flag = 0;
  
  CaptureGraphics(); write("Run Capture Graphics()");
  testReportAddWindowCapture("Profile Settings","","Profile Driver 1","./profile_setting.jpg");  
  
  write("Change to Profile Driver 2");
  setSignal(IAU_ProfileIDRVal, 0x3); // Profile Driver 2
  testWaitForTimeout(5000);
  
  write("Run Get_setting()"); Get_setting();

  for( i = 0; i <= 20; i++){
    if(arr_Profile_Driver2_setting[i] == arr_get_setting[i]){
      flag++;
    }
    else{
      write("Fail: Test-case is NG");
      switch(i){
          case(0): write("Mismatch >> OWD: driver2 = 0x%X, get = 0x%X", arr_Profile_Driver2_setting[i], arr_get_setting[i]); break;
          case(1): write("Mismatch >> OWP: driver2 = 0x%X, get = 0x%X", arr_Profile_Driver2_setting[i], arr_get_setting[i]); break;
          case(2): write("Mismatch >> DEV: driver2 = 0x%X, get = 0x%X", arr_Profile_Driver2_setting[i], arr_get_setting[i]); break;
          case(3): write("Mismatch >> PEV: driver2 = 0x%X, get = 0x%X", arr_Profile_Driver2_setting[i], arr_get_setting[i]); break;
          case(4): write("Mismatch >> 120h: driver2 = 0x%X, get = 0x%X", arr_Profile_Driver2_setting[i], arr_get_setting[i]); break;
          case(5): write("Mismatch >> Parking Time: driver2 = 0x%X, get = 0x%X", arr_Profile_Driver2_setting[i], arr_get_setting[i]); break;
          case(6): write("Mismatch >> TML Interval: driver2 = 0x%X, get = 0x%X", arr_Profile_Driver2_setting[i], arr_get_setting[i]); break;
          case(7): write("Mismatch >> Bfr Time: driver2 = 0x%X, get = 0x%X", arr_Profile_Driver2_setting[i], arr_get_setting[i]); break;
          case(8): write("Mismatch >> Aft Time: driver2 = 0x%X, get = 0x%X", arr_Profile_Driver2_setting[i], arr_get_setting[i]); break;
          case(9): write("Mismatch >> EV Sen Stamp: driver2 = 0x%X, get = 0x%X", arr_Profile_Driver2_setting[i], arr_get_setting[i]); break;
          case(10): write("Mismatch >> Gear Stamp: driver2 = 0x%X, get = 0x%X", arr_Profile_Driver2_setting[i], arr_get_setting[i]); break;
          case(11): write("Mismatch >> Location Stamp: driver2 = 0x%X, get = 0x%X", arr_Profile_Driver2_setting[i], arr_get_setting[i]); break;
          case(12): write("Mismatch >> Velocity Stamp: driver2 = 0x%X, get = 0x%X", arr_Profile_Driver2_setting[i], arr_get_setting[i]); break;
          case(13): write("Mismatch >> Time Stamp: driver2 = 0x%X, get = 0x%X", arr_Profile_Driver2_setting[i], arr_get_setting[i]); break;
          case(16): write("Mismatch >> FCAM Angle: driver2 = 0x%X, get = 0x%X", arr_Profile_Driver2_setting[i], arr_get_setting[i]); break;
          case(17): write("Mismatch >> RCAM Angle: driver2 = 0x%X, get = 0x%X", arr_Profile_Driver2_setting[i], arr_get_setting[i]); break;
          case(18): write("Mismatch >> DEV Sen Level: driver2 = 0x%X, get = 0x%X", arr_Profile_Driver2_setting[i], arr_get_setting[i]); break;
          case(19): write("Mismatch >> PEV Sen Level: driver2 = 0x%X, get = 0x%X", arr_Profile_Driver2_setting[i], arr_get_setting[i]); break;
          case(20): write("Mismatch >> App Notification: driver2 = 0x%X, get = 0x%X", arr_Profile_Driver2_setting[i], arr_get_setting[i]); break;
      }
    }
  }
  if (flag == 21) {
    write("Profile 2 is not copied from Guest Profile");
    condition2 = 1;
  }
  else {
    testStepFail("Fail", "Test-case is NG");
  }
  flag = 0;
  
  CaptureGraphics(); write("Run Capture Graphics()");
  testReportAddWindowCapture("Profile Settings","","Profile Driver 2","./profile_setting.jpg");    
  
  if (condition1 == 1 && condition2 == 1) {
    testStepPass("Pass","All conditions have met. Test-case is OK");
    write("Test-case is OK");
  }
  else {
    int arr[3];
    
    arr[0] = condition1;
    arr[1] = condition2;
    
    testStepFail("Fail","Condition hasn't met. Test-case is NG");
    
    for (i = 0; i < 2; i++){
      
      if (arr[i] != 1){
        
        write("Condition %d is not met", i+1);
        
      }   
    }
  }  
  
  write("KEY_OFF"); KEY_OFF();
  
  @panel::Switch_Clock = 0;
  @panel::Switch_CGWNM = 0;  
  
  write("=== FINISH HU_026_2 ===");    
}

testcase HU_026_3() {
  testStep("Notification","Start test HU_026_3");
  write("=== START HU_026_3 ===");  
  
  @panel::Switch_CGWNM = 1;
  
  @panel::Switch_Clock = 1;  
  
  write("KEY_ON"); KEY_ON();
  testWaitForTimeout(3000);

  write("=== RESET PROFILES ===");
  
  write("Set Factory Mode"); setSignal(ICU_PowerAutoCutModSta, 0x0); // Factory Mode
  testWaitForTimeout(1000);
  
  write("Reset Guest");
  setSignal(IAU_ProfileIDRVal, 0x1); // Profile Guest
  testWaitForTimeout(5000);  
  @panel::Button_clu_USMReset = 1; // Clu_USMReset
  testWaitForTimeout(5000);
  
  write("Reset Profile 1");
  setSignal(IAU_ProfileIDRVal, 0x2); // Profile Driver 1
  testWaitForTimeout(5000);  
  @panel::Button_clu_USMReset = 1; // Clu_USMReset
  testWaitForTimeout(5000);  
  
  write("Reset Profile 2");
  setSignal(IAU_ProfileIDRVal, 0x3); // Profile Driver 2
  testWaitForTimeout(5000);  
  @panel::Button_clu_USMReset = 1; // Clu_USMReset
  testWaitForTimeout(5000);    
  
  write("=== FRS OPERATION ===");
  
  write("Set Customer Mode"); setSignal(ICU_PowerAutoCutModSta, 0x2); //Customer Mode
  testWaitForTimeout(1000);
  write("Set Profile Guest"); setSignal(IAU_ProfileIDRVal, 0x1); // Profile Guest
  testWaitForTimeout(5000);
  write("Send NvalueSet Value");
  
  _HU_BLTN_CAM_E_00.BLTN_CAM_Rec_OWD_NvalueSet = 0x2; // ON
  _HU_BLTN_CAM_E_00.BLTN_CAM_Rec_OWP_NvalueSet = 0x2; // ON
  _HU_BLTN_CAM_E_00.BLTN_CAM_Rec_DEV_NvalueSet = 0x2; // ON
  _HU_BLTN_CAM_E_00.BLTN_CAM_Rec_PEV_NvalueSet = 0x2; // ON
  
  Random_Settings();
  write("=== RANDOM SETTING ===");
  for (i = 0; i <= 20; i++){
   write("arr_random_setting[%d] = 0x%X", i, arr_random_setting[i]);
  }
  
  write("=== ENTER BLTN_CAM ==="); Enter_BLTN_CAM();
  testWaitForTimeout(4000);
    
  BLTN_CAM_Settings();
    
  write("=== EXIT BLTN_CAM ==="); Exit_BLTN_CAM();
  testWaitForTimeout(3000);
  
  testReportAddWindowCapture("Profile Settings","","Profile Guest","./profile_setting.jpg");  
  
  write("=== ENTER BLTN_CAM ==="); Enter_BLTN_CAM();
  
  write("=== CHANGE PROFILE ===");
  
  write("Change to Profile Driver 1");
  setSignal(IAU_ProfileIDRVal, 0x2); // Profile Driver 1
  testWaitForTimeout(5000);
  
  write("Run Get_setting()"); Get_setting(); 
  
  for( i = 0; i <= 20; i++){
    if(arr_Profile_Guest_setting[i] == arr_get_setting[i]){
      flag++;
    }
    else{
      write("Fail: Test-case is NG");
      switch(i){
          case(0): write("Mismatch >> OWD: guest = 0x%X, get = 0x%X", arr_Profile_Guest_setting[i], arr_get_setting[i]); break;
          case(1): write("Mismatch >> OWP: guest = 0x%X, get = 0x%X", arr_Profile_Guest_setting[i], arr_get_setting[i]); break;
          case(2): write("Mismatch >> DEV: guest = 0x%X, get = 0x%X", arr_Profile_Guest_setting[i], arr_get_setting[i]); break;
          case(3): write("Mismatch >> PEV: guest = 0x%X, get = 0x%X", arr_Profile_Guest_setting[i], arr_get_setting[i]); break;
          case(4): write("Mismatch >> 120h: guest = 0x%X, get = 0x%X", arr_Profile_Guest_setting[i], arr_get_setting[i]); break;
          case(5): write("Mismatch >> Parking Time: guest = 0x%X, get = 0x%X", arr_Profile_Guest_setting[i], arr_get_setting[i]); break;
          case(6): write("Mismatch >> TML Interval: guest = 0x%X, get = 0x%X", arr_Profile_Guest_setting[i], arr_get_setting[i]); break;
          case(7): write("Mismatch >> Bfr Time: guest = 0x%X, get = 0x%X", arr_Profile_Guest_setting[i], arr_get_setting[i]); break;
          case(8): write("Mismatch >> Aft Time: guest = 0x%X, get = 0x%X", arr_Profile_Guest_setting[i], arr_get_setting[i]); break;
          case(9): write("Mismatch >> EV Sen Stamp: guest = 0x%X, get = 0x%X", arr_Profile_Guest_setting[i], arr_get_setting[i]); break;
          case(10): write("Mismatch >> Gear Stamp: guest = 0x%X, get = 0x%X", arr_Profile_Guest_setting[i], arr_get_setting[i]); break;
          case(11): write("Mismatch >> Location Stamp: guest = 0x%X, get = 0x%X", arr_Profile_Guest_setting[i], arr_get_setting[i]); break;
          case(12): write("Mismatch >> Velocity Stamp: guest = 0x%X, get = 0x%X", arr_Profile_Guest_setting[i], arr_get_setting[i]); break;
          case(13): write("Mismatch >> Time Stamp: guest = 0x%X, get = 0x%X", arr_Profile_Guest_setting[i], arr_get_setting[i]); break;
          case(16): write("Mismatch >> FCAM Angle: guest = 0x%X, get = 0x%X", arr_Profile_Guest_setting[i], arr_get_setting[i]); break;
          case(17): write("Mismatch >> RCAM Angle: guest = 0x%X, get = 0x%X", arr_Profile_Guest_setting[i], arr_get_setting[i]); break;
          case(18): write("Mismatch >> DEV Sen Level: guest = 0x%X, get = 0x%X", arr_Profile_Guest_setting[i], arr_get_setting[i]); break;
          case(19): write("Mismatch >> PEV Sen Level: guest = 0x%X, get = 0x%X", arr_Profile_Guest_setting[i], arr_get_setting[i]); break;
          case(20): write("Mismatch >> App Notification: guest = 0x%X, get = 0x%X", arr_Profile_Guest_setting[i], arr_get_setting[i]); break;
      }
    }
  }
  if (flag == 21) {
    write("Profile 1 is copied from Guest Profile");
    condition1 = 1;
  }
  else {
    testStepFail("Fail", "Test-case is NG");
  }
  flag = 0;
  
  CaptureGraphics(); write("Run Capture Graphics()");
  testReportAddWindowCapture("Profile Settings","","Profile Driver 1","./profile_setting.jpg");  
  
  write("Change to Profile Driver 2");
  setSignal(IAU_ProfileIDRVal, 0x3); // Profile Driver 2
  testWaitForTimeout(5000);
  
  write("Run Get_setting()"); Get_setting();

  for( i = 0; i <= 20; i++){
    if(arr_Profile_Guest_setting[i] == arr_get_setting[i]){
      flag++;
    }
    else{
      write("Fail: Test-case is NG");
      switch(i){
          case(0): write("Mismatch >> OWD: guest = 0x%X, get = 0x%X", arr_Profile_Guest_setting[i], arr_get_setting[i]); break;
          case(1): write("Mismatch >> OWP: guest = 0x%X, get = 0x%X", arr_Profile_Guest_setting[i], arr_get_setting[i]); break;
          case(2): write("Mismatch >> DEV: guest = 0x%X, get = 0x%X", arr_Profile_Guest_setting[i], arr_get_setting[i]); break;
          case(3): write("Mismatch >> PEV: guest = 0x%X, get = 0x%X", arr_Profile_Guest_setting[i], arr_get_setting[i]); break;
          case(4): write("Mismatch >> 120h: guest = 0x%X, get = 0x%X", arr_Profile_Guest_setting[i], arr_get_setting[i]); break;
          case(5): write("Mismatch >> Parking Time: guest = 0x%X, get = 0x%X", arr_Profile_Guest_setting[i], arr_get_setting[i]); break;
          case(6): write("Mismatch >> TML Interval: guest = 0x%X, get = 0x%X", arr_Profile_Guest_setting[i], arr_get_setting[i]); break;
          case(7): write("Mismatch >> Bfr Time: guest = 0x%X, get = 0x%X", arr_Profile_Guest_setting[i], arr_get_setting[i]); break;
          case(8): write("Mismatch >> Aft Time: guest = 0x%X, get = 0x%X", arr_Profile_Guest_setting[i], arr_get_setting[i]); break;
          case(9): write("Mismatch >> EV Sen Stamp: guest = 0x%X, get = 0x%X", arr_Profile_Guest_setting[i], arr_get_setting[i]); break;
          case(10): write("Mismatch >> Gear Stamp: guest = 0x%X, get = 0x%X", arr_Profile_Guest_setting[i], arr_get_setting[i]); break;
          case(11): write("Mismatch >> Location Stamp: guest = 0x%X, get = 0x%X", arr_Profile_Guest_setting[i], arr_get_setting[i]); break;
          case(12): write("Mismatch >> Velocity Stamp: guest = 0x%X, get = 0x%X", arr_Profile_Guest_setting[i], arr_get_setting[i]); break;
          case(13): write("Mismatch >> Time Stamp: guest = 0x%X, get = 0x%X", arr_Profile_Guest_setting[i], arr_get_setting[i]); break;
          case(16): write("Mismatch >> FCAM Angle: guest = 0x%X, get = 0x%X", arr_Profile_Guest_setting[i], arr_get_setting[i]); break;
          case(17): write("Mismatch >> RCAM Angle: guest = 0x%X, get = 0x%X", arr_Profile_Guest_setting[i], arr_get_setting[i]); break;
          case(18): write("Mismatch >> DEV Sen Level: guest = 0x%X, get = 0x%X", arr_Profile_Guest_setting[i], arr_get_setting[i]); break;
          case(19): write("Mismatch >> PEV Sen Level: guest = 0x%X, get = 0x%X", arr_Profile_Guest_setting[i], arr_get_setting[i]); break;
          case(20): write("Mismatch >> App Notification: guest = 0x%X, get = 0x%X", arr_Profile_Guest_setting[i], arr_get_setting[i]); break;
      }
    }
  }
  if (flag == 21) {
    write("Profile 2 is copied from Guest Profile");
    condition2 = 1;
  }
  else {
    testStepFail("Fail", "Test-case is NG");
  }
  flag = 0;
  
  CaptureGraphics(); write("Run Capture Graphics()");
  testReportAddWindowCapture("Profile Settings","","Profile Driver 2","./profile_setting.jpg");    
  
  if (condition1 == 1 && condition2 == 1) {
    testStepPass("Pass","All conditions have met. Test-case is OK");
    write("Test-case is OK");
  }
  else {
    int arr[3];
    
    arr[0] = condition1;
    arr[1] = condition2;
    
    testStepFail("Fail","Condition hasn't met. Test-case is NG");
    
    for (i = 0; i < 2; i++){
      
      if (arr[i] != 1){
        
        write("Condition %d is not met", i+1);
        
      }   
    }
  }  
  
  write("KEY_OFF"); KEY_OFF();
  
  @panel::Switch_Clock = 0;
  @panel::Switch_CGWNM = 0; 
  
  write("=== FINISH HU_026_3 ===");  
}

void MainTest(){
  
  write("Run Init()"); Init(); 

  testWaitForValueInput("Notification: Enter the testcase ID: (1/2/3)",300000); 
  
  switch(testGetValueInput()){

    case 1: HU_026_1(); HU_026_2(); break;

    case 2: HU_026_3(); break;  
      
    case 3: HU_026_1(); HU_026_2(); HU_026_3(); break;   
  }

}

