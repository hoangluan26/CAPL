/*@!Encoding:65001*/
//Preconditions: - ACC and IGN and ccNC/ccIC switch OFF, AVN mode
//Add signal to graphic 2: BLTN_CAM_RecSta_MAR

#include "DeclarationFunction_Gen2.5.h"

float count_MARRec_time = 0.0;
byte value_Bfr = 0x0;
byte value_Aft = 0x0;

void BLTN_CAM_Settings(int Choose_Option){
  switch (Choose_Option){
    case(1):
      value_Bfr = 0x5; write("Bft: -15"); @panel::TrackBar_EV_Time_Bfr = 2;/*Before Time Setting: -15s*/
      testWaitForTimeout(500);
      value_Aft = 0x0; write("Aft: +10"); @panel::TrackBar_EV_Time_Aft = 10;/*After Time Setting: +10s*/break; 
    case(2):
      value_Bfr = 0x5; write("Bft: -15"); @panel::TrackBar_EV_Time_Bfr = 2;/*Before Time Setting: -15s*/
      testWaitForTimeout(500);
      value_Aft = 0x5; write("Aft: +15"); @panel::TrackBar_EV_Time_Aft = 15;/*After Time Setting: +15s*/break; 
    case(3):
      value_Bfr = 0x5; write("Bft: -15"); @panel::TrackBar_EV_Time_Bfr = 2;/*Before Time Setting: -15s*/
      testWaitForTimeout(500);
      value_Aft = 0xA; write("Aft: +20"); @panel::TrackBar_EV_Time_Aft = 20;/*After Time Setting: +20s*/break;     
  }
  
  testWaitForTimeout(1000);
  
  if($BLTN_CAM_Set_EV_BfrTime != value_Bfr){
      
    write("Bfr_time is not match");
    
    write("Stop test"); stop();
    
  }
  else if($BLTN_CAM_Set_EV_AftTime != value_Aft){
    
    write("Aft_time is not match");
    
    write("Stop test"); stop();
    
  }
}

void KEY_ON(){
  setSignal(SMK_TrmnlCtrlGrpStaBDC,0x1); // Power ON
}

void KEY_OFF(){
   setSignal(SMK_TrmnlCtrlGrpStaBDC,0x0); // Power OFF
}

void Enter_BLTN_CAM(){
  // CAN FD
  _HU_BLTN_CAM_02_200ms.HU_BLTN_CAM_UI_Mode = 0x1; //Enter BLTN_CAM mode
  output(_HU_BLTN_CAM_02_200ms);
}

void Exit_BLTN_CAM(){
  // CAN FD 
  _HU_BLTN_CAM_02_200ms.HU_BLTN_CAM_UI_Mode = 0x0; //Enter AVN mode - Exit BLTN_CAM Mode
  output(_HU_BLTN_CAM_02_200ms);
}

void CaptureGraphics(){
  testWaitForTimeout(3000);
  testReportAddWindowCapture("Graphics 2","BLTN_CAM_RecSta_MAR","Sreenshot","./Husign.jpg");
}

void Turn_OFF_RecSet(){
  if (getSignal(BLTN_CAM_RecSet_OWD) == 0x2 || getSignal(BLTN_CAM_RecSet_OWP) == 0x2 || getSignal(BLTN_CAM_RecSet_DEV) == 0x2 || getSignal(BLTN_CAM_RecSet_PEV) == 0x2){
    @panel::Switch_CGWNM = 1;
  
    KEY_ON();
    testWaitForTimeout(3000);

      
    do {
      Enter_BLTN_CAM();
      testWaitForTimeout(3000);
      
      if (getSignal(BLTN_CAM_RecSet_OWD) == 0x2){
        write("OWD Off"); @panel::LED_Ctrl_SetOWD = 1; testWaitForTimeout(1000);
      } 
      
      else if (getSignal(BLTN_CAM_RecSet_OWP) == 0x2){
        write("OWP Off"); @panel::LED_Ctrl_SetOWP = 1; testWaitForTimeout(1000);
      } 
      
      else if (getSignal(BLTN_CAM_RecSet_DEV) == 0x2){
        write("DEV Off"); @panel::LED_Ctrl_SetDEV = 1; testWaitForTimeout(1000);
      } 
      
      else if (getSignal(BLTN_CAM_RecSet_PEV) == 0x2){
        write("PEV Off"); @panel::LED_Ctrl_SetPEV = 1; testWaitForTimeout(1000);
      } 

      Exit_BLTN_CAM();
      
      flag_RecSet_error++;
      
    } while((getSignal(BLTN_CAM_RecSet_OWD) == 0x2 || getSignal(BLTN_CAM_RecSet_OWP) == 0x2 || getSignal(BLTN_CAM_RecSet_DEV) == 0x2 || getSignal(BLTN_CAM_RecSet_PEV) == 0x2) && (flag_RecSet_error <= 15));
    
    flag_RecSet_error = 0; 
    
    testWaitForTimeout(3000);
    
    KEY_OFF();
  }
  else {
    write("Notifications: All recording setting are turned OFF.");
  }
}

void Setup_Function(int Option){
  float start_sec, end_sec;
  
  @panel::Switch_CGWNM = 1;
  
  KEY_ON();
  testWaitForTimeout(3000);
  
  
  Enter_BLTN_CAM();
  testWaitForTimeout(3000);

  BLTN_CAM_Settings(Option);
  testWaitForTimeout(2000);
  
  @panel::Switch_Clock = 1;
  
  Exit_BLTN_CAM();

  testWaitForTimeout(16000);
  
  _HU_BLTN_CAM_01_00ms.MEV_Rec_Req = 0x0;
  output(_HU_BLTN_CAM_01_00ms);
  
  testWaitForTimeout(500);
  
  _HU_BLTN_CAM_01_00ms.MEV_Rec_Req = 0x1;
  output(_HU_BLTN_CAM_01_00ms);
  
  if (testWaitForSignalChange(BLTN_CAM_RecSta_MAR,100000) == 1){
    write("MAR recording is started");
    start_sec = timeNow()/100000.0;
  }
  else{
    write("Error: MAR recording hasn't started. Stop test !!!");
    stop();
  }
  
  if (testWaitForSignalChange(BLTN_CAM_RecSta_MAR,100000) == 1){
    write("MAR recording is stopped");
    end_sec = timeNow()/100000.0;
  }
  
  count_MARRec_time = end_sec - start_sec;
}

void Rec_Reset(){
  @panel::Switch_CGWNM = 1; 
  
  KEY_ON();
  
  while (getSignal(BLTN_CAM_SD_Format_Op_State) != 0x1){
    @panel::Button_RecReset = 1; 
    testWaitForSignalChange(BLTN_CAM_SD_Format_Op_State,500);
  }
  
  KEY_OFF();
  
  @panel::Switch_CGWNM = 0; 
}

testcase OWD_023_1(){
  testStep("Notification","Start test OWD_023_1");
  write("Start test OWD_023_1");
  
  Setup_Function(1); write("Run Setup_Function()");
  
  if( count_MARRec_time >= 9 && count_MARRec_time <= 11){
    testStepPass("Pass","Test-case is OK");
    write("count_MARRec_time = %.2f",count_MARRec_time);     
  }
  else{
    testStepFail("Fail","Test-case is NG");
    write("count_MARRec_time = %.2f",count_MARRec_time);     
  }
  
  CaptureGraphics(); write("Run CaptureGraphics()");
  
  testWaitForTimeout(1000);
  
  @panel::Switch_CGWNM = 0;
  
  @panel::Switch_Clock = 0;
  
  count_MARRec_time = 0.0;  
  
  KEY_OFF(); write("Run KEY_OFF()"); 
  
  testStep("Notifications","Finish OWD_023_1");
  write("Finish OWD_023_1");
}

testcase OWD_023_2(){
  testStep("Notification","Start test OWD_023_2");
  write("Start test OWD_023_2");

  Setup_Function(2); write("Run Setup_Function()");
  
  if( count_MARRec_time >= 14 && count_MARRec_time <= 16){
    testStepPass("Pass","Test-case is OK");
    write("count_MARRec_time = %.2f",count_MARRec_time); 
  }
  else{
    testStepFail("Fail","Test-case is NG");
    write("count_MARRec_time = %.2f",count_MARRec_time);     
  }
  
  CaptureGraphics(); write("Run CaptureGraphics()");
  
  testWaitForTimeout(1000);
  
  @panel::Switch_CGWNM = 0;
  
  @panel::Switch_Clock = 0;
  
  count_MARRec_time = 0.0;  
  
  KEY_OFF(); write("Run KEY_OFF()"); 
  
  testStep("Notifications","Finish OWD_023_2");
  write("Finish OWD_023_2");
}

testcase OWD_023_3(){
  testStep("Notification","Start test OWD_023_3");
  write("Start test OWD_023_3");

  Setup_Function(3); write("Run Setup_Function()");
  
  if( count_MARRec_time >= 19 && count_MARRec_time <= 21){
    testStepPass("Pass","Test-case is OK");
    write("count_MARRec_time = %.2f",count_MARRec_time);     
  }
  else{
    testStepFail("Fail","Test-case is NG");
    write("count_MARRec_time = %.2f",count_MARRec_time); 
  }
  
  CaptureGraphics(); write("Run CaptureGraphics()");
  
  testWaitForTimeout(1000);
  
  @panel::Switch_CGWNM = 0;
  
  @panel::Switch_Clock = 0;
  
  count_MARRec_time = 0.0;  
  
  KEY_OFF(); write("Run KEY_OFF()"); 
  
  testStep("Notifications","Finish OWD_023_3");
  write("Finish OWD_023_3");
}

void MainTest(){
  write("Run Turn_OFF_RecSet()"); Turn_OFF_RecSet();
  
  write("Run Rec_Reset()"); Rec_Reset();
  
  TestWaitForValueInput("Please enter the ID testcase number: (1/2/3/4)",300000);
  
  switch (testGetValueInput()){
    
    case (1): OWD_023_1(); break;
    
    case (2): OWD_023_2(); break;
    
    case (3): OWD_023_3(); break;
      
    case (4):
      OWD_023_1();
      
      OWD_023_2();
      
      OWD_023_3(); 
      
      break;
  }  
}
