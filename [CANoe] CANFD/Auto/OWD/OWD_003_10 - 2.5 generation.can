/*@!Encoding:1252*/

//Preconditions: - ACC and IGN and ccNC/ccIC switch OFF, AVN mode
//Add signal to graphic 2: BLTN_CAM_RecSta_OWD

#include "DeclarationFunction_Gen2.5.h"

void Setup_Function(){
  @panel::Switch_CGWNM = 1;  // bật Switch_CGWNM để giao tiếp mạng
  
  KEY_ON();  // giả lập bật chìa khóa
  testWaitForTimeout(3000);

  @panel::Switch_CGWNM = 0;   // tắt giao tiếp mạng
  do {
  Enter_BLTN_CAM();
  testWaitForTimeout(3000);
    
  write("OWD On");
  @panel::LED_Ctrl_SetOWD = 1; // Set ghi hình OWD qua panel
  testWaitForTimeout(1000);
  
  Set_Time(); testWaitForTimeout(2000);  // Hàm cài đặt thời gian cho camera
    
  Exit_BLTN_CAM();
    
  flag_RecSet_error++;
    
  } while (getSignal(BLTN_CAM_RecSet_OWD) == 0x1 && flag_RecSet_error <= 15); // tín hiệu phải ở OFF để thực hiện , kiểm tra 15 lần
  
  flag_RecSet_error = 0;
  
  if (testWaitForSignalChange(BLTN_CAM_RecSta_OWD,100000) == 1){      // hiện thong bao owd dang ghi
    write("OWD recording is in progress...");
  }
  else{
    write("Error: OWD recording hasn't started. Stop test !!!");         // OWD khong duoc ghi va dung test
    
    do {
      Enter_BLTN_CAM();
      testWaitForTimeout(3000);
    
      write("OWD Off");
      @panel::LED_Ctrl_SetOWD = 1;  // đưa OWD về Off
      testWaitForTimeout(1000);   
    
      Exit_BLTN_CAM();
    
      flag_RecSet_error++;
    
    } while (getSignal(BLTN_CAM_RecSet_OWD) == 0x2 && flag_RecSet_error <= 15); // nếu vẫn ON thì vẫn lắp lại
  
    flag_RecSet_error = 0;
    
    stop();   // dừng chương trình
  }  
}

void Setup_End_test(){       // xuất ra log và tắt ghi OWD đi
  Enter_BLTN_CAM(); 
  write("Run CaptureGraphics()"); CaptureGraphics("Graphics 2", "BLTN_CAM_RecSta_OWD");
  
  if ($BLTN_CAM_RecSet_OWD == 0x2){
    write("OWD Off"); @panel::LED_Ctrl_SetOWD = 1;
  }
  
  testWaitForTimeout(2000);
  Exit_BLTN_CAM();
  
  while($BLTN_CAM_RecSet_OWD == 0x2 && flag_RecSet_error <= 15){
    Enter_BLTN_CAM();
    testWaitForTimeout(3000);
    write("Set OWD Off");
    @panel::LED_Ctrl_SetOWD = 1;
    testWaitForTimeout(2000);
    flag_RecSet_error++;
    Exit_BLTN_CAM();
  }
  
  flag_RecSet_error = 0;
}


testcase OWD_003_10(){
  testStep("Notification","Start test OWD_003_10");
  write("=== START OWD_003_10 ===");
  
  write("===SETTING BEFORE TESTING===");
  
  write("Run Init()"); Init();
  
  write("Run Turn_OFF_RecSet()"); Turn_OFF_RecSet();
  
  write("===START TEST===");
  
  write("Run Setup_Function()"); Setup_Function(); 
  
  Clock_Down(3*60000);
  
  write("Run Setup_End_test()"); Setup_End_test(); write("Run Setup_End_test()"); 
  
   write("Run KEY_OFF()"); KEY_OFF(); write("Run KEY_OFF()"); 
  
  testStep("Notifications","Finish OWD_003_10");
  write("=== FINISH OWD_003_10 ===");
}

void MainTest(){
  OWD_003_10();
}