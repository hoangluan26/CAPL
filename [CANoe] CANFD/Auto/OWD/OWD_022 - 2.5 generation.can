/*@!Encoding:65001*/
//Preconditions: - ACC and IGN and ccNC/ccIC switch OFF, AVN mode
//Add signal to graphic 2: BLTN_CAM_RecSta_MAR

#include "DeclarationFunction_Gen2.5.h"

float count_MARRec_time = 0.0;
byte value_Bfr = 0x0;
byte value_Aft = 0x0;

void BLTN_CAM_Settings(int Choose_Option){
  switch (Choose_Option){
    case(1):
      value_Bfr = 0x0; write("Bft: -10"); @panel::TrackBar_EV_Time_Bfr = 3;/*Before Time Setting: -10s*/
      testWaitForTimeout(500);
      value_Aft = 0x0; write("Aft: +10"); @panel::TrackBar_EV_Time_Aft = 10;/*After Time Setting: +10s*/break; 
    case(2):
      value_Bfr = 0x0; write("Bft: -10"); @panel::TrackBar_EV_Time_Bfr = 3;/*Before Time Setting: -10s*/
      testWaitForTimeout(500);
      value_Aft = 0x5; write("Bft: +15"); @panel::TrackBar_EV_Time_Aft = 15;/*After Time Setting: +15s*/break; 
    case(3):
      value_Bfr = 0x0; write("Bft: -10"); @panel::TrackBar_EV_Time_Bfr = 3;/*Before Time Setting: -10s*/
      testWaitForTimeout(500);
      value_Aft = 0xA; write("Bft: +20"); @panel::TrackBar_EV_Time_Aft = 20;/*After Time Setting: +20s*/break;      
  }
  testWaitForTimeout(1000);
    
  if($BLTN_CAM_Set_EV_BfrTime != value_Bfr){
      
    write("Bfr_time is not match");
    
    write("Stop test"); stop();
    
  }
  else if($BLTN_CAM_Set_EV_AftTime != value_Aft){
    
    write("Aft_time is not match");
    
    write("Stop test"); stop();
    
  }
}

}

void Setup_Function(int Option){
  float start_sec, end_sec;
  
  @panel::Switch_CGWNM = 1;
  
  KEY_ON();
  testWaitForTimeout(3000);
  
  
  Enter_BLTN_CAM();
  testWaitForTimeout(3000);

  BLTN_CAM_Settings(Option);
  testWaitForTimeout(2000);
  
  @panel::Switch_Clock = 1;
  
  Exit_BLTN_CAM();

  testWaitForTimeout(11000);
  
  _HU_BLTN_CAM_01_00ms.MEV_Rec_Req = 0x0;
  output(_HU_BLTN_CAM_01_00ms);
  
  testWaitForTimeout(500);
  
  _HU_BLTN_CAM_01_00ms.MEV_Rec_Req = 0x1;
  output(_HU_BLTN_CAM_01_00ms);
  
  @panel::Button_SwitchEvt = 1;
  
  if (testWaitForSignalChange(BLTN_CAM_RecSta_MAR,100000) == 1){
    write("MAR recording is started");
    start_sec = timeNow()/100000.00;
  }
  else{
    write("Error: MAR recording hasn't started");
    stop();
  }
  
  if (testWaitForSignalChange(BLTN_CAM_RecSta_MAR,100000) == 1){
    write("MAR recording is stopped");
    end_sec = timeNow()/100000.00;
  }

  count_MARRec_time = end_sec - start_sec;
}

void Rec_Reset(){
  @panel::Switch_CGWNM = 1; 
  
  KEY_ON();
  
  while (getSignal(BLTN_CAM_SD_Format_Op_State) != 0x1){
    @panel::Button_RecReset = 1; 
    testWaitForSignalChange(BLTN_CAM_SD_Format_Op_State,500);
  }
  
  KEY_OFF();
  
  @panel::Switch_CGWNM = 0; 
}

testcase OWD_022_1(){
  testStep("Notification","Start test OWD_022_1");
  write("Start test OWD_022_1");

  Setup_Function(1); write("Run Setup_Function()");
  
  if( count_MARRec_time >= 9 && count_MARRec_time <= 11){
    testStepPass("Pass","Test-case is OK");
    write("count_MARRec_time = %.2f",count_MARRec_time);
  }
  else{
    testStepFail("Fail","Test-case is NG");
    write("count_MARRec_time = %.2f",count_MARRec_time);
  }
  
  CaptureGraphics(); write("Run CaptureGraphics()");
  
  testWaitForTimeout(1000);
  
  @panel::Switch_CGWNM = 0;
  
  @panel::Switch_Clock = 0;
  
  count_MARRec_time = 0.0;  
  
  KEY_OFF(); write("Run KEY_OFF()"); 
  
  testStep("Notifications","Finish OWD_022_1");
  write("Finish OWD_022_1");
}

testcase OWD_022_2(){
  testStep("Notification","Start test OWD_022_2");
  write("Start test OWD_022_2");

  Setup_Function(2); write("Run Setup_Function()");
  
  if( count_MARRec_time >= 14 && count_MARRec_time <= 16){
    testStepPass("Pass","Test-case is OK");
    write("count_MARRec_time = %.2f",count_MARRec_time);
  }
  else{
    testStepFail("Fail","Test-case is NG");
    write("count_MARRec_time = %.2f",count_MARRec_time);    
  }
  
  CaptureGraphics(); write("Run CaptureGraphics()");
  
  testWaitForTimeout(1000);
  
  @panel::Switch_CGWNM = 0;  
  
  @panel::Switch_Clock = 0;
  
  count_MARRec_time = 0.0;  
  
  KEY_OFF(); write("Run KEY_OFF()"); 
  
  testStep("Notifications","Finish OWD_022_2");
  write("Finish OWD_022_2");
}

testcase OWD_022_3(){
  testStep("Notification","Start test OWD_022_3");
  write("Start test OWD_022_3");

  Setup_Function(3); write("Run Setup_Function()");
  
  if( count_MARRec_time >= 19 && count_MARRec_time <= 21){
    testStepPass("Pass","Test-case is OK");
    write("count_MARRec_time = %.2f",count_MARRec_time);    
  }
  else{
    testStepFail("Fail","Test-case is NG");
    write("count_MARRec_time = %.2f",count_MARRec_time);    
  }
  
  CaptureGraphics(); write("Run CaptureGraphics()");
  
  testWaitForTimeout(1000);
  
  @panel::Switch_CGWNM = 0;
  
  @panel::Switch_Clock = 0;

  count_MARRec_time = 0.0;  
  
  KEY_OFF(); write("Run KEY_OFF()"); 
  
  testStep("Notifications","Finish OWD_022_3");
  write("Finish OWD_022_3");
}

void MainTest(){
  write("Run Turn_OFF_RecSet()"); Turn_OFF_RecSet();
  
  write("Run Rec_Reset()"); Rec_Reset();
  
  TestWaitForValueInput("Please enter the ID testcase number:",300000);
  
  switch (testGetValueInput()){
    
    case (1): OWD_022_1(); break;
    
    case (2): OWD_022_2(); break;
    
    case (3): OWD_022_3(); break;
      
    case (4):
      OWD_022_1();
      
      OWD_022_2();
      
      OWD_022_3(); 
      
      break;
  }  
  
}