/*@!Encoding:65001*/
// Preconditions: - ACC and IGN and ccNC/ccIC switch OFF state, AVN mode
includes
{
  
  #include "DeclarationFunction_Gen2.5.h"
  
}

variables
{
  // Message Declaration
  // CAN FD
  message HU_BLTN_CAM_01_00ms _HU_BLTN_CAM_01_00ms;
  message HU_BLTN_CAM_02_200ms _HU_BLTN_CAM_02_200ms;
  message BDC_FD_SMK_03_200ms _BDC_FD_SMK_03_200ms;
  message PDC_FD_10_200ms _PDC_FD_10_200ms;
  message IAU_FD_04_200ms _IAU_FD_04_200ms;
  message PDC_FD_11_200ms _PDC_FD_11_200ms;
  message BDC_FD_04_200ms _BDC_FD_04_200ms;
  //Global Variable Declaration
  // Global Variable Declaration
  int i;
  int flag = 0;
  int flag_RecSet_error = 0;
  int condition1 = 0, condition2 = 0, condition3 = 0;
  byte KEY_state = 0x0;
  byte Profile_value = 0x1;
  byte Mode_state = 0x2;
  byte Bat_val = 0x50; 
  byte Alarm_state = 0x0; 
  int get_PEVRecorded_change = 0;
  byte get_PEVRecorded_value = 0x0;
  // Timer Declaration  
  msTimer send_SMK_TrmnlCtrlGrpStaBDC_timer;
  msTimer send_ICU_PowerAutoCutModSta_timer;
  msTimer send_IAU_ProfileIDRVal_timer;
  msTimer send_ICU_BS2SoC_timer;
  msTimer send_BAlarm_BglrAlrmCurrentSta_timer;
}

void Capture_Graphics() {
  testWaitForTimeout(3000);
  testReportAddWindowCapture("Graphics 2","","BLTN_CAM_RecSta_OWP;BLTN_CAM_RecSta_PEV;BLTN_CAM_PEV_Recorded","./envidence.jpg");  
}

testcase CCS_006_10() {
  testStep("Notifications","Start test-case CCS_006_10");
  write("=== START CCS_006_10 ===");  
  
  write("=== SETTING ===");
  
  write("KEY ON"); KEY_ON(); testWaitForTimeout(3000);
  
  do {
    
    Enter_BLTN_CAM(); testWaitForTimeout(3000);
    
    if ($BLTN_CAM_RecSet_OWP == 0x1) {write("OWP On"); @panel::LED_Ctrl_SetOWP = 1; testWaitForTimeout(500);}
    if ($BLTN_CAM_RecSet_PEV == 0x1) {write("PEV On"); @panel::LED_Ctrl_SetPEV = 1; testWaitForTimeout(500);}
    if ($BLTN_CAM_Set_PEV_AppNoti == 0x1) {write("App Noti On"); @panel::Button_AppNoti_PEV = 1; testWaitForTimeout(500);}
    if ($BLTN_CAM_SenSet_PEV != 0x1) {write("Set Lv.1"); @panel::TrackBar_PEV_Sen = 1; testWaitForTimeout(500);}
    Exit_BLTN_CAM(); testWaitForTimeout(3000);
    flag_RecSet_error++;
    
  } while (($BLTN_CAM_RecSet_OWP == 0x1 || $BLTN_CAM_RecSet_PEV == 0x1 || $BLTN_CAM_Set_PEV_AppNoti == 0x1 || $BLTN_CAM_SenSet_PEV != 0x1) && (flag_RecSet_error < 15));
  
  write("=== TESTING ===");
  
  write("KEY OFF"); KEY_OFF();
  
  if (testWaitForSignalChange(BLTN_CAM_RecSta_OWP,10000) == 1) {
    
    write("OWP recording is started"); @panel::Switch_CGWNM = 1;
    
    testWaitForTimeout(10000);
    
    openPanel("Note");
    
    if (testWaitForSignalChange(BLTN_CAM_RecSta_PEV,20000) == 1) {
      
      write("PEV recording is started"); closePanel("Note");
      
      get_PEVRecorded_change = testWaitForSignalChange(BLTN_CAM_PEV_Recorded,10000);
      
      get_PEVRecorded_value = $BLTN_CAM_PEV_Recorded;
      
      if (get_PEVRecorded_change == 1 && get_PEVRecorded_value == 0x2) {
        
        write("PEV_Recorded: 0x%X << Test-case is OK >>", get_PEVRecorded_value);
        
        testWaitForTimeout(300000);
        
        testStepPass("Pass","Test-case is OK");
        
      }
      else {
        
        write("PEV_Recorded: 0x%X << Test-case is NG >>", get_PEVRecorded_value);
        
        testStepFail("Fail","Test-case is NG");
      }
    }
  }
  else {
    write("OWP recording hasn't started");
    write("Stop measurement"); stop();
  }
  
  write("Run Capture_Graphics()"); Capture_Graphics();  

  @panel::Switch_CGWNM = 0;
  
  write("=== FINISH CCS_006_10 ===");
}

testcase CCS_006_11() {
  testStep("Notifications","Start test-case CCS_006_11");
  write("=== START CCS_006_11 ===");  
  
  write("=== SETTING ===");
  
  write("KEY ON"); KEY_ON(); testWaitForTimeout(3000);
  
  do {
    
    Enter_BLTN_CAM(); testWaitForTimeout(3000);
    
    if ($BLTN_CAM_RecSet_OWP == 0x1) {write("OWP On"); @panel::LED_Ctrl_SetOWP = 1; testWaitForTimeout(500);}
    if ($BLTN_CAM_RecSet_PEV == 0x1) {write("PEV On"); @panel::LED_Ctrl_SetPEV = 1; testWaitForTimeout(500);}
    if ($BLTN_CAM_Set_PEV_AppNoti == 0x1) {write("App Noti On"); @panel::Button_AppNoti_PEV = 1; testWaitForTimeout(500);}
    if ($BLTN_CAM_SenSet_PEV != 0x2) {write("Set Lv.2"); @panel::TrackBar_PEV_Sen = 2; testWaitForTimeout(500);}
    Exit_BLTN_CAM(); testWaitForTimeout(3000);
    flag_RecSet_error++;
    
  } while (($BLTN_CAM_RecSet_OWP == 0x1 || $BLTN_CAM_RecSet_PEV == 0x1 || $BLTN_CAM_Set_PEV_AppNoti == 0x1 || $BLTN_CAM_SenSet_PEV != 0x2) && (flag_RecSet_error < 15));
  
  write("=== TESTING ===");
  
  write("KEY OFF"); KEY_OFF();
  
  if (testWaitForSignalChange(BLTN_CAM_RecSta_OWP,10000) == 1) {
    
    write("OWP recording is started"); @panel::Switch_CGWNM = 1;
    
    testWaitForTimeout(10000);
    
    openPanel("Note");
    
    if (testWaitForSignalChange(BLTN_CAM_RecSta_PEV,20000) == 1) {
      
      write("PEV recording is started"); closePanel("Note");
      
      get_PEVRecorded_change = testWaitForSignalChange(BLTN_CAM_PEV_Recorded,10000);
      
      get_PEVRecorded_value = $BLTN_CAM_PEV_Recorded;
      
      if (get_PEVRecorded_change == 1 && get_PEVRecorded_value == 0x2) {
        
        write("PEV_Recorded: 0x%X << Test-case is OK >>", get_PEVRecorded_value);
        
        testStepPass("Pass","Test-case is OK");
        
      }
      else {
        
        write("PEV_Recorded: 0x%X << Test-case is NG >>", get_PEVRecorded_value);
        
        testStepFail("Fail","Test-case is NG");
      }
    }
  }
  else {
    write("OWP recording hasn't started");
    write("Stop measurement"); stop();
  }
  
  write("Run Capture_Graphics()"); Capture_Graphics();  

  @panel::Switch_CGWNM = 0;
  
  write("=== FINISH CCS_006_11 ===");
}

testcase CCS_006_12() {
  testStep("Notifications","Start test-case CCS_006_12");
  write("=== START CCS_006_12 ===");  
  
  write("=== SETTING ===");
  
  write("KEY ON"); KEY_ON(); testWaitForTimeout(3000);
  
  do {
    
    Enter_BLTN_CAM(); testWaitForTimeout(3000);
    
    if ($BLTN_CAM_RecSet_OWP == 0x1) {write("OWP On"); @panel::LED_Ctrl_SetOWP = 1; testWaitForTimeout(500);}
    if ($BLTN_CAM_RecSet_PEV == 0x1) {write("PEV On"); @panel::LED_Ctrl_SetPEV = 1; testWaitForTimeout(500);}
    if ($BLTN_CAM_Set_PEV_AppNoti == 0x1) {write("App Noti On"); @panel::Button_AppNoti_PEV = 1; testWaitForTimeout(500);}
    if ($BLTN_CAM_SenSet_PEV != 0x3) {write("Set Lv.3"); @panel::TrackBar_PEV_Sen = 3; testWaitForTimeout(500);}
    Exit_BLTN_CAM(); testWaitForTimeout(3000);
    flag_RecSet_error++;
    
  } while (($BLTN_CAM_RecSet_OWP == 0x1 || $BLTN_CAM_RecSet_PEV == 0x1 || $BLTN_CAM_Set_PEV_AppNoti == 0x1 || $BLTN_CAM_SenSet_PEV != 0x3) && (flag_RecSet_error < 15));
  
  write("=== TESTING ===");
  
  write("KEY OFF"); KEY_OFF();
  
  if (testWaitForSignalChange(BLTN_CAM_RecSta_OWP,10000) == 1) {
    
    write("OWP recording is started"); @panel::Switch_CGWNM = 1;
    
    testWaitForTimeout(10000);
    
    openPanel("Note");
    
    if (testWaitForSignalChange(BLTN_CAM_RecSta_PEV,20000) == 1) {
      
      write("PEV recording is started"); closePanel("Note");
      
      get_PEVRecorded_change = testWaitForSignalChange(BLTN_CAM_PEV_Recorded,10000);
      
      get_PEVRecorded_value = $BLTN_CAM_PEV_Recorded;
      
      if (get_PEVRecorded_change == 1 && get_PEVRecorded_value == 0x2) {
        
        write("PEV_Recorded: 0x%X << Test-case is OK >>", get_PEVRecorded_value);
        
        testStepPass("Pass","Test-case is OK");
        
      }
      else {
        
        write("PEV_Recorded: 0x%X << Test-case is NG >>", get_PEVRecorded_value);
        
        testStepFail("Fail","Test-case is NG");
      }
    }
  }
  else {
    write("OWP recording hasn't started");
    write("Stop measurement"); stop();
  }
  
  write("Run Capture_Graphics()"); Capture_Graphics();  

  @panel::Switch_CGWNM = 0;
  
  write("=== FINISH CCS_006_12 ===");
}

testcase CCS_006_13() {
  testStep("Notifications","Start test-case CCS_006_13");
  write("=== START CCS_006_13 ===");  
  
  write("=== SETTING ===");
  
  write("KEY ON"); KEY_ON(); testWaitForTimeout(3000);
  
  do {
    
    Enter_BLTN_CAM(); testWaitForTimeout(3000);
    
    if ($BLTN_CAM_RecSet_OWP == 0x1) {write("OWP On"); @panel::LED_Ctrl_SetOWP = 1; testWaitForTimeout(500);}
    if ($BLTN_CAM_RecSet_PEV == 0x1) {write("PEV On"); @panel::LED_Ctrl_SetPEV = 1; testWaitForTimeout(500);}
    if ($BLTN_CAM_Set_PEV_AppNoti == 0x1) {write("App Noti On"); @panel::Button_AppNoti_PEV = 1; testWaitForTimeout(500);}
    if ($BLTN_CAM_SenSet_PEV != 0x4) {write("Set Lv.4"); @panel::TrackBar_PEV_Sen = 4; testWaitForTimeout(500);}
    Exit_BLTN_CAM(); testWaitForTimeout(3000);
    flag_RecSet_error++;
    
  } while (($BLTN_CAM_RecSet_OWP == 0x1 || $BLTN_CAM_RecSet_PEV == 0x1 || $BLTN_CAM_Set_PEV_AppNoti == 0x1 || $BLTN_CAM_SenSet_PEV != 0x4) && (flag_RecSet_error < 15));
  
  write("=== TESTING ===");
  
  write("KEY OFF"); KEY_OFF();
  
  if (testWaitForSignalChange(BLTN_CAM_RecSta_OWP,10000) == 1) {
    
    write("OWP recording is started"); @panel::Switch_CGWNM = 1;
    
    testWaitForTimeout(10000);
    
    openPanel("Note");
    
    if (testWaitForSignalChange(BLTN_CAM_RecSta_PEV,20000) == 1) {
      
      write("PEV recording is started"); closePanel("Note");
      
      get_PEVRecorded_change = testWaitForSignalChange(BLTN_CAM_PEV_Recorded,10000);
      
      get_PEVRecorded_value = $BLTN_CAM_PEV_Recorded;
      
      if (get_PEVRecorded_change == 1 && get_PEVRecorded_value == 0x2) {
        
        write("PEV_Recorded: 0x%X << Test-case is OK >>", get_PEVRecorded_value);
        
        testStepPass("Pass","Test-case is OK");
        
      }
      else {
        
        write("PEV_Recorded: 0x%X << Test-case is NG >>", get_PEVRecorded_value);
        
        testStepFail("Fail","Test-case is NG");
      }
    }
  }
  else {
    write("OWP recording hasn't started");
    write("Stop measurement"); stop();
  }
  
  write("Run Capture_Graphics()"); Capture_Graphics();  

  @panel::Switch_CGWNM = 0;
  
  write("=== FINISH CCS_006_13 ===");
}

testcase CCS_006_14() {
  testStep("Notifications","Start test-case CCS_006_14");
  write("=== START CCS_006_14 ===");  
  
  write("=== SETTING ===");
  
  write("KEY ON"); KEY_ON(); testWaitForTimeout(3000);
  
  do {
    
    Enter_BLTN_CAM(); testWaitForTimeout(3000);
    
    if ($BLTN_CAM_RecSet_OWP == 0x1) {write("OWP On"); @panel::LED_Ctrl_SetOWP = 1; testWaitForTimeout(500);}
    if ($BLTN_CAM_RecSet_PEV == 0x1) {write("PEV On"); @panel::LED_Ctrl_SetPEV = 1; testWaitForTimeout(500);}
    if ($BLTN_CAM_Set_PEV_AppNoti == 0x1) {write("App Noti On"); @panel::Button_AppNoti_PEV = 1; testWaitForTimeout(500);}
    if ($BLTN_CAM_SenSet_PEV != 0x5) {write("Set Lv.5"); @panel::TrackBar_PEV_Sen = 5; testWaitForTimeout(500);}
    Exit_BLTN_CAM(); testWaitForTimeout(3000);
    flag_RecSet_error++;
    
  } while (($BLTN_CAM_RecSet_OWP == 0x1 || $BLTN_CAM_RecSet_PEV == 0x1 || $BLTN_CAM_Set_PEV_AppNoti == 0x1 || $BLTN_CAM_SenSet_PEV != 0x5) && (flag_RecSet_error < 15));
  
  write("=== TESTING ===");
  
  write("KEY OFF"); KEY_OFF();
  
  if (testWaitForSignalChange(BLTN_CAM_RecSta_OWP,10000) == 1) {
    
    write("OWP recording is started"); @panel::Switch_CGWNM = 1;
    
    testWaitForTimeout(10000);
    
    openPanel("Note");
    
    if (testWaitForSignalChange(BLTN_CAM_RecSta_PEV,20000) == 1) {
      
      write("PEV recording is started"); closePanel("Note");
      
      get_PEVRecorded_change = testWaitForSignalChange(BLTN_CAM_PEV_Recorded,10000);
      
      get_PEVRecorded_value = $BLTN_CAM_PEV_Recorded;
      
      if (get_PEVRecorded_change == 1 && get_PEVRecorded_value == 0x2) {
        
        write("PEV_Recorded: 0x%X << Test-case is OK >>", get_PEVRecorded_value);
        
        testStepPass("Pass","Test-case is OK");
        
      }
      else {
        
        write("PEV_Recorded: 0x%X << Test-case is NG >>", get_PEVRecorded_value);
        
        testStepFail("Fail","Test-case is NG");
      }
    }
  }
  else {
    write("OWP recording hasn't started");
    write("Stop measurement"); stop();
  }
  
  write("Run Capture_Graphics()"); Capture_Graphics();  

  @panel::Switch_CGWNM = 0;
  
  write("=== FINISH CCS_006_14 ===");
}