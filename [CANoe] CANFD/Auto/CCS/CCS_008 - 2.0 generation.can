/*@!Encoding:65001*/
// Preconditions: - Block CCU, ACC and IGN and ccNC/ccIC switch OFF state, AVN mode
includes
{
  
  #include "DeclarationFunction_Gen2.h"
  
}

variables
{
  // Message Declaration
  // CAN
  message HU_BLTN_CAM_E_00 _HU_BLTN_CAM_E_00;
  message HU_BLTN_CAM_PE_00_200ms _HU_BLTN_CAM_PE_00_200ms;
  message HU_BLTN_CAM_E_01 _HU_BLTN_CAM_E_01;
  message SMK_13_200ms _SMK_13_200ms;
  message ICU_08_200ms _ICU_08_200ms;
  message IAU_16_200ms _IAU_16_200ms;  
  message ICU_10_200ms _ICU_10_200ms;  
  message BCM_02_200ms _BCM_02_200ms;
  // Global Variable Declaration
  int i;
  int flag = 0;
  int flag_RecSet_error = 0;
  int condition1 = 0, condition2 = 0, condition3 = 0;
  byte KEY_state = 0x0;
  byte Profile_value = 0x1;
  byte Mode_state = 0x2;
  byte Bat_val = 0x50; 
  byte Alarm_state = 0x0; 
  int get_PEVRecorded_change = 0;
  byte get_PEVRecorded_value = 0x0;
  // Timer Declaration  
  msTimer send_SMK_TrmnlCtrlGrpStaBDC_timer;
  msTimer send_ICU_PowerAutoCutModSta_timer;
  msTimer send_IAU_ProfileIDRVal_timer;
  msTimer send_ICU_BS2SoC_timer;
  msTimer send_BAlarm_BglrAlrmCurrentSta_timer;
}

void Capture_Graphics() {
  testWaitForTimeout(3000);
  testReportAddWindowCapture("Graphics 2","","BLTN_CAM_RecSta_OWP;BLTN_CAM_RecSta_PEV;BLTN_CAM_PEV_Recorded;BAlarm_BglrAlrm_CurrentSta","./envidence.jpg");  
}

on timer send_BAlarm_BglrAlrmCurrentSta_timer {
  _BCM_02_200ms.BAlarm_BglrAlrmCurrentSta = Alarm_state;      
  output(_BCM_02_200ms);  
  send_BAlarm_BglrAlrmCurrentSta_timer.set(200);
}

on timer send_SMK_TrmnlCtrlGrpStaBDC_timer {
  _SMK_13_200ms.SMK_TrmnlCtrlGrpStaBDC = KEY_state;      
  output(_SMK_13_200ms);  
  send_SMK_TrmnlCtrlGrpStaBDC_timer.set(200);
}

on timer send_IAU_ProfileIDRVal_timer {
  _IAU_16_200ms.IAU_ProfileIDRVal = Profile_value;
  output(_IAU_16_200ms); 
  send_IAU_ProfileIDRVal_timer.set(200);
}

on timer send_ICU_PowerAutoCutModSta_timer {
  _ICU_08_200ms.ICU_PowerAutoCutModSta = Mode_state;
  output(_ICU_08_200ms);
  send_ICU_PowerAutoCutModSta_timer.set(200);
}

on timer send_ICU_BS2SoC_timer {
  _ICU_10_200ms.ICU_BS2SoC = Bat_val;
  output(_ICU_10_200ms);
  send_ICU_BS2SoC_timer.set(200);
}

testcase CCS_008_1() {
  testStep("Notifications","Start test-case CCS_008_1");
  write("=== START CCS_008_1 ===");  
  
  write("=== SETTING ===");
  
  Alarm_state = 0x5; 
  
  write("KEY ON"); KEY_state = 0x1; testWaitForTimeout(3000);
  
  do {
    
    Enter_BLTN_CAM(); testWaitForTimeout(3000);
    
    if ($BLTN_CAM_RecSet_OWP == 0x1) {write("OWP On"); @panel::LED_Ctrl_SetOWP = 1; testWaitForTimeout(500);}
    if ($BLTN_CAM_RecSet_PEV == 0x1) {write("PEV On"); @panel::LED_Ctrl_SetPEV = 1; testWaitForTimeout(500);}
    if ($BLTN_CAM_Set_PEV_AppNoti == 0x1) {write("App Noti On"); @panel::Button_AppNoti_PEV = 1; testWaitForTimeout(500);}
    
    Exit_BLTN_CAM(); testWaitForTimeout(3000);
    flag_RecSet_error++;
    
  } while (($BLTN_CAM_RecSet_OWP == 0x1 || $BLTN_CAM_RecSet_PEV == 0x1 || $BLTN_CAM_Set_PEV_AppNoti == 0x1) && (flag_RecSet_error < 15));
  
  write("=== TESTING ===");
  
  write("KEY OFF"); KEY_state = 0x0;
  
  if (testWaitForSignalChange(BLTN_CAM_RecSta_OWP,10000) == 1) {
    
    write("OWP recording is started"); @panel::Switch_CGWNM = 1;
    
    testWaitForTimeout(10000);
    
    openPanel("Note");
    
    if (testWaitForSignalChange(BLTN_CAM_RecSta_PEV,20000) == 1) {
      
      write("PEV recording is started"); closePanel("Note");
      
      get_PEVRecorded_change = testWaitForSignalChange(BLTN_CAM_PEV_Recorded,10000);
      
      get_PEVRecorded_value = $BLTN_CAM_PEV_Recorded;
      
      if (get_PEVRecorded_change != 1 && get_PEVRecorded_value == 0x0) {
        
        write("PEV_Recorded: 0x%X << Test-case is OK >>", get_PEVRecorded_value);
        
        testStepPass("Pass","Test-case is OK");
        
      }
      else {
        
        write("PEV_Recorded: 0x%X << Test-case is NG >>", get_PEVRecorded_value);
        
        testStepFail("Fail","Test-case is NG");
      }
    }
  }
  else {
    write("OWP recording hasn't started");
    write("Stop measurement"); stop();
  }
  
  write("Run Capture_Graphics()"); Capture_Graphics();  
  
  Init();
  
  @panel::Switch_CGWNM = 0;
  
  write("=== FINISH CCS_008_1 ===");
}

testcase CCS_008_2() {
  testStep("Notifications","Start test-case CCS_008_2");
  write("=== START CCS_008_2 ==="); 
  
  Begin();
  
  write("=== SETTING ===");
  
  Alarm_state = 0x5;
  
  write("KEY ON"); KEY_state = 0x1; testWaitForTimeout(3000);
  
  do {
    
    Enter_BLTN_CAM(); testWaitForTimeout(3000);
    
    if ($BLTN_CAM_RecSet_OWP == 0x1) {write("OWP On"); @panel::LED_Ctrl_SetOWP = 1; testWaitForTimeout(500);}
    if ($BLTN_CAM_RecSet_PEV == 0x1) {write("PEV On"); @panel::LED_Ctrl_SetPEV = 1; testWaitForTimeout(500);}
    if ($BLTN_CAM_Set_PEV_AppNoti == 0x1) {write("App Noti On"); @panel::Button_AppNoti_PEV = 1; testWaitForTimeout(500);}
    
    Exit_BLTN_CAM(); testWaitForTimeout(3000);
    flag_RecSet_error++;
    
  } while (($BLTN_CAM_RecSet_OWP == 0x1 || $BLTN_CAM_RecSet_PEV == 0x1 || $BLTN_CAM_Set_PEV_AppNoti == 0x1) && (flag_RecSet_error < 15));
  
  write("=== TESTING ===");
  
  write("KEY OFF"); KEY_state = 0x0;
  
  if (testWaitForSignalChange(BLTN_CAM_RecSta_OWP,10000) == 1) {
    
    write("OWP recording is started"); @panel::Switch_CGWNM = 1;
    
    testWaitForTimeout(5000); send_BAlarm_BglrAlrmCurrentSta_timer.cancel(); testWaitForTimeout(5000);
    
    openPanel("Note");
    
    if (testWaitForSignalChange(BLTN_CAM_RecSta_PEV,20000) == 1) {
      
      write("PEV recording is started"); closePanel("Note");
      
      get_PEVRecorded_change = testWaitForSignalChange(BLTN_CAM_PEV_Recorded,10000);
      
      get_PEVRecorded_value = $BLTN_CAM_PEV_Recorded;
      
      if (get_PEVRecorded_change == 1 && get_PEVRecorded_value == 0x2) {
        
        write("PEV_Recorded: 0x%X << Test-case is OK >>", get_PEVRecorded_value);
        
        testStepPass("Pass","Test-case is OK");
        
      }
      else {
        
        write("PEV_Recorded: 0x%X << Test-case is NG >>", get_PEVRecorded_value);
        
        testStepFail("Fail","Test-case is NG");
      }
    }
  }
  else {
    write("OWP recording hasn't started");
    write("Stop measurement"); stop();
  }
  
  write("Run Capture_Graphics()"); Capture_Graphics();  
  
  Init();
  
  @panel::Switch_CGWNM = 0;
  
  write("=== FINISH CCS_008_2 ===");  
}

testcase CCS_008_3() {
  testStep("Notifications","Start test-case CCS_008_3");
  write("=== START CCS_008_3 ===");  
  
  Begin();
  
  write("=== SETTING ===");
  
  Alarm_state = 0x7; 
  
  write("KEY ON"); KEY_state = 0x1; testWaitForTimeout(3000);
  
  do {
    
    Enter_BLTN_CAM(); testWaitForTimeout(3000);
    
    if ($BLTN_CAM_RecSet_OWP == 0x1) {write("OWP On"); @panel::LED_Ctrl_SetOWP = 1; testWaitForTimeout(500);}
    if ($BLTN_CAM_RecSet_PEV == 0x1) {write("PEV On"); @panel::LED_Ctrl_SetPEV = 1; testWaitForTimeout(500);}
    if ($BLTN_CAM_Set_PEV_AppNoti == 0x1) {write("App Noti On"); @panel::Button_AppNoti_PEV = 1; testWaitForTimeout(500);}
    
    Exit_BLTN_CAM(); testWaitForTimeout(3000);
    flag_RecSet_error++;
    
  } while (($BLTN_CAM_RecSet_OWP == 0x1 || $BLTN_CAM_RecSet_PEV == 0x1 || $BLTN_CAM_Set_PEV_AppNoti == 0x1) && (flag_RecSet_error < 15));
  
  write("=== TESTING ===");
  
  write("KEY OFF"); KEY_state = 0x0;
  
  if (testWaitForSignalChange(BLTN_CAM_RecSta_OWP,10000) == 1) {
    
    write("OWP recording is started"); @panel::Switch_CGWNM = 1;
    
    testWaitForTimeout(10000);
    
    openPanel("Note");
    
    if (testWaitForSignalChange(BLTN_CAM_RecSta_PEV,20000) == 1) {
      
      write("PEV recording is started"); closePanel("Note");
      
      get_PEVRecorded_change = testWaitForSignalChange(BLTN_CAM_PEV_Recorded,10000);
      
      get_PEVRecorded_value = $BLTN_CAM_PEV_Recorded;
      
      if (get_PEVRecorded_change != 1 && get_PEVRecorded_value == 0x0) {
        
        write("PEV_Recorded: 0x%X << Test-case is OK >>", get_PEVRecorded_value);
        
        testStepPass("Pass","Test-case is OK");
        
      }
      else {
        
        write("PEV_Recorded: 0x%X << Test-case is NG >>", get_PEVRecorded_value);
        
        testStepFail("Fail","Test-case is NG");
      }
    }
  }
  else {
    write("OWP recording hasn't started");
    write("Stop measurement"); stop();
  }
  
  write("Run Capture_Graphics()"); Capture_Graphics();  
  
  Init();
  
  @panel::Switch_CGWNM = 0;
  
  write("=== FINISH CCS_008_3 ===");
}

testcase CCS_008_4() {
  testStep("Notifications","Start test-case CCS_008_4");
  write("=== START CCS_008_4 ==="); 
  
  Begin();  
  
  write("=== SETTING ===");
  
  Alarm_state = 0x7;
  
  write("KEY ON"); KEY_state = 0x1; testWaitForTimeout(3000);
  
  do {
    
    Enter_BLTN_CAM(); testWaitForTimeout(3000);
    
    if ($BLTN_CAM_RecSet_OWP == 0x1) {write("OWP On"); @panel::LED_Ctrl_SetOWP = 1; testWaitForTimeout(500);}
    if ($BLTN_CAM_RecSet_PEV == 0x1) {write("PEV On"); @panel::LED_Ctrl_SetPEV = 1; testWaitForTimeout(500);}
    if ($BLTN_CAM_Set_PEV_AppNoti == 0x1) {write("App Noti On"); @panel::Button_AppNoti_PEV = 1; testWaitForTimeout(500);}
    
    Exit_BLTN_CAM(); testWaitForTimeout(3000);
    flag_RecSet_error++;
    
  } while (($BLTN_CAM_RecSet_OWP == 0x1 || $BLTN_CAM_RecSet_PEV == 0x1 || $BLTN_CAM_Set_PEV_AppNoti == 0x1) && (flag_RecSet_error < 15));
  
  write("=== TESTING ===");
  
  write("KEY OFF"); KEY_state = 0x0;
  
  if (testWaitForSignalChange(BLTN_CAM_RecSta_OWP,10000) == 1) {
    
    write("OWP recording is started"); @panel::Switch_CGWNM = 1;
    
    testWaitForTimeout(5000); send_BAlarm_BglrAlrmCurrentSta_timer.cancel(); testWaitForTimeout(5000);
    
    openPanel("Note");
    
    if (testWaitForSignalChange(BLTN_CAM_RecSta_PEV,20000) == 1) {
      
      write("PEV recording is started"); closePanel("Note");
      
      get_PEVRecorded_change = testWaitForSignalChange(BLTN_CAM_PEV_Recorded,10000);
      
      get_PEVRecorded_value = $BLTN_CAM_PEV_Recorded;
      
      if (get_PEVRecorded_change == 1 && get_PEVRecorded_value == 0x2) {
        
        write("PEV_Recorded: 0x%X << Test-case is OK >>", get_PEVRecorded_value);
        
        testStepPass("Pass","Test-case is OK");
        
      }
      else {
        
        write("PEV_Recorded: 0x%X << Test-case is NG >>", get_PEVRecorded_value);
        
        testStepFail("Fail","Test-case is NG");
      }
    }
  }
  else {
    write("OWP recording hasn't started");
    write("Stop measurement"); stop();
  }  
  
  write("Run Capture_Graphics()"); Capture_Graphics();  
  
  Init();
  
  @panel::Switch_CGWNM = 0;
  
  write("=== FINISH CCS_008_4 ===");  
}

testcase CCS_008_5() {
  testStep("Notifications","Start test-case CCS_008_5");
  write("=== START CCS_008_5 ===");  
  
  Begin();  
  
  write("=== SETTING ===");
  
  Alarm_state = 0x8; 
  
  write("KEY ON"); KEY_state = 0x1; testWaitForTimeout(3000);
  
  do {
    
    Enter_BLTN_CAM(); testWaitForTimeout(3000);
    
    if ($BLTN_CAM_RecSet_OWP == 0x1) {write("OWP On"); @panel::LED_Ctrl_SetOWP = 1; testWaitForTimeout(500);}
    if ($BLTN_CAM_RecSet_PEV == 0x1) {write("PEV On"); @panel::LED_Ctrl_SetPEV = 1; testWaitForTimeout(500);}
    if ($BLTN_CAM_Set_PEV_AppNoti == 0x1) {write("App Noti On"); @panel::Button_AppNoti_PEV = 1; testWaitForTimeout(500);}
    
    Exit_BLTN_CAM(); testWaitForTimeout(3000);
    flag_RecSet_error++;
    
  } while (($BLTN_CAM_RecSet_OWP == 0x1 || $BLTN_CAM_RecSet_PEV == 0x1 || $BLTN_CAM_Set_PEV_AppNoti == 0x1) && (flag_RecSet_error < 15));
  
  write("=== TESTING ===");
  
  write("KEY OFF"); KEY_state = 0x0;
  
  if (testWaitForSignalChange(BLTN_CAM_RecSta_OWP,10000) == 1) {
    
    write("OWP recording is started"); @panel::Switch_CGWNM = 1;
    
    testWaitForTimeout(10000);
    
    openPanel("Note");
    
    if (testWaitForSignalChange(BLTN_CAM_RecSta_PEV,20000) == 1) {
      
      write("PEV recording is started"); closePanel("Note");
      
      get_PEVRecorded_change = testWaitForSignalChange(BLTN_CAM_PEV_Recorded,10000);
      
      get_PEVRecorded_value = $BLTN_CAM_PEV_Recorded;
      
      if (get_PEVRecorded_change != 1 && get_PEVRecorded_value == 0x0) {
        
        write("PEV_Recorded: 0x%X << Test-case is OK >>", get_PEVRecorded_value);
        
        testStepPass("Pass","Test-case is OK");
        
      }
      else {
        
        write("PEV_Recorded: 0x%X << Test-case is NG >>", get_PEVRecorded_value);
        
        testStepFail("Fail","Test-case is NG");
      }
    }
  }
  else {
    write("OWP recording hasn't started");
    write("Stop measurement"); stop();
  }
  
  write("Run Capture_Graphics()"); Capture_Graphics();  
  
  Init();
  
  @panel::Switch_CGWNM = 0;
  
  write("=== FINISH CCS_008_5 ===");
}

testcase CCS_008_6() {
  testStep("Notifications","Start test-case CCS_008_6");
  write("=== START CCS_008_6 ==="); 
  
  Begin();  
  
  write("=== SETTING ===");
  
  Alarm_state = 0x8;
  
  write("KEY ON"); KEY_state = 0x1; testWaitForTimeout(3000);
  
  do {
    
    Enter_BLTN_CAM(); testWaitForTimeout(3000);
    
    if ($BLTN_CAM_RecSet_OWP == 0x1) {write("OWP On"); @panel::LED_Ctrl_SetOWP = 1; testWaitForTimeout(500);}
    if ($BLTN_CAM_RecSet_PEV == 0x1) {write("PEV On"); @panel::LED_Ctrl_SetPEV = 1; testWaitForTimeout(500);}
    if ($BLTN_CAM_Set_PEV_AppNoti == 0x1) {write("App Noti On"); @panel::Button_AppNoti_PEV = 1; testWaitForTimeout(500);}
    
    Exit_BLTN_CAM(); testWaitForTimeout(3000);
    flag_RecSet_error++;
    
  } while (($BLTN_CAM_RecSet_OWP == 0x1 || $BLTN_CAM_RecSet_PEV == 0x1 || $BLTN_CAM_Set_PEV_AppNoti == 0x1) && (flag_RecSet_error < 15));
  
  write("=== TESTING ===");
  
  write("KEY OFF"); KEY_state = 0x0;
  
  if (testWaitForSignalChange(BLTN_CAM_RecSta_OWP,10000) == 1) {
    
    write("OWP recording is started"); @panel::Switch_CGWNM = 1;
    
    testWaitForTimeout(5000); send_BAlarm_BglrAlrmCurrentSta_timer.cancel(); testWaitForTimeout(5000);
    
    openPanel("Note");
    
    if (testWaitForSignalChange(BLTN_CAM_RecSta_PEV,20000) == 1) {
      
      write("PEV recording is started"); closePanel("Note");
      
      get_PEVRecorded_change = testWaitForSignalChange(BLTN_CAM_PEV_Recorded,10000);
      
      get_PEVRecorded_value = $BLTN_CAM_PEV_Recorded;
      
      if (get_PEVRecorded_change == 1 && get_PEVRecorded_value == 0x2) {
        
        write("PEV_Recorded: 0x%X << Test-case is OK >>", get_PEVRecorded_value);
        
        testStepPass("Pass","Test-case is OK");
        
      }
      else {
        
        write("PEV_Recorded: 0x%X << Test-case is NG >>", get_PEVRecorded_value);
        
        testStepFail("Fail","Test-case is NG");
      }
    }
  }
  else {
    write("OWP recording hasn't started");
    write("Stop measurement"); stop();
  }  
  
  write("Run Capture_Graphics()"); Capture_Graphics();  
  
  Init();
  
  @panel::Switch_CGWNM = 0;
  
  write("=== FINISH CCS_008_6 ===");  
}

testcase CCS_008_7() {
  testStep("Notifications","Start test-case CCS_008_7");
  write("=== START CCS_008_7 ===");  
  
  Begin();  
  
  write("=== SETTING ===");
  Alarm_state = 0x1; 
  testWaitForTimeout(2000);
  Alarm_state = 0xA; 
  write("KEY ON"); KEY_state = 0x1; testWaitForTimeout(3000);
  
  do {
    
    Enter_BLTN_CAM(); testWaitForTimeout(3000);
    
    if ($BLTN_CAM_RecSet_OWP == 0x1) {write("OWP On"); @panel::LED_Ctrl_SetOWP = 1; testWaitForTimeout(500);}
    if ($BLTN_CAM_RecSet_PEV == 0x1) {write("PEV On"); @panel::LED_Ctrl_SetPEV = 1; testWaitForTimeout(500);}
    if ($BLTN_CAM_Set_PEV_AppNoti == 0x1) {write("App Noti On"); @panel::Button_AppNoti_PEV = 1; testWaitForTimeout(500);}
    
    Exit_BLTN_CAM(); testWaitForTimeout(3000);
    flag_RecSet_error++;
    
  } while (($BLTN_CAM_RecSet_OWP == 0x1 || $BLTN_CAM_RecSet_PEV == 0x1 || $BLTN_CAM_Set_PEV_AppNoti == 0x1) && (flag_RecSet_error < 15));
  
  write("=== TESTING ===");
  
  write("KEY OFF"); KEY_state = 0x0;
  
  if (testWaitForSignalChange(BLTN_CAM_RecSta_OWP,10000) == 1) {
    
    write("OWP recording is started"); @panel::Switch_CGWNM = 1;
    
    testWaitForTimeout(10000);
    
    openPanel("Note");
    
    if (testWaitForSignalChange(BLTN_CAM_RecSta_PEV,20000) == 1) {
      
      write("PEV recording is started"); closePanel("Note");
      
      get_PEVRecorded_change = testWaitForSignalChange(BLTN_CAM_PEV_Recorded,10000);
      
      get_PEVRecorded_value = $BLTN_CAM_PEV_Recorded;
      
      if (get_PEVRecorded_change != 1 && get_PEVRecorded_value == 0x0) {
        
        write("PEV_Recorded: 0x%X << Test-case is OK >>", get_PEVRecorded_value);
        
        testStepPass("Pass","Test-case is OK");
        
      }
      else {
        
        write("PEV_Recorded: 0x%X << Test-case is NG >>", get_PEVRecorded_value);
        
        testStepFail("Fail","Test-case is NG");
      }
    }
  }
  else {
    write("OWP recording hasn't started");
    write("Stop measurement"); stop();
  }  
  
  write("Run Capture_Graphics()"); Capture_Graphics();  
  
  Init();
  
  @panel::Switch_CGWNM = 0;
  
  write("=== FINISH CCS_008_7 ===");
}

testcase CCS_008_8() {
  testStep("Notifications","Start test-case CCS_008_8");
  write("=== START CCS_008_8 ==="); 
  
  Begin();  
  
  write("=== SETTING ===");
  
  Alarm_state = 0xA; 
  write("KEY ON"); KEY_state = 0x1; testWaitForTimeout(3000);
  
  do {
    
    Enter_BLTN_CAM(); testWaitForTimeout(3000);
    
    if ($BLTN_CAM_RecSet_OWP == 0x1) {write("OWP On"); @panel::LED_Ctrl_SetOWP = 1; testWaitForTimeout(500);}
    if ($BLTN_CAM_RecSet_PEV == 0x1) {write("PEV On"); @panel::LED_Ctrl_SetPEV = 1; testWaitForTimeout(500);}
    if ($BLTN_CAM_Set_PEV_AppNoti == 0x1) {write("App Noti On"); @panel::Button_AppNoti_PEV = 1; testWaitForTimeout(500);}
    
    Exit_BLTN_CAM(); testWaitForTimeout(3000);
    flag_RecSet_error++;
    
  } while (($BLTN_CAM_RecSet_OWP == 0x1 || $BLTN_CAM_RecSet_PEV == 0x1 || $BLTN_CAM_Set_PEV_AppNoti == 0x1) && (flag_RecSet_error < 15));
  
  write("=== TESTING ===");
  
  write("KEY OFF"); KEY_state = 0x0;
  
  if (testWaitForSignalChange(BLTN_CAM_RecSta_OWP,10000) == 1) {
    
    write("OWP recording is started"); @panel::Switch_CGWNM = 1;
    
    testWaitForTimeout(5000); send_BAlarm_BglrAlrmCurrentSta_timer.cancel(); testWaitForTimeout(5000);
    
    openPanel("Note");
    
    if (testWaitForSignalChange(BLTN_CAM_RecSta_PEV,20000) == 1) {
      
      write("PEV recording is started"); closePanel("Note");
      
      get_PEVRecorded_change = testWaitForSignalChange(BLTN_CAM_PEV_Recorded,10000);
      
      get_PEVRecorded_value = $BLTN_CAM_PEV_Recorded;
      
      if (get_PEVRecorded_change == 1 && get_PEVRecorded_value == 0x2) {
        
        write("PEV_Recorded: 0x%X << Test-case is OK >>", get_PEVRecorded_value);
        
        testStepPass("Pass","Test-case is OK");
        
      }
      else {
        
        write("PEV_Recorded: 0x%X << Test-case is NG >>", get_PEVRecorded_value);
        
        testStepFail("Fail","Test-case is NG");
      }
    }
  }
  else {
    write("OWP recording hasn't started");
    write("Stop measurement"); stop();
  }
  
  write("Run Capture_Graphics()"); Capture_Graphics();  
  
  Init();
  
  @panel::Switch_CGWNM = 0;
  
  write("=== FINISH CCS_008_8 ===");  
}

testcase CCS_008_9() {
  testStep("Notifications","Start test-case CCS_008_9");
  write("=== START CCS_008_9 ===");  
  
  Begin();  
  
  write("=== SETTING ===");
  
  Alarm_state = 0xB; 
  
  write("KEY ON"); KEY_state = 0x1; testWaitForTimeout(3000);
  
  do {
    
    Enter_BLTN_CAM(); testWaitForTimeout(3000);
    
    if ($BLTN_CAM_RecSet_OWP == 0x1) {write("OWP On"); @panel::LED_Ctrl_SetOWP = 1; testWaitForTimeout(500);}
    if ($BLTN_CAM_RecSet_PEV == 0x1) {write("PEV On"); @panel::LED_Ctrl_SetPEV = 1; testWaitForTimeout(500);}
    if ($BLTN_CAM_Set_PEV_AppNoti == 0x1) {write("App Noti On"); @panel::Button_AppNoti_PEV = 1; testWaitForTimeout(500);}
    
    Exit_BLTN_CAM(); testWaitForTimeout(3000);
    flag_RecSet_error++;
    
  } while (($BLTN_CAM_RecSet_OWP == 0x1 || $BLTN_CAM_RecSet_PEV == 0x1 || $BLTN_CAM_Set_PEV_AppNoti == 0x1) && (flag_RecSet_error < 15));
  
  write("=== TESTING ===");
  
  write("KEY OFF"); KEY_state = 0x0;
  
  if (testWaitForSignalChange(BLTN_CAM_RecSta_OWP,10000) == 1) {
    
    write("OWP recording is started"); @panel::Switch_CGWNM = 1;
    
    testWaitForTimeout(10000);
    
    openPanel("Note");
    
    if (testWaitForSignalChange(BLTN_CAM_RecSta_PEV,20000) == 1) {
      
      write("PEV recording is started"); closePanel("Note");
      
      get_PEVRecorded_change = testWaitForSignalChange(BLTN_CAM_PEV_Recorded,10000);
      
      get_PEVRecorded_value = $BLTN_CAM_PEV_Recorded;
      
      if (get_PEVRecorded_change != 1 && get_PEVRecorded_value == 0x0) {
        
        write("PEV_Recorded: 0x%X << Test-case is OK >>", get_PEVRecorded_value);
        
        testStepPass("Pass","Test-case is OK");
        
      }
      else {
        
        write("PEV_Recorded: 0x%X << Test-case is NG >>", get_PEVRecorded_value);
        
        testStepFail("Fail","Test-case is NG");
      }
    }
  }
  else {
    write("OWP recording hasn't started");
    write("Stop measurement"); stop();
  }  
  
  write("Run Capture_Graphics()"); Capture_Graphics();  
  
  Init();
  
  @panel::Switch_CGWNM = 0;
  
  write("=== FINISH CCS_008_9 ===");
}

testcase CCS_008_10() {
  testStep("Notifications","Start test-case CCS_008_10");
  write("=== START CCS_008_10 ==="); 
  
  Begin();  
  
  write("=== SETTING ===");
  
  Alarm_state = 0xB;
  
  write("KEY ON"); KEY_state = 0x1; testWaitForTimeout(3000);
  
  do {
    
    Enter_BLTN_CAM(); testWaitForTimeout(3000);
    
    if ($BLTN_CAM_RecSet_OWP == 0x1) {write("OWP On"); @panel::LED_Ctrl_SetOWP = 1; testWaitForTimeout(500);}
    if ($BLTN_CAM_RecSet_PEV == 0x1) {write("PEV On"); @panel::LED_Ctrl_SetPEV = 1; testWaitForTimeout(500);}
    if ($BLTN_CAM_Set_PEV_AppNoti == 0x1) {write("App Noti On"); @panel::Button_AppNoti_PEV = 1; testWaitForTimeout(500);}
    
    Exit_BLTN_CAM(); testWaitForTimeout(3000);
    flag_RecSet_error++;
    
  } while (($BLTN_CAM_RecSet_OWP == 0x1 || $BLTN_CAM_RecSet_PEV == 0x1 || $BLTN_CAM_Set_PEV_AppNoti == 0x1) && (flag_RecSet_error < 15));
  
  write("=== TESTING ===");
  
  write("KEY OFF"); KEY_state = 0x0;
  
  if (testWaitForSignalChange(BLTN_CAM_RecSta_OWP,10000) == 1) {
    
    write("OWP recording is started"); @panel::Switch_CGWNM = 1;
    
    testWaitForTimeout(5000); send_BAlarm_BglrAlrmCurrentSta_timer.cancel(); testWaitForTimeout(5000);
    
    openPanel("Note");
    
    if (testWaitForSignalChange(BLTN_CAM_RecSta_PEV,20000) == 1) {
      
      write("PEV recording is started"); closePanel("Note");
      
      get_PEVRecorded_change = testWaitForSignalChange(BLTN_CAM_PEV_Recorded,10000);
      
      get_PEVRecorded_value = $BLTN_CAM_PEV_Recorded;
      
      if (get_PEVRecorded_change == 1 && get_PEVRecorded_value == 0x2) {
        
        write("PEV_Recorded: 0x%X << Test-case is OK >>", get_PEVRecorded_value);
        
        testStepPass("Pass","Test-case is OK");
        
      }
      else {
        
        write("PEV_Recorded: 0x%X << Test-case is NG >>", get_PEVRecorded_value);
        
        testStepFail("Fail","Test-case is NG");
      }
    }
  }
  else {
    write("OWP recording hasn't started");
    write("Stop measurement"); stop();
  }
  
  write("Run Capture_Graphics()"); Capture_Graphics();  
  
  Init();
  
  @panel::Switch_CGWNM = 0;
  
  write("=== FINISH CCS_008_10 ===");  
}

testcase CCS_008_11() {
  testStep("Notifications","Start test-case CCS_008_11");
  write("=== START CCS_008_11 ===");  
  
  Begin();  
  
  write("=== SETTING ===");
  Alarm_state = 0x1; 
  testWaitForTimeout(2000);
  Alarm_state = 0xC; 
  write("KEY ON"); KEY_state = 0x1; testWaitForTimeout(3000);
  
  do {
    
    Enter_BLTN_CAM(); testWaitForTimeout(3000);
    
    if ($BLTN_CAM_RecSet_OWP == 0x1) {write("OWP On"); @panel::LED_Ctrl_SetOWP = 1; testWaitForTimeout(500);}
    if ($BLTN_CAM_RecSet_PEV == 0x1) {write("PEV On"); @panel::LED_Ctrl_SetPEV = 1; testWaitForTimeout(500);}
    if ($BLTN_CAM_Set_PEV_AppNoti == 0x1) {write("App Noti On"); @panel::Button_AppNoti_PEV = 1; testWaitForTimeout(500);}
    
    Exit_BLTN_CAM(); testWaitForTimeout(3000);
    flag_RecSet_error++;
    
  } while (($BLTN_CAM_RecSet_OWP == 0x1 || $BLTN_CAM_RecSet_PEV == 0x1 || $BLTN_CAM_Set_PEV_AppNoti == 0x1) && (flag_RecSet_error < 15));
  
  write("=== TESTING ===");
  
  write("KEY OFF"); KEY_state = 0x0;
  
  if (testWaitForSignalChange(BLTN_CAM_RecSta_OWP,10000) == 1) {
    
    write("OWP recording is started"); @panel::Switch_CGWNM = 1;
    
    testWaitForTimeout(10000);
    
    openPanel("Note");
    
    if (testWaitForSignalChange(BLTN_CAM_RecSta_PEV,20000) == 1) {
      
      write("PEV recording is started"); closePanel("Note");
      
      get_PEVRecorded_change = testWaitForSignalChange(BLTN_CAM_PEV_Recorded,10000);
      
      get_PEVRecorded_value = $BLTN_CAM_PEV_Recorded;
      
      if (get_PEVRecorded_change != 1 && get_PEVRecorded_value == 0x0) {
        
        write("PEV_Recorded: 0x%X << Test-case is OK >>", get_PEVRecorded_value);
        
        testStepPass("Pass","Test-case is OK");
        
      }
      else {
        
        write("PEV_Recorded: 0x%X << Test-case is NG >>", get_PEVRecorded_value);
        
        testStepFail("Fail","Test-case is NG");
      }
    }
  }
  else {
    write("OWP recording hasn't started");
    write("Stop measurement"); stop();
  }
  
  write("Run Capture_Graphics()"); Capture_Graphics();  
  
  Init();
  
  @panel::Switch_CGWNM = 0;
  
  write("=== FINISH CCS_008_11 ===");
}

testcase CCS_008_12() {
  testStep("Notifications","Start test-case CCS_008_12");
  write("=== START CCS_008_12 ==="); 
  
  Begin();  
  
  write("=== SETTING ===");
  
  Alarm_state = 0xC; 
  write("KEY ON"); KEY_state = 0x1; testWaitForTimeout(3000);
  
  do {
    
    Enter_BLTN_CAM(); testWaitForTimeout(3000);
    
    if ($BLTN_CAM_RecSet_OWP == 0x1) {write("OWP On"); @panel::LED_Ctrl_SetOWP = 1; testWaitForTimeout(500);}
    if ($BLTN_CAM_RecSet_PEV == 0x1) {write("PEV On"); @panel::LED_Ctrl_SetPEV = 1; testWaitForTimeout(500);}
    if ($BLTN_CAM_Set_PEV_AppNoti == 0x1) {write("App Noti On"); @panel::Button_AppNoti_PEV = 1; testWaitForTimeout(500);}
    
    Exit_BLTN_CAM(); testWaitForTimeout(3000);
    flag_RecSet_error++;
    
  } while (($BLTN_CAM_RecSet_OWP == 0x1 || $BLTN_CAM_RecSet_PEV == 0x1 || $BLTN_CAM_Set_PEV_AppNoti == 0x1) && (flag_RecSet_error < 15));
  
  write("=== TESTING ===");
  
  write("KEY OFF"); KEY_state = 0x0;
  
  if (testWaitForSignalChange(BLTN_CAM_RecSta_OWP,10000) == 1) {
    
    write("OWP recording is started"); @panel::Switch_CGWNM = 1;
    
    testWaitForTimeout(5000); send_BAlarm_BglrAlrmCurrentSta_timer.cancel(); testWaitForTimeout(5000);
    
    openPanel("Note");
    
    if (testWaitForSignalChange(BLTN_CAM_RecSta_PEV,20000) == 1) {
      
      write("PEV recording is started"); closePanel("Note");
      
      get_PEVRecorded_change = testWaitForSignalChange(BLTN_CAM_PEV_Recorded,10000);
      
      get_PEVRecorded_value = $BLTN_CAM_PEV_Recorded;
      
      if (get_PEVRecorded_change == 1 && get_PEVRecorded_value == 0x2) {
        
        write("PEV_Recorded: 0x%X << Test-case is OK >>", get_PEVRecorded_value);
        
        testStepPass("Pass","Test-case is OK");
        
      }
      else {
        
        write("PEV_Recorded: 0x%X << Test-case is NG >>", get_PEVRecorded_value);
        
        testStepFail("Fail","Test-case is NG");
      }
    }
  }
  else {
    write("OWP recording hasn't started");
    write("Stop measurement"); stop();
  }
  
  write("Run Capture_Graphics()"); Capture_Graphics();  
  
  Init();
  
  @panel::Switch_CGWNM = 0;
  
  write("=== FINISH CCS_008_12 ===");  
}

testcase CCS_008_13() {
  testStep("Notifications","Start test-case CCS_008_13");
  write("=== START CCS_008_13 ===");  
  
  Begin();  
  
  write("=== SETTING ===");
  Alarm_state = 0x1; 
  testWaitForTimeout(2000);
  Alarm_state = 0xD; 
  write("KEY ON"); KEY_state = 0x1; testWaitForTimeout(3000);
  
  do {
    
    Enter_BLTN_CAM(); testWaitForTimeout(3000);
    
    if ($BLTN_CAM_RecSet_OWP == 0x1) {write("OWP On"); @panel::LED_Ctrl_SetOWP = 1; testWaitForTimeout(500);}
    if ($BLTN_CAM_RecSet_PEV == 0x1) {write("PEV On"); @panel::LED_Ctrl_SetPEV = 1; testWaitForTimeout(500);}
    if ($BLTN_CAM_Set_PEV_AppNoti == 0x1) {write("App Noti On"); @panel::Button_AppNoti_PEV = 1; testWaitForTimeout(500);}
    
    Exit_BLTN_CAM(); testWaitForTimeout(3000);
    flag_RecSet_error++;
    
  } while (($BLTN_CAM_RecSet_OWP == 0x1 || $BLTN_CAM_RecSet_PEV == 0x1 || $BLTN_CAM_Set_PEV_AppNoti == 0x1) && (flag_RecSet_error < 15));
  
  write("=== TESTING ===");
  
  write("KEY OFF"); KEY_state = 0x0;
  
  if (testWaitForSignalChange(BLTN_CAM_RecSta_OWP,10000) == 1) {
    
    write("OWP recording is started"); @panel::Switch_CGWNM = 1;
    
    testWaitForTimeout(10000);
    
    openPanel("Note");
    
    if (testWaitForSignalChange(BLTN_CAM_RecSta_PEV,20000) == 1) {
      
      write("PEV recording is started"); closePanel("Note");
      
      get_PEVRecorded_change = testWaitForSignalChange(BLTN_CAM_PEV_Recorded,10000);
      
      get_PEVRecorded_value = $BLTN_CAM_PEV_Recorded;
      
      if (get_PEVRecorded_change != 1 && get_PEVRecorded_value == 0x0) {
        
        write("PEV_Recorded: 0x%X << Test-case is OK >>", get_PEVRecorded_value);
        
        testStepPass("Pass","Test-case is OK");
        
      }
      else {
        
        write("PEV_Recorded: 0x%X << Test-case is NG >>", get_PEVRecorded_value);
        
        testStepFail("Fail","Test-case is NG");
      }
    }
  }
  else {
    write("OWP recording hasn't started");
    write("Stop measurement"); stop();
  }
  
  write("Run Capture_Graphics()"); Capture_Graphics();  
  
  Init();
  
  @panel::Switch_CGWNM = 0;
  
  write("=== FINISH CCS_008_13 ===");
}

testcase CCS_008_14() {
  testStep("Notifications","Start test-case CCS_008_14");
  write("=== START CCS_008_14 ==="); 
  
  Begin();  
  
  write("=== SETTING ===");
  
  Alarm_state = 0xD; 
  write("KEY ON"); KEY_state = 0x1; testWaitForTimeout(3000);
  
  do {
    
    Enter_BLTN_CAM(); testWaitForTimeout(3000);
    
    if ($BLTN_CAM_RecSet_OWP == 0x1) {write("OWP On"); @panel::LED_Ctrl_SetOWP = 1; testWaitForTimeout(500);}
    if ($BLTN_CAM_RecSet_PEV == 0x1) {write("PEV On"); @panel::LED_Ctrl_SetPEV = 1; testWaitForTimeout(500);}
    if ($BLTN_CAM_Set_PEV_AppNoti == 0x1) {write("App Noti On"); @panel::Button_AppNoti_PEV = 1; testWaitForTimeout(500);}
    
    Exit_BLTN_CAM(); testWaitForTimeout(3000);
    flag_RecSet_error++;
    
  } while (($BLTN_CAM_RecSet_OWP == 0x1 || $BLTN_CAM_RecSet_PEV == 0x1 || $BLTN_CAM_Set_PEV_AppNoti == 0x1) && (flag_RecSet_error < 15));
  
  write("=== TESTING ===");
  
  write("KEY OFF"); KEY_state = 0x0;
  
  if (testWaitForSignalChange(BLTN_CAM_RecSta_OWP,10000) == 1) {
    
    write("OWP recording is started"); @panel::Switch_CGWNM = 1;
    
    testWaitForTimeout(5000); send_BAlarm_BglrAlrmCurrentSta_timer.cancel(); testWaitForTimeout(5000);
    
    openPanel("Note");
    
    if (testWaitForSignalChange(BLTN_CAM_RecSta_PEV,20000) == 1) {
      
      write("PEV recording is started"); closePanel("Note");
      
      get_PEVRecorded_change = testWaitForSignalChange(BLTN_CAM_PEV_Recorded,10000);
      
      get_PEVRecorded_value = $BLTN_CAM_PEV_Recorded;
      
      if (get_PEVRecorded_change == 1 && get_PEVRecorded_value == 0x2) {
        
        write("PEV_Recorded: 0x%X << Test-case is OK >>", get_PEVRecorded_value);
        
        testStepPass("Pass","Test-case is OK");
        
      }
      else {
        
        write("PEV_Recorded: 0x%X << Test-case is NG >>", get_PEVRecorded_value);
        
        testStepFail("Fail","Test-case is NG");
      }
    }
  }
  else {
    write("OWP recording hasn't started");
    write("Stop measurement"); stop();
  }
  
  write("Run Capture_Graphics()"); Capture_Graphics();  
  
  Init();
  
  @panel::Switch_CGWNM = 0;
  
  write("=== FINISH CCS_008_14 ===");  
}

testcase CCS_008_15() {
  testStep("Notifications","Start test-case CCS_008_15");
  write("=== START CCS_008_15 ===");  
  
  Begin();  
  
  write("=== SETTING ===");
  Alarm_state = 0x1; 
  testWaitForTimeout(2000);
  Alarm_state = 0xE; 
  write("KEY ON"); KEY_state = 0x1; testWaitForTimeout(3000);
  
  do {
    
    Enter_BLTN_CAM(); testWaitForTimeout(3000);
    
    if ($BLTN_CAM_RecSet_OWP == 0x1) {write("OWP On"); @panel::LED_Ctrl_SetOWP = 1; testWaitForTimeout(500);}
    if ($BLTN_CAM_RecSet_PEV == 0x1) {write("PEV On"); @panel::LED_Ctrl_SetPEV = 1; testWaitForTimeout(500);}
    if ($BLTN_CAM_Set_PEV_AppNoti == 0x1) {write("App Noti On"); @panel::Button_AppNoti_PEV = 1; testWaitForTimeout(500);}
    
    Exit_BLTN_CAM(); testWaitForTimeout(3000);
    flag_RecSet_error++;
    
  } while (($BLTN_CAM_RecSet_OWP == 0x1 || $BLTN_CAM_RecSet_PEV == 0x1 || $BLTN_CAM_Set_PEV_AppNoti == 0x1) && (flag_RecSet_error < 15));
  
  write("=== TESTING ===");
  
  write("KEY OFF"); KEY_state = 0x0;
  
  if (testWaitForSignalChange(BLTN_CAM_RecSta_OWP,10000) == 1) {
    
    write("OWP recording is started"); @panel::Switch_CGWNM = 1;
    
    testWaitForTimeout(10000);
    
    openPanel("Note");
    
    if (testWaitForSignalChange(BLTN_CAM_RecSta_PEV,20000) == 1) {
      
      write("PEV recording is started"); closePanel("Note");
      
      get_PEVRecorded_change = testWaitForSignalChange(BLTN_CAM_PEV_Recorded,10000);
      
      get_PEVRecorded_value = $BLTN_CAM_PEV_Recorded;
      
      if (get_PEVRecorded_change != 1 && get_PEVRecorded_value == 0x0) {
        
        write("PEV_Recorded: 0x%X << Test-case is OK >>", get_PEVRecorded_value);
        
        testStepPass("Pass","Test-case is OK");
        
      }
      else {
        
        write("PEV_Recorded: 0x%X << Test-case is NG >>", get_PEVRecorded_value);
        
        testStepFail("Fail","Test-case is NG");
      }
    }
  }
  else {
    write("OWP recording hasn't started");
    write("Stop measurement"); stop();
  }
  
  write("Run Capture_Graphics()"); Capture_Graphics();  
  
  Init();
  
  @panel::Switch_CGWNM = 0;
  
  write("=== FINISH CCS_008_15 ===");
}

testcase CCS_008_16() {
  testStep("Notifications","Start test-case CCS_008_16");
  write("=== START CCS_008_16 ==="); 
  
  Begin();  
  
  write("=== SETTING ===");
  
  Alarm_state = 0xE; 
  write("KEY ON"); KEY_state = 0x1; testWaitForTimeout(3000);
  
  do {
    
    Enter_BLTN_CAM(); testWaitForTimeout(3000);
    
    if ($BLTN_CAM_RecSet_OWP == 0x1) {write("OWP On"); @panel::LED_Ctrl_SetOWP = 1; testWaitForTimeout(500);}
    if ($BLTN_CAM_RecSet_PEV == 0x1) {write("PEV On"); @panel::LED_Ctrl_SetPEV = 1; testWaitForTimeout(500);}
    if ($BLTN_CAM_Set_PEV_AppNoti == 0x1) {write("App Noti On"); @panel::Button_AppNoti_PEV = 1; testWaitForTimeout(500);}
    
    Exit_BLTN_CAM(); testWaitForTimeout(3000);
    flag_RecSet_error++;
    
  } while (($BLTN_CAM_RecSet_OWP == 0x1 || $BLTN_CAM_RecSet_PEV == 0x1 || $BLTN_CAM_Set_PEV_AppNoti == 0x1) && (flag_RecSet_error < 15));
  
  write("=== TESTING ===");
  
  write("KEY OFF"); KEY_state = 0x0;
  
  if (testWaitForSignalChange(BLTN_CAM_RecSta_OWP,10000) == 1) {
    
    write("OWP recording is started"); @panel::Switch_CGWNM = 1;
    
    testWaitForTimeout(5000); send_BAlarm_BglrAlrmCurrentSta_timer.cancel(); testWaitForTimeout(5000);
    
    openPanel("Note");
    
    if (testWaitForSignalChange(BLTN_CAM_RecSta_PEV,20000) == 1) {
      
      write("PEV recording is started"); closePanel("Note");
      
      get_PEVRecorded_change = testWaitForSignalChange(BLTN_CAM_PEV_Recorded,10000);
      
      get_PEVRecorded_value = $BLTN_CAM_PEV_Recorded;
      
      if (get_PEVRecorded_change == 1 && get_PEVRecorded_value == 0x2) {
        
        write("PEV_Recorded: 0x%X << Test-case is OK >>", get_PEVRecorded_value);
        
        testStepPass("Pass","Test-case is OK");
        
      }
      else {
        
        write("PEV_Recorded: 0x%X << Test-case is NG >>", get_PEVRecorded_value);
        
        testStepFail("Fail","Test-case is NG");
      }
    }
  }
  else {
    write("OWP recording hasn't started");
    write("Stop measurement"); stop();
  }
  
  write("Run Capture_Graphics()"); Capture_Graphics();  
  
  Init();
  
  @panel::Switch_CGWNM = 0;
  
  write("=== FINISH CCS_008_16 ===");  
}

void MainTest() {
  
  Begin();
  
  KEY_state = 0x1; testWaitForTimeout(3000);
  
  if ($BLTN_CAM_RecSet_OWD == 0x1 || $BLTN_CAM_RecSet_OWP == 0x1 || $BLTN_CAM_RecSet_DEV == 0x1 || $BLTN_CAM_RecSet_PEV == 0x1) {
    
    write("Run Set_All_Recording_OFF()"); Set_All_Recording_OFF();
  
  }
  else {
    
    write("All settings are set to Off");
  
  }
  
  KEY_state = 0x0;
  
  TestWaitForValueInput("Please enter the test ID (1/2/3/4/5/6/7/8/9/10/11/12/13/14/15/16/17)", 300000);
  switch (TestGetValueInput()){
    
   case(1) : CCS_008_1(); break;
   case(2) : CCS_008_2(); break;
   case(3) : CCS_008_3(); break; 
   case(4) : CCS_008_4(); break;
   case(5) : CCS_008_5(); break;
   case(6) : CCS_008_6(); break;
   case(7) : CCS_008_7(); break;
   case(8) : CCS_008_8(); break;     
   case(9) : CCS_008_9(); break;
   case(10) : CCS_008_10(); break;
   case(11) : CCS_008_11(); break; 
   case(12) : CCS_008_12(); break;     
   case(13) : CCS_008_13(); break;
   case(14) : CCS_008_14(); break;     
   case(15) : CCS_008_15(); break;
   case(16) : CCS_008_16(); break;
   case(17) : CCS_008_1(); CCS_008_2(); CCS_008_3(); CCS_008_4(); CCS_008_5(); CCS_008_6(); CCS_008_7(); CCS_008_8(); CCS_008_9(); CCS_008_10(); CCS_008_11(); CCS_008_12(); CCS_008_13(); CCS_008_14(); CCS_008_15(); CCS_008_16(); 
   break;  
     
  }      
  
}