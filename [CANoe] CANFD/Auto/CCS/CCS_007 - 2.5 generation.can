/*@!Encoding:65001*/
// Preconditions: - Block CCU, ACC and IGN and ccNC/ccIC switch OFF state, AVN mode
includes
{
  
  #include "DeclarationFunction_Gen2.5.h"
  
}

variables
{
  // Message Declaration
  // CAN FD
  message HU_BLTN_CAM_01_00ms _HU_BLTN_CAM_01_00ms;
  message HU_BLTN_CAM_02_200ms _HU_BLTN_CAM_02_200ms;
  message BDC_FD_SMK_03_200ms _BDC_FD_SMK_03_200ms;
  message PDC_FD_10_200ms _PDC_FD_10_200ms;
  message IAU_FD_04_200ms _IAU_FD_04_200ms;
  message PDC_FD_11_200ms _PDC_FD_11_200ms;
  message BDC_FD_04_200ms _BDC_FD_04_200ms;
  //Global Variable Declaration
  // Global Variable Declaration
  int i;
  int flag = 0;
  int flag_RecSet_error = 0;
  int condition1 = 0, condition2 = 0, condition3 = 0;
  byte KEY_state = 0x0;
  byte Profile_value = 0x1;
  byte Mode_state = 0x2;
  byte Bat_val = 0x50; 
  byte Alarm_state = 0x0; 
  int get_PEVRecorded_change = 0;
  byte get_PEVRecorded_value = 0x0;
  // Timer Declaration  
  msTimer send_SMK_TrmnlCtrlGrpStaBDC_timer;
  msTimer send_ICU_PowerAutoCutModSta_timer;
  msTimer send_IAU_ProfileIDRVal_timer;
  msTimer send_ICU_BS2SoC_timer;
  msTimer send_BAlarm_BglrAlrmCurrentSta_timer;
}

void Capture_Graphics() {
  testWaitForTimeout(3000);
  testReportAddWindowCapture("Graphics 2","","BLTN_CAM_RecSta_OWP;BLTN_CAM_RecSta_PEV;BLTN_CAM_PEV_Recorded;BAlarm_BglrAlrm_CurrentSta","./envidence.jpg");  
}

on timer send_BAlarm_BglrAlrmCurrentSta_timer {
  _BDC_FD_04_200ms.BAlarm_BglrAlrm_CurrentSta = Alarm_state;      
  output(_BDC_FD_04_200ms);  
  send_BAlarm_BglrAlrmCurrentSta_timer.set(200);
}

on timer send_SMK_TrmnlCtrlGrpStaBDC_timer {
  _BDC_FD_SMK_03_200ms.SMK_TrmnlCtrlGrpStaBDC = KEY_state; //IGN
  output(_BDC_FD_SMK_03_200ms);
  send_SMK_TrmnlCtrlGrpStaBDC_timer.set(200);
}

on timer send_IAU_ProfileIDRVal_timer {
  _IAU_FD_04_200ms.IAU_ProfileIDRVal = Profile_value;
  output(_IAU_FD_04_200ms);
  send_IAU_ProfileIDRVal_timer.set(200);
}

on timer send_ICU_PowerAutoCutModSta_timer {
  _PDC_FD_10_200ms.ICU_PowerAutoCutModSta = Mode_state;
  output(_PDC_FD_10_200ms);
  send_ICU_PowerAutoCutModSta_timer.set(200);
}

on timer send_ICU_BS2SoC_timer {
  _PDC_FD_11_200ms.ICU_BS2SoC = Bat_val;
  output(_PDC_FD_11_200ms);
  send_ICU_BS2SoC_timer.set(200);
}

testcase CCS_007_1() {
  testStep("Notifications","Start test-case CCS_007_1");
  write("=== START CCS_007_1 ===");  
  
  write("=== SETTING ===");
  
  Alarm_state = 0x2; 
  write("KEY ON"); KEY_state = 0x1; testWaitForTimeout(3000);
  
  do {
    
    Enter_BLTN_CAM(); testWaitForTimeout(3000);
    
    if ($BLTN_CAM_RecSet_OWP == 0x1) {write("OWP On"); @panel::LED_Ctrl_SetOWP = 1; testWaitForTimeout(500);}
    if ($BLTN_CAM_RecSet_PEV == 0x1) {write("PEV On"); @panel::LED_Ctrl_SetPEV = 1; testWaitForTimeout(500);}
    if ($BLTN_CAM_Set_PEV_AppNoti == 0x1) {write("App Noti On"); @panel::Button_AppNoti_PEV = 1; testWaitForTimeout(500);}
    
    Exit_BLTN_CAM(); testWaitForTimeout(3000);
    flag_RecSet_error++;
    
  } while (($BLTN_CAM_RecSet_OWP == 0x1 || $BLTN_CAM_RecSet_PEV == 0x1 || $BLTN_CAM_Set_PEV_AppNoti == 0x1) && (flag_RecSet_error < 15));
  
  write("=== TESTING ===");
  
  write("KEY OFF"); KEY_state = 0x0;
  
  if (testWaitForSignalChange(BLTN_CAM_RecSta_OWP,10000) == 1) {
    
    write("OWP recording is started"); @panel::Switch_CGWNM = 1;
    
    testWaitForTimeout(10000);
    
    openPanel("Note");
    
    if (testWaitForSignalChange(BLTN_CAM_RecSta_PEV,20000) == 1) {
      
      write("PEV recording is started"); closePanel("Note");
      
      get_PEVRecorded_change = testWaitForSignalChange(BLTN_CAM_PEV_Recorded,10000);
      
      get_PEVRecorded_value = $BLTN_CAM_PEV_Recorded;
      
      if (get_PEVRecorded_change == 1 && get_PEVRecorded_value == 0x2) {
        
        write("PEV_Recorded: 0x%X << Test-case is OK >>", get_PEVRecorded_value);
        
        testStepPass("Pass","Test-case is OK");
        
      }
      else {
        
        write("PEV_Recorded: 0x%X << Test-case is NG >>", get_PEVRecorded_value);
        
        testStepFail("Fail","Test-case is NG");
      }
    }
  }
  else {
    write("OWP recording hasn't started");
    write("Stop measurement"); stop();
  }
  
  write("Run Capture_Graphics()"); Capture_Graphics();
  
  Init();
  
  @panel::Switch_CGWNM = 0;
  
  write("=== FINISH CCS_007_1 ===");
}

testcase CCS_007_2() {
  testStep("Notifications","Start test-case CCS_007_2");
  write("=== START CCS_007_2 ==="); 
  
  Begin();  
  
  write("=== SETTING ===");
  
  Alarm_state = 0x2; 
  write("KEY ON"); KEY_state = 0x1; testWaitForTimeout(3000);
  
  do {
    
    Enter_BLTN_CAM(); testWaitForTimeout(3000);
    
    if ($BLTN_CAM_RecSet_OWP == 0x1) {write("OWP On"); @panel::LED_Ctrl_SetOWP = 1; testWaitForTimeout(500);}
    if ($BLTN_CAM_RecSet_PEV == 0x1) {write("PEV On"); @panel::LED_Ctrl_SetPEV = 1; testWaitForTimeout(500);}
    if ($BLTN_CAM_Set_PEV_AppNoti == 0x1) {write("App Noti On"); @panel::Button_AppNoti_PEV = 1; testWaitForTimeout(500);}
    
    Exit_BLTN_CAM(); testWaitForTimeout(3000);
    flag_RecSet_error++;
    
  } while (($BLTN_CAM_RecSet_OWP == 0x1 || $BLTN_CAM_RecSet_PEV == 0x1 || $BLTN_CAM_Set_PEV_AppNoti == 0x1) && (flag_RecSet_error < 15));
  
  write("=== TESTING ===");
  
  write("KEY OFF"); KEY_state = 0x0;
  
  if (testWaitForSignalChange(BLTN_CAM_RecSta_OWP,10000) == 1) {
    
    write("OWP recording is started"); @panel::Switch_CGWNM = 1;
    
    testWaitForTimeout(5000); send_BAlarm_BglrAlrmCurrentSta_timer.cancel(); testWaitForTimeout(5000);
    
    openPanel("Note");
    
    if (testWaitForSignalChange(BLTN_CAM_RecSta_PEV,20000) == 1) {
      
      write("PEV recording is started"); closePanel("Note");
      
      get_PEVRecorded_change = testWaitForSignalChange(BLTN_CAM_PEV_Recorded,10000);
      
      get_PEVRecorded_value = $BLTN_CAM_PEV_Recorded;
      
      if (get_PEVRecorded_change == 1 && get_PEVRecorded_value == 0x2) {
        
        write("PEV_Recorded: 0x%X << Test-case is OK >>", get_PEVRecorded_value);
        
        testStepPass("Pass","Test-case is OK");
        
      }
      else {
        
        write("PEV_Recorded: 0x%X << Test-case is NG >>", get_PEVRecorded_value);
        
        testStepFail("Fail","Test-case is NG");
      }
    }
  }
  else {
    write("OWP recording hasn't started");
    write("Stop measurement"); stop();
  }  
  
  write("Run Capture_Graphics()"); Capture_Graphics();  
  
  Init();
  
  @panel::Switch_CGWNM = 0;
  
  write("=== FINISH CCS_007_2 ===");  
}

testcase CCS_007_3() {
  testStep("Notifications","Start test-case CCS_007_3");
  write("=== START CCS_007_3 ===");  
  
  Begin();  
  
  write("=== SETTING ===");
  
  Alarm_state = 0x6; 
  write("KEY ON"); KEY_state = 0x1; testWaitForTimeout(3000);
  
  do {
    
    Enter_BLTN_CAM(); testWaitForTimeout(3000);
    
    if ($BLTN_CAM_RecSet_OWP == 0x1) {write("OWP On"); @panel::LED_Ctrl_SetOWP = 1; testWaitForTimeout(500);}
    if ($BLTN_CAM_RecSet_PEV == 0x1) {write("PEV On"); @panel::LED_Ctrl_SetPEV = 1; testWaitForTimeout(500);}
    if ($BLTN_CAM_Set_PEV_AppNoti == 0x1) {write("App Noti On"); @panel::Button_AppNoti_PEV = 1; testWaitForTimeout(500);}
    
    Exit_BLTN_CAM(); testWaitForTimeout(3000);
    flag_RecSet_error++;
    
  } while (($BLTN_CAM_RecSet_OWP == 0x1 || $BLTN_CAM_RecSet_PEV == 0x1 || $BLTN_CAM_Set_PEV_AppNoti == 0x1) && (flag_RecSet_error < 15));
  
  write("=== TESTING ===");
  
  write("KEY OFF"); KEY_state = 0x0;
  
  if (testWaitForSignalChange(BLTN_CAM_RecSta_OWP,10000) == 1) {
    
    write("OWP recording is started"); @panel::Switch_CGWNM = 1;
    
    testWaitForTimeout(10000);
    
    openPanel("Note");
    
    if (testWaitForSignalChange(BLTN_CAM_RecSta_PEV,20000) == 1) {
      
      write("PEV recording is started"); closePanel("Note");
      
      get_PEVRecorded_change = testWaitForSignalChange(BLTN_CAM_PEV_Recorded,10000);
      
      get_PEVRecorded_value = $BLTN_CAM_PEV_Recorded;
      
      if (get_PEVRecorded_change == 1 && get_PEVRecorded_value == 0x2) {
        
        write("PEV_Recorded: 0x%X << Test-case is OK >>", get_PEVRecorded_value);
        
        testStepPass("Pass","Test-case is OK");
        
      }
      else {
        
        write("PEV_Recorded: 0x%X << Test-case is NG >>", get_PEVRecorded_value);
        
        testStepFail("Fail","Test-case is NG");
      }
    }
  }
  else {
    write("OWP recording hasn't started");
    write("Stop measurement"); stop();
  }  
  
  write("Run Capture_Graphics()"); Capture_Graphics();  
  
  Init();
  
  @panel::Switch_CGWNM = 0;
  
  write("=== FINISH CCS_007_3 ===");
}

testcase CCS_007_4() {
  testStep("Notifications","Start test-case CCS_007_4");
  write("=== START CCS_007_4 ==="); 
  
  Begin();  
  
  write("=== SETTING ===");
  
  Alarm_state = 0x6; 
  write("KEY ON"); KEY_state = 0x1; testWaitForTimeout(3000);
  
  do {
    
    Enter_BLTN_CAM(); testWaitForTimeout(3000);
    
    if ($BLTN_CAM_RecSet_OWP == 0x1) {write("OWP On"); @panel::LED_Ctrl_SetOWP = 1; testWaitForTimeout(500);}
    if ($BLTN_CAM_RecSet_PEV == 0x1) {write("PEV On"); @panel::LED_Ctrl_SetPEV = 1; testWaitForTimeout(500);}
    if ($BLTN_CAM_Set_PEV_AppNoti == 0x1) {write("App Noti On"); @panel::Button_AppNoti_PEV = 1; testWaitForTimeout(500);}
    
    Exit_BLTN_CAM(); testWaitForTimeout(3000);
    flag_RecSet_error++;
    
  } while (($BLTN_CAM_RecSet_OWP == 0x1 || $BLTN_CAM_RecSet_PEV == 0x1 || $BLTN_CAM_Set_PEV_AppNoti == 0x1) && (flag_RecSet_error < 15));
  
  write("=== TESTING ===");
  
  write("KEY OFF"); KEY_state = 0x0;
  
  if (testWaitForSignalChange(BLTN_CAM_RecSta_OWP,10000) == 1) {
    
    write("OWP recording is started"); @panel::Switch_CGWNM = 1;
    
    testWaitForTimeout(5000); send_BAlarm_BglrAlrmCurrentSta_timer.cancel(); testWaitForTimeout(5000);
    
    openPanel("Note");
    
    if (testWaitForSignalChange(BLTN_CAM_RecSta_PEV,20000) == 1) {
      
      write("PEV recording is started"); closePanel("Note");
      
      get_PEVRecorded_change = testWaitForSignalChange(BLTN_CAM_PEV_Recorded,10000);
      
      get_PEVRecorded_value = $BLTN_CAM_PEV_Recorded;
      
      if (get_PEVRecorded_change == 1 && get_PEVRecorded_value == 0x2) {
        
        write("PEV_Recorded: 0x%X << Test-case is OK >>", get_PEVRecorded_value);
        
        testStepPass("Pass","Test-case is OK");
        
      }
      else {
        
        write("PEV_Recorded: 0x%X << Test-case is NG >>", get_PEVRecorded_value);
        
        testStepFail("Fail","Test-case is NG");
      }
    }
  }
  else {
    write("OWP recording hasn't started");
    write("Stop measurement"); stop();
  }
  
  write("Run Capture_Graphics()"); Capture_Graphics();  
  
  Init();
  
  @panel::Switch_CGWNM = 0;
  
  write("=== FINISH CCS_007_4 ===");  
}

testcase CCS_007_5() {
  testStep("Notifications","Start test-case CCS_007_5");
  write("=== START CCS_007_5 ===");  
  
  Begin();  
  
  write("=== SETTING ===");

  write("KEY ON"); KEY_state = 0x1; testWaitForTimeout(3000);
  
  do {
    
    Enter_BLTN_CAM(); testWaitForTimeout(3000);
    
    if ($BLTN_CAM_RecSet_OWP == 0x1) {write("OWP On"); @panel::LED_Ctrl_SetOWP = 1; testWaitForTimeout(500);}
    if ($BLTN_CAM_RecSet_PEV == 0x1) {write("PEV On"); @panel::LED_Ctrl_SetPEV = 1; testWaitForTimeout(500);}
    if ($BLTN_CAM_Set_PEV_AppNoti == 0x1) {write("App Noti On"); @panel::Button_AppNoti_PEV = 1; testWaitForTimeout(500);}
    
    Exit_BLTN_CAM(); testWaitForTimeout(3000);
    flag_RecSet_error++;
    
  } while (($BLTN_CAM_RecSet_OWP == 0x1 || $BLTN_CAM_RecSet_PEV == 0x1 || $BLTN_CAM_Set_PEV_AppNoti == 0x1) && (flag_RecSet_error < 15));
  
  write("=== TESTING ===");
  
  write("KEY OFF"); KEY_state = 0x0;
  
  if (testWaitForSignalChange(BLTN_CAM_RecSta_OWP,10000) == 1) {
    
    write("OWP recording is started"); @panel::Switch_CGWNM = 1;
    
    testWaitForTimeout(10000);  Alarm_state = 0x9; 
 
    if (testWaitForSignalChange(BLTN_CAM_RecSta_PEV,20000) == 1) {
      
      write("PEV recording is started");
      
      get_PEVRecorded_change = testWaitForSignalChange(BLTN_CAM_PEV_Recorded,10000);
      
      get_PEVRecorded_value = $BLTN_CAM_PEV_Recorded;
      
      if (get_PEVRecorded_change == 1 && get_PEVRecorded_value == 0x2) {
        
        write("PEV_Recorded: 0x%X << Test-case is OK >>", get_PEVRecorded_value);
        
        testStepPass("Pass","Test-case is OK");
        
      }
      else {
        
        write("PEV_Recorded: 0x%X << Test-case is NG >>", get_PEVRecorded_value);
        
        testStepFail("Fail","Test-case is NG");
      }
    }
  }
  else {
    write("OWP recording hasn't started");
    write("Stop measurement"); stop();
  }  
  
  write("Run Capture_Graphics()"); Capture_Graphics();  
  
  Init();
  
  @panel::Switch_CGWNM = 0;
  
  write("=== FINISH CCS_007_5 ===");
}

testcase CCS_007_6() {
  testStep("Notifications","Start test-case CCS_007_6");
  write("=== START CCS_007_6 ==="); 
  
  Begin();  
  
  write("=== SETTING ===");
  
  Alarm_state = 0x9; 
  write("KEY ON"); KEY_state = 0x1; testWaitForTimeout(3000);
  
  do {
    
    Enter_BLTN_CAM(); testWaitForTimeout(3000);
    
    if ($BLTN_CAM_RecSet_OWP == 0x1) {write("OWP On"); @panel::LED_Ctrl_SetOWP = 1; testWaitForTimeout(500);}
    if ($BLTN_CAM_RecSet_PEV == 0x1) {write("PEV On"); @panel::LED_Ctrl_SetPEV = 1; testWaitForTimeout(500);}
    if ($BLTN_CAM_Set_PEV_AppNoti == 0x1) {write("App Noti On"); @panel::Button_AppNoti_PEV = 1; testWaitForTimeout(500);}
    
    Exit_BLTN_CAM(); testWaitForTimeout(3000);
    flag_RecSet_error++;
    
  } while (($BLTN_CAM_RecSet_OWP == 0x1 || $BLTN_CAM_RecSet_PEV == 0x1 || $BLTN_CAM_Set_PEV_AppNoti == 0x1) && (flag_RecSet_error < 15));
  
  write("=== TESTING ===");
  
  write("KEY OFF"); KEY_state = 0x0;
  
  if (testWaitForSignalChange(BLTN_CAM_RecSta_OWP,10000) == 1) {
    
    write("OWP recording is started"); @panel::Switch_CGWNM = 1;
    
    testWaitForTimeout(5000); send_BAlarm_BglrAlrmCurrentSta_timer.cancel(); testWaitForTimeout(5000);
    
    openPanel("Note");
    
    if (testWaitForSignalChange(BLTN_CAM_RecSta_PEV,20000) == 1) {
      
      write("PEV recording is started"); closePanel("Note");
      
      get_PEVRecorded_change = testWaitForSignalChange(BLTN_CAM_PEV_Recorded,10000);
      
      get_PEVRecorded_value = $BLTN_CAM_PEV_Recorded;
      
      if (get_PEVRecorded_change == 1 && get_PEVRecorded_value == 0x2) {
        
        write("PEV_Recorded: 0x%X << Test-case is OK >>", get_PEVRecorded_value);
        
        testStepPass("Pass","Test-case is OK");
        
      }
      else {
        
        write("PEV_Recorded: 0x%X << Test-case is NG >>", get_PEVRecorded_value);
        
        testStepFail("Fail","Test-case is NG");
      }
    }
  }
  else {
    write("OWP recording hasn't started");
    write("Stop measurement"); stop();
  }  
  
  write("Run Capture_Graphics()"); Capture_Graphics();  
  
  Init();
  
  @panel::Switch_CGWNM = 0;
  
  write("=== FINISH CCS_007_6 ===");  
}

testcase CCS_007_7() {
  testStep("Notifications","Start test-case CCS_007_7");
  write("=== START CCS_007_7 ===");  
  
  Begin();  
  
  write("=== SETTING ===");
  
  Alarm_state = 0xF; 
  write("KEY ON"); KEY_state = 0x1; testWaitForTimeout(3000);
  
  do {
    
    Enter_BLTN_CAM(); testWaitForTimeout(3000);
    
    if ($BLTN_CAM_RecSet_OWP == 0x1) {write("OWP On"); @panel::LED_Ctrl_SetOWP = 1; testWaitForTimeout(500);}
    if ($BLTN_CAM_RecSet_PEV == 0x1) {write("PEV On"); @panel::LED_Ctrl_SetPEV = 1; testWaitForTimeout(500);}
    if ($BLTN_CAM_Set_PEV_AppNoti == 0x1) {write("App Noti On"); @panel::Button_AppNoti_PEV = 1; testWaitForTimeout(500);}
    
    Exit_BLTN_CAM(); testWaitForTimeout(3000);
    flag_RecSet_error++;
    
  } while (($BLTN_CAM_RecSet_OWP == 0x1 || $BLTN_CAM_RecSet_PEV == 0x1 || $BLTN_CAM_Set_PEV_AppNoti == 0x1) && (flag_RecSet_error < 15));
  
  write("=== TESTING ===");
  
  write("KEY OFF"); KEY_state = 0x0;
  
  if (testWaitForSignalChange(BLTN_CAM_RecSta_OWP,10000) == 1) {
    
    write("OWP recording is started"); @panel::Switch_CGWNM = 1;
    
    testWaitForTimeout(10000);
    
    openPanel("Note");
    
    if (testWaitForSignalChange(BLTN_CAM_RecSta_PEV,20000) == 1) {
      
      write("PEV recording is started"); closePanel("Note");
      
      get_PEVRecorded_change = testWaitForSignalChange(BLTN_CAM_PEV_Recorded,10000);
      
      get_PEVRecorded_value = $BLTN_CAM_PEV_Recorded;
      
      if (get_PEVRecorded_change == 1 && get_PEVRecorded_value == 0x2) {
        
        write("PEV_Recorded: 0x%X << Test-case is OK >>", get_PEVRecorded_value);
        
        testStepPass("Pass","Test-case is OK");
        
      }
      else {
        
        write("PEV_Recorded: 0x%X << Test-case is NG >>", get_PEVRecorded_value);
        
        testStepFail("Fail","Test-case is NG");
      }
    }
  }
  else {
    write("OWP recording hasn't started");
    write("Stop measurement"); stop();
  }
  
  write("Run Capture_Graphics()"); Capture_Graphics();  
  
  Init();
  
  @panel::Switch_CGWNM = 0;
  
  write("=== FINISH CCS_007_7 ===");
}

testcase CCS_007_8() {
  testStep("Notifications","Start test-case CCS_007_8");
  write("=== START CCS_007_8 ==="); 
  
  Begin();  
  
  write("=== SETTING ===");
  
  Alarm_state = 0xF; 
  write("KEY ON"); KEY_state = 0x1; testWaitForTimeout(3000);
  
  do {
    
    Enter_BLTN_CAM(); testWaitForTimeout(3000);
    
    if ($BLTN_CAM_RecSet_OWP == 0x1) {write("OWP On"); @panel::LED_Ctrl_SetOWP = 1; testWaitForTimeout(500);}
    if ($BLTN_CAM_RecSet_PEV == 0x1) {write("PEV On"); @panel::LED_Ctrl_SetPEV = 1; testWaitForTimeout(500);}
    if ($BLTN_CAM_Set_PEV_AppNoti == 0x1) {write("App Noti On"); @panel::Button_AppNoti_PEV = 1; testWaitForTimeout(500);}
    
    Exit_BLTN_CAM(); testWaitForTimeout(3000);
    flag_RecSet_error++;
    
  } while (($BLTN_CAM_RecSet_OWP == 0x1 || $BLTN_CAM_RecSet_PEV == 0x1 || $BLTN_CAM_Set_PEV_AppNoti == 0x1) && (flag_RecSet_error < 15));
  
  write("=== TESTING ===");
  
  write("KEY OFF"); KEY_state = 0x0;
  
  if (testWaitForSignalChange(BLTN_CAM_RecSta_OWP,10000) == 1) {
    
    write("OWP recording is started"); @panel::Switch_CGWNM = 1;
    
    testWaitForTimeout(5000); send_BAlarm_BglrAlrmCurrentSta_timer.cancel(); testWaitForTimeout(5000);
    
    openPanel("Note");
    
    if (testWaitForSignalChange(BLTN_CAM_RecSta_PEV,20000) == 1) {
      
      write("PEV recording is started"); closePanel("Note");
      
      get_PEVRecorded_change = testWaitForSignalChange(BLTN_CAM_PEV_Recorded,10000);
      
      get_PEVRecorded_value = $BLTN_CAM_PEV_Recorded;
      
      if (get_PEVRecorded_change == 1 && get_PEVRecorded_value == 0x2) {
        
        write("PEV_Recorded: 0x%X << Test-case is OK >>", get_PEVRecorded_value);
        
        testStepPass("Pass","Test-case is OK");
        
      }
      else {
        
        write("PEV_Recorded: 0x%X << Test-case is NG >>", get_PEVRecorded_value);
        
        testStepFail("Fail","Test-case is NG");
      }
    }
  }
  else {
    write("OWP recording hasn't started");
    write("Stop measurement"); stop();
  }
  
  write("Run Capture_Graphics()"); Capture_Graphics();  
  
  Init();
  
  @panel::Switch_CGWNM = 0;
  
  write("=== FINISH CCS_007_8 ===");  
}

testcase CCS_007_9() {
  testStep("Notifications","Start test-case CCS_007_9");
  write("=== START CCS_007_9 ===");  
  
  Begin();  
  
  write("=== SETTING ===");
  Alarm_state = 0x1; 
  testWaitForTimeout(2000);
  Alarm_state = 0x0; 
  write("KEY ON"); KEY_state = 0x1; testWaitForTimeout(3000);
  
  do {
    
    Enter_BLTN_CAM(); testWaitForTimeout(3000);
    
    if ($BLTN_CAM_RecSet_OWP == 0x1) {write("OWP On"); @panel::LED_Ctrl_SetOWP = 1; testWaitForTimeout(500);}
    if ($BLTN_CAM_RecSet_PEV == 0x1) {write("PEV On"); @panel::LED_Ctrl_SetPEV = 1; testWaitForTimeout(500);}
    if ($BLTN_CAM_Set_PEV_AppNoti == 0x1) {write("App Noti On"); @panel::Button_AppNoti_PEV = 1; testWaitForTimeout(500);}
    
    Exit_BLTN_CAM(); testWaitForTimeout(3000);
    flag_RecSet_error++;
    
  } while (($BLTN_CAM_RecSet_OWP == 0x1 || $BLTN_CAM_RecSet_PEV == 0x1 || $BLTN_CAM_Set_PEV_AppNoti == 0x1) && (flag_RecSet_error < 15));
  
  write("=== TESTING ===");
  
  write("KEY OFF"); KEY_state = 0x0;
  
  if (testWaitForSignalChange(BLTN_CAM_RecSta_OWP,10000) == 1) {
    
    write("OWP recording is started"); @panel::Switch_CGWNM = 1;
    
    testWaitForTimeout(10000);
    
    openPanel("Note");
    
    if (testWaitForSignalChange(BLTN_CAM_RecSta_PEV,20000) == 1) {
      
      write("PEV recording is started"); closePanel("Note");
      
      get_PEVRecorded_change = testWaitForSignalChange(BLTN_CAM_PEV_Recorded,10000);
      
      get_PEVRecorded_value = $BLTN_CAM_PEV_Recorded;
      
      if (get_PEVRecorded_change != 1 && get_PEVRecorded_value == 0x0) {
        
        write("PEV_Recorded: 0x%X << Test-case is OK >>", get_PEVRecorded_value);
        
        testStepPass("Pass","Test-case is OK");
        
      }
      else {
        
        write("PEV_Recorded: 0x%X << Test-case is NG >>", get_PEVRecorded_value);
        
        testStepFail("Fail","Test-case is NG");
      }
    }
  }
  else {
    write("OWP recording hasn't started");
    write("Stop measurement"); stop();
  }
  
  write("Run Capture_Graphics()"); Capture_Graphics();  
  
  Init();
  
  @panel::Switch_CGWNM = 0;
  
  write("=== FINISH CCS_007_9 ===");
}

testcase CCS_007_10() {
  testStep("Notifications","Start test-case CCS_007_10");
  write("=== START CCS_007_10 ==="); 
  
  Begin();  
  
  write("=== SETTING ===");
  
  Alarm_state = 0x0; 
  write("KEY ON"); KEY_state = 0x1; testWaitForTimeout(3000);
  
  do {
    
    Enter_BLTN_CAM(); testWaitForTimeout(3000);
    
    if ($BLTN_CAM_RecSet_OWP == 0x1) {write("OWP On"); @panel::LED_Ctrl_SetOWP = 1; testWaitForTimeout(500);}
    if ($BLTN_CAM_RecSet_PEV == 0x1) {write("PEV On"); @panel::LED_Ctrl_SetPEV = 1; testWaitForTimeout(500);}
    if ($BLTN_CAM_Set_PEV_AppNoti == 0x1) {write("App Noti On"); @panel::Button_AppNoti_PEV = 1; testWaitForTimeout(500);}
    
    Exit_BLTN_CAM(); testWaitForTimeout(3000);
    flag_RecSet_error++;
    
  } while (($BLTN_CAM_RecSet_OWP == 0x1 || $BLTN_CAM_RecSet_PEV == 0x1 || $BLTN_CAM_Set_PEV_AppNoti == 0x1) && (flag_RecSet_error < 15));
  
  write("=== TESTING ===");
  
  write("KEY OFF"); KEY_state = 0x0;
  
  if (testWaitForSignalChange(BLTN_CAM_RecSta_OWP,10000) == 1) {
    
    write("OWP recording is started"); @panel::Switch_CGWNM = 1;
    
    testWaitForTimeout(5000); send_BAlarm_BglrAlrmCurrentSta_timer.cancel(); testWaitForTimeout(5000);
    
    openPanel("Note");
    
    if (testWaitForSignalChange(BLTN_CAM_RecSta_PEV,20000) == 1) {
      
      write("PEV recording is started"); closePanel("Note");
      
      get_PEVRecorded_change = testWaitForSignalChange(BLTN_CAM_PEV_Recorded,10000);
      
      get_PEVRecorded_value = $BLTN_CAM_PEV_Recorded;
      
      if (get_PEVRecorded_change == 1 && get_PEVRecorded_value == 0x2) {
        
        write("PEV_Recorded: 0x%X << Test-case is OK >>", get_PEVRecorded_value);
        
        testStepPass("Pass","Test-case is OK");
        
      }
      else {
        
        write("PEV_Recorded: 0x%X << Test-case is NG >>", get_PEVRecorded_value);
        
        testStepFail("Fail","Test-case is NG");
      }
    }
  }
  else {
    write("OWP recording hasn't started");
    write("Stop measurement"); stop();
  }
  
  write("Run Capture_Graphics()"); Capture_Graphics();  
  
  Init();
  
  @panel::Switch_CGWNM = 0;
  
  write("=== FINISH CCS_007_10 ===");  
}

testcase CCS_007_11() {
  testStep("Notifications","Start test-case CCS_007_11");
  write("=== START CCS_007_11 ===");  
  
  Begin();  
  
  write("=== SETTING ===");
  
  Alarm_state = 0x1; 
  
  write("KEY ON"); KEY_state = 0x1; testWaitForTimeout(3000);
  
  do {
    
    Enter_BLTN_CAM(); testWaitForTimeout(3000);
    
    if ($BLTN_CAM_RecSet_OWP == 0x1) {write("OWP On"); @panel::LED_Ctrl_SetOWP = 1; testWaitForTimeout(500);}
    if ($BLTN_CAM_RecSet_PEV == 0x1) {write("PEV On"); @panel::LED_Ctrl_SetPEV = 1; testWaitForTimeout(500);}
    if ($BLTN_CAM_Set_PEV_AppNoti == 0x1) {write("App Noti On"); @panel::Button_AppNoti_PEV = 1; testWaitForTimeout(500);}
    
    Exit_BLTN_CAM(); testWaitForTimeout(3000);
    flag_RecSet_error++;
    
  } while (($BLTN_CAM_RecSet_OWP == 0x1 || $BLTN_CAM_RecSet_PEV == 0x1 || $BLTN_CAM_Set_PEV_AppNoti == 0x1) && (flag_RecSet_error < 15));
  
  write("=== TESTING ===");
  
  write("KEY OFF"); KEY_state = 0x0;
  
  if (testWaitForSignalChange(BLTN_CAM_RecSta_OWP,10000) == 1) {
    
    write("OWP recording is started"); @panel::Switch_CGWNM = 1;
    
    testWaitForTimeout(10000);
    
    openPanel("Note");
    
    if (testWaitForSignalChange(BLTN_CAM_RecSta_PEV,20000) == 1) {
      
      write("PEV recording is started"); closePanel("Note");
      
      get_PEVRecorded_change = testWaitForSignalChange(BLTN_CAM_PEV_Recorded,10000);
      
      get_PEVRecorded_value = $BLTN_CAM_PEV_Recorded;
      
      if (get_PEVRecorded_change != 1 && get_PEVRecorded_value == 0x0) {
        
        write("PEV_Recorded: 0x%X << Test-case is OK >>", get_PEVRecorded_value);
        
        testStepPass("Pass","Test-case is OK");
        
      }
      else {
        
        write("PEV_Recorded: 0x%X << Test-case is NG >>", get_PEVRecorded_value);
        
        testStepFail("Fail","Test-case is NG");
      }
    }
  }
  else {
    write("OWP recording hasn't started");
    write("Stop measurement"); stop();
  }
  
  write("Run Capture_Graphics()"); Capture_Graphics();  
  
  Init();
  
  @panel::Switch_CGWNM = 0;
  
  write("=== FINISH CCS_007_11 ===");
}

testcase CCS_007_12() {
  testStep("Notifications","Start test-case CCS_007_12");
  write("=== START CCS_007_12 ==="); 
  
  Begin();  
  
  write("=== SETTING ===");
  
  Alarm_state = 0x1;
  
  write("KEY ON"); KEY_state = 0x1; testWaitForTimeout(3000);
  
  do {
    
    Enter_BLTN_CAM(); testWaitForTimeout(3000);
    
    if ($BLTN_CAM_RecSet_OWP == 0x1) {write("OWP On"); @panel::LED_Ctrl_SetOWP = 1; testWaitForTimeout(500);}
    if ($BLTN_CAM_RecSet_PEV == 0x1) {write("PEV On"); @panel::LED_Ctrl_SetPEV = 1; testWaitForTimeout(500);}
    if ($BLTN_CAM_Set_PEV_AppNoti == 0x1) {write("App Noti On"); @panel::Button_AppNoti_PEV = 1; testWaitForTimeout(500);}
    
    Exit_BLTN_CAM(); testWaitForTimeout(3000);
    flag_RecSet_error++;
    
  } while (($BLTN_CAM_RecSet_OWP == 0x1 || $BLTN_CAM_RecSet_PEV == 0x1 || $BLTN_CAM_Set_PEV_AppNoti == 0x1) && (flag_RecSet_error < 15));
  
  write("=== TESTING ===");
  
  write("KEY OFF"); KEY_state = 0x0;
  
  if (testWaitForSignalChange(BLTN_CAM_RecSta_OWP,10000) == 1) {
    
    write("OWP recording is started"); @panel::Switch_CGWNM = 1;
    
    testWaitForTimeout(5000); send_BAlarm_BglrAlrmCurrentSta_timer.cancel(); testWaitForTimeout(5000);
    
    openPanel("Note");
    
    if (testWaitForSignalChange(BLTN_CAM_RecSta_PEV,20000) == 1) {
      
      write("PEV recording is started"); closePanel("Note");
      
      get_PEVRecorded_change = testWaitForSignalChange(BLTN_CAM_PEV_Recorded,10000);
      
      get_PEVRecorded_value = $BLTN_CAM_PEV_Recorded;
      
      if (get_PEVRecorded_change == 1 && get_PEVRecorded_value == 0x2) {
        
        write("PEV_Recorded: 0x%X << Test-case is OK >>", get_PEVRecorded_value);
        
        testStepPass("Pass","Test-case is OK");
        
      }
      else {
        
        write("PEV_Recorded: 0x%X << Test-case is NG >>", get_PEVRecorded_value);
        
        testStepFail("Fail","Test-case is NG");
      }
    }
  }
  else {
    write("OWP recording hasn't started");
    write("Stop measurement"); stop();
  }
  
  write("Run Capture_Graphics()"); Capture_Graphics();  
  
  Init();
  
  @panel::Switch_CGWNM = 0;
  
  write("=== FINISH CCS_007_12 ===");  
}

testcase CCS_007_13() {
  testStep("Notifications","Start test-case CCS_007_13");
  write("=== START CCS_007_13 ===");  
  
  Begin();  
  
  write("=== SETTING ===");
  
  Alarm_state = 0x3; 
  
  write("KEY ON"); KEY_state = 0x1; testWaitForTimeout(3000);
  
  do {
    
    Enter_BLTN_CAM(); testWaitForTimeout(3000);
    
    if ($BLTN_CAM_RecSet_OWP == 0x1) {write("OWP On"); @panel::LED_Ctrl_SetOWP = 1; testWaitForTimeout(500);}
    if ($BLTN_CAM_RecSet_PEV == 0x1) {write("PEV On"); @panel::LED_Ctrl_SetPEV = 1; testWaitForTimeout(500);}
    if ($BLTN_CAM_Set_PEV_AppNoti == 0x1) {write("App Noti On"); @panel::Button_AppNoti_PEV = 1; testWaitForTimeout(500);}
    
    Exit_BLTN_CAM(); testWaitForTimeout(3000);
    flag_RecSet_error++;
    
  } while (($BLTN_CAM_RecSet_OWP == 0x1 || $BLTN_CAM_RecSet_PEV == 0x1 || $BLTN_CAM_Set_PEV_AppNoti == 0x1) && (flag_RecSet_error < 15));
  
  write("=== TESTING ===");
  
  write("KEY OFF"); KEY_state = 0x0;
  
  if (testWaitForSignalChange(BLTN_CAM_RecSta_OWP,10000) == 1) {
    
    write("OWP recording is started"); @panel::Switch_CGWNM = 1;
    
    testWaitForTimeout(10000);
    
    openPanel("Note");
    
    if (testWaitForSignalChange(BLTN_CAM_RecSta_PEV,20000) == 1) {
      
      write("PEV recording is started"); closePanel("Note");
      
      get_PEVRecorded_change = testWaitForSignalChange(BLTN_CAM_PEV_Recorded,10000);
      
      get_PEVRecorded_value = $BLTN_CAM_PEV_Recorded;
      
      if (get_PEVRecorded_change != 1 && get_PEVRecorded_value == 0x0) {
        
        write("PEV_Recorded: 0x%X << Test-case is OK >>", get_PEVRecorded_value);
        
        testStepPass("Pass","Test-case is OK");
        
      }
      else {
        
        write("PEV_Recorded: 0x%X << Test-case is NG >>", get_PEVRecorded_value);
        
        testStepFail("Fail","Test-case is NG");
      }
    }
  }
  else {
    write("OWP recording hasn't started");
    write("Stop measurement"); stop();
  }
  
  write("Run Capture_Graphics()"); Capture_Graphics();  
  
  Init();
  
  @panel::Switch_CGWNM = 0;
  
  write("=== FINISH CCS_007_13 ===");
}

testcase CCS_007_14() {
  testStep("Notifications","Start test-case CCS_007_14");
  write("=== START CCS_007_14 ==="); 
  
  Begin();  
  
  write("=== SETTING ===");
  
  Alarm_state = 0x3;
  
  write("KEY ON"); KEY_state = 0x1; testWaitForTimeout(3000);
  
  do {
    
    Enter_BLTN_CAM(); testWaitForTimeout(3000);
    
    if ($BLTN_CAM_RecSet_OWP == 0x1) {write("OWP On"); @panel::LED_Ctrl_SetOWP = 1; testWaitForTimeout(500);}
    if ($BLTN_CAM_RecSet_PEV == 0x1) {write("PEV On"); @panel::LED_Ctrl_SetPEV = 1; testWaitForTimeout(500);}
    if ($BLTN_CAM_Set_PEV_AppNoti == 0x1) {write("App Noti On"); @panel::Button_AppNoti_PEV = 1; testWaitForTimeout(500);}
    
    Exit_BLTN_CAM(); testWaitForTimeout(3000);
    flag_RecSet_error++;
    
  } while (($BLTN_CAM_RecSet_OWP == 0x1 || $BLTN_CAM_RecSet_PEV == 0x1 || $BLTN_CAM_Set_PEV_AppNoti == 0x1) && (flag_RecSet_error < 15));
  
  write("=== TESTING ===");
  
  write("KEY OFF"); KEY_state = 0x0;
  
  if (testWaitForSignalChange(BLTN_CAM_RecSta_OWP,10000) == 1) {
    
    write("OWP recording is started"); @panel::Switch_CGWNM = 1;
    
    testWaitForTimeout(5000); send_BAlarm_BglrAlrmCurrentSta_timer.cancel(); testWaitForTimeout(5000);
    
    openPanel("Note");
    
    if (testWaitForSignalChange(BLTN_CAM_RecSta_PEV,20000) == 1) {
      
      write("PEV recording is started"); closePanel("Note");
      
      get_PEVRecorded_change = testWaitForSignalChange(BLTN_CAM_PEV_Recorded,10000);
      
      get_PEVRecorded_value = $BLTN_CAM_PEV_Recorded;
      
      if (get_PEVRecorded_change == 1 && get_PEVRecorded_value == 0x2) {
        
        write("PEV_Recorded: 0x%X << Test-case is OK >>", get_PEVRecorded_value);
        
        testStepPass("Pass","Test-case is OK");
        
      }
      else {
        
        write("PEV_Recorded: 0x%X << Test-case is NG >>", get_PEVRecorded_value);
        
        testStepFail("Fail","Test-case is NG");
      }
    }
  }
  else {
    write("OWP recording hasn't started");
    write("Stop measurement"); stop();
  }
  
  write("Run Capture_Graphics()"); Capture_Graphics();  
  
  Init();
  
  @panel::Switch_CGWNM = 0;
  
  write("=== FINISH CCS_007_14 ===");  
}

testcase CCS_007_15() {
  testStep("Notifications","Start test-case CCS_007_15");
  write("=== START CCS_007_15 ===");  
  
  Begin();  
  
  write("=== SETTING ===");
  
  Alarm_state = 0x4; 
  
  write("KEY ON"); KEY_state = 0x1; testWaitForTimeout(3000);
  
  do {
    
    Enter_BLTN_CAM(); testWaitForTimeout(3000);
    
    if ($BLTN_CAM_RecSet_OWP == 0x1) {write("OWP On"); @panel::LED_Ctrl_SetOWP = 1; testWaitForTimeout(500);}
    if ($BLTN_CAM_RecSet_PEV == 0x1) {write("PEV On"); @panel::LED_Ctrl_SetPEV = 1; testWaitForTimeout(500);}
    if ($BLTN_CAM_Set_PEV_AppNoti == 0x1) {write("App Noti On"); @panel::Button_AppNoti_PEV = 1; testWaitForTimeout(500);}
    
    Exit_BLTN_CAM(); testWaitForTimeout(3000);
    flag_RecSet_error++;
    
  } while (($BLTN_CAM_RecSet_OWP == 0x1 || $BLTN_CAM_RecSet_PEV == 0x1 || $BLTN_CAM_Set_PEV_AppNoti == 0x1) && (flag_RecSet_error < 15));
  
  write("=== TESTING ===");
  
  write("KEY OFF"); KEY_state = 0x0;
  
  if (testWaitForSignalChange(BLTN_CAM_RecSta_OWP,10000) == 1) {
    
    write("OWP recording is started"); @panel::Switch_CGWNM = 1;
    
    testWaitForTimeout(10000);
    
    openPanel("Note");
    
    if (testWaitForSignalChange(BLTN_CAM_RecSta_PEV,20000) == 1) {
      
      write("PEV recording is started"); closePanel("Note");
      
      get_PEVRecorded_change = testWaitForSignalChange(BLTN_CAM_PEV_Recorded,10000);
      
      get_PEVRecorded_value = $BLTN_CAM_PEV_Recorded;
      
      if (get_PEVRecorded_change != 1 && get_PEVRecorded_value == 0x0) {
        
        write("PEV_Recorded: 0x%X << Test-case is OK >>", get_PEVRecorded_value);
        
        testStepPass("Pass","Test-case is OK");
        
      }
      else {
        
        write("PEV_Recorded: 0x%X << Test-case is NG >>", get_PEVRecorded_value);
        
        testStepFail("Fail","Test-case is NG");
      }
    }
  }
  else {
    write("OWP recording hasn't started");
    write("Stop measurement"); stop();
  }  
  
  write("Run Capture_Graphics()"); Capture_Graphics();  
  
  Init();
  
  @panel::Switch_CGWNM = 0;
  
  write("=== FINISH CCS_007_15 ===");
}

testcase CCS_007_16() {
  testStep("Notifications","Start test-case CCS_007_16");
  write("=== START CCS_007_16 ==="); 
  
  Begin();  
  
  write("=== SETTING ===");
  
  Alarm_state = 0x4;
  
  write("KEY ON"); KEY_state = 0x1; testWaitForTimeout(3000);
  
  do {
    
    Enter_BLTN_CAM(); testWaitForTimeout(3000);
    
    if ($BLTN_CAM_RecSet_OWP == 0x1) {write("OWP On"); @panel::LED_Ctrl_SetOWP = 1; testWaitForTimeout(500);}
    if ($BLTN_CAM_RecSet_PEV == 0x1) {write("PEV On"); @panel::LED_Ctrl_SetPEV = 1; testWaitForTimeout(500);}
    if ($BLTN_CAM_Set_PEV_AppNoti == 0x1) {write("App Noti On"); @panel::Button_AppNoti_PEV = 1; testWaitForTimeout(500);}
    
    Exit_BLTN_CAM(); testWaitForTimeout(3000);
    flag_RecSet_error++;
    
  } while (($BLTN_CAM_RecSet_OWP == 0x1 || $BLTN_CAM_RecSet_PEV == 0x1 || $BLTN_CAM_Set_PEV_AppNoti == 0x1) && (flag_RecSet_error < 15));
  
  write("=== TESTING ===");
  
  write("KEY OFF"); KEY_state = 0x0;
  
  if (testWaitForSignalChange(BLTN_CAM_RecSta_OWP,10000) == 1) {
    
    write("OWP recording is started"); @panel::Switch_CGWNM = 1;
    
    testWaitForTimeout(5000); send_BAlarm_BglrAlrmCurrentSta_timer.cancel(); testWaitForTimeout(5000);
    
    openPanel("Note");
    
    if (testWaitForSignalChange(BLTN_CAM_RecSta_PEV,20000) == 1) {
      
      write("PEV recording is started"); closePanel("Note");
      
      get_PEVRecorded_change = testWaitForSignalChange(BLTN_CAM_PEV_Recorded,10000);
      
      get_PEVRecorded_value = $BLTN_CAM_PEV_Recorded;
      
      if (get_PEVRecorded_change == 1 && get_PEVRecorded_value == 0x2) {
        
        write("PEV_Recorded: 0x%X << Test-case is OK >>", get_PEVRecorded_value);
        
        testStepPass("Pass","Test-case is OK");
        
      }
      else {
        
        write("PEV_Recorded: 0x%X << Test-case is NG >>", get_PEVRecorded_value);
        
        testStepFail("Fail","Test-case is NG");
      }
    }
  }
  else {
    write("OWP recording hasn't started");
    write("Stop measurement"); stop();
  }
  
  write("Run Capture_Graphics()"); Capture_Graphics();  
  
  Init();
  
  @panel::Switch_CGWNM = 0;
  
  write("=== FINISH CCS_007_16 ===");  
}

void MainTest() {
  
  Begin();
  
  KEY_state = 0x1; testWaitForTimeout(3000);
  
  if ($BLTN_CAM_RecSet_OWD == 0x1 || $BLTN_CAM_RecSet_OWP == 0x1 || $BLTN_CAM_RecSet_DEV == 0x1 || $BLTN_CAM_RecSet_PEV == 0x1) {
    
    write("Run Set_All_Recording_OFF()"); Set_All_Recording_OFF();
  
  }
  else {
    
    write("All settings are set to Off");
  
  }
  
  KEY_state = 0x0;
  
  TestWaitForValueInput("Please enter the test ID (1/2/3/4/5/6/7/8/9/10/11/12/13/14/15/16/17)", 300000);
  switch (TestGetValueInput()){
    
   case(1) : CCS_007_1(); break;
   case(2) : CCS_007_2(); break;
   case(3) : CCS_007_3(); break; 
   case(4) : CCS_007_4(); break;
   case(5) : CCS_007_5(); break;
   case(6) : CCS_007_6(); break;
   case(7) : CCS_007_7(); break;
   case(8) : CCS_007_8(); break;     
   case(9) : CCS_007_9(); break;
   case(10) : CCS_007_10(); break;
   case(11) : CCS_007_11(); break; 
   case(12) : CCS_007_12(); break;     
   case(13) : CCS_007_13(); break;
   case(14) : CCS_007_14(); break;     
   case(15) : CCS_007_15(); break;
   case(16) : CCS_007_16(); break;
   case(17) : CCS_007_1(); CCS_007_2(); CCS_007_3(); CCS_007_4(); CCS_007_5(); CCS_007_6(); CCS_007_7(); CCS_007_8(); CCS_007_9(); CCS_007_10(); CCS_007_11(); CCS_007_12(); CCS_007_13(); CCS_007_14(); CCS_007_15(); CCS_007_16(); 
   break;  
     
  }      
  
}