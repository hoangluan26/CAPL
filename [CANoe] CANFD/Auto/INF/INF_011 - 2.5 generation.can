/*@!Encoding:65001*/
//Precondition: Simulation Setup -> Block CGW_CCU; ccNC/ccIC switch OFF; All recording setting OFF; Enter AVN mode
//Add signals to graphic: BLTN_CAM_RecSta_OWD; Lamp_TrnSigLmpLftOnReq/Lamp_TrnSigLmpRtOnReq
includes 
{
  #include "DeclarationFunction_Gen2.5.h"
}

variables
{ // Global Variable Declaration
  byte i;
  byte lamp_Lft_value = 0x0;
  byte lamp_Rt_value = 0x0;
  int flag_RecSet_error = 0;
  dword speed_value  = 0x0;
  byte spd_UnitTyp_value = 0x2;
  byte gear_Pos_value = 0x0;
  char arr_ICE_modeType[3] = {'I','C','E'};
  char arr_HEV_modeType[3] = {'H','E','V'};
  char arr_EV_modeType[2] = {'E','V'};
  char answer[3];
  // CAN FD Message Declaration
  message HU_BLTN_CAM_02_200ms _HU_BLTN_CAM_02_200ms;
  message HU_BLTN_CAM_01_00ms _HU_BLTN_CAM_01_00ms;
  message PDC_FD_04_200ms _PDC_FD_04_200ms;
  message TCU_01_10ms _TCU_01_10ms;
  message HTCU_05_10ms _HTCU_05_10ms;
  message HTCU_04_10ms _HTCU_04_10ms;
  message VCU_01_10ms _VCU_01_10ms;  
  // Timer Declaration 
  msTimer send_PDC_FD_04_200ms_timer;
  msTimer send_CLU_01_20ms_timer;
  msTimer send_TCU_01_10ms_timer;
  msTimer send_HTCU_04_10ms_timer;
  msTimer send_VCU_01_10ms_timer;
  msTimer send_ICU_ModState_timer;
}

on timer send_PDC_FD_04_200ms_timer{
  _PDC_FD_04_200ms.Lamp_TrnSigLmpLftOnReq = lamp_Lft_value;
  _PDC_FD_04_200ms.Lamp_TrnSigLmpRtOnReq = lamp_Rt_value;
  output(_PDC_FD_04_200ms);
  
  send_PDC_FD_04_200ms_timer.set(200);
}

testcase INF_011_13(){
  testStep("Notifications","Start test INF_011_13");
  write("=== START INF_011_13 ==="); 
  
  KEY_ON();
  
  for(i = 0x0; i <= 0x3; i++){
    
  @panel::Switch_CGWNM = 1;
  @panel::Switch_Clock = 1;
    
  lamp_Lft_value = i;
  
  send_PDC_FD_04_200ms_timer.set(200);
  
  if ($BLTN_CAM_RecSet_OWD == 0x1){
    do {
      
      write("Run Enter_BLTN_CAM()"); Enter_BLTN_CAM();
      testWaitForTimeout(3000);
      
      if ($BLTN_CAM_RecSet_OWD == 0x1) {write("OWD On"); @panel::LED_Ctrl_SetOWD = 1; testWaitForTimeout(1000);}   
            
      write("Run Exit_BLTN_CAM()"); Exit_BLTN_CAM();
      
      flag_RecSet_error++;
      
    } while ($BLTN_CAM_RecSet_OWD == 0x1 && (flag_RecSet_error < 15));
    
    flag_RecSet_error = 0;     
  }
  
  if (testWaitForSignalChange(BLTN_CAM_RecSta_OWD,10000) == 1){
   
    write("OWD recording is started");
    
    testWaitForTimeout(10000);
    
    write("Run Enter_BLTN_CAM()"); Enter_BLTN_CAM();
    
    write("Run CaptureGraphics_Lft()"); CaptureGraphics_Lft();
    
    do {
      
      write("OWD Off"); @panel::LED_Ctrl_SetOWD = 1;
      
      testWaitForTimeout(1000);
      
      flag_RecSet_error++; 
      
    } while ($BLTN_CAM_RecSet_OWD == 0x2 && flag_RecSet_error);
    
    flag_RecSet_error = 0;
    
    write("Run Exit_BLTN_CAM()"); Exit_BLTN_CAM();
  }
  else {
    
    write("Error: OWD recording hasn't started");
    
    testStepWarning("Warning","OWD recording hasn't started");
  
    do {
      
      write("Run Enter_BLTN_CAM()"); Enter_BLTN_CAM();
    
      testWaitForTimeout(3000);
      
      write("OWD Off"); @panel::LED_Ctrl_SetOWD = 1;
      
      testWaitForTimeout(1000);
      
      write("Run Exit_BLTN_CAM()"); Exit_BLTN_CAM();
      
      flag_RecSet_error++; 
      
    } while ($BLTN_CAM_RecSet_OWD == 0x2 && flag_RecSet_error);
    
    flag_RecSet_error = 0;
    
    write("Stop mearsurement"); stop();    
    
  }
  
  @panel::Switch_CGWNM = 0;
  @panel::Switch_Clock = 0;
  
  lamp_Lft_value = 0x0;
  lamp_Rt_value = 0x0;
  testWaitForTimeout(1000);

  send_PDC_FD_04_200ms_timer.cancel();
  
  KEY_OFF();
  }
  testStep("Notifications","Done test INF_011_13");
  write("=== FINISH INF_011_13 ===");  
}

testcase INF_011_14(){
  testStep("Notifications","Start test INF_011_14");
  write("=== START INF_011_14 ==="); 
  
  KEY_ON();
  
  for(i = 0x0; i <= 0x3; i++){
    
  @panel::Switch_CGWNM = 1;
  @panel::Switch_Clock = 1;
    
  lamp_Rt_value = i;
  
  send_PDC_FD_04_200ms_timer.set(200);
  
  if ($BLTN_CAM_RecSet_OWD == 0x1){
    do {
      
      write("Run Enter_BLTN_CAM()"); Enter_BLTN_CAM();
      testWaitForTimeout(3000);
      
      if ($BLTN_CAM_RecSet_OWD == 0x1) {write("OWD On"); @panel::LED_Ctrl_SetOWD = 1; testWaitForTimeout(1000);}   
      
      write("Run Exit_BLTN_CAM()"); Exit_BLTN_CAM();
      
      flag_RecSet_error++;
      
    } while ($BLTN_CAM_RecSet_OWD == 0x1 && (flag_RecSet_error < 15));
    
    flag_RecSet_error = 0;     
    
  }
  
  if (testWaitForSignalChange(BLTN_CAM_RecSta_OWD,10000) == 1){
   
    write("OWD recording is started");
    
    testWaitForTimeout(10000);
    
    write("Run Enter_BLTN_CAM()"); Enter_BLTN_CAM();
    
    write("Run CaptureGraphics_Rt()"); CaptureGraphics_Rt();
    
    do {
      
      write("OWD Off"); @panel::LED_Ctrl_SetOWD = 1;
      
      testWaitForTimeout(1000);
      
      flag_RecSet_error++; 
      
    } while (getSignal(BLTN_CAM_RecSet_OWD) == 0x2 && flag_RecSet_error);
    
    flag_RecSet_error = 0;
    
    write("Run Exit_BLTN_CAM()"); Exit_BLTN_CAM();
  }
  else {
    
    write("Error: OWD recording hasn't started");
    
    testStepFail("Warning","OWD recording hasn't started");
    
    write("Run Enter_BLTN_CAM()"); Enter_BLTN_CAM();
    
    testWaitForTimeout(3000);
    
    do {
      
      write("Run Enter_BLTN_CAM()"); Enter_BLTN_CAM();
    
      testWaitForTimeout(3000);
      
      write("OWD Off"); @panel::LED_Ctrl_SetOWD = 1;
      
      testWaitForTimeout(1000);
      
      write("Run Exit_BLTN_CAM()"); Exit_BLTN_CAM();
      
      flag_RecSet_error++; 
      
    } while ($BLTN_CAM_RecSet_OWD == 0x2 && flag_RecSet_error);
    
    flag_RecSet_error = 0;
    
    write("Stop mearsurement"); stop();
    
  }
  
  @panel::Switch_CGWNM = 0;
  @panel::Switch_Clock = 0;
  
  lamp_Lft_value = 0x0;
  lamp_Rt_value = 0x0;
  testWaitForTimeout(1000);

  send_PDC_FD_04_200ms_timer.cancel();
  
  KEY_OFF();
  }
  testStep("Notifications","Done test INF_011_14");
  write("=== FINISH INF_011_14 ===");  
}

void MainTest(){
  write("Run Init()"); Init();
  
  TestWaitForValueInput("Please enter the test ID (1/2/3)", 300000); 
  switch (TestGetValueInput()){

   case(1) : INF_011_13(); break; 
   case(2) : INF_011_14(); break;
   case(3): INF_011_13(); INF_011_14(); break; 
     
  } 
}