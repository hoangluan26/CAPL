/*@!Encoding:65001*/

// Preconditions: - ACC and IGN and ccNC/ccIC switch OFF, AVN mode
//                - Add Graphics 2: BLTN_CAM_Prk_Oprable_Time;BLTN_CAM_RecSta_OWP

variables
{
  //Global Variable Declaration
  int flag_RecSet_error = 0; 
  byte j;
  char PLBM_Battery[4] = {'P','L','B','M'};
  char eAGM_Battery[4] = {'E','A','G','M'};
  char answer[4];
  // Message Declaration for CAN FD
  message HU_BLTN_CAM_02_200ms _HU_BLTN_CAM_02_200ms;
  message HU_BLTN_CAM_01_00ms _HU_BLTN_CAM_01_00ms;
//  //Message Declaration for CAN
//  message HU_BLTN_CAM_PE_00_200ms _HU_BLTN_CAM_PE_00_200ms;
//  message HU_BLTN_CAM_E_00 _HU_BLTN_CAM_E_00;
}

int checkBatteryType(char a[], int size)
{
  int i, matchPLBM, matchEAGM;
  
  matchPLBM = 1;
  
  matchEAGM = 1;
  
  for (i = 0; i < size; i++)
  {
    if (a[i] != PLBM_Battery[i])
    {
      matchPLBM = 0;
    }
    if (a[i] != eAGM_Battery[i])
    {
      matchEAGM = 0;
    }
  }

  if (matchPLBM)
    return 1;
  else if (matchEAGM)
    return 2;
  else
    return 0;
}

void Set_Battery(){
  int flag_Timeout; 
  int battery_Type; 
  
  flag_Timeout = 0;
  battery_Type = 0;
  
  @panel::Switch_CGWNM = 1;
  
  KEY_ON();
  
  do
  {
    testWaitForStringInput("Please enter kind of battery (PLBM or EAGM):", 300000);
    
    testGetStringInput(answer, 5);
    
    write("You entered: %c%c%c%c", answer[0], answer[1], answer[2], answer[3]);
    
    battery_Type = checkBatteryType(answer,4);
    
    if(battery_Type == 0){
      write("Invalid input! Please enter 'PLBM' or 'EAGM'.");
    }
  } while(battery_Type == 0);
  
  switch(battery_Type){
    case(1): 
      write("Battery type is PLBM.");     
      @ControlPowerSupply::RadioBtn_PwrSplyModel = 1; //Choose model power suplly TL305TP
      @ControlPowerSupply::Numeric_PortNum = 3; //Choose numberic port to connect PC 
 
      if( @ControlPowerSupply::RadioBtn_PwrSplyModel == 1 && @ControlPowerSupply::Numeric_PortNum == 3 ){
        while (@ControlPowerSupply::isConectedPwrSply == 0 && flag_Timeout <= 30){
        @ControlPowerSupply::Button_Connect = 0; 
        testWaitForTimeout(1000);
        @ControlPowerSupply::Button_Connect = 1;
        testWaitForTimeout(1000);  
        @ControlPowerSupply::Button_Connect = 0;
        flag_Timeout++;  
        }
      }
      flag_Timeout = 0;
      break;
    case(2):
      write("Battery type is EAGM.");
      setSignal(ICU_BS2SoC, 0x50); break;
  }

  KEY_OFF();
  
  @panel::Switch_CGWNM = 0;
}

void Change_Battery_capa(){
  for (j = 1; j <= 30; j++){
   setSignal(ICU_BS2SoC, 0x64 - j); testWaitForTimeout(2000);
   write("Remain Capacity = %d%% .Battery is discharging...", 0x64 - j); 
  }
}

void BLTN_CAM_Settings(int Choose_Option){
  switch (Choose_Option){
    case(1):
      // CAN FD
      _HU_BLTN_CAM_01_00ms.BLTN_CAM_Rec_OWP_NvalueSet = 0x2;/*OWP setting ON*/break;
//      // CAN
//      _HU_BLTN_CAM_E_00.BLTN_CAM_Rec_OWP_NvalueSet = 0x2; break;
    case(2):
      // CAN FD
      _HU_BLTN_CAM_01_00ms.BLTN_CAM_Rec_OWP_NvalueSet = 0x1;/*OWP setting OFF*/break;
//      // CAN
//      _HU_BLTN_CAM_E_00.BLTN_CAM_Rec_OWP_NvalueSet = 0x1; break;
    case(3):
      // CAN FD 
      _HU_BLTN_CAM_01_00ms.BLTN_CAM_Rec_OWP_NvalueSet = 0x2;
      _HU_BLTN_CAM_01_00ms.BLTN_CAM_PrkTime_NvalueSet = 0x14; /*OWP setting ON, Parking recording time set 20h*/break;
//      // CAN 
//      _HU_BLTN_CAM_E_00.BLTN_CAM_Rec_OWP_NvalueSet = 0x2;
//      _HU_BLTN_CAM_E_00.BLTN_CAM_PrkTime_NvalueSet = 0x14; break;      
    case(4):
      // CAN FD
      _HU_BLTN_CAM_01_00ms.BLTN_CAM_Rec_OWP_NvalueSet = 0x1;
      _HU_BLTN_CAM_01_00ms.BLTN_CAM_Rec_PEV_NvalueSet = 0x2; /*OWP setting OFF, PEV setting ON*/break;
//      // CAN 
//      _HU_BLTN_CAM_E_00.BLTN_CAM_Rec_OWP_NvalueSet = 0x1;
//      _HU_BLTN_CAM_E_00.BLTN_CAM_Rec_PEV_NvalueSet = 0x2; break;
    case(5):
    // CAN FD  
      _HU_BLTN_CAM_01_00ms.BLTN_CAM_Rec_OWD_NvalueSet = 0x1; //OWD setting OFF
      _HU_BLTN_CAM_01_00ms.BLTN_CAM_Rec_OWP_NvalueSet = 0x1; //OWP setting OFF
      _HU_BLTN_CAM_01_00ms.BLTN_CAM_Rec_DEV_NvalueSet = 0x1; //DEV setting OFF
      _HU_BLTN_CAM_01_00ms.BLTN_CAM_Rec_PEV_NvalueSet = 0x1; //PEV setting OFF
      _HU_BLTN_CAM_01_00ms.CF_AVN_BLTN_CAM_RecReset = 0x1;
      break;
//    // CAN  
//      _HU_BLTN_CAM_E_00.BLTN_CAM_Rec_OWD_NvalueSet = 0x1; //OWD setting OFF
//      _HU_BLTN_CAM_E_00.BLTN_CAM_Rec_OWP_NvalueSet = 0x1; //OWP setting OFF
//      _HU_BLTN_CAM_E_00.BLTN_CAM_Rec_DEV_NvalueSet = 0x1; //DEV setting OFF
//      _HU_BLTN_CAM_E_00.BLTN_CAM_Rec_PEV_NvalueSet = 0x1; //PEV setting OFF
//      _HU_BLTN_CAM_E_00.CF_AVN_BLTN_CAM_RecReset = 0x1; 
//      break;        
  }
  output(_HU_BLTN_CAM_01_00ms);
//  output(_HU_BLTN_CAM_E_00);
}

void KEY_ON(){
  setSignal(SMK_TrmnlCtrlGrpStaBDC,0x1); // Power ON
}

void KEY_OFF(){
   setSignal(SMK_TrmnlCtrlGrpStaBDC,0x0); // Power OFF
}

void Enter_BLTN_CAM(){
  // CAN FD
  _HU_BLTN_CAM_02_200ms.HU_BLTN_CAM_UI_Mode = 0x1; //Enter BLTN_CAM mode
  output(_HU_BLTN_CAM_02_200ms);
//  // CAN
//  _HU_BLTN_CAM_PE_00_200ms.HU_BLTN_CAM_UI_Mode=0x1;
//  output(_HU_BLTN_CAM_PE_00_200ms); //Enter BLTN_CAM mode  
}

void Exit_BLTN_CAM(){
  // CAN FD 
  _HU_BLTN_CAM_02_200ms.HU_BLTN_CAM_UI_Mode = 0x0; //Enter AVN mode - Exit BLTN_CAM Mode
  output(_HU_BLTN_CAM_02_200ms);
//  // CAN
//  _HU_BLTN_CAM_PE_00_200ms.HU_BLTN_CAM_UI_Mode=0x0;
//  output(_HU_BLTN_CAM_PE_00_200ms);//Exit BLTN_CAM Mode    
}

void CaptureGraphics(){
  testWaitForTimeout(3000);
  testReportAddWindowCapture("Graphics 2","BLTN_CAM_Prk_Oprable_Time;BLTN_CAM_RecSta_OWP","Sreenshot","./Husign.jpg");
}

void Count_down_Clock(long CD_time){
  int countSinceLastCall;
  
  countSinceLastCall = 0; // Count minutes since last Random_message call
  
  testStep("Notifications","Start Count down clock");
  write("===Start Count down clock ===");
  
  while (CD_time > 0){
    
  testStep("Notifications","Remaining time = %02d::%02d",CD_time/60, CD_time%60);  
  write("Remaining time: %02d::%02d",CD_time/60, CD_time%60);
  
    if (countSinceLastCall == 60){
  
      @panel::Switch_CGWNM = 1; 
    
      testStep("Check value","Value of BLTN_CAM_Prk_Oprable_Time: 0x%X",getSignal(BLTN_CAM_Prk_Oprable_Time));  
      write("Value of BLTN_CAM_Prk_Oprable_Time: 0x%X",getSignal(BLTN_CAM_Prk_Oprable_Time));
    
      CaptureGraphics();
    
      @panel::Switch_CGWNM = 0;  
    
      countSinceLastCall=0; //Reset after random message is called  
    }
    else if (CD_time == 59){
      write("===Start BAT_012_2===");
  
      @panel::Switch_CGWNM = 1;   
    
      write("Value of BLTN_CAM_Prk_Oprable_Time: 0x%X",getSignal(BLTN_CAM_Prk_Oprable_Time));
    
      CaptureGraphics();

      @panel::Switch_CGWNM = 0;  
      write("===Finish BAT_012_2===");
    }
  testWaitForTimeout(60000); // Wait 1 minute
  CD_time--;
  countSinceLastCall++;
  }
}

void Turn_OFF_RecSet(){
  if (getSignal(BLTN_CAM_RecSet_OWD) == 0x2 || getSignal(BLTN_CAM_RecSet_OWP) == 0x2 || getSignal(BLTN_CAM_RecSet_DEV) == 0x2 || getSignal(BLTN_CAM_RecSet_PEV) == 0x2){
    @panel::Switch_CGWNM = 1;
  
    KEY_ON();
    testWaitForTimeout(3000);
  
    @panel::Switch_CGWNM = 0;
  
    Enter_BLTN_CAM();
    testWaitForTimeout(3000);
    
    while((getSignal(BLTN_CAM_RecSet_OWD) == 0x2 || getSignal(BLTN_CAM_RecSet_OWP) == 0x2 || getSignal(BLTN_CAM_RecSet_DEV) == 0x2 || getSignal(BLTN_CAM_RecSet_PEV) == 0x2) && (flag_RecSet_error < 30)){
      BLTN_CAM_Settings(5);
      testWaitForTimeout(1000);
      flag_RecSet_error++;
    }
    
    flag_RecSet_error = 0; 
    
    Exit_BLTN_CAM();
    testWaitForTimeout(3000);
    
    KEY_OFF();
  }
  else {
    write("Notifications: All recording setting are turned OFF.");
  }
}

void Setup_Function(){
  @panel::Switch_CGWNM = 1;
  
  KEY_ON();
  testWaitForTimeout(3000);
  
  Enter_BLTN_CAM();
  testWaitForTimeout(3000);
  
  BLTN_CAM_Settings(1);
  testWaitForTimeout(1000);
  
  @panel::Switch_Clock = 1;
  
  testWaitForTimeout(1000);
  
  @panel::Switch_Clock = 0;
  
  Exit_BLTN_CAM();
  testWaitForTimeout(3000);
  
  KEY_OFF();
  
  if (testWaitForSignalChange(BLTN_CAM_RecSta_OWP,100000) == 1){
    @panel::Switch_CGWNM = 0;
    write("OWP recording is in progress...");
  }
  else{
    write("Error: OWP recording hasn't started. Stop test !!!");
    
    Setup_End_test();
    
    KEY_OFF();
  
    stop();
  }  
}

void Setup_End_test(){
  
  KEY_ON();
  testWaitForTimeout(3000);
  
  Enter_BLTN_CAM();
  testWaitForTimeout(3000);
  
  while(getSignal(BLTN_CAM_RecSet_OWP) == 0x2 && flag_RecSet_error < 30){
    BLTN_CAM_Settings(2);
    testWaitForTimeout(1000);
    flag_RecSet_error++;
  }
  
  flag_RecSet_error = 0;
  
  Exit_BLTN_CAM();
  testWaitForTimeout(1000);      
}

testcase BAT_012_1_2(){
  testStepBegin("Notification","Start test BAT_012_1_2");
  write("Notification","Start test BAT_012_1_2");
  
  write("===SETTING BEFORE TESTING===");
  
  Turn_OFF_RecSet(); write("Run Turn_OFF_RecSet()");
  
  Set_Battery(); write("Run Set_Battery()");
  
  write("===START TEST===");
  
  Setup_Function(); write("Run Setup_Function()");
  
  Count_down_Clock(1200); write("Run Count_down_Clock()");
  
  @panel::Switch_CGWNM = 1;
    
  Setup_End_test(); write("Run Setup_End_test()");
  
  @panel::Switch_CGWNM = 0;
  
  KEY_OFF(); write("KEY_OFF");
  
  testStepPass("Notification","Done testcase BAT_012_1_2");
  write("Done testcase BAT_012_1_2");
}

testcase BAT_012_3(){
  testStepBegin("Notification","Start test BAT_012_3");
  write("Notification","Start test BAT_012_3");
  
  write("===SETTING BEFORE TESTING===");
  
  Turn_OFF_RecSet(); write("Run Turn_OFF_RecSet()");
  
  Set_Battery(); write("Run Set_Battery()");
  
  write("===START TEST===");
  
  @panel::Switch_CGWNM = 1; 
  
  KEY_ON(); write("Run KEY_ON()");
  testWaitForTimeout(3000);
  
  Change_Battery_capa(); write("Run Change_Battery_capa()");
  
  @panel::Switch_CGWNM = 0;
  
  Enter_BLTN_CAM(); write("Run Enter_BLTN_CAM()");
  testWaitForTimeout(3000);
  
  BLTN_CAM_Settings(4); write("Run BLTN_CAM_Settings()");
  testWaitForTimeout(1000);
  
  @panel::Switch_Clock = 1;
  
  testWaitForTimeout(1000);
  
  @panel::Switch_Clock = 0;
  
  Exit_BLTN_CAM(); write("Run Exit_BLTN_CAM()");
  
  testWaitForTimeout(1000);
  
  KEY_OFF(); write("Run KEY_OFF()");

  testWaitForTimeout(20000); write("Wait Network Sleep State");
  
  @panel::Switch_CGWNM = 1;
  
  testWaitForTimeout(3000);
  
  testStep("Check value","Value of BLTN_CAM_Prk_Oprable_Time: 0x%X",getSignal(BLTN_CAM_Prk_Oprable_Time));  
  write("Value of BLTN_CAM_Prk_Oprable_Time: 0x%X",getSignal(BLTN_CAM_Prk_Oprable_Time));
    
  CaptureGraphics(); write("Run CaptureGraphics()");
  
  KEY_ON(); write("Run KEY_ON()");
  testWaitForTimeout(3000);
    
  Enter_BLTN_CAM(); write("Run Enter_BLTN_CAM()");
  testWaitForTimeout(3000);   
  
  @panel::Switch_CGWNM = 0;
    
  BLTN_CAM_Settings(2); write("Run BLTN_CAM_Settings()");
    
  testWaitForTimeout(1000);
    
  Exit_BLTN_CAM(); write("Run Exit_BLTN_CAM()");
    
  KEY_OFF(); write("Run KEY_OFF()");
  
  testStepPass("Notification","Done testcase BAT_012_3");
  write("Done testcase BAT_012_3");  
}

void MainTest(){
   testWaitForValueInput("Enter the testcase ID (1/2/3)",300000);
  
  switch(testGetValueInput()){
    case(1): BAT_012_1_2();break; //Test case BAT_012_1_2
      
    case(2): BAT_012_3();break; //Test case BAT_012_3
      
    case(3): 
      BAT_012_1_2();
      BAT_012_3();
      break;
  }
}