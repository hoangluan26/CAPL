VERSION ""

NS_ :

BS_:

BU_: SHVU_CCS_FD ARS_FD WPC_FD WPC2_FD SCM_FD SHVU_FRNT_FD FLLR_FD vDummy_FD_B2 GW_SAU_DRV_FD ATS_FD PSB_FD GW_PSU_RR_FD SHVU_RL_FD RWPC_FD CGW_CCU OHCL_FD SHVU_REAR_FD BLTN_CAM_FD GW_PSU_DRV_FD FCS_FD GW_PSU_AST_FD GW_PSU_3RD_FD RCS_FD GW_PSU_RL_FD SHVU_3RD_FD SHVU_RR_FD RCM_FD DCM_FD SGU_FD vFD_B2

BO_ 676 HU_CLU_03_200ms: 32 CGW_CCU
 SG_ HU_CLU_Crc3Val : 0|16@1+ (1,0) [0|0] "" Vector__XXX
 SG_ AVNT_NModeSel2_Custom1SetVal : 101|2@1+ (1,0) [0|0] "" Vector__XXX
 SG_ AVNT_NModeSel2_Custom2SetVal : 103|2@1+ (1,0) [0|0] "" Vector__XXX
 SG_ AVNT_NHndlSel2_SportSetVal : 105|2@1+ (1,0) [0|0] "" Vector__XXX
 SG_ AVNT_NHndlSel2_TrackSetVal : 107|2@1+ (1,0) [0|0] "" Vector__XXX
 SG_ AVNT_NHndlSel2_DriftSetVal : 109|2@1+ (1,0) [0|0] "" Vector__XXX
 SG_ AVNT_NHndlSel2_WetSetVal : 111|2@1+ (1,0) [0|0] "" Vector__XXX
 SG_ HU_DispThmSetStaMem : 113|3@1+ (1,0) [0|0] "" Vector__XXX
 SG_ HU_DispThmMemSta : 120|8@1+ (1,0) [0|0] "" Vector__XXX
 SG_ AVNT_NModeSel_NSetVal : 128|2@1+ (1,0) [0|0] "" Vector__XXX
 SG_ AVNT_NModeSel_Custom1SetVal : 130|2@1+ (1,0) [0|0] "" Vector__XXX
 SG_ AVNT_NModeSel_Custom2SetVal : 132|2@1+ (1,0) [0|0] "" Vector__XXX
 SG_ AVNT_NHndlSel_SportSetVal : 134|2@1+ (1,0) [0|0] "" Vector__XXX
 SG_ HD_SPS_ChannelNo : 136|4@1+ (1,0) [0|0] "" Vector__XXX
 SG_ HU_CLU_BlueLightLvl : 140|4@1+ (1,0) [0|0] "" Vector__XXX
 SG_ HU_CLU_BlueLightSta : 154|2@1+ (1,0) [0|0] "" Vector__XXX
 SG_ SXM_ChannelNo : 158|10@1+ (1,0) [0|999] "" Vector__XXX
 SG_ HU_CLU_AlvCnt3Val : 16|8@1+ (1,0) [0|0] "" Vector__XXX
 SG_ AVNT_N1setVal : 173|5@1+ (1,0) [0|0] "" Vector__XXX
 SG_ AVNT_N2setVal : 178|5@1+ (1,0) [0|0] "" Vector__XXX
 SG_ AVNT_NHndlSel_TrackSetVal : 184|2@1+ (1,0) [0|0] "" Vector__XXX
 SG_ AVNT_NHndlSel_DriftSetVal : 186|2@1+ (1,0) [0|0] "" Vector__XXX
 SG_ AVNT_NHndlSel_WetSetVal : 188|2@1+ (1,0) [0|0] "" Vector__XXX
 SG_ LapTimer_LapNumber_HU : 192|7@1+ (1,0) [0|0] ""  BLTN_CAM_FD
 SG_ LapTimer_Hour_HU : 199|7@1+ (1,0) [0|0] "Hour"  BLTN_CAM_FD
 SG_ LapTimer_Minute_HU : 206|6@1+ (1,0) [0|0] "minute"  BLTN_CAM_FD
 SG_ LapTimer_Second_HU : 212|6@1+ (1,0) [0|0] "Sec"  BLTN_CAM_FD
 SG_ LapTimer_milisecond_HU : 225|7@1+ (1,0) [0|0] "ms"  BLTN_CAM_FD
 SG_ LapTimer_CountStart : 251|2@1+ (1,0) [0|0] ""  BLTN_CAM_FD
 SG_ AVNT_NModeSel2_NSetVal : 99|2@1+ (1,0) [0|0] "" Vector__XXX

BO_ 256 EMS_02_10ms: 32 CGW_CCU
 SG_ EMS_Crc2Val : 0|16@1+ (1,0) [0|0] ""  GW_PSU_DRV_FD
 SG_ ENG_CrwlSta : 100|4@1+ (1,0) [0|0] "" Vector__XXX
 SG_ ACC_CrsMainSwLmpSta : 104|2@1+ (1,0) [0|0] "" Vector__XXX
 SG_ ACC_CrsSetSwLmpSta : 106|2@1+ (1,0) [0|0] "" Vector__XXX
 SG_ ENG_LV_FUP_ENA_THD : 109|1@1+ (1,0) [0|0] "" Vector__XXX
 SG_ ENG_SoakTimeErrSta : 110|2@1+ (1,0) [0|0] "" Vector__XXX
 SG_ ENG_SoakTimeVal : 112|8@1+ (1,0) [0|0] "Min" Vector__XXX
 SG_ ENG_SprkTimeVal : 120|8@1+ (0.375,-35.625) [0|0] "˚" Vector__XXX
 SG_ ENG_MinIndTqVal : 128|12@1- (1,0) [0|0] "Nm" Vector__XXX
 SG_ ENG_TrgtTqVal : 144|12@1- (1,0) [0|0] "Nm" Vector__XXX
 SG_ EMS_AlvCnt2Val : 16|8@1+ (1,0) [0|0] ""  GW_PSU_DRV_FD
 SG_ ENG_MaxIndTqVal : 160|12@1- (1,0) [0|0] "Nm" Vector__XXX
 SG_ ENG_AppAccelPdlSta : 176|2@1+ (1,0) [0|0] "" Vector__XXX
 SG_ ENG_BrkCtrlReq : 178|2@1+ (1,0) [0|0] "" Vector__XXX
 SG_ ACC_DnShftCtrlReq : 180|4@1+ (1,0) [0|0] "" Vector__XXX
 SG_ ENG_DclBrkCntrlReq : 192|12@1+ (0.001,-4.094) [0|0] "m/s^2" Vector__XXX
 SG_ ENG_BstPrsrVal : 204|12@1+ (1.322,0) [0|0] "hPa" Vector__XXX
 SG_ ENG_EngOilTempVal : 216|8@1+ (0.75,-40) [0|0] "℃" Vector__XXX
 SG_ ENG_AmbtTempModelVal : 224|8@1+ (0.5,-41) [0|0] "℃" Vector__XXX
 SG_ ENG_DpfWrngSta : 232|2@1+ (1,0) [0|0] "" Vector__XXX
 SG_ ENG_BattWrngLmpSta : 234|2@1+ (1,0) [0|0] "" Vector__XXX
 SG_ ENG_OilPrsrWrngLmpSta : 236|2@1+ (1,0) [0|0] "" Vector__XXX
 SG_ ENG_IsgInhbtLmpSta : 238|2@1+ (1,0) [0|0] ""  FCS_FD
 SG_ ENG_BrkSwSta : 32|2@1+ (1,0) [0|0] ""  BLTN_CAM_FD
 SG_ ENG_ObdFrzFrmSta : 34|6@1+ (1,0) [0|0] "" Vector__XXX
 SG_ ENG_EngClntTempVal : 40|8@1+ (0.75,-48) [0|0] "℃" Vector__XXX
 SG_ ENG_MafCrctVal : 48|8@1+ (0.00781,0) [0|0] "" Vector__XXX
 SG_ ENG_BattDscnctSta : 56|2@1+ (1,0) [0|0] "" Vector__XXX
 SG_ OBD_MilConfgVal : 58|3@1+ (1,0) [0|0] "" Vector__XXX
 SG_ ENG_EngSta : 61|3@1+ (1,0) [0|0] ""  ARS_FD,BLTN_CAM_FD,GW_PSU_3RD_FD,GW_PSU_AST_FD,GW_PSU_DRV_FD,GW_PSU_RL_FD,GW_PSU_RR_FD,GW_SAU_DRV_FD,PSB_FD,RCM_FD,RWPC_FD,SCM_FD,SHVU_3RD_FD,SHVU_CCS_FD,SHVU_FRNT_FD,SHVU_REAR_FD,SHVU_RL_FD,SHVU_RR_FD,WPC2_FD,WPC_FD
 SG_ ENG_Ack4EngStpSta : 64|2@1+ (1,0) [0|0] "" Vector__XXX
 SG_ ENG_OverDrvOffReq : 66|2@1+ (1,0) [0|0] "" Vector__XXX
 SG_ ENG_AccActSta : 68|2@1+ (1,0) [0|0] "" Vector__XXX
 SG_ ENG_CltchOpSta : 70|2@1+ (1,0) [0|0] "" Vector__XXX
 SG_ EMS_BrkReq_Slope : 72|1@1+ (1,0) [0|0] "" Vector__XXX
 SG_ ENG_AccDrvAlertDisp : 74|2@1+ (1,0) [0|0] "" Vector__XXX
 SG_ DSL_GlowCtrlReq : 76|2@1+ (1,0) [0|0] "" Vector__XXX
 SG_ ENG_GlowLmpSta : 78|2@1+ (1,0) [0|0] "" Vector__XXX
 SG_ ENG_ThrPosVal : 80|8@1+ (0.4694836,-15.0234742) [0|0] "%" Vector__XXX
 SG_ ENG_AccelPdlVal : 88|10@1+ (0.09784,0) [0|0] "%"  BLTN_CAM_FD

BO_ 261 EMS_07_10ms: 32 CGW_CCU
 SG_ EMS_Crc7Val : 0|16@1+ (1,0) [0|0] "" Vector__XXX
 SG_ HEV_AccelPdlVal : 103|10@1+ (0.09784,0) [0|0] "%"  BLTN_CAM_FD
 SG_ HEV_IndTqTar : 113|8@1+ (0.3906,0) [0|0] "%" Vector__XXX
 SG_ HEV_IndTqVal_Extd : 128|14@1+ (0.1,0) [0|0] "Nm" Vector__XXX
 SG_ ENG_CSModeReq : 144|2@1+ (1,0) [0|0] "" Vector__XXX
 SG_ HEV_TqStndVal_Extd : 146|8@1+ (10,0) [0|0] "Nm" Vector__XXX
 SG_ EMS_AlvCnt7Val : 16|8@1+ (1,0) [0|0] "" Vector__XXX
 SG_ HEV_IndTqVal : 24|12@1+ (0.1,0) [0|0] "Nm" Vector__XXX
 SG_ HEV_DrvTqVal : 36|12@1+ (0.390625,0) [0|0] "%" Vector__XXX
 SG_ HEV_TqStndVal : 48|6@1+ (10,0) [0|0] "Nm" Vector__XXX
 SG_ HEV_OilDilution_IncICELoad : 54|1@1+ (1,0) [0|0] "" Vector__XXX
 SG_ HEV_OilDilution_ServMode : 56|2@1+ (1,0) [0|0] "" Vector__XXX
 SG_ EMS_TqLmtSta : 58|3@1+ (1,0) [0|0] "" Vector__XXX
 SG_ EMS_EU7 : 61|1@1+ (1,0) [0|0] "" Vector__XXX
 SG_ HEV_FrctTqVal : 64|12@1+ (0.1,0) [0|0] "Nm" Vector__XXX
 SG_ HEV_EngSpdVal : 76|16@1+ (0.25,0) [0|0] "rpm" Vector__XXX
 SG_ HEV_EngOpSta : 92|3@1+ (1,0) [0|0] ""  GW_PSU_3RD_FD,RWPC_FD,WPC2_FD,WPC_FD
 SG_ HEV_IntakeAirTempVal : 95|8@1+ (0.75,-48) [0|0] "℃" Vector__XXX

BO_ 813 SBCM_DRV_FD_01_200ms: 32 CGW_CCU
 SG_ SBCM_DRV_FD_Crc1Val : 0|16@1+ (1,0) [0|0] ""  GW_PSU_DRV_FD
 SG_ Latch_TypeOption_DRV : 100|2@1+ (1,0) [0|0] ""  RWPC_FD,WPC2_FD,WPC_FD
 SG_ DRV_SWFailAlarm : 102|2@1+ (1,0) [0|0] ""  ATS_FD
 SG_ USM_PwrDRApprOpnSetSta : 104|2@1+ (1,0) [0|0] "" Vector__XXX
 SG_ USM_PwrDRCloseByRKELockSta : 108|2@1+ (1,0) [0|0] "" Vector__XXX
 SG_ USM_PwrDRCloseByRKELockOpt : 110|2@1+ (1,0) [0|0] "" Vector__XXX
 SG_ USM_PwrDRCloseByBrakeSta : 112|2@1+ (1,0) [0|0] "" Vector__XXX
 SG_ USM_PwrDRBuzzerSta : 116|2@1+ (1,0) [0|0] "" Vector__XXX
 SG_ PDS_TypeOption_DRV : 120|2@1+ (1,0) [0|0] ""  ATS_FD
 SG_ C_DrvDoorApproachOpen : 122|2@1+ (1,0) [0|0] "" Vector__XXX
 SG_ C_DrvDoorApproachClose : 124|2@1+ (1,0) [0|0] "" Vector__XXX
 SG_ DoorLock_PDSLkSwSta_DRV : 126|2@1+ (1,0) [0|0] "" Vector__XXX
 SG_ SBCM_DRV_DiagSta : 136|2@1+ (1,0) [0|0] "" Vector__XXX
 SG_ DoorLock_CtrlDrLkUnLkSwSta_SBCM : 138|2@1+ (1,0) [0|0] "" Vector__XXX
 SG_ SBCM_PsvDrLkReq : 144|2@1+ (1,0) [0|0] "" Vector__XXX
 SG_ CDMAutoWashModeSet_SBCM : 146|3@1+ (1,0) [0|0] "" Vector__XXX
 SG_ USM_DrvGhostDoorSta : 150|2@1+ (1,0) [0|0] "" Vector__XXX
 SG_ Mirror_LH_FoldingSta : 152|2@1+ (1,0) [0|0] "" Vector__XXX
 SG_ Mirror_LH_UnfoldingSta : 154|2@1+ (1,0) [0|0] "" Vector__XXX
 SG_ DRV_CrashMRActAlarm : 156|2@1+ (1,0) [0|0] "" Vector__XXX
 SG_ AFH_DRV_FldUnFldSta : 158|2@1+ (1,0) [0|0] "" Vector__XXX
 SG_ SBCM_DRV_FD_AlvCnt1Val : 16|8@1+ (1,0) [0|0] ""  GW_PSU_DRV_FD
 SG_ MirrorFldReq : 160|2@1+ (1,0) [0|0] "" Vector__XXX
 SG_ OMU_TypeOption_DRV : 162|2@1+ (1,0) [0|0] "" Vector__XXX
 SG_ IMS_OSMirPlayBackSta_LH : 164|4@1+ (1,0) [0|0] ""  GW_PSU_DRV_FD
 SG_ ECMMRR_PLUS : 168|8@1+ (1,0) [0|0] "" Vector__XXX
 SG_ EHL_TxInfo_SBCM_DRV : 176|3@1+ (1,0) [0|0] "" Vector__XXX
 SG_ IMS_OSMirPlayBackSta_LH_New : 184|4@1+ (1,0) [0|0] ""  GW_PSU_DRV_FD
 SG_ CDM_InsideOpnSwSta : 200|2@1+ (1,0) [0|0] "" Vector__XXX
 SG_ CDM_TypeOption : 202|2@1+ (1,0) [0|0] "" Vector__XXX
 SG_ CDM_ImmeChgSw_SBCM : 208|2@1+ (1,0) [0|0] "" Vector__XXX
 SG_ CDM_FobSrchReq_DRV : 210|2@1+ (1,0) [0|0] "" Vector__XXX
 SG_ CDM_OpnClsState_SBCM : 212|2@1+ (1,0) [0|0] "" Vector__XXX
 SG_ CDM_WarnMsg_SBCM : 214|2@1+ (1,0) [0|0] "" Vector__XXX
 SG_ CDM_AutoWashModeSta : 216|3@1+ (1,0) [0|0] "" Vector__XXX
 SG_ CDM_CmdStatus_SBCM : 220|4@1+ (1,0) [0|0] "" Vector__XXX
 SG_ CDM_OutsideOpnSwSta : 224|2@1+ (1,0) [0|0] "" Vector__XXX
 SG_ SBCM_ExtnlWaringReq : 226|2@1+ (1,0) [0|0] "" Vector__XXX
 SG_ Warn_HoodSwSta_SBCM : 228|2@1+ (1,0) [0|0] ""  BLTN_CAM_FD
 SG_ Hood_TypeOption : 230|2@1+ (1,0) [0|0] ""  BLTN_CAM_FD
 SG_ SBCM_FrunkSta : 232|2@1+ (1,0) [0|0] "" Vector__XXX
 SG_ Warn_HoodSwFullSta_SBCM : 234|2@1+ (1,0) [0|0] "" Vector__XXX
 SG_ FrunkWarning_SBCM : 236|2@1+ (1,0) [0|0] "" Vector__XXX
 SG_ FrunkReleaseSwSta_SBCM : 24|2@1+ (1,0) [0|0] "" Vector__XXX
 SG_ PwrDRClosingDRVDrSta : 240|3@1+ (1,0) [0|0] ""  ATS_FD
 SG_ Drv_DrLkRetryFail_SBCM : 243|2@1+ (1,0) [0|0] "" Vector__XXX
 SG_ CDM_GbtImmeChgSw_SBCM : 246|2@1+ (1,0) [0|0] "" Vector__XXX
 SG_ CDM_GbtOpnClsState_SBCM : 248|2@1+ (1,0) [0|0] "" Vector__XXX
 SG_ CDM_GbtWarnMsg_SBCM : 250|2@1+ (1,0) [0|0] "" Vector__XXX
 SG_ CDM_GbtOutsideOpnSwSta : 252|2@1+ (1,0) [0|0] "" Vector__XXX
 SG_ DoorLock_DrvLkOutSta_SBCM : 254|2@1+ (1,0) [0|0] "" Vector__XXX
 SG_ FrunkEmergencySwSta_SBCM : 28|2@1+ (1,0) [0|0] "" Vector__XXX
 SG_ DRV_DetectObj_warn_LH : 30|2@1+ (1,0) [0|0] ""  ATS_FD
 SG_ PwrDROpenClosingDdvSdDRSta : 32|3@1+ (1,0) [0|0] ""  ATS_FD
 SG_ PwrDRBuzzerOut_DRV_New : 35|3@1+ (1,0) [0|0] "" Vector__XXX
 SG_ Coach_TypeOption_DRV : 38|2@1+ (1,0) [0|0] ""  ATS_FD,GW_PSU_RL_FD,GW_PSU_RR_FD
 SG_ PwrDrSta_Drv : 40|2@1+ (1,0) [0|0] ""  ATS_FD
 SG_ PwrDrSta_DrvSd : 42|2@1+ (1,0) [0|0] ""  ATS_FD
 SG_ USM_PwrDrOpnTypSta : 44|2@1+ (1,0) [0|0] "" Vector__XXX
 SG_ DischrgDr_OpnClsState_SBCM : 46|2@1+ (1,0) [0|0] "" Vector__XXX
 SG_ SBCM_DRV_DoorAngle : 48|7@1+ (1,0) [0|0] "˚"  ATS_FD
 SG_ SBCM_DoorType_DRV : 60|2@1+ (1,0) [0|0] "" Vector__XXX
 SG_ CDM_DrType_DRV : 62|2@1+ (1,0) [0|0] "" Vector__XXX
 SG_ DRVDoorPushAlarm : 72|2@1+ (1,0) [0|0] "" Vector__XXX
 SG_ DRV_CrashUnlockCmd : 74|1@1+ (1,0) [0|0] ""  BLTN_CAM_FD
 SG_ C_ApprOpenStatus : 75|1@1+ (1,0) [0|0] "" Vector__XXX
 SG_ DoorLock_DrvKeyLkSwSta_SBCM : 80|2@1+ (1,0) [0|0] "" Vector__XXX
 SG_ DoorLock_DrvKeyUnLkSwSta_SBCM : 82|2@1+ (1,0) [0|0] "" Vector__XXX
 SG_ Warn_DrvDrSwSta_SBCM : 84|2@1+ (1,0) [0|0] ""  ATS_FD,BLTN_CAM_FD,DCM_FD,GW_PSU_DRV_FD,PSB_FD,RWPC_FD,WPC2_FD,WPC_FD
 SG_ DoorLock_DrvDrUnLkSta_SBCM : 86|2@1+ (1,0) [0|0] ""  ATS_FD,FCS_FD,GW_PSU_DRV_FD
 SG_ DRV_SEAWarn_LH : 88|2@1+ (1,0) [0|0] ""  ATS_FD
 SG_ DRV_SEAWarn_RH : 90|2@1+ (1,0) [0|0] "" Vector__XXX
 SG_ DRV_SEWWarn_LH : 92|2@1+ (1,0) [0|0] "" Vector__XXX
 SG_ DRV_SEWWarn_RH : 94|2@1+ (1,0) [0|0] "" Vector__XXX
 SG_ DRV_MRActivationAlarm : 96|2@1+ (1,0) [0|0] "" Vector__XXX
 SG_ DRV_ReleaseWarn : 98|2@1+ (1,0) [0|0] "" Vector__XXX

BO_ 2659690497 BLTN_CAM_WU_01_500ms: 16 BLTN_CAM_FD
 SG_ BLTN_CAM_WU_Crc1Val : 0|16@1+ (1,0) [0|0] ""  vFD_B2
 SG_ BLTN_CAM_WU_AlvCnt1Val : 16|8@1+ (1,0) [0|0] ""  vFD_B2
 SG_ BLTN_CAM_WU_NM_B2 : 24|1@1+ (1,0) [0|0] ""  vFD_B2
 SG_ BLTN_CAM_WU_L_RecStpByBattEmpty : 40|1@1+ (1,0) [0|0] ""  vFD_B2
 SG_ BLTN_CAM_WU_L_RecStpByBLTNCAMErr : 41|1@1+ (1,0) [0|0] ""  vFD_B2
 SG_ BLTN_CAM_WU_L_RecStpBySDCardErr : 42|1@1+ (1,0) [0|0] ""  vFD_B2
 SG_ BLTN_CAM_WU_L_RecStpBySDCardEjec : 43|1@1+ (1,0) [0|0] ""  vFD_B2
 SG_ BLTN_CAM_WU_L_RecStpByUsrSetting : 44|1@1+ (1,0) [0|0] ""  vFD_B2
 SG_ BLTN_CAM_WU_L_ParkEvent : 45|1@1+ (1,0) [0|0] ""  vFD_B2

BO_ 811 SBCM_AST_FD_01_200ms: 32 CGW_CCU
 SG_ SBCM_AST_FD_Crc1Val : 0|16@1+ (1,0) [0|0] ""  GW_PSU_DRV_FD
 SG_ USM_AstGhostDoorSta : 100|2@1+ (1,0) [0|0] "" Vector__XXX
 SG_ AST_SWFailAlarm : 102|2@1+ (1,0) [0|0] ""  ATS_FD
 SG_ DoorLock_PDSLkSwSta_AST : 104|2@1+ (1,0) [0|0] "" Vector__XXX
 SG_ PDS_TypeOption_AST : 106|2@1+ (1,0) [0|0] "" Vector__XXX
 SG_ AFCU_AutoWashModeSta_SBCM_AST : 120|3@1+ (1,0) [0|0] "" Vector__XXX
 SG_ CDM_AutoWashModeSta_SBCM_AST : 123|3@1+ (1,0) [0|0] "" Vector__XXX
 SG_ AFH_AST_FldUnFldSta : 126|2@1+ (1,0) [0|0] "" Vector__XXX
 SG_ SBCM_AST_DiagSta : 136|2@1+ (1,0) [0|0] "" Vector__XXX
 SG_ CDM_TypeOption_AST : 138|2@1+ (1,0) [0|0] "" Vector__XXX
 SG_ CDM_ImmeChgSw_AST : 144|2@1+ (1,0) [0|0] "" Vector__XXX
 SG_ CDM_FobSrchReq_AST : 146|2@1+ (1,0) [0|0] "" Vector__XXX
 SG_ CDM_OpnClsState_AST : 148|2@1+ (1,0) [0|0] "" Vector__XXX
 SG_ CDM_WarnMsg_AST : 150|2@1+ (1,0) [0|0] "" Vector__XXX
 SG_ Mirror_RH_FoldingSta : 152|2@1+ (1,0) [0|0] "" Vector__XXX
 SG_ Mirror_RH_UnfoldingSta : 154|2@1+ (1,0) [0|0] "" Vector__XXX
 SG_ CDM_CmdStatus_AST : 156|4@1+ (1,0) [0|0] "" Vector__XXX
 SG_ SBCM_AST_FD_AlvCnt1Val : 16|8@1+ (1,0) [0|0] ""  GW_PSU_DRV_FD
 SG_ AST_CrashMRActAlarm : 160|2@1+ (1,0) [0|0] "" Vector__XXX
 SG_ PwrDRBuzzerOut_AST : 162|2@1+ (1,0) [0|0] "" Vector__XXX
 SG_ IMS_OSMirPlayBackSta_RH : 164|4@1+ (1,0) [0|0] ""  GW_PSU_DRV_FD
 SG_ PwrDRClosingASTDrSta : 168|3@1+ (1,0) [0|0] ""  ATS_FD
 SG_ CDM_OutsideOpnSwSta_AST : 172|2@1+ (1,0) [0|0] "" Vector__XXX
 SG_ Hood_TypeOption_AST : 176|2@1+ (1,0) [0|0] "" Vector__XXX
 SG_ Warn_HoodSwSta_AST : 178|2@1+ (1,0) [0|0] "" Vector__XXX
 SG_ FrunkWarning_AST : 180|2@1+ (1,0) [0|0] "" Vector__XXX
 SG_ SBCM_FrunkSta_AST : 182|2@1+ (1,0) [0|0] "" Vector__XXX
 SG_ IMS_OSMirPlayBackSta_RH_New : 184|4@1+ (1,0) [0|0] ""  GW_PSU_DRV_FD
 SG_ Ast_DrLkRetryFail_SBCM : 188|2@1+ (1,0) [0|0] "" Vector__XXX
 SG_ DoorLock_AstLkOutSta_SBCM : 190|2@1+ (1,0) [0|0] "" Vector__XXX
 SG_ FrunkReleaseSwSta_SBCM_AST : 192|2@1+ (1,0) [0|0] "" Vector__XXX
 SG_ FrunkInsideRelSwSta_SBCM_AST : 194|2@1+ (1,0) [0|0] "" Vector__XXX
 SG_ FrunkEmergencySwSta_SBCM_AST : 196|2@1+ (1,0) [0|0] "" Vector__XXX
 SG_ PwrDrSta_Ast : 24|2@1+ (1,0) [0|0] ""  ATS_FD
 SG_ PwrDrSta_AstSd : 26|2@1+ (1,0) [0|0] ""  ATS_FD
 SG_ DischrgDr_OpnClsState_SBCM_AST : 28|2@1+ (1,0) [0|0] "" Vector__XXX
 SG_ AST_DetectObj_warn_LH : 30|2@1+ (1,0) [0|0] ""  ATS_FD
 SG_ PwrDROpenClosingAstSdDRSta : 32|3@1+ (1,0) [0|0] ""  ATS_FD
 SG_ PwrDRBuzzerOut_AST_New : 35|3@1+ (1,0) [0|0] "" Vector__XXX
 SG_ SBCM_AST_DoorAngle : 40|7@1+ (1,0) [0|0] "˚"  ATS_FD
 SG_ EHL_TxInfo_SBCM_AST : 47|3@1+ (1,0) [0|0] "" Vector__XXX
 SG_ CDM_DrType_AST : 62|2@1+ (1,0) [0|0] "" Vector__XXX
 SG_ ASTDoorPushAlarm : 72|2@1+ (1,0) [0|0] "" Vector__XXX
 SG_ AST_CrashUnlockCmd : 74|1@1+ (1,0) [0|0] ""  BLTN_CAM_FD
 SG_ DoorLock_CtrlDrLkSwSta_SBCM : 80|2@1+ (1,0) [0|0] "" Vector__XXX
 SG_ DoorLock_CtrlDrUnLkSwSta_SBCM : 82|2@1+ (1,0) [0|0] "" Vector__XXX
 SG_ Warn_AsstDrSwSta_SBCM : 84|2@1+ (1,0) [0|0] ""  ATS_FD,BLTN_CAM_FD,DCM_FD,GW_PSU_AST_FD,GW_SAU_DRV_FD,PSB_FD,RWPC_FD,WPC2_FD,WPC_FD
 SG_ DoorLock_AsstDrUnLkSta_SBCM : 86|2@1+ (1,0) [0|0] ""  ATS_FD,FCS_FD
 SG_ AST_SEAWarn_RH : 88|2@1+ (1,0) [0|0] "" Vector__XXX
 SG_ AST_SEAWarn_LH : 90|2@1+ (1,0) [0|0] ""  ATS_FD
 SG_ AST_SEWWarn_LH : 92|2@1+ (1,0) [0|0] "" Vector__XXX
 SG_ AST_SEWWarn_RH : 94|2@1+ (1,0) [0|0] "" Vector__XXX
 SG_ AST_MRActivationAlarm : 96|2@1+ (1,0) [0|0] "" Vector__XXX
 SG_ AST_ReleaseWarn : 98|2@1+ (1,0) [0|0] "" Vector__XXX

BO_ 930 CLU_HU_03_200ms: 32 CGW_CCU
 SG_ CLU_HU_Crc3Val : 0|16@1+ (1,0) [0|0] "" Vector__XXX
 SG_ CLU_TermAvgSync_MM : 128|2@1+ (1,0) [0|0] "" Vector__XXX
 SG_ CLU_TermAvgFCL_Digit_MM : 130|2@1+ (1,0) [0|0] "" Vector__XXX
 SG_ CLU_TermAvgFuelCnsmptnVal_MM : 132|10@1+ (0.1,0) [0|0] "" Vector__XXX
 SG_ CLU_OptionInfo : 144|8@1+ (1,0) [0|0] "" Vector__XXX
 SG_ CLU_DispThmSetRdy : 152|2@1+ (1,0) [0|0] "" Vector__XXX
 SG_ CLU_DispThmMemSta : 154|8@1+ (1,0) [0|0] "" Vector__XXX
 SG_ CLU_HU_AlvCnt3Val : 16|8@1+ (1,0) [0|0] "" Vector__XXX
 SG_ CLU_DispThmDeleteSta : 162|3@1+ (1,0) [0|0] "" Vector__XXX
 SG_ CLU_DispThmCopySta : 165|3@1+ (1,0) [0|0] "" Vector__XXX
 SG_ CLU_DispThmSetStaMem : 168|3@1+ (1,0) [0|0] "" Vector__XXX
 SG_ CLU_LapTimer_LapNumber_MM : 192|7@1+ (1,0) [0|0] ""  BLTN_CAM_FD
 SG_ CLU_LapTimer_Hour_MM : 199|7@1+ (1,0) [0|0] "Hour"  BLTN_CAM_FD
 SG_ CLU_LapTimer_Minute_MM : 206|6@1+ (1,0) [0|0] "minute"  BLTN_CAM_FD
 SG_ CLU_LapTimer_Second_MM : 212|6@1+ (1,0) [0|0] "Sec"  BLTN_CAM_FD
 SG_ CLU_LapTimer_MeasuringStatus_MM : 218|2@1+ (1,0) [0|0] ""  BLTN_CAM_FD
 SG_ CLU_LapTimer_milisecond_MM : 220|7@1+ (1,0) [0|0] ""  BLTN_CAM_FD
 SG_ CLU_N1SetVal_MM : 64|4@1+ (1,0) [0|0] "" Vector__XXX
 SG_ CLU_N2SetVal_MM : 68|4@1+ (1,0) [0|0] "" Vector__XXX
 SG_ Usm_TorqueUnitSetSta_MM : 72|2@1+ (1,0) [0|0] "" Vector__XXX
 SG_ Usm_TurboPressureUnitSetSta_MM : 74|3@1+ (1,0) [0|0] "" Vector__XXX
 SG_ USM_ShiftLightNmodeSetSta_MM : 77|2@1+ (1,0) [0|0] "" Vector__XXX
 SG_ USM_ShiftLightCustomSetSta_MM : 79|2@1+ (1,0) [0|0] "" Vector__XXX
 SG_ USM_ShiftLightSportSetSta_MM : 81|2@1+ (1,0) [0|0] "" Vector__XXX
 SG_ USM_ShiftLightNormalSetSta_MM : 83|2@1+ (1,0) [0|0] "" Vector__XXX
 SG_ USM_ShiftLightEcoSetSta_MM : 85|2@1+ (1,0) [0|0] "" Vector__XXX
 SG_ USM_ShiftLightBeepSndSetSta_MM : 87|2@1+ (1,0) [0|0] "" Vector__XXX
 SG_ USM_ShiftLightCustom2SetSta_MM : 89|2@1+ (1,0) [0|0] "" Vector__XXX
 SG_ USM_LapTimerAutoMsreSetSta_MM : 91|2@1+ (1,0) [0|0] ""  BLTN_CAM_FD
 SG_ USM_LapTimerTimeGapSetSta_MM : 93|2@1+ (1,0) [0|0] ""  BLTN_CAM_FD

BO_ 518 GNSS_07_100ms: 32 CGW_CCU
 SG_ GNSS_Crc7Val : 0|16@1+ (1,0) [0|0] "" Vector__XXX
 SG_ HU_DR_Latitude : 128|32@1- (1,0) [0|0] "˚"  BLTN_CAM_FD
 SG_ GNSS_AlvCnt7Val : 16|8@1+ (1,0) [0|0] "" Vector__XXX
 SG_ HU_DR_Longitude : 160|32@1- (1,0) [0|0] "˚"  BLTN_CAM_FD
 SG_ HU_DR_Heading : 192|16@1+ (1,0) [0|0] "˚"  BLTN_CAM_FD
 SG_ HU_DR_Speed : 208|16@1- (0.01,0) [0|0] "m/s" Vector__XXX
 SG_ HU_DR_TimeOfWeek : 24|32@1+ (1,0) [0|0] "ms" Vector__XXX
 SG_ HU_DR_Position_Status : 64|1@1+ (1,0) [0|0] "" Vector__XXX
 SG_ HU_DR_Altitude_Status : 65|1@1+ (1,0) [0|0] "" Vector__XXX
 SG_ HU_DR_Heading_Status : 66|1@1+ (1,0) [0|0] "" Vector__XXX
 SG_ HU_DR_Speed_Status : 67|1@1+ (1,0) [0|0] "" Vector__XXX
 SG_ HU_DR_DirectionSwitch_Sta : 68|1@1+ (1,0) [0|0] "" Vector__XXX
 SG_ HU_DR_Direction : 69|1@1+ (1,0) [0|0] "" Vector__XXX
 SG_ HU_DR_GyroCalib_Sta : 70|1@1+ (1,0) [0|0] "" Vector__XXX
 SG_ HU_DR_TachoCalib_Sta : 71|1@1+ (1,0) [0|0] "" Vector__XXX
 SG_ HU_DR_Solution_Sta : 72|1@1+ (1,0) [0|0] "" Vector__XXX
 SG_ HU_DR_GNSS_Fix_Age : 73|8@1+ (1,0) [0|0] "Sec" Vector__XXX
 SG_ HU_DR_Altitude : 81|16@1- (1,0) [0|0] "m"  BLTN_CAM_FD

BO_ 309 BAT_01_10ms: 16 CGW_CCU
 SG_ BAT_Crc1Val : 0|16@1+ (1,0) [0|0] "" Vector__XXX
 SG_ BAT_AlvCnt1Val : 16|8@1+ (1,0) [0|0] "" Vector__XXX
 SG_ BAT_CurrVal : 24|16@1+ (0.01,-327) [0|0] "A" Vector__XXX
 SG_ BAT_SocVal : 40|8@1+ (1,0) [0|0] ""  BLTN_CAM_FD
 SG_ BAT_VoltVal : 48|14@1+ (0.001,6) [0|0] "V" Vector__XXX
 SG_ BAT_AuxBattOpt : 62|2@1+ (1,0) [0|0] "" Vector__XXX
 SG_ BAT_TempVal : 64|9@1+ (0.5,-40) [0|0] "℃"  BLTN_CAM_FD
 SG_ BAT_SocErrSta : 73|2@1+ (1,0) [0|0] "" Vector__XXX
 SG_ BAT_SohVal : 75|7@1+ (1,0) [0|0] "%" Vector__XXX
 SG_ BAT_SnsrInvldSta : 82|2@1+ (1,0) [0|0] "" Vector__XXX
 SG_ BAT_SofVal : 84|7@1+ (0.1,0) [0|0] "V" Vector__XXX
 SG_ BAT_RspErrSta : 91|2@1+ (1,0) [0|0] "" Vector__XXX
 SG_ BAT_CapacityVal : 96|8@1+ (1,0) [0|0] "" Vector__XXX

CM_ BO_ 676 "[PE] Periodic and On Event";
CM_ SG_ 676 HU_CLU_Crc3Val "HU_CLU_CyclicRedundancyCheck3Value";
CM_ SG_ 676 HD_SPS_ChannelNo "Information for SPS(Supplementary Program Service) Channel Number of HD Radio";
CM_ SG_ 676 HU_CLU_BlueLightSta "HU Bluelight state: On/Off";
CM_ SG_ 676 SXM_ChannelNo "Information for SXM Channel Number

Range : 0~999";
CM_ SG_ 676 HU_CLU_AlvCnt3Val "HU_CLU_AliveCounter3Value";
CM_ SG_ 676 LapTimer_CountStart "Lap Timer CountStart for H/unit";
CM_ BO_ 256 "[P] Periodic";
CM_ SG_ 256 EMS_Crc2Val "EMS_CyclicRedundancyCheck2Value";
CM_ SG_ 256 ENG_CrwlSta "Engine Crawl Mode State";
CM_ SG_ 256 ACC_CrsMainSwLmpSta "ACC_CruiseMainSwLampStatus ##2G##EMS - EMS16 - CRUISE_LAMP_M";
CM_ SG_ 256 ACC_CrsSetSwLmpSta "ACC_CruiseSetSwLampStatus ##2G##EMS - EMS16 - CRUISE_LAMP_S";
CM_ SG_ 256 ENG_LV_FUP_ENA_THD "Fuel prsssure state ##2G##EMS - LPI11 - LV_FUP_ENA_THD";
CM_ SG_ 256 ENG_SoakTimeErrSta "ENG_SoakTimeErrorStatus ##2G##EMS - EMS16 - SOAK_TIME_ERROR";
CM_ SG_ 256 ENG_SoakTimeVal "ENG_SoakTimeValue ##2G##EMS - EMS16 - SOAK_TIME";
CM_ SG_ 256 ENG_SprkTimeVal "ENG_SparkTimeValue ##2G##EMS - EMS16 - SPK_TIME_CUR";
CM_ SG_ 256 ENG_MinIndTqVal "ENG_MinimumIndicatedTorqueValue ##2G##EMS - EMS16 - TQI_MIN";
CM_ SG_ 256 ENG_TrgtTqVal "ENG_TargetTorqueValue ##2G##EMS - EMS16 - TQI_TARGET";
CM_ SG_ 256 EMS_AlvCnt2Val "EMS_AliveCounter2Value";
CM_ SG_ 256 ENG_MaxIndTqVal "ENG_MaximumIndicatedTorqueValue ##2G##EMS - EMS16 - TQI_MAX";
CM_ SG_ 256 ENG_AppAccelPdlSta "ENG_AppliedAcceleratorPedalStatus ##2G##EMS - EMS16 - CF_Ems_AclAct";
CM_ SG_ 256 ENG_BrkCtrlReq "ENG_BrakeControlRequest ##2G##EMS - EMS19 - CF_Ems_BrkReq";
CM_ SG_ 256 ACC_DnShftCtrlReq "ACC_DownShiftControlRequest ##2G##EMS - EMS19 - CF_Ems_DnShftReq";
CM_ SG_ 256 ENG_DclBrkCntrlReq "ENG_DecelerationBrakeControlRequest ##2G##EMS - EMS19 - CF_Ems_DecelReq";
CM_ SG_ 256 ENG_BstPrsrVal "ENG_BoostPressureValue ##2G##EMS - EMS19 - CR_Ems_BstPre";
CM_ SG_ 256 ENG_EngOilTempVal "ENG_EngineOilTemperatureValue ##2G##EMS - EMS19 - CR_Ems_EngOilTemp";
CM_ SG_ 256 ENG_AmbtTempModelVal "ENG_AmbientTemperatureModelValue ##2G##EMS - EMS19 - CF_Ems_ModeledAmbTemp";
CM_ SG_ 256 ENG_DpfWrngSta "ENG_DpfWarningStatus ##2G##EMS - EMS19 - DPF_LAMP_STAT";
CM_ SG_ 256 ENG_BattWrngLmpSta "ENG_BatteryWarningLampStatus ##2G##EMS - EMS19 - BAT_LAMP_STAT";
CM_ SG_ 256 ENG_OilPrsrWrngLmpSta "ENG_OilPressureWarningLampStatus ##2G##EMS - EMS19 - CF_Ems_OPSFail";
CM_ SG_ 256 ENG_IsgInhbtLmpSta "ENG_IsgInhibitLampStatus ##2G##EMS - EMS19 - ISG_INHIBIT_LAMP_STAT";
CM_ SG_ 256 ENG_BrkSwSta "ENG_BrakeSwitchStatus ##2G##EMS - EMS12 - BRAKE_ACT";
CM_ SG_ 256 ENG_ObdFrzFrmSta "ENG_ObdFreezeFrameStatus ##2G##EMS - EMS12 - OBD_FRF_ACK";
CM_ SG_ 256 ENG_EngClntTempVal "ENG_EngineCoolantTemperatureValue ##2G##EMS - EMS12 - TEMP_ENG";
CM_ SG_ 256 ENG_MafCrctVal "ENG_MassAirFlowCorrectionValue ##2G##EMS - EMS12 - MAF_FAC_ALTI_MMV";
CM_ SG_ 256 ENG_BattDscnctSta "ENG_BatteryDisconnectStatus ##2G##EMS - EMS12 - VB_OFF_ACT";
CM_ SG_ 256 OBD_MilConfgVal "OBD_MalfunctionIndicationLampConfigurationValue ##2G##EMS - EMS12 - CONF_MIL_FMY";
CM_ SG_ 256 ENG_EngSta "ENG_EngineStatus ##2G##EMS - EMS16 - ENG_STAT";
CM_ SG_ 256 ENG_Ack4EngStpSta "ENG_AcknowledgeForEngineStopStatus ##2G##EMS - EMS12 - ACK_ES";
CM_ SG_ 256 ENG_OverDrvOffReq "ENG_OverDriveOffRequest ##2G##EMS - EMS12 - OD_OFF_REQ";
CM_ SG_ 256 ENG_AccActSta "ENG_AutoCruiseControlActiveStatus ##2G##EMS - EMS12 - ACC_ACT";
CM_ SG_ 256 ENG_CltchOpSta "ENG_ClutchStatus ##2G##EMS - EMS12 - CLU_ACK";
CM_ SG_ 256 EMS_BrkReq_Slope "Brake request at slope for anti-stall";
CM_ SG_ 256 ENG_AccDrvAlertDisp "The status of No Auto cruise Engaged or Auto cruise Disengaged.";
CM_ SG_ 256 DSL_GlowCtrlReq "DSL_GlowControlRequest ##2G##EMS - EMS12 - GP_CTL";
CM_ SG_ 256 ENG_GlowLmpSta "ENG_GlowLampStatus ##2G##EMS - EMS16 - GLOW_STAT";
CM_ SG_ 256 ENG_ThrPosVal "ENG_ThrottlePositionValue ##2G##EMS - EMS12 - TPS";
CM_ SG_ 256 ENG_AccelPdlVal "ENG_AcceleratorPedalValue ##2G##EMS - EMS12 - PV_AV_CAN";
CM_ BO_ 261 "[P] Periodic";
CM_ SG_ 261 EMS_Crc7Val "EMS_CyclicRedundancyCheck7Value";
CM_ SG_ 261 HEV_AccelPdlVal "HEV_AcceleratorPedalValue";
CM_ SG_ 261 HEV_IndTqTar "HEV_IndicatedTorqueTarget";
CM_ SG_ 261 HEV_IndTqVal_Extd "HEV_IndicatedTorqueValue_Extended";
CM_ SG_ 261 ENG_CSModeReq "ENG_CSModeRequest";
CM_ SG_ 261 HEV_TqStndVal_Extd "HEV_TorqueStandardValue (Extended Signal)";
CM_ SG_ 261 EMS_AlvCnt7Val "EMS_AliveCounter7Value";
CM_ SG_ 261 HEV_IndTqVal "HEV_IndicatedTorqueValue";
CM_ SG_ 261 HEV_DrvTqVal "HEV_DriverTorqueValue";
CM_ SG_ 261 HEV_TqStndVal "HEV_TorqueStandardValue";
CM_ SG_ 261 HEV_OilDilution_IncICELoad "HEV Oil Dilution Increase ICE Load";
CM_ SG_ 261 HEV_OilDilution_ServMode "HEV Oil Dilution Service Mode";
CM_ SG_ 261 EMS_TqLmtSta "Status of Torque Limit. Reference for TMS Cooperative control and Cluster notification";
CM_ SG_ 261 EMS_EU7 "Whether the vehicle is EU7 or not";
CM_ SG_ 261 HEV_FrctTqVal "HEV_FrictionTorqueValue";
CM_ SG_ 261 HEV_EngSpdVal "HEV_EngineSpeedValue";
CM_ SG_ 261 HEV_EngOpSta "HEV_EngineOperatingStatus";
CM_ SG_ 261 HEV_IntakeAirTempVal "HEV_IntakeAirTemperatureValue";
CM_ BO_ 813 "[PE] Periodic and On Event";
CM_ SG_ 813 SBCM_DRV_FD_Crc1Val "SBCM_DRV_FD_CyclicRedundancyCheck1Value";
CM_ SG_ 813 C_DrvDoorApproachOpen "Approach open";
CM_ SG_ 813 DoorLock_CtrlDrLkUnLkSwSta_SBCM "Central Door Lock/Unlock Switch State";
CM_ SG_ 813 CDMAutoWashModeSet_SBCM "Auto wash mode set signal for CDM from SBCM_DRV";
CM_ SG_ 813 SBCM_DRV_FD_AlvCnt1Val "SBCM_DRV_FD_AliveCounter1Value";
CM_ SG_ 813 ECMMRR_PLUS "ECM Voltage value";
CM_ SG_ 813 EHL_TxInfo_SBCM_DRV "Electronic hood latch status signal transfer for dual hood latch type (Copy to CANFD)";
CM_ SG_ 813 CDM_TypeOption "CDM_HS_OptionType";
CM_ SG_ 813 CDM_ImmeChgSw_SBCM "State of Immediate Charging Switch";
CM_ SG_ 813 CDM_OpnClsState_SBCM "CDM_HS_ OpenCloseState";
CM_ SG_ 813 CDM_WarnMsg_SBCM "CDM_HS_WarningMessage";
CM_ SG_ 813 CDM_CmdStatus_SBCM "CDM_HS_CommandStatus";
CM_ SG_ 813 Hood_TypeOption "E-Hood_Option Type";
CM_ SG_ 813 FrunkReleaseSwSta_SBCM "FrunkReleaseState";
CM_ SG_ 813 CDM_GbtImmeChgSw_SBCM "State of Immediate Charging Switch";
CM_ SG_ 813 CDM_GbtOpnClsState_SBCM "CDM_HS_ OpenCloseState";
CM_ SG_ 813 CDM_GbtWarnMsg_SBCM "CDM_HS_WarningMessage";
CM_ SG_ 813 FrunkEmergencySwSta_SBCM "FrunkEmergencySwState";
CM_ SG_ 813 C_ApprOpenStatus "Stop fob searching signal";
CM_ SG_ 813 DoorLock_DrvKeyLkSwSta_SBCM "DoorLock_DriverKeyLockSwitchStatus ##2G## -  - C_DrvKeyLockSw";
CM_ SG_ 813 DoorLock_DrvKeyUnLkSwSta_SBCM "DoorLock_DriverKeyUnLockSwitchStatus ##2G## -  - C_DrvKeyUnlockSw";
CM_ SG_ 813 Warn_DrvDrSwSta_SBCM "DoorLock_DriverDoorSwitchStatus ##2G## -  - C_DrvDrSw,CF_Gway_DrvDrSw,Warn_DrvDrSwSta";
CM_ SG_ 813 DoorLock_DrvDrUnLkSta_SBCM "DoorLock_DriverDoorUnLockStatus ##2G## -  - C_DrvUnlockState,CF_Gway_DrvUnlockState";
CM_ BO_ 2659690497 "[PE] Periodic and On Event";
CM_ SG_ 2659690497 BLTN_CAM_WU_Crc1Val "BLTN_CAM_WU_CyclicRedundancyCheck1Value";
CM_ SG_ 2659690497 BLTN_CAM_WU_AlvCnt1Val "BLTN_CAM_WU_AliveCounter1Value";
CM_ SG_ 2659690497 BLTN_CAM_WU_NM_B2 "BLTN_CAM Wake Up by NM in B2";
CM_ SG_ 2659690497 BLTN_CAM_WU_L_RecStpByBattEmpty "BLTN_CAM Wake Up by Logic - RecStpByBattEmpty";
CM_ SG_ 2659690497 BLTN_CAM_WU_L_RecStpByBLTNCAMErr "BLTN_CAM Wake Up by Logic - RecStpByBLTNCAMErr";
CM_ SG_ 2659690497 BLTN_CAM_WU_L_RecStpBySDCardErr "BLTN_CAM Wake Up by Logic - RecStpBySDCardErr";
CM_ SG_ 2659690497 BLTN_CAM_WU_L_RecStpBySDCardEjec "BLTN_CAM Wake Up by Logic - RecStpBySDCardEjec";
CM_ SG_ 2659690497 BLTN_CAM_WU_L_RecStpByUsrSetting "BLTN_CAM Wake Up by Logic - RecStpByUsrSetting";
CM_ SG_ 2659690497 BLTN_CAM_WU_L_ParkEvent "BLTN_CAM Wake Up by Logic - ParkEvent";
CM_ BO_ 811 "[PE] Periodic and On Event";
CM_ SG_ 811 SBCM_AST_FD_Crc1Val "SBCM_AST_FD_CyclicRedundancyCheck1Value";
CM_ SG_ 811 SBCM_AST_FD_AlvCnt1Val "SBCM_AST_FD_AliveCounter1Value";
CM_ SG_ 811 Hood_TypeOption_AST "E-Hood_Option Type";
CM_ SG_ 811 FrunkReleaseSwSta_SBCM_AST "FrunkReleaseState (SBCM_AST_FD to SBCM_DRV_FD) RHD Spec";
CM_ SG_ 811 FrunkInsideRelSwSta_SBCM_AST "FrunkInsideReleaseSwState (SBCM_AST_FD to SBCM_DRV_FD) RHD Spec";
CM_ SG_ 811 FrunkEmergencySwSta_SBCM_AST "FrunkEmergencySwState (SBCM_AST_FD to SBCM_DRV_FD) RHD Spec";
CM_ SG_ 811 EHL_TxInfo_SBCM_AST "Electronic hood latch status signal transfer for dual hood latch type";
CM_ SG_ 811 AST_CrashUnlockCmd "AssistCrashUnlockCommand";
CM_ SG_ 811 DoorLock_CtrlDrLkSwSta_SBCM "DoorLock_CentralDoorLockAssistSwitchStatus";
CM_ SG_ 811 DoorLock_CtrlDrUnLkSwSta_SBCM "DoorLock_CentralDoorUnLockAssistSwitchStatus";
CM_ SG_ 811 Warn_AsstDrSwSta_SBCM "Warn_AssistDoorSwitchStatus ##2G## -  - C_AstDrSw,CF_Gway_AstDrSw,Warn_AsstDrSwSta";
CM_ SG_ 811 DoorLock_AsstDrUnLkSta_SBCM "DoorLock_AssistDoorUnLockStatus ##2G## -  - C_AstUnlockState,DoorLock_AsstDrUnLkSta";
CM_ SG_ 811 AST_SEAWarn_RH "Assist SEA Warning (LHD)";
CM_ BO_ 930 "[PE] Periodic and On Event";
CM_ SG_ 930 CLU_HU_Crc3Val "CLU_HU_CyclicRedundancyCheck3Value";
CM_ SG_ 930 CLU_TermAvgSync_MM "2nd General ? MM-CAN(LS):CF_Clu_TermAvgSync";
CM_ SG_ 930 CLU_TermAvgFCL_Digit_MM "2nd General ? MM-CAN(LS):CR_Clu_TermAvgFCI_Digit";
CM_ SG_ 930 CLU_TermAvgFuelCnsmptnVal_MM "2nd General ? MM-CAN(LS):CR_Clu_TermAvgFCI";
CM_ SG_ 930 CLU_OptionInfo "Information of CLU functions";
CM_ SG_ 930 CLU_DispThmSetRdy "Available of CLU DisplayTheme change";
CM_ SG_ 930 CLU_DispThmMemSta "The signal indicates CLU FoD Diplay Theme Memory status for sync with HU";
CM_ SG_ 930 CLU_HU_AlvCnt3Val "CLU_HU_AliveCounter3Value";
CM_ SG_ 930 CLU_LapTimer_LapNumber_MM "MM-CAN(LS):CLU_HU_PE_04/LapTimer_LapNumber";
CM_ SG_ 930 CLU_LapTimer_Hour_MM "MM-CAN(LS):CLU_HU_PE_04/LapTimer_Hour";
CM_ SG_ 930 CLU_LapTimer_Minute_MM "MM-CAN(LS):CLU_HU_PE_04/LapTimer_Minute";
CM_ SG_ 930 CLU_LapTimer_Second_MM "MM-CAN(LS):CLU_HU_PE_04/LapTimer_Second";
CM_ SG_ 930 CLU_LapTimer_MeasuringStatus_MM "MM-CAN(LS):CLU_HU_PE_04/LapTimer_MeasuringStatus";
CM_ SG_ 930 CLU_LapTimer_milisecond_MM "MM-CAN(LS):CLU_HU_PE_04/LapTimer_milisecond";
CM_ SG_ 930 CLU_N1SetVal_MM "N1 S/W set value feedback to H/U";
CM_ SG_ 930 CLU_N2SetVal_MM "N2 S/W set value feedback to H/U";
CM_ SG_ 930 Usm_TorqueUnitSetSta_MM "MM-CAN(LS) : CLU_HU_PE_05/Clu_Usm_TorqueUnit";
CM_ SG_ 930 Usm_TurboPressureUnitSetSta_MM "MM-CAN(LS):CLU_HU_PE_05/Clu_Usm_TurboPressureUnit";
CM_ SG_ 930 USM_ShiftLightNmodeSetSta_MM "It is a signal for Shiftlight AVN USM";
CM_ SG_ 930 USM_ShiftLightCustomSetSta_MM "When AVN send a signal(Event), Cluster send this feeback signal for changing setting value";
CM_ SG_ 930 USM_ShiftLightSportSetSta_MM "When AVN send a signal(Event), Cluster send this feeback signal for changing setting value";
CM_ SG_ 930 USM_ShiftLightNormalSetSta_MM "When AVN send a signal(Event), Cluster send this feeback signal for changing setting value";
CM_ SG_ 930 USM_ShiftLightEcoSetSta_MM "When AVN send a signal(Event), Cluster send this feeback signal for changing setting value";
CM_ SG_ 930 USM_ShiftLightBeepSndSetSta_MM "When AVN send a signal(Event), Cluster send this feeback signal for changing setting value";
CM_ SG_ 930 USM_ShiftLightCustom2SetSta_MM "When AVN send a signal(Event), Cluster send this feeback signal for changing setting value";
CM_ SG_ 930 USM_LapTimerAutoMsreSetSta_MM "Setting value for auto-measurement of Laptimer";
CM_ SG_ 930 USM_LapTimerTimeGapSetSta_MM "setting value for laptimer time gap displaying";
CM_ BO_ 518 "[P] Periodic";
CM_ SG_ 518 GNSS_Crc7Val "GNSS_CyclicRedundancyCheck7Value";
CM_ SG_ 518 HU_DR_Latitude "1sc(semi-cicle)= pi rad=180  /   unit : 2^-31sc  /  range [-1/2~1/2] sc";
CM_ SG_ 518 GNSS_AlvCnt7Val "GNSS_AliveCounter7Value";
CM_ SG_ 518 HU_DR_Longitude "1sc(semi-circle)=pi rad=180 / unit:2^-31sc / range:[-1, 1]sc";
CM_ SG_ 518 HU_DR_Heading "1sc(semi-circle)=pi rad=180 / unit=2^-15sc / range:[0,2]SC";
CM_ SG_ 518 HU_DR_Speed "unit : 1cm/s";
CM_ SG_ 518 HU_DR_TimeOfWeek "Local Time which DR data is transmitted";
CM_ SG_ 518 HU_DR_Position_Status "DR Position status";
CM_ SG_ 518 HU_DR_Altitude_Status "DR Altitude Status";
CM_ SG_ 518 HU_DR_Heading_Status "DR Heading Status";
CM_ SG_ 518 HU_DR_Speed_Status "DR Speed status";
CM_ SG_ 518 HU_DR_DirectionSwitch_Sta "DR DirectionSwitch Status";
CM_ SG_ 518 HU_DR_Direction "DR Direction, Backward";
CM_ SG_ 518 HU_DR_GyroCalib_Sta "DR Gyro Calibration Status";
CM_ SG_ 518 HU_DR_TachoCalib_Sta "DR Tacho Calibration Status";
CM_ SG_ 518 HU_DR_GNSS_Fix_Age "Time since last GNSS fix";
CM_ SG_ 518 HU_DR_Altitude "range [-400,10000]";
CM_ BO_ 309 "[P] Periodic";
CM_ SG_ 309 BAT_Crc1Val "BAT_CyclicRedundancyCheck1Value";
CM_ SG_ 309 BAT_AlvCnt1Val "BAT_AliveCounter1Value";
CM_ SG_ 309 BAT_CurrVal "BAT_CurrentValue";
CM_ SG_ 309 BAT_SocVal "BAT_StateOfChargeValue";
CM_ SG_ 309 BAT_VoltVal "BAT_VoltageValue";
CM_ SG_ 309 BAT_AuxBattOpt "12V Battery Option Value(LFP 12V Battery)";
CM_ SG_ 309 BAT_TempVal "BAT_TemperatureValue";
CM_ SG_ 309 BAT_SocErrSta "BAT_SoCErrorStatus";
CM_ SG_ 309 BAT_SohVal "BAT_StateOfHealthValue";
CM_ SG_ 309 BAT_SnsrInvldSta "BAT_SensorInvalidStatus";
CM_ SG_ 309 BAT_SofVal "BAT_StateOfFunctionValue";
CM_ SG_ 309 BAT_RspErrSta "BAT_ResponseErrorStatus";
CM_ SG_ 309 BAT_CapacityVal "12V Battery Capacity Value";
BA_DEF_ BO_  "GenMsgEVName" STRING ;
BA_DEF_ BO_  "NmAsrMessage" ENUM  "No","Yes";
BA_DEF_ BO_  "DiagState" ENUM  "No","Yes";
BA_DEF_ BO_  "DiagRequest" ENUM  "No","Yes";
BA_DEF_ BO_  "TpMessage" ENUM  "No","Yes";
BA_DEF_ BO_  "UsrMsgIDSforwardDeviation" INT 0 100;
BA_DEF_ BO_  "UsrMsgIDSbackwardDeviation" INT 50 1000;
BA_DEF_ BO_  "GenMsgCycleTime" INT 0 2000;
BA_DEF_ BO_  "GenMsgStartDelayTime" INT 0 2000;
BA_DEF_ BO_  "GenMsgSendType" ENUM  "Cyclic","NoMsgSendType";
BA_DEF_ BO_  "GenMsgCycleTimeFast" INT 0 500;
BA_DEF_ BO_  "GenMsgDelayTime" INT 0 20;
BA_DEF_ BO_  "GenMsgILSupport" ENUM  "No","Yes";
BA_DEF_ BO_  "GenMsgNrOfRepetition" INT 0 3;
BA_DEF_ BO_  "VFrameFormat" ENUM  "StandardCAN","ExtendedCAN","reserved","reserved","reserved","reserved","reserved","reserved","reserved","reserved","reserved","reserved","reserved","reserved","StandardCAN_FD","ExtendedCAN_FD";
BA_DEF_ SG_  "UserSigValidity" ENUM  "B+","ACC","IG","IG1","IG2","IG3","IG1 or IG2","IG1 or IG3","Undef";
BA_DEF_ SG_  "TimeoutValue" STRING ;
BA_DEF_ SG_  "UsrSigPurpose" ENUM  "Undef","FN","DIAG","DIAG(Req)","DIAG(Res)","DIAG(Func)","DEV","CCP","NM","TP";
BA_DEF_ SG_  "GenSigStartValue" INT 0 1215752192;
BA_DEF_ SG_  "NetworkRequest" ENUM  "Yes","No";
BA_DEF_ SG_  "NetworkRequestHoldingTime" INT 0 65535;
BA_DEF_ SG_  "Description" STRING ;
BA_DEF_ SG_  "Version" STRING ;
BA_DEF_ SG_  "GenSigEnvVarType" ENUM  "Int","Float","Undef";
BA_DEF_ SG_  "GenSigSendType" ENUM  "Cyclic","OnWrite","OnWriteWithRepetition","OnChange","OnChangeWithRepetition","IfActive","IfActiveWithRepetition","NoSigSendType","OnChangeAndIfActive","OnChangeAndIfActiveWithRepetition";
BA_DEF_ SG_  "GwSigLatencyTime" INT 0 65536;
BA_DEF_ SG_  "GwSigMissingSourceType" ENUM  "Undef","OldValue","DefaultValue","InitialValue";
BA_DEF_ SG_  "NWM-WakeupAllowed" ENUM  "<n.a.>";
BA_DEF_ SG_  "RoutingFactor" INT 1 1215752192;
BA_DEF_ SG_  "SystemSignalLongSymbol" STRING ;
BA_DEF_REL_ BU_SG_REL_  "GenSigTimeoutTime" INT 0 7000;
BA_DEF_DEF_  "GenMsgEVName" "@Signame";
BA_DEF_DEF_  "NmAsrMessage" "No";
BA_DEF_DEF_  "DiagState" "No";
BA_DEF_DEF_  "DiagRequest" "No";
BA_DEF_DEF_  "TpMessage" "No";
BA_DEF_DEF_  "UsrMsgIDSforwardDeviation" 10;
BA_DEF_DEF_  "UsrMsgIDSbackwardDeviation" 100;
BA_DEF_DEF_  "GenMsgCycleTime" 200;
BA_DEF_DEF_  "GenMsgStartDelayTime" 0;
BA_DEF_DEF_  "GenMsgSendType" "NoMsgSendType";
BA_DEF_DEF_  "GenMsgCycleTimeFast" 40;
BA_DEF_DEF_  "GenMsgDelayTime" 20;
BA_DEF_DEF_  "GenMsgILSupport" "Yes";
BA_DEF_DEF_  "GenMsgNrOfRepetition" 3;
BA_DEF_DEF_  "VFrameFormat" "StandardCAN";
BA_DEF_DEF_  "UserSigValidity" "IG";
BA_DEF_DEF_  "TimeoutValue" "";
BA_DEF_DEF_  "UsrSigPurpose" "FN";
BA_DEF_DEF_  "GenSigStartValue" 0;
BA_DEF_DEF_  "NetworkRequest" "No";
BA_DEF_DEF_  "NetworkRequestHoldingTime" 0;
BA_DEF_DEF_  "Description" "";
BA_DEF_DEF_  "Version" "";
BA_DEF_DEF_  "GenSigEnvVarType" "Undef";
BA_DEF_DEF_  "GenSigSendType" "NoSigSendType";
BA_DEF_DEF_  "GwSigLatencyTime" 40;
BA_DEF_DEF_  "GwSigMissingSourceType" "Undef";
BA_DEF_DEF_  "NWM-WakeupAllowed" "<n.a.>";
BA_DEF_DEF_  "RoutingFactor" 1;
BA_DEF_DEF_REL_ "GenSigTimeoutTime" 500;
BA_DEF_DEF_  "SystemSignalLongSymbol" "";
BA_ "GenMsgStartDelayTime" BO_ 676 40;
BA_ "GenMsgSendType" BO_ 676 0;
BA_ "VFrameFormat" BO_ 676 14;
BA_ "GenMsgNrOfRepetition" BO_ 256 0;
BA_ "GenMsgCycleTimeFast" BO_ 256 0;
BA_ "GenMsgCycleTime" BO_ 256 50;
BA_ "GenMsgSendType" BO_ 256 0;
BA_ "VFrameFormat" BO_ 256 14;
BA_ "GenMsgNrOfRepetition" BO_ 261 0;
BA_ "GenMsgCycleTimeFast" BO_ 261 0;
BA_ "GenMsgCycleTime" BO_ 261 50;
BA_ "GenMsgSendType" BO_ 261 0;
BA_ "VFrameFormat" BO_ 261 14;
BA_ "GenMsgSendType" BO_ 813 0;
BA_ "VFrameFormat" BO_ 813 14;
BA_ "GenMsgCycleTime" BO_ 2659690497 1000;
BA_ "GenMsgSendType" BO_ 2659690497 0;
BA_ "VFrameFormat" BO_ 2659690497 15;
BA_ "GenMsgSendType" BO_ 811 0;
BA_ "VFrameFormat" BO_ 811 14;
BA_ "GenMsgStartDelayTime" BO_ 930 10;
BA_ "GenMsgSendType" BO_ 930 0;
BA_ "VFrameFormat" BO_ 930 14;
BA_ "GenMsgNrOfRepetition" BO_ 518 0;
BA_ "GenMsgCycleTimeFast" BO_ 518 0;
BA_ "GenMsgCycleTime" BO_ 518 100;
BA_ "GenMsgSendType" BO_ 518 0;
BA_ "VFrameFormat" BO_ 518 14;
BA_ "GenMsgNrOfRepetition" BO_ 309 0;
BA_ "GenMsgCycleTimeFast" BO_ 309 0;
BA_ "GenMsgCycleTime" BO_ 309 50;
BA_ "GenMsgSendType" BO_ 309 0;
BA_ "VFrameFormat" BO_ 309 14;
BA_ "Version" SG_ 676 HU_CLU_Crc3Val "22.10.20";
BA_ "UserSigValidity" SG_ 676 HU_CLU_Crc3Val 3;
BA_ "GenSigStartValue" SG_ 676 HU_CLU_Crc3Val 65535;
BA_ "GenSigSendType" SG_ 676 HU_CLU_Crc3Val 4;
BA_ "Description" SG_ 676 HU_CLU_Crc3Val "The data area for CRC calculation is based on the data length (DLC) of the message DB.

The CRC shall be calculated over the entire data block (excluding the CRC bytes) including the user data, alive counter and Data ID



- CRC Polynomial (0x1021) , Ini";
BA_ "Version" SG_ 676 AVNT_NModeSel2_Custom1SetVal "22.08.01";
BA_ "UserSigValidity" SG_ 676 AVNT_NModeSel2_Custom1SetVal 3;
BA_ "GenSigSendType" SG_ 676 AVNT_NModeSel2_Custom1SetVal 4;
BA_ "Description" SG_ 676 AVNT_NModeSel2_Custom1SetVal "Custom Mode 1 setting value in N Mode selection 2 of N1/N2";
BA_ "Version" SG_ 676 AVNT_NModeSel2_Custom2SetVal "22.08.01";
BA_ "UserSigValidity" SG_ 676 AVNT_NModeSel2_Custom2SetVal 3;
BA_ "GenSigSendType" SG_ 676 AVNT_NModeSel2_Custom2SetVal 4;
BA_ "Description" SG_ 676 AVNT_NModeSel2_Custom2SetVal "Custom Mode 2 setting value in N Mode selection2 of N1/N2";
BA_ "Version" SG_ 676 AVNT_NHndlSel2_SportSetVal "22.08.01";
BA_ "UserSigValidity" SG_ 676 AVNT_NHndlSel2_SportSetVal 3;
BA_ "GenSigSendType" SG_ 676 AVNT_NHndlSel2_SportSetVal 4;
BA_ "Description" SG_ 676 AVNT_NHndlSel2_SportSetVal "Sport mode setting value in N Handling selection2 of N1/N2";
BA_ "Version" SG_ 676 AVNT_NHndlSel2_TrackSetVal "22.08.01";
BA_ "UserSigValidity" SG_ 676 AVNT_NHndlSel2_TrackSetVal 3;
BA_ "GenSigSendType" SG_ 676 AVNT_NHndlSel2_TrackSetVal 4;
BA_ "Description" SG_ 676 AVNT_NHndlSel2_TrackSetVal "Track mode setting value in N Handling selection2 of N1/N2";
BA_ "Version" SG_ 676 AVNT_NHndlSel2_DriftSetVal "22.08.01";
BA_ "UserSigValidity" SG_ 676 AVNT_NHndlSel2_DriftSetVal 3;
BA_ "GenSigSendType" SG_ 676 AVNT_NHndlSel2_DriftSetVal 4;
BA_ "Description" SG_ 676 AVNT_NHndlSel2_DriftSetVal "Drift mode setting value in N Handling selection2 of N1/N2";
BA_ "Version" SG_ 676 AVNT_NHndlSel2_WetSetVal "22.08.01";
BA_ "UserSigValidity" SG_ 676 AVNT_NHndlSel2_WetSetVal 3;
BA_ "GenSigSendType" SG_ 676 AVNT_NHndlSel2_WetSetVal 4;
BA_ "Description" SG_ 676 AVNT_NHndlSel2_WetSetVal "Wet mode setting value in N Handling selection 2 of N1/N2";
BA_ "Version" SG_ 676 HU_DispThmSetStaMem "23.08.03";
BA_ "UserSigValidity" SG_ 676 HU_DispThmSetStaMem 0;
BA_ "GenSigSendType" SG_ 676 HU_DispThmSetStaMem 4;
BA_ "Description" SG_ 676 HU_DispThmSetStaMem "Display theme setting request (Memory).";
BA_ "Version" SG_ 676 HU_DispThmMemSta "23.08.03";
BA_ "UserSigValidity" SG_ 676 HU_DispThmMemSta 0;
BA_ "GenSigSendType" SG_ 676 HU_DispThmMemSta 4;
BA_ "Description" SG_ 676 HU_DispThmMemSta "HU Display Theme memory saving status (Memory 1/2/3).";
BA_ "Version" SG_ 676 AVNT_NModeSel_NSetVal "22.07.05";
BA_ "UserSigValidity" SG_ 676 AVNT_NModeSel_NSetVal 3;
BA_ "GenSigSendType" SG_ 676 AVNT_NModeSel_NSetVal 4;
BA_ "Description" SG_ 676 AVNT_NModeSel_NSetVal "N mode setting value in N Mode selection of N1/N2";
BA_ "Version" SG_ 676 AVNT_NModeSel_Custom1SetVal "22.07.05";
BA_ "UserSigValidity" SG_ 676 AVNT_NModeSel_Custom1SetVal 3;
BA_ "GenSigSendType" SG_ 676 AVNT_NModeSel_Custom1SetVal 4;
BA_ "Description" SG_ 676 AVNT_NModeSel_Custom1SetVal "Custom Mode 1 setting value in N Mode selection of N1/N2";
BA_ "Version" SG_ 676 AVNT_NModeSel_Custom2SetVal "22.07.05";
BA_ "UserSigValidity" SG_ 676 AVNT_NModeSel_Custom2SetVal 3;
BA_ "GenSigSendType" SG_ 676 AVNT_NModeSel_Custom2SetVal 4;
BA_ "Description" SG_ 676 AVNT_NModeSel_Custom2SetVal "Custom Mode 2 setting value in N Mode selection of N1/N2";
BA_ "Version" SG_ 676 AVNT_NHndlSel_SportSetVal "22.07.05";
BA_ "UserSigValidity" SG_ 676 AVNT_NHndlSel_SportSetVal 3;
BA_ "GenSigSendType" SG_ 676 AVNT_NHndlSel_SportSetVal 4;
BA_ "Description" SG_ 676 AVNT_NHndlSel_SportSetVal "Sport mode setting value in N Handling selection of N1/N2";
BA_ "Version" SG_ 676 HD_SPS_ChannelNo "22.07.05";
BA_ "NetworkRequest" SG_ 676 HD_SPS_ChannelNo 0;
BA_ "UserSigValidity" SG_ 676 HD_SPS_ChannelNo 1;
BA_ "GenSigStartValue" SG_ 676 HD_SPS_ChannelNo 15;
BA_ "GenSigSendType" SG_ 676 HD_SPS_ChannelNo 4;
BA_ "Version" SG_ 676 HU_CLU_BlueLightLvl "22.07.05";
BA_ "UserSigValidity" SG_ 676 HU_CLU_BlueLightLvl 0;
BA_ "GenSigStartValue" SG_ 676 HU_CLU_BlueLightLvl 15;
BA_ "GenSigSendType" SG_ 676 HU_CLU_BlueLightLvl 4;
BA_ "Description" SG_ 676 HU_CLU_BlueLightLvl "HU Bluelight filter level state: 0~9level";
BA_ "Version" SG_ 676 HU_CLU_BlueLightSta "22.07.05";
BA_ "UserSigValidity" SG_ 676 HU_CLU_BlueLightSta 0;
BA_ "GenSigSendType" SG_ 676 HU_CLU_BlueLightSta 4;
BA_ "Description" SG_ 676 HU_CLU_BlueLightSta "HU Bluelight state: On/Off";
BA_ "Version" SG_ 676 SXM_ChannelNo "22.07.05";
BA_ "NetworkRequest" SG_ 676 SXM_ChannelNo 0;
BA_ "UserSigValidity" SG_ 676 SXM_ChannelNo 1;
BA_ "GenSigStartValue" SG_ 676 SXM_ChannelNo 1023;
BA_ "GenSigSendType" SG_ 676 SXM_ChannelNo 4;
BA_ "Version" SG_ 676 HU_CLU_AlvCnt3Val "22.10.20";
BA_ "UserSigValidity" SG_ 676 HU_CLU_AlvCnt3Val 3;
BA_ "GenSigSendType" SG_ 676 HU_CLU_AlvCnt3Val 4;
BA_ "Description" SG_ 676 HU_CLU_AlvCnt3Val "For the first transmission request for a data element the counter shall be initialized with 0 and shall be incremented by 1 for every subsequent send request. 

When the counter reaches the maximum value(0xFF), then it shall restart with 0 for the next s";
BA_ "Version" SG_ 676 AVNT_N1setVal "22.11.00";
BA_ "UserSigValidity" SG_ 676 AVNT_N1setVal 3;
BA_ "GenSigSendType" SG_ 676 AVNT_N1setVal 4;
BA_ "Description" SG_ 676 AVNT_N1setVal "N1 button setting value for N vehicles";
BA_ "Version" SG_ 676 AVNT_N2setVal "22.11.00";
BA_ "UserSigValidity" SG_ 676 AVNT_N2setVal 3;
BA_ "GenSigSendType" SG_ 676 AVNT_N2setVal 4;
BA_ "Description" SG_ 676 AVNT_N2setVal "N2 button setting value N vehicles";
BA_ "Version" SG_ 676 AVNT_NHndlSel_TrackSetVal "22.07.05";
BA_ "UserSigValidity" SG_ 676 AVNT_NHndlSel_TrackSetVal 3;
BA_ "GenSigSendType" SG_ 676 AVNT_NHndlSel_TrackSetVal 4;
BA_ "Description" SG_ 676 AVNT_NHndlSel_TrackSetVal "Track mode setting value in N Handling selection of N1/N2";
BA_ "Version" SG_ 676 AVNT_NHndlSel_DriftSetVal "22.07.05";
BA_ "UserSigValidity" SG_ 676 AVNT_NHndlSel_DriftSetVal 3;
BA_ "GenSigSendType" SG_ 676 AVNT_NHndlSel_DriftSetVal 4;
BA_ "Description" SG_ 676 AVNT_NHndlSel_DriftSetVal "Drift mode setting value in N Handling selection of N1/N2";
BA_ "Version" SG_ 676 AVNT_NHndlSel_WetSetVal "22.07.05";
BA_ "UserSigValidity" SG_ 676 AVNT_NHndlSel_WetSetVal 3;
BA_ "GenSigSendType" SG_ 676 AVNT_NHndlSel_WetSetVal 4;
BA_ "Description" SG_ 676 AVNT_NHndlSel_WetSetVal "Wet mode setting value in N Handling selection of N1/N2";
BA_ "Version" SG_ 676 LapTimer_LapNumber_HU "22.06.01";
BA_ "UserSigValidity" SG_ 676 LapTimer_LapNumber_HU 3;
BA_ "GenSigStartValue" SG_ 676 LapTimer_LapNumber_HU 127;
BA_ "GenSigSendType" SG_ 676 LapTimer_LapNumber_HU 4;
BA_ "Description" SG_ 676 LapTimer_LapNumber_HU "Lap Number measured by AVNT";
BA_ "Version" SG_ 676 LapTimer_Hour_HU "22.06.01";
BA_ "UserSigValidity" SG_ 676 LapTimer_Hour_HU 3;
BA_ "GenSigStartValue" SG_ 676 LapTimer_Hour_HU 127;
BA_ "GenSigSendType" SG_ 676 LapTimer_Hour_HU 4;
BA_ "Description" SG_ 676 LapTimer_Hour_HU "Hour of laptime measured by AVNT";
BA_ "Version" SG_ 676 LapTimer_Minute_HU "22.06.01";
BA_ "UserSigValidity" SG_ 676 LapTimer_Minute_HU 3;
BA_ "GenSigStartValue" SG_ 676 LapTimer_Minute_HU 63;
BA_ "GenSigSendType" SG_ 676 LapTimer_Minute_HU 4;
BA_ "Description" SG_ 676 LapTimer_Minute_HU "Minute of laptime measured by AVNT";
BA_ "Version" SG_ 676 LapTimer_Second_HU "22.06.01";
BA_ "UserSigValidity" SG_ 676 LapTimer_Second_HU 3;
BA_ "GenSigStartValue" SG_ 676 LapTimer_Second_HU 63;
BA_ "GenSigSendType" SG_ 676 LapTimer_Second_HU 4;
BA_ "Description" SG_ 676 LapTimer_Second_HU "Second of laptime mesured by AVNT";
BA_ "Version" SG_ 676 LapTimer_milisecond_HU "22.06.01";
BA_ "UserSigValidity" SG_ 676 LapTimer_milisecond_HU 3;
BA_ "GenSigStartValue" SG_ 676 LapTimer_milisecond_HU 127;
BA_ "GenSigSendType" SG_ 676 LapTimer_milisecond_HU 4;
BA_ "Description" SG_ 676 LapTimer_milisecond_HU "Milisecond of laptime measured by AVNT";
BA_ "Version" SG_ 676 LapTimer_CountStart "22.11.02";
BA_ "UserSigValidity" SG_ 676 LapTimer_CountStart 3;
BA_ "GenSigStartValue" SG_ 676 LapTimer_CountStart 3;
BA_ "GenSigSendType" SG_ 676 LapTimer_CountStart 4;
BA_ "Version" SG_ 676 AVNT_NModeSel2_NSetVal "22.08.01";
BA_ "UserSigValidity" SG_ 676 AVNT_NModeSel2_NSetVal 3;
BA_ "GenSigSendType" SG_ 676 AVNT_NModeSel2_NSetVal 4;
BA_ "Description" SG_ 676 AVNT_NModeSel2_NSetVal "N mode setting value in N Mode selection 2 of N1/N2";
BA_ "Version" SG_ 256 EMS_Crc2Val "21.09.03";
BA_ "RoutingFactor" SG_ 256 EMS_Crc2Val 0;
BA_ "UserSigValidity" SG_ 256 EMS_Crc2Val 3;
BA_ "GenSigStartValue" SG_ 256 EMS_Crc2Val 65535;
BA_ "Description" SG_ 256 EMS_Crc2Val "The data area for CRC calculation is based on the data length (DLC) of the message DB.

The CRC shall be calculated over the entire data block (excluding the CRC bytes) including the user data, alive counter and Data ID



- CRC Polynomial (0x1021) , Ini";
BA_ "Version" SG_ 256 ENG_CrwlSta "24.10.01";
BA_ "RoutingFactor" SG_ 256 ENG_CrwlSta 0;
BA_ "UserSigValidity" SG_ 256 ENG_CrwlSta 3;
BA_ "Description" SG_ 256 ENG_CrwlSta "Engine Crawl Mode State";
BA_ "Version" SG_ 256 ACC_CrsMainSwLmpSta "17.12.00";
BA_ "RoutingFactor" SG_ 256 ACC_CrsMainSwLmpSta 0;
BA_ "UserSigValidity" SG_ 256 ACC_CrsMainSwLmpSta 3;
BA_ "Description" SG_ 256 ACC_CrsMainSwLmpSta "This signal indicates that an ECU requests cluster to turn on/off auto-cruise control “MAIN” switch indication lamp.



This signal is for the CAN-type cluster installed vehicled only.";
BA_ "Version" SG_ 256 ACC_CrsSetSwLmpSta "17.12.00";
BA_ "RoutingFactor" SG_ 256 ACC_CrsSetSwLmpSta 0;
BA_ "UserSigValidity" SG_ 256 ACC_CrsSetSwLmpSta 3;
BA_ "Description" SG_ 256 ACC_CrsSetSwLmpSta "This signal indicates that an ECU requests cluster to turn on/off auto-cruise control “SET” switch indication lamp.



This signal is for the CAN-type cluster installed vehicled only.";
BA_ "Version" SG_ 256 ENG_LV_FUP_ENA_THD "18.12.01";
BA_ "RoutingFactor" SG_ 256 ENG_LV_FUP_ENA_THD 0;
BA_ "UserSigValidity" SG_ 256 ENG_LV_FUP_ENA_THD 3;
BA_ "Description" SG_ 256 ENG_LV_FUP_ENA_THD "The signal indicates that the status of the pressure on fuel rail is enough high to start engine.

(LPI)";
BA_ "Version" SG_ 256 ENG_SoakTimeErrSta "17.12.00";
BA_ "RoutingFactor" SG_ 256 ENG_SoakTimeErrSta 0;
BA_ "UserSigValidity" SG_ 256 ENG_SoakTimeErrSta 3;
BA_ "Description" SG_ 256 ENG_SoakTimeErrSta "This signal indicates that information on soak time error.";
BA_ "Version" SG_ 256 ENG_SoakTimeVal "17.12.00";
BA_ "RoutingFactor" SG_ 256 ENG_SoakTimeVal 0;
BA_ "UserSigValidity" SG_ 256 ENG_SoakTimeVal 3;
BA_ "Description" SG_ 256 ENG_SoakTimeVal "The Signal SOAK_TIME means the duration from Engine Ignition Off to Ignition On.";
BA_ "Version" SG_ 256 ENG_SprkTimeVal "17.12.00";
BA_ "RoutingFactor" SG_ 256 ENG_SprkTimeVal 0;
BA_ "UserSigValidity" SG_ 256 ENG_SprkTimeVal 3;
BA_ "Description" SG_ 256 ENG_SprkTimeVal "This signal indicates output value of final spark timing from ECU which reflects torque intervention requests by ESC(TCS), SCC and TCU.



Physical range:

-35.625˚ … 0˚  =  00H .. 5FH (Retard)

0.375˚ … 60˚  =  60H .. FFH (Advance) 



Conversion:";
BA_ "Version" SG_ 256 ENG_MinIndTqVal "18.01.01";
BA_ "RoutingFactor" SG_ 256 ENG_MinIndTqVal 0;
BA_ "UserSigValidity" SG_ 256 ENG_MinIndTqVal 3;
BA_ "Description" SG_ 256 ENG_MinIndTqVal "The signal TQI_MIN is the minimum engine torque (minimum air charging rate) which can be fired without misfire including compensation factors such as atmospheric pressure and temperature.

It is not enough to keep the engine running without external powe";
BA_ "Version" SG_ 256 ENG_TrgtTqVal "18.01.01";
BA_ "RoutingFactor" SG_ 256 ENG_TrgtTqVal 0;
BA_ "UserSigValidity" SG_ 256 ENG_TrgtTqVal 3;
BA_ "Description" SG_ 256 ENG_TrgtTqVal "The signal TQI_TARGET is determined by an engine torque map with input which consists of  acceleration pedal value, MAF sensor, current RPM and etc. This signal reflects driver’s demand directly. 

But it does not depend on torque interventions realised";
BA_ "Version" SG_ 256 EMS_AlvCnt2Val "21.09.03";
BA_ "RoutingFactor" SG_ 256 EMS_AlvCnt2Val 0;
BA_ "UserSigValidity" SG_ 256 EMS_AlvCnt2Val 3;
BA_ "Description" SG_ 256 EMS_AlvCnt2Val "For the first transmission request for a data element the counter shall be initialized with 0 and shall be incremented by 1 for every subsequent send request. 

When the counter reaches the maximum value(0xFF), then it shall restart with 0 for the next s";
BA_ "Version" SG_ 256 ENG_MaxIndTqVal "18.01.01";
BA_ "RoutingFactor" SG_ 256 ENG_MaxIndTqVal 0;
BA_ "UserSigValidity" SG_ 256 ENG_MaxIndTqVal 3;
BA_ "Description" SG_ 256 ENG_MaxIndTqVal "The signal TQI_MAX is the current maximum indicated engine torque. This signal reflects the maximum engine torque under current conditions (engine speed, etc…).



Note : TQI_MAX must be transmitted actual engine torque including COT, thermal/spark effi";
BA_ "Version" SG_ 256 ENG_AppAccelPdlSta "17.12.00";
BA_ "RoutingFactor" SG_ 256 ENG_AppAccelPdlSta 0;
BA_ "UserSigValidity" SG_ 256 ENG_AppAccelPdlSta 3;
BA_ "Description" SG_ 256 ENG_AppAccelPdlSta "This signal indicates if the driver applies the accelerator pedal. 

The signal always indicates the actual operation of the accelerator pedal, independent from SCC mode.";
BA_ "Version" SG_ 256 ENG_BrkCtrlReq "17.12.00";
BA_ "RoutingFactor" SG_ 256 ENG_BrkCtrlReq 0;
BA_ "UserSigValidity" SG_ 256 ENG_BrkCtrlReq 3;
BA_ "Description" SG_ 256 ENG_BrkCtrlReq "This signal indicates that if brake control request during cruise control or speed limiter is active or not. This signal is for prevention of unwanted vehicle speed increase during cruise control or speed limiter control mode.";
BA_ "Version" SG_ 256 ACC_DnShftCtrlReq "17.12.00";
BA_ "RoutingFactor" SG_ 256 ACC_DnShftCtrlReq 0;
BA_ "UserSigValidity" SG_ 256 ACC_DnShftCtrlReq 3;
BA_ "Description" SG_ 256 ACC_DnShftCtrlReq "This signal indicates target gear for downshift control request during cruise control or speed limiter is active or not. This signal is for prevention of unwanted vehicle speed increase during cruise control or speed limiter control mode.";
BA_ "Version" SG_ 256 ENG_DclBrkCntrlReq "17.12.00";
BA_ "RoutingFactor" SG_ 256 ENG_DclBrkCntrlReq 0;
BA_ "UserSigValidity" SG_ 256 ENG_DclBrkCntrlReq 3;
BA_ "GenSigStartValue" SG_ 256 ENG_DclBrkCntrlReq 4094;
BA_ "Description" SG_ 256 ENG_DclBrkCntrlReq "When current vehicle speed goes over set vehicle speed in the downhill during cruise control or speed limiter, ECU requests brake control to TCS with target deceleration. This is function of (Current vehicle speed - Set vehicle speed).";
BA_ "Version" SG_ 256 ENG_BstPrsrVal "17.12.00";
BA_ "RoutingFactor" SG_ 256 ENG_BstPrsrVal 0;
BA_ "UserSigValidity" SG_ 256 ENG_BstPrsrVal 3;
BA_ "Description" SG_ 256 ENG_BstPrsrVal "Boost pressure for Turbo engine";
BA_ "Version" SG_ 256 ENG_EngOilTempVal "17.12.00";
BA_ "RoutingFactor" SG_ 256 ENG_EngOilTempVal 0;
BA_ "UserSigValidity" SG_ 256 ENG_EngOilTempVal 3;
BA_ "GenSigStartValue" SG_ 256 ENG_EngOilTempVal 53;
BA_ "Description" SG_ 256 ENG_EngOilTempVal "engine oil temperature";
BA_ "Version" SG_ 256 ENG_AmbtTempModelVal "17.12.00";
BA_ "RoutingFactor" SG_ 256 ENG_AmbtTempModelVal 0;
BA_ "UserSigValidity" SG_ 256 ENG_AmbtTempModelVal 3;
BA_ "GenSigStartValue" SG_ 256 ENG_AmbtTempModelVal 164;
BA_ "Description" SG_ 256 ENG_AmbtTempModelVal "Modeled Ambient temperature";
BA_ "Version" SG_ 256 ENG_DpfWrngSta "17.12.00";
BA_ "RoutingFactor" SG_ 256 ENG_DpfWrngSta 0;
BA_ "UserSigValidity" SG_ 256 ENG_DpfWrngSta 3;
BA_ "Description" SG_ 256 ENG_DpfWrngSta "The signal indicates the status of the 'DPF Warning Level'";
BA_ "Version" SG_ 256 ENG_BattWrngLmpSta "17.12.00";
BA_ "RoutingFactor" SG_ 256 ENG_BattWrngLmpSta 0;
BA_ "UserSigValidity" SG_ 256 ENG_BattWrngLmpSta 3;
BA_ "Description" SG_ 256 ENG_BattWrngLmpSta "The signal indicates the status of the 'Battery Warning Lamp'";
BA_ "Version" SG_ 256 ENG_OilPrsrWrngLmpSta "17.12.00";
BA_ "RoutingFactor" SG_ 256 ENG_OilPrsrWrngLmpSta 0;
BA_ "UserSigValidity" SG_ 256 ENG_OilPrsrWrngLmpSta 3;
BA_ "Description" SG_ 256 ENG_OilPrsrWrngLmpSta "The signal indicates the status of the 'Oil Pressure Warning Lamp'";
BA_ "Version" SG_ 256 ENG_IsgInhbtLmpSta "24.04.01";
BA_ "RoutingFactor" SG_ 256 ENG_IsgInhbtLmpSta 0;
BA_ "UserSigValidity" SG_ 256 ENG_IsgInhbtLmpSta 3;
BA_ "Description" SG_ 256 ENG_IsgInhbtLmpSta "The signal indicates the status of the 'ISG Inhibit Lamp'";
BA_ "Version" SG_ 256 ENG_BrkSwSta "18.11.00";
BA_ "RoutingFactor" SG_ 256 ENG_BrkSwSta 0;
BA_ "UserSigValidity" SG_ 256 ENG_BrkSwSta 3;
BA_ "GenSigStartValue" SG_ 256 ENG_BrkSwSta 1;
BA_ "Description" SG_ 256 ENG_BrkSwSta "This signal indicates that a brake switch is activated or not. When the brake switch is activated(pressed) its value is 01H otherwise its value is 00H.

If the EMS does not support this signal the value is 02H.



Physical range : 0 ... 100

Conversion :";
BA_ "Version" SG_ 256 ENG_ObdFrzFrmSta "17.12.00";
BA_ "RoutingFactor" SG_ 256 ENG_ObdFrzFrmSta 0;
BA_ "UserSigValidity" SG_ 256 ENG_ObdFrzFrmSta 3;
BA_ "Description" SG_ 256 ENG_ObdFrzFrmSta "An ECU which detects an OBD fault, requires the EMS to store a set of environmental conditions

(freeze frame). If the EMS follows this requirement it is acknowledged in OBD_FRF_ACK. Also the synchronization of OBD relevant ECUs is made by this signal:

";
BA_ "Version" SG_ 256 ENG_EngClntTempVal "17.12.00";
BA_ "RoutingFactor" SG_ 256 ENG_EngClntTempVal 0;
BA_ "UserSigValidity" SG_ 256 ENG_EngClntTempVal 3;
BA_ "GenSigStartValue" SG_ 256 ENG_EngClntTempVal 255;
BA_ "Description" SG_ 256 ENG_EngClntTempVal "Engine coolant temperature in EMS sensed via an A/D converter; converted into degrees centigrade (°C).";
BA_ "Version" SG_ 256 ENG_MafCrctVal "17.12.00";
BA_ "RoutingFactor" SG_ 256 ENG_MafCrctVal 0;
BA_ "UserSigValidity" SG_ 256 ENG_MafCrctVal 3;
BA_ "GenSigStartValue" SG_ 256 ENG_MafCrctVal 128;
BA_ "Description" SG_ 256 ENG_MafCrctVal "The altitude correction factor MAF_FAC_ALTI_MMV is calculated from division of MAF by MAF_SUB_DIAG (=limp home-value for MAF) or from AMP_AD by 1013 mbar in order to take into account different atmospheric pressures at different altitudes.



The Initial";
BA_ "Version" SG_ 256 ENG_BattDscnctSta "17.12.00";
BA_ "RoutingFactor" SG_ 256 ENG_BattDscnctSta 0;
BA_ "UserSigValidity" SG_ 256 ENG_BattDscnctSta 3;
BA_ "Description" SG_ 256 ENG_BattDscnctSta "The signal specifies that ECU has detected a disconnection of the battery since last driving cycle, and therefore has reset the adaptive values and failure memory.

If the EMS does not support this signal the value is 00H



The failure memory erasure is";
BA_ "Version" SG_ 256 OBD_MilConfgVal "17.12.00";
BA_ "RoutingFactor" SG_ 256 OBD_MilConfgVal 0;
BA_ "UserSigValidity" SG_ 256 OBD_MilConfgVal 3;
BA_ "GenSigStartValue" SG_ 256 OBD_MilConfgVal 3;
BA_ "Description" SG_ 256 OBD_MilConfgVal "The signal specifies the Configuration of the MIL Handling and Failure Memory Management by ECU.";
BA_ "Version" SG_ 256 ENG_EngSta "17.12.00";
BA_ "RoutingFactor" SG_ 256 ENG_EngSta 0;
BA_ "UserSigValidity" SG_ 256 ENG_EngSta 3;
BA_ "Description" SG_ 256 ENG_EngSta "This signal indicates that a status of engine.";
BA_ "Version" SG_ 256 ENG_Ack4EngStpSta "17.12.00";
BA_ "RoutingFactor" SG_ 256 ENG_Ack4EngStpSta 0;
BA_ "UserSigValidity" SG_ 256 ENG_Ack4EngStpSta 3;
BA_ "Description" SG_ 256 ENG_Ack4EngStpSta "The signal specifies the acknowledgement of the request for the operating state 'engine stopped'.";
BA_ "Version" SG_ 256 ENG_OverDrvOffReq "17.12.00";
BA_ "RoutingFactor" SG_ 256 ENG_OverDrvOffReq 0;
BA_ "UserSigValidity" SG_ 256 ENG_OverDrvOffReq 3;
BA_ "Description" SG_ 256 ENG_OverDrvOffReq "This signal indicates that auto cruise control function requests over drive off of TCU. 

In general, the over drive off request is done by hardware. (i.e. line-to-line signal between an EMS and a TCU). However, some systems may not have external over dr";
BA_ "Version" SG_ 256 ENG_AccActSta "17.12.00";
BA_ "RoutingFactor" SG_ 256 ENG_AccActSta 0;
BA_ "UserSigValidity" SG_ 256 ENG_AccActSta 3;
BA_ "Description" SG_ 256 ENG_AccActSta "EMS sends the state of the cruise control via the signal ACC_ACT. 

If the EMS does not support this signal the value is 00H



If the cruise control is activated then ACC_ACT = 1. In this period, vehicle speed control (cruise control) is performed by th";
BA_ "Version" SG_ 256 ENG_CltchOpSta "17.12.00";
BA_ "RoutingFactor" SG_ 256 ENG_CltchOpSta 0;
BA_ "UserSigValidity" SG_ 256 ENG_CltchOpSta 3;
BA_ "Description" SG_ 256 ENG_CltchOpSta "This signal indicates that ECU has detected an operation of a clutch. Using this signal an ISG (Idle Stop & Go) system acts as an alternator or a starter.



If the EMS does not support this signal the value is 00H";
BA_ "Version" SG_ 256 EMS_BrkReq_Slope "20.04.06";
BA_ "RoutingFactor" SG_ 256 EMS_BrkReq_Slope 0;
BA_ "UserSigValidity" SG_ 256 EMS_BrkReq_Slope 3;
BA_ "Description" SG_ 256 EMS_BrkReq_Slope "Brake request at slope for anti-stall";
BA_ "Version" SG_ 256 ENG_AccDrvAlertDisp "19.12.08";
BA_ "RoutingFactor" SG_ 256 ENG_AccDrvAlertDisp 0;
BA_ "UserSigValidity" SG_ 256 ENG_AccDrvAlertDisp 3;
BA_ "TimeoutValue" SG_ 256 ENG_AccDrvAlertDisp "0x0";
BA_ "Description" SG_ 256 ENG_AccDrvAlertDisp "If EMS sends the No Auto cruise engaged status or Auto cruise Disengaged status, 

Cluster shall display the status of Auto cruise.";
BA_ "Version" SG_ 256 DSL_GlowCtrlReq "17.12.00";
BA_ "RoutingFactor" SG_ 256 DSL_GlowCtrlReq 0;
BA_ "UserSigValidity" SG_ 256 DSL_GlowCtrlReq 3;
BA_ "Description" SG_ 256 DSL_GlowCtrlReq "This signal indicates that a diesel ECU requests ISS system to control glow plugs. 



If the EMS does not support this signal the value is 00H";
BA_ "Version" SG_ 256 ENG_GlowLmpSta "17.12.00";
BA_ "RoutingFactor" SG_ 256 ENG_GlowLmpSta 0;
BA_ "UserSigValidity" SG_ 256 ENG_GlowLmpSta 3;
BA_ "GenSigStartValue" SG_ 256 ENG_GlowLmpSta 1;
BA_ "Description" SG_ 256 ENG_GlowLmpSta "This signal indicates that a status of glow lamp.



This signal is used for a Diesel or LPI Engine alternatively.";
BA_ "Version" SG_ 256 ENG_ThrPosVal "17.12.00";
BA_ "RoutingFactor" SG_ 256 ENG_ThrPosVal 0;
BA_ "UserSigValidity" SG_ 256 ENG_ThrPosVal 3;
BA_ "GenSigStartValue" SG_ 256 ENG_ThrPosVal 32;
BA_ "Description" SG_ 256 ENG_ThrPosVal "The signal TPS is a measure of the throttle position.

The throttle position is determined via a potentiometer, which is connected mechanically to the throttle shaft. The voltage value, which is adjusted in the port via the voltage divider, is sensed in ";
BA_ "Version" SG_ 256 ENG_AccelPdlVal "18.01.01";
BA_ "RoutingFactor" SG_ 256 ENG_AccelPdlVal 0;
BA_ "UserSigValidity" SG_ 256 ENG_AccelPdlVal 3;
BA_ "Description" SG_ 256 ENG_AccelPdlVal "The signal PV_AV_CAN is a measure of the Accelerator Pedal value.

The accelerator pedal value is determined via 2 pedal sensors, which are connected mechanically to the

accelerator pedal. If the EMS-ECU recognizes that the accelerator pedal is not acti";
BA_ "Version" SG_ 261 EMS_Crc7Val "21.09.03";
BA_ "RoutingFactor" SG_ 261 EMS_Crc7Val 5;
BA_ "UserSigValidity" SG_ 261 EMS_Crc7Val 3;
BA_ "GenSigStartValue" SG_ 261 EMS_Crc7Val 65535;
BA_ "Description" SG_ 261 EMS_Crc7Val "The data area for CRC calculation is based on the data length (DLC) of the message DB.

The CRC shall be calculated over the entire data block (excluding the CRC bytes) including the user data, alive counter and Data ID



- CRC Polynomial (0x1021) , Ini";
BA_ "Version" SG_ 261 HEV_AccelPdlVal "19.11.11";
BA_ "RoutingFactor" SG_ 261 HEV_AccelPdlVal 5;
BA_ "UserSigValidity" SG_ 261 HEV_AccelPdlVal 3;
BA_ "Description" SG_ 261 HEV_AccelPdlVal "The signal is a measure of the Accelerator Pedal value.

The accelerator pedal value is determined via 2 pedal sensors, which are connected mechanically to the accelerator pedal. If the EMS-ECU recognizes that the accelerator pedal is not activated, then";
BA_ "Version" SG_ 261 HEV_IndTqTar "18.05.04";
BA_ "RoutingFactor" SG_ 261 HEV_IndTqTar 5;
BA_ "UserSigValidity" SG_ 261 HEV_IndTqTar 3;
BA_ "Description" SG_ 261 HEV_IndTqTar "Indicated Engine (Desired) Torque";
BA_ "Version" SG_ 261 HEV_IndTqVal_Extd "23.08.03";
BA_ "RoutingFactor" SG_ 261 HEV_IndTqVal_Extd 5;
BA_ "UserSigValidity" SG_ 261 HEV_IndTqVal_Extd 3;
BA_ "Description" SG_ 261 HEV_IndTqVal_Extd "Indicated engine torque after torque coordination(intervention)



0x0000 ~ 0x3FFF : Physical Value (0~1638.3Nm)



Depending on the engine specifications, the signals are separated as follows.

HEV Engine Only.

- HEV_IndTqVal : Kappa, Gamma, Nu Engine

";
BA_ "Version" SG_ 261 ENG_CSModeReq "25.04.00";
BA_ "RoutingFactor" SG_ 261 ENG_CSModeReq 5;
BA_ "UserSigValidity" SG_ 261 ENG_CSModeReq 3;
BA_ "Description" SG_ 261 ENG_CSModeReq "CS Mode request for OBD monitoring";
BA_ "Version" SG_ 261 HEV_TqStndVal_Extd "25.09.01";
BA_ "RoutingFactor" SG_ 261 HEV_TqStndVal_Extd 5;
BA_ "UserSigValidity" SG_ 261 HEV_TqStndVal_Extd 3;
BA_ "Description" SG_ 261 HEV_TqStndVal_Extd "Standard value for torque scaling in torque interface (Extended Signal)";
BA_ "Version" SG_ 261 EMS_AlvCnt7Val "21.09.03";
BA_ "RoutingFactor" SG_ 261 EMS_AlvCnt7Val 5;
BA_ "UserSigValidity" SG_ 261 EMS_AlvCnt7Val 3;
BA_ "Description" SG_ 261 EMS_AlvCnt7Val "For the first transmission request for a data element the counter shall be initialized with 0 and shall be incremented by 1 for every subsequent send request. 

When the counter reaches the maximum value(0xFF), then it shall restart with 0 for the next s";
BA_ "Version" SG_ 261 HEV_IndTqVal "18.10.07";
BA_ "RoutingFactor" SG_ 261 HEV_IndTqVal 5;
BA_ "UserSigValidity" SG_ 261 HEV_IndTqVal 3;
BA_ "Description" SG_ 261 HEV_IndTqVal "Indicated engine torque after torque coordination(intervention)";
BA_ "Version" SG_ 261 HEV_DrvTqVal "18.05.04";
BA_ "RoutingFactor" SG_ 261 HEV_DrvTqVal 5;
BA_ "UserSigValidity" SG_ 261 HEV_DrvTqVal 3;
BA_ "Description" SG_ 261 HEV_DrvTqVal "Driver's demand torque";
BA_ "Version" SG_ 261 HEV_TqStndVal "18.05.04";
BA_ "RoutingFactor" SG_ 261 HEV_TqStndVal 5;
BA_ "UserSigValidity" SG_ 261 HEV_TqStndVal 3;
BA_ "Description" SG_ 261 HEV_TqStndVal "Standard value for torque scaling in torque interface";
BA_ "Version" SG_ 261 HEV_OilDilution_IncICELoad "22.05.04";
BA_ "RoutingFactor" SG_ 261 HEV_OilDilution_IncICELoad 5;
BA_ "UserSigValidity" SG_ 261 HEV_OilDilution_IncICELoad 3;
BA_ "Description" SG_ 261 HEV_OilDilution_IncICELoad "This signal indicates oil dilution ICE load increase mode.";
BA_ "Version" SG_ 261 HEV_OilDilution_ServMode "22.05.04";
BA_ "RoutingFactor" SG_ 261 HEV_OilDilution_ServMode 5;
BA_ "UserSigValidity" SG_ 261 HEV_OilDilution_ServMode 3;
BA_ "Description" SG_ 261 HEV_OilDilution_ServMode "This signal indicates oil dilution service mode.";
BA_ "Version" SG_ 261 EMS_TqLmtSta "23.04.02";
BA_ "RoutingFactor" SG_ 261 EMS_TqLmtSta 5;
BA_ "UserSigValidity" SG_ 261 EMS_TqLmtSta 3;
BA_ "Description" SG_ 261 EMS_TqLmtSta "Status of Torque Limit.";
BA_ "Version" SG_ 261 EMS_EU7 "23.04.02";
BA_ "RoutingFactor" SG_ 261 EMS_EU7 5;
BA_ "UserSigValidity" SG_ 261 EMS_EU7 3;
BA_ "Description" SG_ 261 EMS_EU7 "This signal defines if the vehicle is EU7 vehicle.";
BA_ "Version" SG_ 261 HEV_FrctTqVal "18.10.07";
BA_ "RoutingFactor" SG_ 261 HEV_FrctTqVal 5;
BA_ "UserSigValidity" SG_ 261 HEV_FrctTqVal 3;
BA_ "Description" SG_ 261 HEV_FrctTqVal "Friction Loss Torque";
BA_ "Version" SG_ 261 HEV_EngSpdVal "18.05.04";
BA_ "RoutingFactor" SG_ 261 HEV_EngSpdVal 5;
BA_ "UserSigValidity" SG_ 261 HEV_EngSpdVal 3;
BA_ "Description" SG_ 261 HEV_EngSpdVal "Engine Speed";
BA_ "Version" SG_ 261 HEV_EngOpSta "18.05.04";
BA_ "RoutingFactor" SG_ 261 HEV_EngOpSta 5;
BA_ "UserSigValidity" SG_ 261 HEV_EngOpSta 3;
BA_ "Description" SG_ 261 HEV_EngOpSta "Engine Operating State";
BA_ "Version" SG_ 261 HEV_IntakeAirTempVal "18.05.04";
BA_ "RoutingFactor" SG_ 261 HEV_IntakeAirTempVal 5;
BA_ "UserSigValidity" SG_ 261 HEV_IntakeAirTempVal 3;
BA_ "Description" SG_ 261 HEV_IntakeAirTempVal "Intake air temperature";
BA_ "Version" SG_ 813 SBCM_DRV_FD_Crc1Val "22.10.20";
BA_ "UserSigValidity" SG_ 813 SBCM_DRV_FD_Crc1Val 3;
BA_ "GenSigStartValue" SG_ 813 SBCM_DRV_FD_Crc1Val 65535;
BA_ "GenSigSendType" SG_ 813 SBCM_DRV_FD_Crc1Val 4;
BA_ "Description" SG_ 813 SBCM_DRV_FD_Crc1Val "The data area for CRC calculation is based on the data length (DLC) of the message DB.

The CRC shall be calculated over the entire data block (excluding the CRC bytes) including the user data, alive counter and Data ID



- CRC Polynomial (0x1021) , Ini";
BA_ "Version" SG_ 813 Latch_TypeOption_DRV "21.07.07";
BA_ "NetworkRequest" SG_ 813 Latch_TypeOption_DRV 0;
BA_ "UserSigValidity" SG_ 813 Latch_TypeOption_DRV 0;
BA_ "GenSigSendType" SG_ 813 Latch_TypeOption_DRV 4;
BA_ "Description" SG_ 813 Latch_TypeOption_DRV "If the E-Lacth is applied, the signal will be send for identify the door lock/unlock function and option.";
BA_ "Version" SG_ 813 DRV_SWFailAlarm "21.07.07";
BA_ "NetworkRequestHoldingTime" SG_ 813 DRV_SWFailAlarm 5000;
BA_ "NetworkRequest" SG_ 813 DRV_SWFailAlarm 0;
BA_ "UserSigValidity" SG_ 813 DRV_SWFailAlarm 0;
BA_ "GenSigSendType" SG_ 813 DRV_SWFailAlarm 4;
BA_ "Version" SG_ 813 USM_PwrDRApprOpnSetSta "21.07.07";
BA_ "NetworkRequestHoldingTime" SG_ 813 USM_PwrDRApprOpnSetSta 5000;
BA_ "NetworkRequest" SG_ 813 USM_PwrDRApprOpnSetSta 0;
BA_ "UserSigValidity" SG_ 813 USM_PwrDRApprOpnSetSta 0;
BA_ "GenSigSendType" SG_ 813 USM_PwrDRApprOpnSetSta 4;
BA_ "Version" SG_ 813 USM_PwrDRCloseByRKELockSta "22.10.01";
BA_ "NetworkRequestHoldingTime" SG_ 813 USM_PwrDRCloseByRKELockSta 5000;
BA_ "NetworkRequest" SG_ 813 USM_PwrDRCloseByRKELockSta 0;
BA_ "UserSigValidity" SG_ 813 USM_PwrDRCloseByRKELockSta 0;
BA_ "GenSigSendType" SG_ 813 USM_PwrDRCloseByRKELockSta 4;
BA_ "Version" SG_ 813 USM_PwrDRCloseByRKELockOpt "22.10.01";
BA_ "NetworkRequestHoldingTime" SG_ 813 USM_PwrDRCloseByRKELockOpt 5000;
BA_ "NetworkRequest" SG_ 813 USM_PwrDRCloseByRKELockOpt 0;
BA_ "UserSigValidity" SG_ 813 USM_PwrDRCloseByRKELockOpt 0;
BA_ "GenSigSendType" SG_ 813 USM_PwrDRCloseByRKELockOpt 4;
BA_ "Version" SG_ 813 USM_PwrDRCloseByBrakeSta "21.07.07";
BA_ "NetworkRequestHoldingTime" SG_ 813 USM_PwrDRCloseByBrakeSta 5000;
BA_ "NetworkRequest" SG_ 813 USM_PwrDRCloseByBrakeSta 0;
BA_ "UserSigValidity" SG_ 813 USM_PwrDRCloseByBrakeSta 0;
BA_ "GenSigSendType" SG_ 813 USM_PwrDRCloseByBrakeSta 4;
BA_ "Version" SG_ 813 USM_PwrDRBuzzerSta "21.07.07";
BA_ "NetworkRequestHoldingTime" SG_ 813 USM_PwrDRBuzzerSta 5000;
BA_ "NetworkRequest" SG_ 813 USM_PwrDRBuzzerSta 0;
BA_ "UserSigValidity" SG_ 813 USM_PwrDRBuzzerSta 0;
BA_ "GenSigSendType" SG_ 813 USM_PwrDRBuzzerSta 4;
BA_ "Version" SG_ 813 PDS_TypeOption_DRV "23.04.02";
BA_ "NetworkRequest" SG_ 813 PDS_TypeOption_DRV 0;
BA_ "UserSigValidity" SG_ 813 PDS_TypeOption_DRV 0;
BA_ "GenSigSendType" SG_ 813 PDS_TypeOption_DRV 4;
BA_ "Version" SG_ 813 C_DrvDoorApproachOpen "21.07.07";
BA_ "UserSigValidity" SG_ 813 C_DrvDoorApproachOpen 0;
BA_ "GenSigSendType" SG_ 813 C_DrvDoorApproachOpen 4;
BA_ "Description" SG_ 813 C_DrvDoorApproachOpen "Fob searching start and stop signal for PDS.";
BA_ "Version" SG_ 813 C_DrvDoorApproachClose "21.07.07";
BA_ "UserSigValidity" SG_ 813 C_DrvDoorApproachClose 0;
BA_ "GenSigSendType" SG_ 813 C_DrvDoorApproachClose 4;
BA_ "Description" SG_ 813 C_DrvDoorApproachClose "To close the door automatically, request the fob searching signal";
BA_ "Version" SG_ 813 DoorLock_PDSLkSwSta_DRV "21.07.07";
BA_ "NetworkRequest" SG_ 813 DoorLock_PDSLkSwSta_DRV 0;
BA_ "UserSigValidity" SG_ 813 DoorLock_PDSLkSwSta_DRV 0;
BA_ "GenSigSendType" SG_ 813 DoorLock_PDSLkSwSta_DRV 4;
BA_ "Version" SG_ 813 SBCM_DRV_DiagSta "21.07.07";
BA_ "NetworkRequestHoldingTime" SG_ 813 SBCM_DRV_DiagSta 5000;
BA_ "NetworkRequest" SG_ 813 SBCM_DRV_DiagSta 0;
BA_ "UserSigValidity" SG_ 813 SBCM_DRV_DiagSta 0;
BA_ "GenSigSendType" SG_ 813 SBCM_DRV_DiagSta 4;
BA_ "Version" SG_ 813 DoorLock_CtrlDrLkUnLkSwSta_SBCM "21.07.07";
BA_ "NetworkRequestHoldingTime" SG_ 813 DoorLock_CtrlDrLkUnLkSwSta_SBCM 5000;
BA_ "NetworkRequest" SG_ 813 DoorLock_CtrlDrLkUnLkSwSta_SBCM 0;
BA_ "UserSigValidity" SG_ 813 DoorLock_CtrlDrLkUnLkSwSta_SBCM 0;
BA_ "GenSigSendType" SG_ 813 DoorLock_CtrlDrLkUnLkSwSta_SBCM 4;
BA_ "Description" SG_ 813 DoorLock_CtrlDrLkUnLkSwSta_SBCM "Central Door Lock/Unlock Switch State";
BA_ "Version" SG_ 813 SBCM_PsvDrLkReq "21.07.07";
BA_ "NetworkRequest" SG_ 813 SBCM_PsvDrLkReq 0;
BA_ "UserSigValidity" SG_ 813 SBCM_PsvDrLkReq 0;
BA_ "GenSigSendType" SG_ 813 SBCM_PsvDrLkReq 4;
BA_ "Version" SG_ 813 CDMAutoWashModeSet_SBCM "22.07.00";
BA_ "UserSigValidity" SG_ 813 CDMAutoWashModeSet_SBCM 3;
BA_ "GenSigSendType" SG_ 813 CDMAutoWashModeSet_SBCM 4;
BA_ "Version" SG_ 813 USM_DrvGhostDoorSta "21.07.07";
BA_ "NetworkRequestHoldingTime" SG_ 813 USM_DrvGhostDoorSta 5000;
BA_ "NetworkRequest" SG_ 813 USM_DrvGhostDoorSta 0;
BA_ "UserSigValidity" SG_ 813 USM_DrvGhostDoorSta 0;
BA_ "GenSigSendType" SG_ 813 USM_DrvGhostDoorSta 4;
BA_ "Version" SG_ 813 Mirror_LH_FoldingSta "21.07.07";
BA_ "NetworkRequestHoldingTime" SG_ 813 Mirror_LH_FoldingSta 5000;
BA_ "NetworkRequest" SG_ 813 Mirror_LH_FoldingSta 0;
BA_ "UserSigValidity" SG_ 813 Mirror_LH_FoldingSta 0;
BA_ "GenSigSendType" SG_ 813 Mirror_LH_FoldingSta 4;
BA_ "Version" SG_ 813 Mirror_LH_UnfoldingSta "21.07.07";
BA_ "NetworkRequestHoldingTime" SG_ 813 Mirror_LH_UnfoldingSta 5000;
BA_ "NetworkRequest" SG_ 813 Mirror_LH_UnfoldingSta 0;
BA_ "UserSigValidity" SG_ 813 Mirror_LH_UnfoldingSta 0;
BA_ "GenSigSendType" SG_ 813 Mirror_LH_UnfoldingSta 4;
BA_ "Version" SG_ 813 DRV_CrashMRActAlarm "21.07.07";
BA_ "NetworkRequestHoldingTime" SG_ 813 DRV_CrashMRActAlarm 5000;
BA_ "NetworkRequest" SG_ 813 DRV_CrashMRActAlarm 0;
BA_ "UserSigValidity" SG_ 813 DRV_CrashMRActAlarm 0;
BA_ "GenSigSendType" SG_ 813 DRV_CrashMRActAlarm 4;
BA_ "Version" SG_ 813 AFH_DRV_FldUnFldSta "24.07.06";
BA_ "NetworkRequestHoldingTime" SG_ 813 AFH_DRV_FldUnFldSta 5000;
BA_ "NetworkRequest" SG_ 813 AFH_DRV_FldUnFldSta 0;
BA_ "UserSigValidity" SG_ 813 AFH_DRV_FldUnFldSta 0;
BA_ "GenSigSendType" SG_ 813 AFH_DRV_FldUnFldSta 4;
BA_ "Version" SG_ 813 SBCM_DRV_FD_AlvCnt1Val "22.10.20";
BA_ "UserSigValidity" SG_ 813 SBCM_DRV_FD_AlvCnt1Val 3;
BA_ "GenSigSendType" SG_ 813 SBCM_DRV_FD_AlvCnt1Val 4;
BA_ "Description" SG_ 813 SBCM_DRV_FD_AlvCnt1Val "For the first transmission request for a data element the counter shall be initialized with 0 and shall be incremented by 1 for every subsequent send request. 

When the counter reaches the maximum value(0xFF), then it shall restart with 0 for the next s";
BA_ "Version" SG_ 813 MirrorFldReq "21.07.07";
BA_ "NetworkRequestHoldingTime" SG_ 813 MirrorFldReq 5000;
BA_ "NetworkRequest" SG_ 813 MirrorFldReq 0;
BA_ "UserSigValidity" SG_ 813 MirrorFldReq 0;
BA_ "GenSigSendType" SG_ 813 MirrorFldReq 4;
BA_ "Version" SG_ 813 OMU_TypeOption_DRV "21.07.07";
BA_ "NetworkRequestHoldingTime" SG_ 813 OMU_TypeOption_DRV 5000;
BA_ "NetworkRequest" SG_ 813 OMU_TypeOption_DRV 0;
BA_ "UserSigValidity" SG_ 813 OMU_TypeOption_DRV 0;
BA_ "GenSigSendType" SG_ 813 OMU_TypeOption_DRV 4;
BA_ "Version" SG_ 813 IMS_OSMirPlayBackSta_LH "21.07.07";
BA_ "NetworkRequestHoldingTime" SG_ 813 IMS_OSMirPlayBackSta_LH 5000;
BA_ "NetworkRequest" SG_ 813 IMS_OSMirPlayBackSta_LH 0;
BA_ "UserSigValidity" SG_ 813 IMS_OSMirPlayBackSta_LH 0;
BA_ "GenSigSendType" SG_ 813 IMS_OSMirPlayBackSta_LH 4;
BA_ "Version" SG_ 813 ECMMRR_PLUS "21.07.07";
BA_ "NetworkRequestHoldingTime" SG_ 813 ECMMRR_PLUS 5000;
BA_ "NetworkRequest" SG_ 813 ECMMRR_PLUS 0;
BA_ "UserSigValidity" SG_ 813 ECMMRR_PLUS 0;
BA_ "GenSigSendType" SG_ 813 ECMMRR_PLUS 4;
BA_ "Description" SG_ 813 ECMMRR_PLUS "This signal for passenger outside mirror OEC function(or ECM)

SBCM_DRV receive the ECM voltage value via H/wiring and then send this signal to SBCM_AST";
BA_ "Version" SG_ 813 EHL_TxInfo_SBCM_DRV "24.07.03";
BA_ "NetworkRequestHoldingTime" SG_ 813 EHL_TxInfo_SBCM_DRV 5000;
BA_ "NetworkRequest" SG_ 813 EHL_TxInfo_SBCM_DRV 0;
BA_ "UserSigValidity" SG_ 813 EHL_TxInfo_SBCM_DRV 0;
BA_ "GenSigSendType" SG_ 813 EHL_TxInfo_SBCM_DRV 4;
BA_ "Description" SG_ 813 EHL_TxInfo_SBCM_DRV "Electronic hood latch status signal transfer for dual hood latch type

(Copy to CANFD)";
BA_ "Version" SG_ 813 IMS_OSMirPlayBackSta_LH_New "23.01.03";
BA_ "NetworkRequestHoldingTime" SG_ 813 IMS_OSMirPlayBackSta_LH_New 5000;
BA_ "NetworkRequest" SG_ 813 IMS_OSMirPlayBackSta_LH_New 0;
BA_ "UserSigValidity" SG_ 813 IMS_OSMirPlayBackSta_LH_New 0;
BA_ "GenSigSendType" SG_ 813 IMS_OSMirPlayBackSta_LH_New 4;
BA_ "Description" SG_ 813 IMS_OSMirPlayBackSta_LH_New "Applied from standard DB 2.0";
BA_ "Version" SG_ 813 CDM_InsideOpnSwSta "23.04.05";
BA_ "NetworkRequestHoldingTime" SG_ 813 CDM_InsideOpnSwSta 5000;
BA_ "NetworkRequest" SG_ 813 CDM_InsideOpnSwSta 0;
BA_ "UserSigValidity" SG_ 813 CDM_InsideOpnSwSta 0;
BA_ "GenSigSendType" SG_ 813 CDM_InsideOpnSwSta 4;
BA_ "Version" SG_ 813 CDM_TypeOption "23.04.02";
BA_ "NetworkRequestHoldingTime" SG_ 813 CDM_TypeOption 5000;
BA_ "NetworkRequest" SG_ 813 CDM_TypeOption 0;
BA_ "UserSigValidity" SG_ 813 CDM_TypeOption 0;
BA_ "GenSigSendType" SG_ 813 CDM_TypeOption 4;
BA_ "Description" SG_ 813 CDM_TypeOption "0x1 : On (CDM is applied)

0x2 : On_2EA (CDM 2EA are applied)";
BA_ "Version" SG_ 813 CDM_ImmeChgSw_SBCM "23.04.05";
BA_ "UserSigValidity" SG_ 813 CDM_ImmeChgSw_SBCM 0;
BA_ "GenSigSendType" SG_ 813 CDM_ImmeChgSw_SBCM 4;
BA_ "Description" SG_ 813 CDM_ImmeChgSw_SBCM "State of Immediate Charging Switch";
BA_ "Version" SG_ 813 CDM_FobSrchReq_DRV "24.05.03";
BA_ "NetworkRequestHoldingTime" SG_ 813 CDM_FobSrchReq_DRV 5000;
BA_ "NetworkRequest" SG_ 813 CDM_FobSrchReq_DRV 0;
BA_ "UserSigValidity" SG_ 813 CDM_FobSrchReq_DRV 0;
BA_ "GenSigSendType" SG_ 813 CDM_FobSrchReq_DRV 4;
BA_ "Version" SG_ 813 CDM_OpnClsState_SBCM "23.04.05";
BA_ "UserSigValidity" SG_ 813 CDM_OpnClsState_SBCM 0;
BA_ "GenSigSendType" SG_ 813 CDM_OpnClsState_SBCM 4;
BA_ "Description" SG_ 813 CDM_OpnClsState_SBCM "This signal indicates CDM Open/Close Status";
BA_ "Version" SG_ 813 CDM_WarnMsg_SBCM "23.04.05";
BA_ "UserSigValidity" SG_ 813 CDM_WarnMsg_SBCM 0;
BA_ "GenSigSendType" SG_ 813 CDM_WarnMsg_SBCM 4;
BA_ "Description" SG_ 813 CDM_WarnMsg_SBCM "Command for CDM Warning on cluster";
BA_ "Version" SG_ 813 CDM_AutoWashModeSta "22.02.00";
BA_ "NetworkRequestHoldingTime" SG_ 813 CDM_AutoWashModeSta 5000;
BA_ "NetworkRequest" SG_ 813 CDM_AutoWashModeSta 0;
BA_ "UserSigValidity" SG_ 813 CDM_AutoWashModeSta 0;
BA_ "GenSigSendType" SG_ 813 CDM_AutoWashModeSta 4;
BA_ "Version" SG_ 813 CDM_CmdStatus_SBCM "23.04.05";
BA_ "UserSigValidity" SG_ 813 CDM_CmdStatus_SBCM 0;
BA_ "GenSigStartValue" SG_ 813 CDM_CmdStatus_SBCM 15;
BA_ "GenSigSendType" SG_ 813 CDM_CmdStatus_SBCM 4;
BA_ "Description" SG_ 813 CDM_CmdStatus_SBCM "User Condition Check For CDM Operation";
BA_ "Version" SG_ 813 CDM_OutsideOpnSwSta "23.04.05";
BA_ "NetworkRequestHoldingTime" SG_ 813 CDM_OutsideOpnSwSta 5000;
BA_ "NetworkRequest" SG_ 813 CDM_OutsideOpnSwSta 0;
BA_ "UserSigValidity" SG_ 813 CDM_OutsideOpnSwSta 0;
BA_ "GenSigSendType" SG_ 813 CDM_OutsideOpnSwSta 4;
BA_ "Description" SG_ 813 CDM_OutsideOpnSwSta "Charing Dorr O/S SW State";
BA_ "Version" SG_ 813 SBCM_ExtnlWaringReq "25.04.00";
BA_ "NetworkRequestHoldingTime" SG_ 813 SBCM_ExtnlWaringReq 5000;
BA_ "NetworkRequest" SG_ 813 SBCM_ExtnlWaringReq 0;
BA_ "UserSigValidity" SG_ 813 SBCM_ExtnlWaringReq 0;
BA_ "GenSigSendType" SG_ 813 SBCM_ExtnlWaringReq 4;
BA_ "Version" SG_ 813 Warn_HoodSwSta_SBCM "21.09.08";
BA_ "NetworkRequestHoldingTime" SG_ 813 Warn_HoodSwSta_SBCM 5000;
BA_ "NetworkRequest" SG_ 813 Warn_HoodSwSta_SBCM 0;
BA_ "UserSigValidity" SG_ 813 Warn_HoodSwSta_SBCM 0;
BA_ "GenSigSendType" SG_ 813 Warn_HoodSwSta_SBCM 4;
BA_ "Version" SG_ 813 Hood_TypeOption "22.03.01";
BA_ "NetworkRequestHoldingTime" SG_ 813 Hood_TypeOption 5000;
BA_ "NetworkRequest" SG_ 813 Hood_TypeOption 0;
BA_ "UserSigValidity" SG_ 813 Hood_TypeOption 0;
BA_ "GenSigSendType" SG_ 813 Hood_TypeOption 4;
BA_ "Description" SG_ 813 Hood_TypeOption "If the E-Hood is applied, the signal will be send.";
BA_ "Version" SG_ 813 SBCM_FrunkSta "22.01.06";
BA_ "NetworkRequestHoldingTime" SG_ 813 SBCM_FrunkSta 5000;
BA_ "NetworkRequest" SG_ 813 SBCM_FrunkSta 0;
BA_ "UserSigValidity" SG_ 813 SBCM_FrunkSta 0;
BA_ "GenSigSendType" SG_ 813 SBCM_FrunkSta 4;
BA_ "Version" SG_ 813 Warn_HoodSwFullSta_SBCM "22.01.06";
BA_ "NetworkRequestHoldingTime" SG_ 813 Warn_HoodSwFullSta_SBCM 5000;
BA_ "NetworkRequest" SG_ 813 Warn_HoodSwFullSta_SBCM 0;
BA_ "UserSigValidity" SG_ 813 Warn_HoodSwFullSta_SBCM 0;
BA_ "GenSigSendType" SG_ 813 Warn_HoodSwFullSta_SBCM 4;
BA_ "Version" SG_ 813 FrunkWarning_SBCM "22.03.01";
BA_ "NetworkRequestHoldingTime" SG_ 813 FrunkWarning_SBCM 5000;
BA_ "NetworkRequest" SG_ 813 FrunkWarning_SBCM 0;
BA_ "UserSigValidity" SG_ 813 FrunkWarning_SBCM 0;
BA_ "GenSigSendType" SG_ 813 FrunkWarning_SBCM 4;
BA_ "Version" SG_ 813 FrunkReleaseSwSta_SBCM "23.04.04";
BA_ "NetworkRequestHoldingTime" SG_ 813 FrunkReleaseSwSta_SBCM 50000;
BA_ "NetworkRequest" SG_ 813 FrunkReleaseSwSta_SBCM 0;
BA_ "UserSigValidity" SG_ 813 FrunkReleaseSwSta_SBCM 0;
BA_ "GenSigSendType" SG_ 813 FrunkReleaseSwSta_SBCM 4;
BA_ "Description" SG_ 813 FrunkReleaseSwSta_SBCM "FrunkReleaseState";
BA_ "Version" SG_ 813 PwrDRClosingDRVDrSta "23.10.11";
BA_ "NetworkRequestHoldingTime" SG_ 813 PwrDRClosingDRVDrSta 5000;
BA_ "NetworkRequest" SG_ 813 PwrDRClosingDRVDrSta 0;
BA_ "UserSigValidity" SG_ 813 PwrDRClosingDRVDrSta 0;
BA_ "GenSigSendType" SG_ 813 PwrDRClosingDRVDrSta 4;
BA_ "Version" SG_ 813 Drv_DrLkRetryFail_SBCM "23.03.00";
BA_ "NetworkRequestHoldingTime" SG_ 813 Drv_DrLkRetryFail_SBCM 5000;
BA_ "NetworkRequest" SG_ 813 Drv_DrLkRetryFail_SBCM 0;
BA_ "UserSigValidity" SG_ 813 Drv_DrLkRetryFail_SBCM 0;
BA_ "TimeoutValue" SG_ 813 Drv_DrLkRetryFail_SBCM "0x0";
BA_ "GenSigSendType" SG_ 813 Drv_DrLkRetryFail_SBCM 4;
BA_ "Version" SG_ 813 CDM_GbtImmeChgSw_SBCM "23.04.02";
BA_ "UserSigValidity" SG_ 813 CDM_GbtImmeChgSw_SBCM 0;
BA_ "GenSigSendType" SG_ 813 CDM_GbtImmeChgSw_SBCM 4;
BA_ "Description" SG_ 813 CDM_GbtImmeChgSw_SBCM "State of Immediate Charging Switch";
BA_ "Version" SG_ 813 CDM_GbtOpnClsState_SBCM "23.04.02";
BA_ "UserSigValidity" SG_ 813 CDM_GbtOpnClsState_SBCM 0;
BA_ "GenSigSendType" SG_ 813 CDM_GbtOpnClsState_SBCM 4;
BA_ "Description" SG_ 813 CDM_GbtOpnClsState_SBCM "This signal indicates CDM Open/Close Status(Gbt)";
BA_ "Version" SG_ 813 CDM_GbtWarnMsg_SBCM "23.04.02";
BA_ "UserSigValidity" SG_ 813 CDM_GbtWarnMsg_SBCM 0;
BA_ "GenSigSendType" SG_ 813 CDM_GbtWarnMsg_SBCM 4;
BA_ "Description" SG_ 813 CDM_GbtWarnMsg_SBCM "Command for CDM Warning on cluster(Gbt)";
BA_ "Version" SG_ 813 CDM_GbtOutsideOpnSwSta "24.01.03";
BA_ "NetworkRequestHoldingTime" SG_ 813 CDM_GbtOutsideOpnSwSta 5000;
BA_ "NetworkRequest" SG_ 813 CDM_GbtOutsideOpnSwSta 0;
BA_ "UserSigValidity" SG_ 813 CDM_GbtOutsideOpnSwSta 0;
BA_ "GenSigSendType" SG_ 813 CDM_GbtOutsideOpnSwSta 4;
BA_ "Version" SG_ 813 DoorLock_DrvLkOutSta_SBCM "23.02.09";
BA_ "NetworkRequestHoldingTime" SG_ 813 DoorLock_DrvLkOutSta_SBCM 5000;
BA_ "NetworkRequest" SG_ 813 DoorLock_DrvLkOutSta_SBCM 0;
BA_ "UserSigValidity" SG_ 813 DoorLock_DrvLkOutSta_SBCM 0;
BA_ "GenSigSendType" SG_ 813 DoorLock_DrvLkOutSta_SBCM 4;
BA_ "Description" SG_ 813 DoorLock_DrvLkOutSta_SBCM "- Door Lock or Unlock Output State 

0x0 : Off (Door lock/unlock output Off state)

0x1 : On (Door lock/unlock output On state)";
BA_ "Version" SG_ 813 FrunkEmergencySwSta_SBCM "23.04.04";
BA_ "NetworkRequestHoldingTime" SG_ 813 FrunkEmergencySwSta_SBCM 5000;
BA_ "NetworkRequest" SG_ 813 FrunkEmergencySwSta_SBCM 0;
BA_ "UserSigValidity" SG_ 813 FrunkEmergencySwSta_SBCM 0;
BA_ "GenSigSendType" SG_ 813 FrunkEmergencySwSta_SBCM 4;
BA_ "Description" SG_ 813 FrunkEmergencySwSta_SBCM "FrunkEmergencySwState";
BA_ "Version" SG_ 813 DRV_DetectObj_warn_LH "25.11.00";
BA_ "NetworkRequestHoldingTime" SG_ 813 DRV_DetectObj_warn_LH 5000;
BA_ "NetworkRequest" SG_ 813 DRV_DetectObj_warn_LH 0;
BA_ "UserSigValidity" SG_ 813 DRV_DetectObj_warn_LH 0;
BA_ "GenSigSendType" SG_ 813 DRV_DetectObj_warn_LH 4;
BA_ "Version" SG_ 813 PwrDROpenClosingDdvSdDRSta "23.10.11";
BA_ "NetworkRequestHoldingTime" SG_ 813 PwrDROpenClosingDdvSdDRSta 5000;
BA_ "NetworkRequest" SG_ 813 PwrDROpenClosingDdvSdDRSta 0;
BA_ "UserSigValidity" SG_ 813 PwrDROpenClosingDdvSdDRSta 0;
BA_ "GenSigSendType" SG_ 813 PwrDROpenClosingDdvSdDRSta 4;
BA_ "Version" SG_ 813 PwrDRBuzzerOut_DRV_New "25.01.00";
BA_ "NetworkRequestHoldingTime" SG_ 813 PwrDRBuzzerOut_DRV_New 5000;
BA_ "NetworkRequest" SG_ 813 PwrDRBuzzerOut_DRV_New 0;
BA_ "UserSigValidity" SG_ 813 PwrDRBuzzerOut_DRV_New 0;
BA_ "GenSigSendType" SG_ 813 PwrDRBuzzerOut_DRV_New 4;
BA_ "Description" SG_ 813 PwrDRBuzzerOut_DRV_New "Applied from JG onwards";
BA_ "Version" SG_ 813 Coach_TypeOption_DRV "24.01.07";
BA_ "NetworkRequestHoldingTime" SG_ 813 Coach_TypeOption_DRV 5000;
BA_ "NetworkRequest" SG_ 813 Coach_TypeOption_DRV 0;
BA_ "UserSigValidity" SG_ 813 Coach_TypeOption_DRV 0;
BA_ "GenSigStartValue" SG_ 813 Coach_TypeOption_DRV 3;
BA_ "GenSigSendType" SG_ 813 Coach_TypeOption_DRV 4;
BA_ "Version" SG_ 813 PwrDrSta_Drv "24.01.05";
BA_ "NetworkRequestHoldingTime" SG_ 813 PwrDrSta_Drv 5000;
BA_ "NetworkRequest" SG_ 813 PwrDrSta_Drv 0;
BA_ "UserSigValidity" SG_ 813 PwrDrSta_Drv 0;
BA_ "GenSigSendType" SG_ 813 PwrDrSta_Drv 4;
BA_ "Version" SG_ 813 PwrDrSta_DrvSd "24.01.05";
BA_ "NetworkRequestHoldingTime" SG_ 813 PwrDrSta_DrvSd 5000;
BA_ "NetworkRequest" SG_ 813 PwrDrSta_DrvSd 0;
BA_ "UserSigValidity" SG_ 813 PwrDrSta_DrvSd 0;
BA_ "GenSigSendType" SG_ 813 PwrDrSta_DrvSd 4;
BA_ "Version" SG_ 813 USM_PwrDrOpnTypSta "24.01.05";
BA_ "NetworkRequestHoldingTime" SG_ 813 USM_PwrDrOpnTypSta 5000;
BA_ "NetworkRequest" SG_ 813 USM_PwrDrOpnTypSta 0;
BA_ "UserSigValidity" SG_ 813 USM_PwrDrOpnTypSta 0;
BA_ "GenSigSendType" SG_ 813 USM_PwrDrOpnTypSta 4;
BA_ "Version" SG_ 813 DischrgDr_OpnClsState_SBCM "24.01.04";
BA_ "NetworkRequestHoldingTime" SG_ 813 DischrgDr_OpnClsState_SBCM 5000;
BA_ "NetworkRequest" SG_ 813 DischrgDr_OpnClsState_SBCM 0;
BA_ "UserSigValidity" SG_ 813 DischrgDr_OpnClsState_SBCM 0;
BA_ "GenSigSendType" SG_ 813 DischrgDr_OpnClsState_SBCM 4;
BA_ "Version" SG_ 813 SBCM_DRV_DoorAngle "25.04.00";
BA_ "NetworkRequestHoldingTime" SG_ 813 SBCM_DRV_DoorAngle 5000;
BA_ "NetworkRequest" SG_ 813 SBCM_DRV_DoorAngle 0;
BA_ "UserSigValidity" SG_ 813 SBCM_DRV_DoorAngle 0;
BA_ "GenSigStartValue" SG_ 813 SBCM_DRV_DoorAngle 100;
BA_ "GenSigSendType" SG_ 813 SBCM_DRV_DoorAngle 4;
BA_ "Description" SG_ 813 SBCM_DRV_DoorAngle "PDSM_FL_DoorAngle";
BA_ "Version" SG_ 813 SBCM_DoorType_DRV "24.01.07";
BA_ "NetworkRequestHoldingTime" SG_ 813 SBCM_DoorType_DRV 5000;
BA_ "NetworkRequest" SG_ 813 SBCM_DoorType_DRV 0;
BA_ "UserSigValidity" SG_ 813 SBCM_DoorType_DRV 0;
BA_ "GenSigStartValue" SG_ 813 SBCM_DoorType_DRV 2;
BA_ "GenSigSendType" SG_ 813 SBCM_DoorType_DRV 4;
BA_ "Description" SG_ 813 SBCM_DoorType_DRV "SBCM Applied Type";
BA_ "Version" SG_ 813 CDM_DrType_DRV "24.05.01";
BA_ "NetworkRequestHoldingTime" SG_ 813 CDM_DrType_DRV 5000;
BA_ "NetworkRequest" SG_ 813 CDM_DrType_DRV 0;
BA_ "UserSigValidity" SG_ 813 CDM_DrType_DRV 7;
BA_ "GenSigSendType" SG_ 813 CDM_DrType_DRV 4;
BA_ "Version" SG_ 813 DRVDoorPushAlarm "21.07.07";
BA_ "NetworkRequestHoldingTime" SG_ 813 DRVDoorPushAlarm 5000;
BA_ "NetworkRequest" SG_ 813 DRVDoorPushAlarm 0;
BA_ "UserSigValidity" SG_ 813 DRVDoorPushAlarm 0;
BA_ "GenSigSendType" SG_ 813 DRVDoorPushAlarm 4;
BA_ "Version" SG_ 813 DRV_CrashUnlockCmd "21.07.07";
BA_ "NetworkRequest" SG_ 813 DRV_CrashUnlockCmd 0;
BA_ "UserSigValidity" SG_ 813 DRV_CrashUnlockCmd 0;
BA_ "GenSigSendType" SG_ 813 DRV_CrashUnlockCmd 4;
BA_ "Description" SG_ 813 DRV_CrashUnlockCmd "Drive Crash Unlock Command";
BA_ "Version" SG_ 813 C_ApprOpenStatus "21.07.07";
BA_ "UserSigValidity" SG_ 813 C_ApprOpenStatus 0;
BA_ "GenSigSendType" SG_ 813 C_ApprOpenStatus 4;
BA_ "Description" SG_ 813 C_ApprOpenStatus "This is for Power Door System enable/disable signal.";
BA_ "Version" SG_ 813 DoorLock_DrvKeyLkSwSta_SBCM "21.07.07";
BA_ "NetworkRequest" SG_ 813 DoorLock_DrvKeyLkSwSta_SBCM 0;
BA_ "UserSigValidity" SG_ 813 DoorLock_DrvKeyLkSwSta_SBCM 0;
BA_ "GenSigSendType" SG_ 813 DoorLock_DrvKeyLkSwSta_SBCM 4;
BA_ "Description" SG_ 813 DoorLock_DrvKeyLkSwSta_SBCM "Door Lock Driver Mechanical Key Input Signal";
BA_ "Version" SG_ 813 DoorLock_DrvKeyUnLkSwSta_SBCM "21.07.07";
BA_ "NetworkRequest" SG_ 813 DoorLock_DrvKeyUnLkSwSta_SBCM 0;
BA_ "UserSigValidity" SG_ 813 DoorLock_DrvKeyUnLkSwSta_SBCM 0;
BA_ "GenSigSendType" SG_ 813 DoorLock_DrvKeyUnLkSwSta_SBCM 4;
BA_ "Description" SG_ 813 DoorLock_DrvKeyUnLkSwSta_SBCM "Door Drive Mechanical Key Unlock Switch State";
BA_ "Version" SG_ 813 Warn_DrvDrSwSta_SBCM "21.09.05";
BA_ "NetworkRequest" SG_ 813 Warn_DrvDrSwSta_SBCM 0;
BA_ "UserSigValidity" SG_ 813 Warn_DrvDrSwSta_SBCM 0;
BA_ "GenSigSendType" SG_ 813 Warn_DrvDrSwSta_SBCM 4;
BA_ "Description" SG_ 813 Warn_DrvDrSwSta_SBCM "Warning Drive Door Switch State";
BA_ "Version" SG_ 813 DoorLock_DrvDrUnLkSta_SBCM "21.09.05";
BA_ "NetworkRequest" SG_ 813 DoorLock_DrvDrUnLkSta_SBCM 0;
BA_ "UserSigValidity" SG_ 813 DoorLock_DrvDrUnLkSta_SBCM 0;
BA_ "GenSigSendType" SG_ 813 DoorLock_DrvDrUnLkSta_SBCM 4;
BA_ "Description" SG_ 813 DoorLock_DrvDrUnLkSta_SBCM "Drive Door Lock Unlock Status";
BA_ "Version" SG_ 813 DRV_SEAWarn_LH "21.07.07";
BA_ "NetworkRequest" SG_ 813 DRV_SEAWarn_LH 0;
BA_ "UserSigValidity" SG_ 813 DRV_SEAWarn_LH 0;
BA_ "GenSigSendType" SG_ 813 DRV_SEAWarn_LH 4;
BA_ "Description" SG_ 813 DRV_SEAWarn_LH "Drive (FLH) Door SEA Warning";
BA_ "Version" SG_ 813 DRV_SEAWarn_RH "21.07.07";
BA_ "NetworkRequest" SG_ 813 DRV_SEAWarn_RH 0;
BA_ "UserSigValidity" SG_ 813 DRV_SEAWarn_RH 0;
BA_ "GenSigSendType" SG_ 813 DRV_SEAWarn_RH 4;
BA_ "Description" SG_ 813 DRV_SEAWarn_RH "Drive (FRH) Door SEA Warning";
BA_ "Version" SG_ 813 DRV_SEWWarn_LH "21.07.07";
BA_ "NetworkRequest" SG_ 813 DRV_SEWWarn_LH 0;
BA_ "UserSigValidity" SG_ 813 DRV_SEWWarn_LH 0;
BA_ "GenSigSendType" SG_ 813 DRV_SEWWarn_LH 4;
BA_ "Description" SG_ 813 DRV_SEWWarn_LH "Drive (FLH) Door Safety Exit Warning";
BA_ "Version" SG_ 813 DRV_SEWWarn_RH "21.07.07";
BA_ "NetworkRequest" SG_ 813 DRV_SEWWarn_RH 0;
BA_ "UserSigValidity" SG_ 813 DRV_SEWWarn_RH 0;
BA_ "GenSigSendType" SG_ 813 DRV_SEWWarn_RH 4;
BA_ "Description" SG_ 813 DRV_SEWWarn_RH "Drive (FRH) Door Safety Exit Warning";
BA_ "Version" SG_ 813 DRV_MRActivationAlarm "21.07.07";
BA_ "NetworkRequestHoldingTime" SG_ 813 DRV_MRActivationAlarm 5000;
BA_ "NetworkRequest" SG_ 813 DRV_MRActivationAlarm 0;
BA_ "UserSigValidity" SG_ 813 DRV_MRActivationAlarm 0;
BA_ "GenSigSendType" SG_ 813 DRV_MRActivationAlarm 4;
BA_ "Version" SG_ 813 DRV_ReleaseWarn "21.09.05";
BA_ "NetworkRequestHoldingTime" SG_ 813 DRV_ReleaseWarn 5000;
BA_ "NetworkRequest" SG_ 813 DRV_ReleaseWarn 0;
BA_ "UserSigValidity" SG_ 813 DRV_ReleaseWarn 0;
BA_ "GenSigSendType" SG_ 813 DRV_ReleaseWarn 4;
BA_ "Version" SG_ 2659690497 BLTN_CAM_WU_Crc1Val "25.01.02";
BA_ "UserSigValidity" SG_ 2659690497 BLTN_CAM_WU_Crc1Val 0;
BA_ "GenSigStartValue" SG_ 2659690497 BLTN_CAM_WU_Crc1Val 65535;
BA_ "GenSigSendType" SG_ 2659690497 BLTN_CAM_WU_Crc1Val 4;
BA_ "Description" SG_ 2659690497 BLTN_CAM_WU_Crc1Val "The data area for CRC calculation is based on the data length (DLC) of the message DB.

The CRC shall be calculated over the entire data block (excluding the CRC bytes) including the user data, alive counter and Data ID



- CRC Polynomial (0x1021) , Ini";
BA_ "Version" SG_ 2659690497 BLTN_CAM_WU_AlvCnt1Val "25.01.02";
BA_ "UserSigValidity" SG_ 2659690497 BLTN_CAM_WU_AlvCnt1Val 0;
BA_ "GenSigSendType" SG_ 2659690497 BLTN_CAM_WU_AlvCnt1Val 4;
BA_ "Description" SG_ 2659690497 BLTN_CAM_WU_AlvCnt1Val "For the first transmission request for a data element the counter shall be initialized with 0 and shall be incremented by 1 for every subsequent send request. 

When the counter reaches the maximum value(0xFF), then it shall restart with 0 for the next s";
BA_ "Version" SG_ 2659690497 BLTN_CAM_WU_NM_B2 "25.01.02";
BA_ "UserSigValidity" SG_ 2659690497 BLTN_CAM_WU_NM_B2 0;
BA_ "GenSigSendType" SG_ 2659690497 BLTN_CAM_WU_NM_B2 4;
BA_ "Version" SG_ 2659690497 BLTN_CAM_WU_L_RecStpByBattEmpty "25.01.02";
BA_ "UserSigValidity" SG_ 2659690497 BLTN_CAM_WU_L_RecStpByBattEmpty 0;
BA_ "GenSigSendType" SG_ 2659690497 BLTN_CAM_WU_L_RecStpByBattEmpty 4;
BA_ "Version" SG_ 2659690497 BLTN_CAM_WU_L_RecStpByBLTNCAMErr "25.01.02";
BA_ "UserSigValidity" SG_ 2659690497 BLTN_CAM_WU_L_RecStpByBLTNCAMErr 0;
BA_ "GenSigSendType" SG_ 2659690497 BLTN_CAM_WU_L_RecStpByBLTNCAMErr 4;
BA_ "Version" SG_ 2659690497 BLTN_CAM_WU_L_RecStpBySDCardErr "25.01.02";
BA_ "UserSigValidity" SG_ 2659690497 BLTN_CAM_WU_L_RecStpBySDCardErr 0;
BA_ "GenSigSendType" SG_ 2659690497 BLTN_CAM_WU_L_RecStpBySDCardErr 4;
BA_ "Version" SG_ 2659690497 BLTN_CAM_WU_L_RecStpBySDCardEjec "25.01.02";
BA_ "UserSigValidity" SG_ 2659690497 BLTN_CAM_WU_L_RecStpBySDCardEjec 0;
BA_ "GenSigSendType" SG_ 2659690497 BLTN_CAM_WU_L_RecStpBySDCardEjec 4;
BA_ "SystemSignalLongSymbol" SG_ 2659690497 BLTN_CAM_WU_L_RecStpBySDCardEjec "BLTN_CAM_WU_L_RecStpBySDCardEject";
BA_ "Version" SG_ 2659690497 BLTN_CAM_WU_L_RecStpByUsrSetting "25.01.02";
BA_ "UserSigValidity" SG_ 2659690497 BLTN_CAM_WU_L_RecStpByUsrSetting 0;
BA_ "GenSigSendType" SG_ 2659690497 BLTN_CAM_WU_L_RecStpByUsrSetting 4;
BA_ "Version" SG_ 2659690497 BLTN_CAM_WU_L_ParkEvent "25.01.02";
BA_ "UserSigValidity" SG_ 2659690497 BLTN_CAM_WU_L_ParkEvent 0;
BA_ "GenSigSendType" SG_ 2659690497 BLTN_CAM_WU_L_ParkEvent 4;
BA_ "Version" SG_ 811 SBCM_AST_FD_Crc1Val "22.10.20";
BA_ "UserSigValidity" SG_ 811 SBCM_AST_FD_Crc1Val 3;
BA_ "GenSigStartValue" SG_ 811 SBCM_AST_FD_Crc1Val 65535;
BA_ "GenSigSendType" SG_ 811 SBCM_AST_FD_Crc1Val 4;
BA_ "Description" SG_ 811 SBCM_AST_FD_Crc1Val "The data area for CRC calculation is based on the data length (DLC) of the message DB.

The CRC shall be calculated over the entire data block (excluding the CRC bytes) including the user data, alive counter and Data ID



- CRC Polynomial (0x1021) , Ini";
BA_ "Version" SG_ 811 USM_AstGhostDoorSta "21.07.07";
BA_ "NetworkRequestHoldingTime" SG_ 811 USM_AstGhostDoorSta 5000;
BA_ "NetworkRequest" SG_ 811 USM_AstGhostDoorSta 0;
BA_ "UserSigValidity" SG_ 811 USM_AstGhostDoorSta 0;
BA_ "GenSigSendType" SG_ 811 USM_AstGhostDoorSta 4;
BA_ "Version" SG_ 811 AST_SWFailAlarm "21.07.07";
BA_ "NetworkRequestHoldingTime" SG_ 811 AST_SWFailAlarm 5000;
BA_ "NetworkRequest" SG_ 811 AST_SWFailAlarm 0;
BA_ "UserSigValidity" SG_ 811 AST_SWFailAlarm 0;
BA_ "GenSigSendType" SG_ 811 AST_SWFailAlarm 4;
BA_ "Version" SG_ 811 DoorLock_PDSLkSwSta_AST "21.09.05";
BA_ "NetworkRequest" SG_ 811 DoorLock_PDSLkSwSta_AST 0;
BA_ "UserSigValidity" SG_ 811 DoorLock_PDSLkSwSta_AST 0;
BA_ "GenSigSendType" SG_ 811 DoorLock_PDSLkSwSta_AST 4;
BA_ "Version" SG_ 811 PDS_TypeOption_AST "21.07.07";
BA_ "NetworkRequest" SG_ 811 PDS_TypeOption_AST 0;
BA_ "UserSigValidity" SG_ 811 PDS_TypeOption_AST 0;
BA_ "GenSigSendType" SG_ 811 PDS_TypeOption_AST 4;
BA_ "Version" SG_ 811 AFCU_AutoWashModeSta_SBCM_AST "22.07.00";
BA_ "NetworkRequestHoldingTime" SG_ 811 AFCU_AutoWashModeSta_SBCM_AST 5000;
BA_ "NetworkRequest" SG_ 811 AFCU_AutoWashModeSta_SBCM_AST 0;
BA_ "UserSigValidity" SG_ 811 AFCU_AutoWashModeSta_SBCM_AST 0;
BA_ "GenSigSendType" SG_ 811 AFCU_AutoWashModeSta_SBCM_AST 4;
BA_ "Version" SG_ 811 CDM_AutoWashModeSta_SBCM_AST "22.07.00";
BA_ "NetworkRequestHoldingTime" SG_ 811 CDM_AutoWashModeSta_SBCM_AST 5000;
BA_ "NetworkRequest" SG_ 811 CDM_AutoWashModeSta_SBCM_AST 0;
BA_ "UserSigValidity" SG_ 811 CDM_AutoWashModeSta_SBCM_AST 0;
BA_ "GenSigSendType" SG_ 811 CDM_AutoWashModeSta_SBCM_AST 4;
BA_ "Version" SG_ 811 AFH_AST_FldUnFldSta "24.07.06";
BA_ "NetworkRequestHoldingTime" SG_ 811 AFH_AST_FldUnFldSta 5000;
BA_ "NetworkRequest" SG_ 811 AFH_AST_FldUnFldSta 0;
BA_ "UserSigValidity" SG_ 811 AFH_AST_FldUnFldSta 0;
BA_ "GenSigSendType" SG_ 811 AFH_AST_FldUnFldSta 4;
BA_ "Version" SG_ 811 SBCM_AST_DiagSta "21.07.07";
BA_ "NetworkRequestHoldingTime" SG_ 811 SBCM_AST_DiagSta 5000;
BA_ "NetworkRequest" SG_ 811 SBCM_AST_DiagSta 0;
BA_ "UserSigValidity" SG_ 811 SBCM_AST_DiagSta 0;
BA_ "GenSigSendType" SG_ 811 SBCM_AST_DiagSta 4;
BA_ "Version" SG_ 811 CDM_TypeOption_AST "24.07.03";
BA_ "NetworkRequestHoldingTime" SG_ 811 CDM_TypeOption_AST 5000;
BA_ "NetworkRequest" SG_ 811 CDM_TypeOption_AST 0;
BA_ "UserSigValidity" SG_ 811 CDM_TypeOption_AST 7;
BA_ "GenSigSendType" SG_ 811 CDM_TypeOption_AST 4;
BA_ "Version" SG_ 811 CDM_ImmeChgSw_AST "21.07.07";
BA_ "NetworkRequestHoldingTime" SG_ 811 CDM_ImmeChgSw_AST 5000;
BA_ "NetworkRequest" SG_ 811 CDM_ImmeChgSw_AST 0;
BA_ "UserSigValidity" SG_ 811 CDM_ImmeChgSw_AST 7;
BA_ "GenSigSendType" SG_ 811 CDM_ImmeChgSw_AST 4;
BA_ "Version" SG_ 811 CDM_FobSrchReq_AST "24.05.03";
BA_ "NetworkRequestHoldingTime" SG_ 811 CDM_FobSrchReq_AST 5000;
BA_ "NetworkRequest" SG_ 811 CDM_FobSrchReq_AST 0;
BA_ "UserSigValidity" SG_ 811 CDM_FobSrchReq_AST 0;
BA_ "GenSigSendType" SG_ 811 CDM_FobSrchReq_AST 4;
BA_ "Version" SG_ 811 CDM_OpnClsState_AST "21.07.07";
BA_ "NetworkRequestHoldingTime" SG_ 811 CDM_OpnClsState_AST 5000;
BA_ "NetworkRequest" SG_ 811 CDM_OpnClsState_AST 0;
BA_ "UserSigValidity" SG_ 811 CDM_OpnClsState_AST 7;
BA_ "GenSigSendType" SG_ 811 CDM_OpnClsState_AST 4;
BA_ "Version" SG_ 811 CDM_WarnMsg_AST "21.07.07";
BA_ "NetworkRequestHoldingTime" SG_ 811 CDM_WarnMsg_AST 5000;
BA_ "NetworkRequest" SG_ 811 CDM_WarnMsg_AST 0;
BA_ "UserSigValidity" SG_ 811 CDM_WarnMsg_AST 7;
BA_ "GenSigSendType" SG_ 811 CDM_WarnMsg_AST 4;
BA_ "Version" SG_ 811 Mirror_RH_FoldingSta "21.07.07";
BA_ "NetworkRequestHoldingTime" SG_ 811 Mirror_RH_FoldingSta 5000;
BA_ "NetworkRequest" SG_ 811 Mirror_RH_FoldingSta 0;
BA_ "UserSigValidity" SG_ 811 Mirror_RH_FoldingSta 0;
BA_ "GenSigSendType" SG_ 811 Mirror_RH_FoldingSta 4;
BA_ "Version" SG_ 811 Mirror_RH_UnfoldingSta "21.07.07";
BA_ "NetworkRequestHoldingTime" SG_ 811 Mirror_RH_UnfoldingSta 5000;
BA_ "NetworkRequest" SG_ 811 Mirror_RH_UnfoldingSta 0;
BA_ "UserSigValidity" SG_ 811 Mirror_RH_UnfoldingSta 0;
BA_ "GenSigSendType" SG_ 811 Mirror_RH_UnfoldingSta 4;
BA_ "Version" SG_ 811 CDM_CmdStatus_AST "22.08.03";
BA_ "NetworkRequestHoldingTime" SG_ 811 CDM_CmdStatus_AST 5000;
BA_ "NetworkRequest" SG_ 811 CDM_CmdStatus_AST 0;
BA_ "UserSigValidity" SG_ 811 CDM_CmdStatus_AST 7;
BA_ "GenSigStartValue" SG_ 811 CDM_CmdStatus_AST 15;
BA_ "GenSigSendType" SG_ 811 CDM_CmdStatus_AST 4;
BA_ "Version" SG_ 811 SBCM_AST_FD_AlvCnt1Val "22.10.20";
BA_ "UserSigValidity" SG_ 811 SBCM_AST_FD_AlvCnt1Val 3;
BA_ "GenSigSendType" SG_ 811 SBCM_AST_FD_AlvCnt1Val 4;
BA_ "Description" SG_ 811 SBCM_AST_FD_AlvCnt1Val "For the first transmission request for a data element the counter shall be initialized with 0 and shall be incremented by 1 for every subsequent send request. 

When the counter reaches the maximum value(0xFF), then it shall restart with 0 for the next s";
BA_ "Version" SG_ 811 AST_CrashMRActAlarm "21.07.07";
BA_ "NetworkRequestHoldingTime" SG_ 811 AST_CrashMRActAlarm 5000;
BA_ "NetworkRequest" SG_ 811 AST_CrashMRActAlarm 0;
BA_ "UserSigValidity" SG_ 811 AST_CrashMRActAlarm 0;
BA_ "GenSigSendType" SG_ 811 AST_CrashMRActAlarm 4;
BA_ "Version" SG_ 811 PwrDRBuzzerOut_AST "21.07.07";
BA_ "NetworkRequestHoldingTime" SG_ 811 PwrDRBuzzerOut_AST 5000;
BA_ "NetworkRequest" SG_ 811 PwrDRBuzzerOut_AST 0;
BA_ "UserSigValidity" SG_ 811 PwrDRBuzzerOut_AST 0;
BA_ "GenSigSendType" SG_ 811 PwrDRBuzzerOut_AST 4;
BA_ "Version" SG_ 811 IMS_OSMirPlayBackSta_RH "21.07.07";
BA_ "NetworkRequestHoldingTime" SG_ 811 IMS_OSMirPlayBackSta_RH 5000;
BA_ "NetworkRequest" SG_ 811 IMS_OSMirPlayBackSta_RH 0;
BA_ "UserSigValidity" SG_ 811 IMS_OSMirPlayBackSta_RH 0;
BA_ "GenSigSendType" SG_ 811 IMS_OSMirPlayBackSta_RH 4;
BA_ "Version" SG_ 811 PwrDRClosingASTDrSta "23.07.06";
BA_ "NetworkRequestHoldingTime" SG_ 811 PwrDRClosingASTDrSta 5000;
BA_ "NetworkRequest" SG_ 811 PwrDRClosingASTDrSta 0;
BA_ "UserSigValidity" SG_ 811 PwrDRClosingASTDrSta 0;
BA_ "GenSigSendType" SG_ 811 PwrDRClosingASTDrSta 4;
BA_ "Version" SG_ 811 CDM_OutsideOpnSwSta_AST "23.02.02";
BA_ "NetworkRequestHoldingTime" SG_ 811 CDM_OutsideOpnSwSta_AST 5000;
BA_ "NetworkRequest" SG_ 811 CDM_OutsideOpnSwSta_AST 0;
BA_ "UserSigValidity" SG_ 811 CDM_OutsideOpnSwSta_AST 7;
BA_ "GenSigSendType" SG_ 811 CDM_OutsideOpnSwSta_AST 4;
BA_ "Description" SG_ 811 CDM_OutsideOpnSwSta_AST "Charging Door O/S SW State";
BA_ "Version" SG_ 811 Hood_TypeOption_AST "22.10.19";
BA_ "NetworkRequestHoldingTime" SG_ 811 Hood_TypeOption_AST 5000;
BA_ "NetworkRequest" SG_ 811 Hood_TypeOption_AST 0;
BA_ "UserSigValidity" SG_ 811 Hood_TypeOption_AST 0;
BA_ "GenSigSendType" SG_ 811 Hood_TypeOption_AST 4;
BA_ "Description" SG_ 811 Hood_TypeOption_AST "If the E-Hood is applied, the signal will be send.

Frunk signal from SBCM_AST to SBCM_DRV (RHD specification)";
BA_ "Version" SG_ 811 Warn_HoodSwSta_AST "22.10.19";
BA_ "NetworkRequestHoldingTime" SG_ 811 Warn_HoodSwSta_AST 5000;
BA_ "NetworkRequest" SG_ 811 Warn_HoodSwSta_AST 0;
BA_ "UserSigValidity" SG_ 811 Warn_HoodSwSta_AST 0;
BA_ "GenSigSendType" SG_ 811 Warn_HoodSwSta_AST 4;
BA_ "Description" SG_ 811 Warn_HoodSwSta_AST "Frunk signal from SBCM_AST to SBCM_DRV (RHD specification)";
BA_ "Version" SG_ 811 FrunkWarning_AST "22.10.19";
BA_ "NetworkRequestHoldingTime" SG_ 811 FrunkWarning_AST 5000;
BA_ "NetworkRequest" SG_ 811 FrunkWarning_AST 0;
BA_ "UserSigValidity" SG_ 811 FrunkWarning_AST 0;
BA_ "GenSigSendType" SG_ 811 FrunkWarning_AST 4;
BA_ "Description" SG_ 811 FrunkWarning_AST "Frunk signal from SBCM_AST to SBCM_DRV (RHD specification)";
BA_ "Version" SG_ 811 SBCM_FrunkSta_AST "22.10.19";
BA_ "NetworkRequestHoldingTime" SG_ 811 SBCM_FrunkSta_AST 5000;
BA_ "NetworkRequest" SG_ 811 SBCM_FrunkSta_AST 0;
BA_ "UserSigValidity" SG_ 811 SBCM_FrunkSta_AST 0;
BA_ "GenSigSendType" SG_ 811 SBCM_FrunkSta_AST 4;
BA_ "Description" SG_ 811 SBCM_FrunkSta_AST "Frunk signal from SBCM_AST to SBCM_DRV (RHD specification)";
BA_ "Version" SG_ 811 IMS_OSMirPlayBackSta_RH_New "23.01.03";
BA_ "NetworkRequestHoldingTime" SG_ 811 IMS_OSMirPlayBackSta_RH_New 5000;
BA_ "NetworkRequest" SG_ 811 IMS_OSMirPlayBackSta_RH_New 0;
BA_ "UserSigValidity" SG_ 811 IMS_OSMirPlayBackSta_RH_New 0;
BA_ "GenSigSendType" SG_ 811 IMS_OSMirPlayBackSta_RH_New 4;
BA_ "Description" SG_ 811 IMS_OSMirPlayBackSta_RH_New "Applied from standard DB 2.0";
BA_ "Version" SG_ 811 Ast_DrLkRetryFail_SBCM "23.03.00";
BA_ "NetworkRequestHoldingTime" SG_ 811 Ast_DrLkRetryFail_SBCM 5000;
BA_ "NetworkRequest" SG_ 811 Ast_DrLkRetryFail_SBCM 0;
BA_ "UserSigValidity" SG_ 811 Ast_DrLkRetryFail_SBCM 0;
BA_ "TimeoutValue" SG_ 811 Ast_DrLkRetryFail_SBCM "0x0";
BA_ "GenSigSendType" SG_ 811 Ast_DrLkRetryFail_SBCM 4;
BA_ "Version" SG_ 811 DoorLock_AstLkOutSta_SBCM "23.02.09";
BA_ "NetworkRequestHoldingTime" SG_ 811 DoorLock_AstLkOutSta_SBCM 5000;
BA_ "NetworkRequest" SG_ 811 DoorLock_AstLkOutSta_SBCM 0;
BA_ "UserSigValidity" SG_ 811 DoorLock_AstLkOutSta_SBCM 0;
BA_ "GenSigSendType" SG_ 811 DoorLock_AstLkOutSta_SBCM 4;
BA_ "Description" SG_ 811 DoorLock_AstLkOutSta_SBCM "- Door Lock or Unlock Output State 

0x0 : Off (Door lock/unlock output Off state)

0x1 : On (Door lock/unlock output On state)";
BA_ "Version" SG_ 811 FrunkReleaseSwSta_SBCM_AST "23.03.01";
BA_ "NetworkRequestHoldingTime" SG_ 811 FrunkReleaseSwSta_SBCM_AST 5000;
BA_ "NetworkRequest" SG_ 811 FrunkReleaseSwSta_SBCM_AST 0;
BA_ "UserSigValidity" SG_ 811 FrunkReleaseSwSta_SBCM_AST 0;
BA_ "GenSigSendType" SG_ 811 FrunkReleaseSwSta_SBCM_AST 4;
BA_ "Description" SG_ 811 FrunkReleaseSwSta_SBCM_AST "FrunkReleaseState (SBCM_AST_FD to SBCM_DRV_FD) RHD Spec";
BA_ "Version" SG_ 811 FrunkInsideRelSwSta_SBCM_AST "23.03.01";
BA_ "NetworkRequestHoldingTime" SG_ 811 FrunkInsideRelSwSta_SBCM_AST 5000;
BA_ "NetworkRequest" SG_ 811 FrunkInsideRelSwSta_SBCM_AST 0;
BA_ "UserSigValidity" SG_ 811 FrunkInsideRelSwSta_SBCM_AST 0;
BA_ "GenSigSendType" SG_ 811 FrunkInsideRelSwSta_SBCM_AST 4;
BA_ "Description" SG_ 811 FrunkInsideRelSwSta_SBCM_AST "FrunkInsideReleaseSwState (SBCM_AST_FD to SBCM_DRV_FD) RHD Spec";
BA_ "Version" SG_ 811 FrunkEmergencySwSta_SBCM_AST "23.03.01";
BA_ "NetworkRequestHoldingTime" SG_ 811 FrunkEmergencySwSta_SBCM_AST 5000;
BA_ "NetworkRequest" SG_ 811 FrunkEmergencySwSta_SBCM_AST 0;
BA_ "UserSigValidity" SG_ 811 FrunkEmergencySwSta_SBCM_AST 0;
BA_ "GenSigSendType" SG_ 811 FrunkEmergencySwSta_SBCM_AST 4;
BA_ "Description" SG_ 811 FrunkEmergencySwSta_SBCM_AST "FrunkEmergencySwState (SBCM_AST_FD to SBCM_DRV_FD) RHD Spec";
BA_ "Version" SG_ 811 PwrDrSta_Ast "24.01.05";
BA_ "NetworkRequestHoldingTime" SG_ 811 PwrDrSta_Ast 5000;
BA_ "NetworkRequest" SG_ 811 PwrDrSta_Ast 0;
BA_ "UserSigValidity" SG_ 811 PwrDrSta_Ast 0;
BA_ "GenSigSendType" SG_ 811 PwrDrSta_Ast 4;
BA_ "Version" SG_ 811 PwrDrSta_AstSd "24.01.05";
BA_ "NetworkRequestHoldingTime" SG_ 811 PwrDrSta_AstSd 5000;
BA_ "NetworkRequest" SG_ 811 PwrDrSta_AstSd 0;
BA_ "UserSigValidity" SG_ 811 PwrDrSta_AstSd 0;
BA_ "GenSigSendType" SG_ 811 PwrDrSta_AstSd 4;
BA_ "Version" SG_ 811 DischrgDr_OpnClsState_SBCM_AST "24.07.03";
BA_ "NetworkRequestHoldingTime" SG_ 811 DischrgDr_OpnClsState_SBCM_AST 5000;
BA_ "NetworkRequest" SG_ 811 DischrgDr_OpnClsState_SBCM_AST 0;
BA_ "UserSigValidity" SG_ 811 DischrgDr_OpnClsState_SBCM_AST 0;
BA_ "GenSigSendType" SG_ 811 DischrgDr_OpnClsState_SBCM_AST 4;
BA_ "Version" SG_ 811 AST_DetectObj_warn_LH "25.11.00";
BA_ "NetworkRequestHoldingTime" SG_ 811 AST_DetectObj_warn_LH 5000;
BA_ "NetworkRequest" SG_ 811 AST_DetectObj_warn_LH 0;
BA_ "UserSigValidity" SG_ 811 AST_DetectObj_warn_LH 0;
BA_ "GenSigSendType" SG_ 811 AST_DetectObj_warn_LH 4;
BA_ "Version" SG_ 811 PwrDROpenClosingAstSdDRSta "23.10.11";
BA_ "NetworkRequestHoldingTime" SG_ 811 PwrDROpenClosingAstSdDRSta 5000;
BA_ "NetworkRequest" SG_ 811 PwrDROpenClosingAstSdDRSta 0;
BA_ "UserSigValidity" SG_ 811 PwrDROpenClosingAstSdDRSta 0;
BA_ "GenSigSendType" SG_ 811 PwrDROpenClosingAstSdDRSta 4;
BA_ "Version" SG_ 811 PwrDRBuzzerOut_AST_New "25.01.00";
BA_ "NetworkRequestHoldingTime" SG_ 811 PwrDRBuzzerOut_AST_New 5000;
BA_ "NetworkRequest" SG_ 811 PwrDRBuzzerOut_AST_New 0;
BA_ "UserSigValidity" SG_ 811 PwrDRBuzzerOut_AST_New 0;
BA_ "GenSigSendType" SG_ 811 PwrDRBuzzerOut_AST_New 4;
BA_ "Description" SG_ 811 PwrDRBuzzerOut_AST_New "Applied from JG onwards";
BA_ "Version" SG_ 811 SBCM_AST_DoorAngle "25.04.00";
BA_ "NetworkRequestHoldingTime" SG_ 811 SBCM_AST_DoorAngle 5000;
BA_ "NetworkRequest" SG_ 811 SBCM_AST_DoorAngle 0;
BA_ "UserSigValidity" SG_ 811 SBCM_AST_DoorAngle 0;
BA_ "GenSigStartValue" SG_ 811 SBCM_AST_DoorAngle 100;
BA_ "GenSigSendType" SG_ 811 SBCM_AST_DoorAngle 4;
BA_ "Description" SG_ 811 SBCM_AST_DoorAngle "PDSM_FR_DoorAngle";
BA_ "Version" SG_ 811 EHL_TxInfo_SBCM_AST "24.07.03";
BA_ "NetworkRequestHoldingTime" SG_ 811 EHL_TxInfo_SBCM_AST 5000;
BA_ "NetworkRequest" SG_ 811 EHL_TxInfo_SBCM_AST 0;
BA_ "UserSigValidity" SG_ 811 EHL_TxInfo_SBCM_AST 0;
BA_ "GenSigSendType" SG_ 811 EHL_TxInfo_SBCM_AST 4;
BA_ "Description" SG_ 811 EHL_TxInfo_SBCM_AST "Electronic hood latch status signal transfer for dual hood latch type";
BA_ "Version" SG_ 811 CDM_DrType_AST "24.05.01";
BA_ "NetworkRequestHoldingTime" SG_ 811 CDM_DrType_AST 5000;
BA_ "NetworkRequest" SG_ 811 CDM_DrType_AST 0;
BA_ "UserSigValidity" SG_ 811 CDM_DrType_AST 7;
BA_ "GenSigSendType" SG_ 811 CDM_DrType_AST 4;
BA_ "Version" SG_ 811 ASTDoorPushAlarm "21.07.07";
BA_ "NetworkRequestHoldingTime" SG_ 811 ASTDoorPushAlarm 5000;
BA_ "NetworkRequest" SG_ 811 ASTDoorPushAlarm 0;
BA_ "UserSigValidity" SG_ 811 ASTDoorPushAlarm 0;
BA_ "GenSigSendType" SG_ 811 ASTDoorPushAlarm 4;
BA_ "Version" SG_ 811 AST_CrashUnlockCmd "21.07.07";
BA_ "NetworkRequest" SG_ 811 AST_CrashUnlockCmd 0;
BA_ "UserSigValidity" SG_ 811 AST_CrashUnlockCmd 0;
BA_ "GenSigSendType" SG_ 811 AST_CrashUnlockCmd 4;
BA_ "Description" SG_ 811 AST_CrashUnlockCmd "Assist Crash Unlock Command";
BA_ "Version" SG_ 811 DoorLock_CtrlDrLkSwSta_SBCM "21.07.07";
BA_ "NetworkRequest" SG_ 811 DoorLock_CtrlDrLkSwSta_SBCM 0;
BA_ "UserSigValidity" SG_ 811 DoorLock_CtrlDrLkSwSta_SBCM 0;
BA_ "GenSigSendType" SG_ 811 DoorLock_CtrlDrLkSwSta_SBCM 4;
BA_ "Description" SG_ 811 DoorLock_CtrlDrLkSwSta_SBCM "Central Door Lock Assist Switch Status";
BA_ "Version" SG_ 811 DoorLock_CtrlDrUnLkSwSta_SBCM "21.07.07";
BA_ "NetworkRequest" SG_ 811 DoorLock_CtrlDrUnLkSwSta_SBCM 0;
BA_ "UserSigValidity" SG_ 811 DoorLock_CtrlDrUnLkSwSta_SBCM 0;
BA_ "GenSigSendType" SG_ 811 DoorLock_CtrlDrUnLkSwSta_SBCM 4;
BA_ "Description" SG_ 811 DoorLock_CtrlDrUnLkSwSta_SBCM "Central Door Unlock Assist Switch Status";
BA_ "Version" SG_ 811 Warn_AsstDrSwSta_SBCM "21.09.05";
BA_ "NetworkRequest" SG_ 811 Warn_AsstDrSwSta_SBCM 0;
BA_ "UserSigValidity" SG_ 811 Warn_AsstDrSwSta_SBCM 0;
BA_ "GenSigSendType" SG_ 811 Warn_AsstDrSwSta_SBCM 4;
BA_ "Description" SG_ 811 Warn_AsstDrSwSta_SBCM "Warning Assist Door Switch Status";
BA_ "Version" SG_ 811 DoorLock_AsstDrUnLkSta_SBCM "21.07.07";
BA_ "NetworkRequest" SG_ 811 DoorLock_AsstDrUnLkSta_SBCM 0;
BA_ "UserSigValidity" SG_ 811 DoorLock_AsstDrUnLkSta_SBCM 0;
BA_ "GenSigSendType" SG_ 811 DoorLock_AsstDrUnLkSta_SBCM 4;
BA_ "Description" SG_ 811 DoorLock_AsstDrUnLkSta_SBCM "Assist Door Unlock Status";
BA_ "Version" SG_ 811 AST_SEAWarn_RH "21.07.07";
BA_ "NetworkRequest" SG_ 811 AST_SEAWarn_RH 0;
BA_ "UserSigValidity" SG_ 811 AST_SEAWarn_RH 0;
BA_ "GenSigSendType" SG_ 811 AST_SEAWarn_RH 4;
BA_ "Description" SG_ 811 AST_SEAWarn_RH "Assist (FRH) SEA Warning";
BA_ "Version" SG_ 811 AST_SEAWarn_LH "21.07.07";
BA_ "NetworkRequest" SG_ 811 AST_SEAWarn_LH 0;
BA_ "UserSigValidity" SG_ 811 AST_SEAWarn_LH 0;
BA_ "GenSigSendType" SG_ 811 AST_SEAWarn_LH 4;
BA_ "Description" SG_ 811 AST_SEAWarn_LH "Assist (FLH) Door SEA Warning";
BA_ "Version" SG_ 811 AST_SEWWarn_LH "21.07.07";
BA_ "NetworkRequest" SG_ 811 AST_SEWWarn_LH 0;
BA_ "UserSigValidity" SG_ 811 AST_SEWWarn_LH 0;
BA_ "GenSigSendType" SG_ 811 AST_SEWWarn_LH 4;
BA_ "Version" SG_ 811 AST_SEWWarn_RH "21.07.07";
BA_ "NetworkRequest" SG_ 811 AST_SEWWarn_RH 0;
BA_ "UserSigValidity" SG_ 811 AST_SEWWarn_RH 0;
BA_ "GenSigSendType" SG_ 811 AST_SEWWarn_RH 4;
BA_ "Version" SG_ 811 AST_MRActivationAlarm "21.07.07";
BA_ "NetworkRequestHoldingTime" SG_ 811 AST_MRActivationAlarm 5000;
BA_ "NetworkRequest" SG_ 811 AST_MRActivationAlarm 0;
BA_ "UserSigValidity" SG_ 811 AST_MRActivationAlarm 0;
BA_ "GenSigSendType" SG_ 811 AST_MRActivationAlarm 4;
BA_ "Version" SG_ 811 AST_ReleaseWarn "21.09.05";
BA_ "NetworkRequestHoldingTime" SG_ 811 AST_ReleaseWarn 5000;
BA_ "NetworkRequest" SG_ 811 AST_ReleaseWarn 0;
BA_ "UserSigValidity" SG_ 811 AST_ReleaseWarn 0;
BA_ "GenSigSendType" SG_ 811 AST_ReleaseWarn 4;
BA_ "Version" SG_ 930 CLU_HU_Crc3Val "22.10.20";
BA_ "UserSigValidity" SG_ 930 CLU_HU_Crc3Val 3;
BA_ "GenSigStartValue" SG_ 930 CLU_HU_Crc3Val 65535;
BA_ "GenSigSendType" SG_ 930 CLU_HU_Crc3Val 4;
BA_ "Description" SG_ 930 CLU_HU_Crc3Val "The data area for CRC calculation is based on the data length (DLC) of the message DB.

The CRC shall be calculated over the entire data block (excluding the CRC bytes) including the user data, alive counter and Data ID



- CRC Polynomial (0x1021) , Ini";
BA_ "Version" SG_ 930 CLU_TermAvgSync_MM "22.07.05";
BA_ "UserSigValidity" SG_ 930 CLU_TermAvgSync_MM 3;
BA_ "GenSigSendType" SG_ 930 CLU_TermAvgSync_MM 4;
BA_ "Description" SG_ 930 CLU_TermAvgSync_MM "Information for COUNTING 2.5 minutes Sync for AVN

Circulate value 0 to 3 each 2.5 minutes";
BA_ "Version" SG_ 930 CLU_TermAvgFCL_Digit_MM "22.07.05";
BA_ "UserSigValidity" SG_ 930 CLU_TermAvgFCL_Digit_MM 3;
BA_ "GenSigSendType" SG_ 930 CLU_TermAvgFCL_Digit_MM 4;
BA_ "Description" SG_ 930 CLU_TermAvgFCL_Digit_MM "Information for 2.5 minutes interval Average Fuel Consumption Digit

- Considering CF_Clu_AvgFCL (display is changed)

- For expression of 2 digit, decimal point is on dislpay (0~99.9) 

- For expression of 3 digit, decimal point is deleted on dislpay (1";
BA_ "Version" SG_ 930 CLU_TermAvgFuelCnsmptnVal_MM "22.07.05";
BA_ "UserSigValidity" SG_ 930 CLU_TermAvgFuelCnsmptnVal_MM 3;
BA_ "GenSigSendType" SG_ 930 CLU_TermAvgFuelCnsmptnVal_MM 4;
BA_ "Description" SG_ 930 CLU_TermAvgFuelCnsmptnVal_MM "Information for 2.5 minutes interval Average Fuel Consumption



-2.5 minutes interval Average Fuel Consumption Value is displayed by bar[(km/L, L/100km: 0.0~30.0), (MPG: 0.0~45.0)]

-Consider CR_Clu_TermAvgFCI_Digit signal for decimal point

  └ 0x0 : ";
BA_ "Version" SG_ 930 CLU_OptionInfo "25.04.00";
BA_ "UserSigValidity" SG_ 930 CLU_OptionInfo 3;
BA_ "GenSigSendType" SG_ 930 CLU_OptionInfo 4;
BA_ "Description" SG_ 930 CLU_OptionInfo "Information of CLU functions

This signal is used for judging state of CLU functions(Logic,Ui.. etc)

Bit0 : (EnergyFlow) : 0 - 8 Segment Display / 1 - Linear Display

Bit1 : Theme Support (0:No, 1:Yes)

Bit2 : eSignature Result (0:Success, 1:Fail)

Bit3";
BA_ "Version" SG_ 930 CLU_DispThmSetRdy "23.07.03";
BA_ "UserSigValidity" SG_ 930 CLU_DispThmSetRdy 3;
BA_ "GenSigSendType" SG_ 930 CLU_DispThmSetRdy 4;
BA_ "Description" SG_ 930 CLU_DispThmSetRdy "0x1 (Not Ready) : CLU can't change DisplayTheme 

0x2 (Ready) : CLU can change DisplayTheme";
BA_ "Version" SG_ 930 CLU_DispThmMemSta "23.07.03";
BA_ "UserSigValidity" SG_ 930 CLU_DispThmMemSta 3;
BA_ "GenSigSendType" SG_ 930 CLU_DispThmMemSta 4;
BA_ "Description" SG_ 930 CLU_DispThmMemSta "bit0: memory 1 (0:empty / 1:saved)

bit1: memory 2 (0:empty / 1:saved)

bit2: memory 3 (0:empty / 1:saved)

bit3~6: reserved

bit7: Invalid";
BA_ "Version" SG_ 930 CLU_HU_AlvCnt3Val "22.10.20";
BA_ "UserSigValidity" SG_ 930 CLU_HU_AlvCnt3Val 3;
BA_ "GenSigSendType" SG_ 930 CLU_HU_AlvCnt3Val 4;
BA_ "Description" SG_ 930 CLU_HU_AlvCnt3Val "For the first transmission request for a data element the counter shall be initialized with 0 and shall be incremented by 1 for every subsequent send request. 

When the counter reaches the maximum value(0xFF), then it shall restart with 0 for the next s";
BA_ "Version" SG_ 930 CLU_DispThmDeleteSta "23.07.03";
BA_ "UserSigValidity" SG_ 930 CLU_DispThmDeleteSta 3;
BA_ "GenSigSendType" SG_ 930 CLU_DispThmDeleteSta 4;
BA_ "Description" SG_ 930 CLU_DispThmDeleteSta "The signal is the feedback signal of Display Theme Delete Request

※ HU_DispThmDeleteReq";
BA_ "Version" SG_ 930 CLU_DispThmCopySta "23.07.03";
BA_ "UserSigValidity" SG_ 930 CLU_DispThmCopySta 3;
BA_ "GenSigSendType" SG_ 930 CLU_DispThmCopySta 4;
BA_ "Description" SG_ 930 CLU_DispThmCopySta "The signal is the feedback signal of Display Theme Copy Request

※ HU_DispThmCopyReq";
BA_ "Version" SG_ 930 CLU_DispThmSetStaMem "23.07.03";
BA_ "UserSigValidity" SG_ 930 CLU_DispThmSetStaMem 3;
BA_ "GenSigSendType" SG_ 930 CLU_DispThmSetStaMem 4;
BA_ "Description" SG_ 930 CLU_DispThmSetStaMem "The signal indicates status of CLU theme displayed";
BA_ "Version" SG_ 930 CLU_LapTimer_LapNumber_MM "22.07.05";
BA_ "UserSigValidity" SG_ 930 CLU_LapTimer_LapNumber_MM 3;
BA_ "GenSigSendType" SG_ 930 CLU_LapTimer_LapNumber_MM 4;
BA_ "Description" SG_ 930 CLU_LapTimer_LapNumber_MM "This signal means Lap Number. Laptimer function is interoperated in Cluater and AVN. Cluster displays Lap Time in real time and AVN displays the history of Lap Time.";
BA_ "Version" SG_ 930 CLU_LapTimer_Hour_MM "22.07.05";
BA_ "UserSigValidity" SG_ 930 CLU_LapTimer_Hour_MM 3;
BA_ "GenSigSendType" SG_ 930 CLU_LapTimer_Hour_MM 4;
BA_ "Description" SG_ 930 CLU_LapTimer_Hour_MM "This signal means 'Hour' of each LapTime. Laptimer function is interoperated in Cluater and AVN. Cluster displays Lap Time in real time and AVN displays the history of Lap Time.";
BA_ "Version" SG_ 930 CLU_LapTimer_Minute_MM "22.07.05";
BA_ "UserSigValidity" SG_ 930 CLU_LapTimer_Minute_MM 3;
BA_ "GenSigSendType" SG_ 930 CLU_LapTimer_Minute_MM 4;
BA_ "Description" SG_ 930 CLU_LapTimer_Minute_MM "This signal means 'Minute' value of each LapTime. Laptimer function is interoperated in Cluater and AVN. Cluster displays Lap Time in real time and AVN displays the history of Lap Time.";
BA_ "Version" SG_ 930 CLU_LapTimer_Second_MM "22.07.05";
BA_ "UserSigValidity" SG_ 930 CLU_LapTimer_Second_MM 3;
BA_ "GenSigSendType" SG_ 930 CLU_LapTimer_Second_MM 4;
BA_ "Description" SG_ 930 CLU_LapTimer_Second_MM "This signal means 'second' value of each LapTime. Laptimer function is interoperated in Cluater and AVN. Cluster displays Lap Time in real time and AVN displays the history of Lap Time.";
BA_ "Version" SG_ 930 CLU_LapTimer_MeasuringStatus_MM "22.07.05";
BA_ "UserSigValidity" SG_ 930 CLU_LapTimer_MeasuringStatus_MM 3;
BA_ "GenSigSendType" SG_ 930 CLU_LapTimer_MeasuringStatus_MM 4;
BA_ "Description" SG_ 930 CLU_LapTimer_MeasuringStatus_MM "This signal means current measuring status of Lap Time in Cluster.";
BA_ "Version" SG_ 930 CLU_LapTimer_milisecond_MM "22.07.05";
BA_ "UserSigValidity" SG_ 930 CLU_LapTimer_milisecond_MM 3;
BA_ "GenSigSendType" SG_ 930 CLU_LapTimer_milisecond_MM 4;
BA_ "Description" SG_ 930 CLU_LapTimer_milisecond_MM "This signal means '1/100second' value of each LapTime. Laptimer function is interoperated in Cluater and AVN. Cluster displays Lap Time in real time and AVN displays the history of Lap Time.";
BA_ "Version" SG_ 930 CLU_N1SetVal_MM "22.07.05";
BA_ "UserSigValidity" SG_ 930 CLU_N1SetVal_MM 3;
BA_ "GenSigSendType" SG_ 930 CLU_N1SetVal_MM 4;
BA_ "Description" SG_ 930 CLU_N1SetVal_MM "N1 S/W set value feedback to H/U

※ 2nd general DB:CLU17/CLU_N1SetVal";
BA_ "Version" SG_ 930 CLU_N2SetVal_MM "22.07.05";
BA_ "UserSigValidity" SG_ 930 CLU_N2SetVal_MM 3;
BA_ "GenSigSendType" SG_ 930 CLU_N2SetVal_MM 4;
BA_ "Description" SG_ 930 CLU_N2SetVal_MM "N2 S/W set value feedback to H/U

※ 2nd general DB:CLU17/CLU_N2SetVal";
BA_ "Version" SG_ 930 Usm_TorqueUnitSetSta_MM "22.07.05";
BA_ "UserSigValidity" SG_ 930 Usm_TorqueUnitSetSta_MM 3;
BA_ "GenSigSendType" SG_ 930 Usm_TorqueUnitSetSta_MM 4;
BA_ "Description" SG_ 930 Usm_TorqueUnitSetSta_MM "Torque gauge unit  setting for AVN USM";
BA_ "Version" SG_ 930 Usm_TurboPressureUnitSetSta_MM "22.07.05";
BA_ "UserSigValidity" SG_ 930 Usm_TurboPressureUnitSetSta_MM 3;
BA_ "GenSigSendType" SG_ 930 Usm_TurboPressureUnitSetSta_MM 4;
BA_ "Description" SG_ 930 Usm_TurboPressureUnitSetSta_MM "Turbo boost pressre unit setting for AVN USM";
BA_ "Version" SG_ 930 USM_ShiftLightNmodeSetSta_MM "22.07.05";
BA_ "UserSigValidity" SG_ 930 USM_ShiftLightNmodeSetSta_MM 3;
BA_ "GenSigSendType" SG_ 930 USM_ShiftLightNmodeSetSta_MM 4;
BA_ "Description" SG_ 930 USM_ShiftLightNmodeSetSta_MM "It is a signal for Shiftlight AVN USM

When AVN send a signal(Event), Cluster send this feeback signal for changing setting value";
BA_ "Version" SG_ 930 USM_ShiftLightCustomSetSta_MM "22.07.05";
BA_ "UserSigValidity" SG_ 930 USM_ShiftLightCustomSetSta_MM 3;
BA_ "GenSigSendType" SG_ 930 USM_ShiftLightCustomSetSta_MM 4;
BA_ "Description" SG_ 930 USM_ShiftLightCustomSetSta_MM "It is a signal for Shiftlight AVN USM

When AVN send a signal(Event), Cluster send this feeback signal for changing setting value";
BA_ "Version" SG_ 930 USM_ShiftLightSportSetSta_MM "22.07.05";
BA_ "UserSigValidity" SG_ 930 USM_ShiftLightSportSetSta_MM 3;
BA_ "GenSigSendType" SG_ 930 USM_ShiftLightSportSetSta_MM 4;
BA_ "Description" SG_ 930 USM_ShiftLightSportSetSta_MM "It is a signal for Shiftlight AVN USM

When AVN send a signal(Event), Cluster send this feeback signal for changing setting value";
BA_ "Version" SG_ 930 USM_ShiftLightNormalSetSta_MM "22.07.05";
BA_ "UserSigValidity" SG_ 930 USM_ShiftLightNormalSetSta_MM 3;
BA_ "GenSigSendType" SG_ 930 USM_ShiftLightNormalSetSta_MM 4;
BA_ "Description" SG_ 930 USM_ShiftLightNormalSetSta_MM "It is a signal for Shiftlight AVN USM

When AVN send a signal(Event), Cluster send this feeback signal for changing setting value";
BA_ "Version" SG_ 930 USM_ShiftLightEcoSetSta_MM "22.07.05";
BA_ "UserSigValidity" SG_ 930 USM_ShiftLightEcoSetSta_MM 3;
BA_ "GenSigSendType" SG_ 930 USM_ShiftLightEcoSetSta_MM 4;
BA_ "Description" SG_ 930 USM_ShiftLightEcoSetSta_MM "It is a signal for Shiftlight AVN USM

When AVN send a signal(Event), Cluster send this feeback signal for changing setting value";
BA_ "Version" SG_ 930 USM_ShiftLightBeepSndSetSta_MM "22.07.05";
BA_ "UserSigValidity" SG_ 930 USM_ShiftLightBeepSndSetSta_MM 3;
BA_ "GenSigSendType" SG_ 930 USM_ShiftLightBeepSndSetSta_MM 4;
BA_ "Description" SG_ 930 USM_ShiftLightBeepSndSetSta_MM "It is a signal for Shiftlight AVN USM

When AVN send a signal(Event), Cluster send this feeback signal for changing setting value";
BA_ "Version" SG_ 930 USM_ShiftLightCustom2SetSta_MM "22.07.05";
BA_ "UserSigValidity" SG_ 930 USM_ShiftLightCustom2SetSta_MM 3;
BA_ "GenSigSendType" SG_ 930 USM_ShiftLightCustom2SetSta_MM 4;
BA_ "Description" SG_ 930 USM_ShiftLightCustom2SetSta_MM "It is a signal for Shiftlight AVN USM

When AVN send a signal(Event), Cluster send this feeback signal for changing setting value";
BA_ "Version" SG_ 930 USM_LapTimerAutoMsreSetSta_MM "22.07.05";
BA_ "UserSigValidity" SG_ 930 USM_LapTimerAutoMsreSetSta_MM 3;
BA_ "GenSigSendType" SG_ 930 USM_LapTimerAutoMsreSetSta_MM 4;
BA_ "Description" SG_ 930 USM_LapTimerAutoMsreSetSta_MM "Setting value for auto-measurement of Laptimer

This is signal for AVN USM 

MM-CAN(LS) :CLU_HU_PE_05/ LapTimer_AutoMeasure_Set_FB";
BA_ "Version" SG_ 930 USM_LapTimerTimeGapSetSta_MM "22.07.05";
BA_ "UserSigValidity" SG_ 930 USM_LapTimerTimeGapSetSta_MM 3;
BA_ "GenSigSendType" SG_ 930 USM_LapTimerTimeGapSetSta_MM 4;
BA_ "Description" SG_ 930 USM_LapTimerTimeGapSetSta_MM "setting value for laptimer time gap displaying

It is signal for AVN USM

MM-CAN(LS) : CLU_HU_PE_05/LapTimer_TimeGap_Setting_FB";
BA_ "Version" SG_ 518 GNSS_Crc7Val "22.10.20";
BA_ "UserSigValidity" SG_ 518 GNSS_Crc7Val 3;
BA_ "GenSigStartValue" SG_ 518 GNSS_Crc7Val 65535;
BA_ "Description" SG_ 518 GNSS_Crc7Val "The data area for CRC calculation is based on the data length (DLC) of the message DB.

The CRC shall be calculated over the entire data block (excluding the CRC bytes) including the user data, alive counter and Data ID



- CRC Polynomial (0x1021) , Ini";
BA_ "Version" SG_ 518 HU_DR_Latitude "22.07.05";
BA_ "UserSigValidity" SG_ 518 HU_DR_Latitude 1;
BA_ "Version" SG_ 518 GNSS_AlvCnt7Val "22.10.20";
BA_ "UserSigValidity" SG_ 518 GNSS_AlvCnt7Val 3;
BA_ "Description" SG_ 518 GNSS_AlvCnt7Val "For the first transmission request for a data element the counter shall be initialized with 0 and shall be incremented by 1 for every subsequent send request. 

When the counter reaches the maximum value(0xFF), then it shall restart with 0 for the next s";
BA_ "Version" SG_ 518 HU_DR_Longitude "22.07.05";
BA_ "UserSigValidity" SG_ 518 HU_DR_Longitude 1;
BA_ "Version" SG_ 518 HU_DR_Heading "22.07.05";
BA_ "UserSigValidity" SG_ 518 HU_DR_Heading 1;
BA_ "Version" SG_ 518 HU_DR_Speed "22.07.05";
BA_ "UserSigValidity" SG_ 518 HU_DR_Speed 1;
BA_ "Description" SG_ 518 HU_DR_Speed "negative if the direction is backward.";
BA_ "Version" SG_ 518 HU_DR_TimeOfWeek "23.07.03";
BA_ "UserSigValidity" SG_ 518 HU_DR_TimeOfWeek 1;
BA_ "Description" SG_ 518 HU_DR_TimeOfWeek "0x0~0x23FD41BF: PHY VALUE";
BA_ "Version" SG_ 518 HU_DR_Position_Status "22.07.05";
BA_ "UserSigValidity" SG_ 518 HU_DR_Position_Status 1;
BA_ "Description" SG_ 518 HU_DR_Position_Status "0x1:Valid";
BA_ "Version" SG_ 518 HU_DR_Altitude_Status "22.07.05";
BA_ "UserSigValidity" SG_ 518 HU_DR_Altitude_Status 1;
BA_ "Description" SG_ 518 HU_DR_Altitude_Status "0x1=Valid";
BA_ "Version" SG_ 518 HU_DR_Heading_Status "22.07.05";
BA_ "UserSigValidity" SG_ 518 HU_DR_Heading_Status 1;
BA_ "Description" SG_ 518 HU_DR_Heading_Status "0x1=Valid";
BA_ "Version" SG_ 518 HU_DR_Speed_Status "22.07.05";
BA_ "UserSigValidity" SG_ 518 HU_DR_Speed_Status 1;
BA_ "Description" SG_ 518 HU_DR_Speed_Status "0x1=Valid";
BA_ "Version" SG_ 518 HU_DR_DirectionSwitch_Sta "22.07.05";
BA_ "UserSigValidity" SG_ 518 HU_DR_DirectionSwitch_Sta 1;
BA_ "Description" SG_ 518 HU_DR_DirectionSwitch_Sta "0x1=valid";
BA_ "Version" SG_ 518 HU_DR_Direction "22.07.05";
BA_ "UserSigValidity" SG_ 518 HU_DR_Direction 1;
BA_ "Description" SG_ 518 HU_DR_Direction "0x1=Backward";
BA_ "Version" SG_ 518 HU_DR_GyroCalib_Sta "22.07.05";
BA_ "UserSigValidity" SG_ 518 HU_DR_GyroCalib_Sta 1;
BA_ "Description" SG_ 518 HU_DR_GyroCalib_Sta "0x1=Calibrated";
BA_ "Version" SG_ 518 HU_DR_TachoCalib_Sta "22.07.05";
BA_ "UserSigValidity" SG_ 518 HU_DR_TachoCalib_Sta 1;
BA_ "Description" SG_ 518 HU_DR_TachoCalib_Sta "0x1=Calibrated";
BA_ "Version" SG_ 518 HU_DR_Solution_Sta "22.07.05";
BA_ "UserSigValidity" SG_ 518 HU_DR_Solution_Sta 1;
BA_ "Description" SG_ 518 HU_DR_Solution_Sta "0x1 : Dr is fully calibrated and DR position is valid";
BA_ "Version" SG_ 518 HU_DR_GNSS_Fix_Age "22.07.05";
BA_ "UserSigValidity" SG_ 518 HU_DR_GNSS_Fix_Age 1;
BA_ "Description" SG_ 518 HU_DR_GNSS_Fix_Age "0-254 = Time since last GNSS fix

255= No GNSS fix yet";
BA_ "Version" SG_ 518 HU_DR_Altitude "22.07.05";
BA_ "UserSigValidity" SG_ 518 HU_DR_Altitude 1;
BA_ "Description" SG_ 518 HU_DR_Altitude "MSL";
BA_ "Version" SG_ 309 BAT_Crc1Val "21.09.03";
BA_ "RoutingFactor" SG_ 309 BAT_Crc1Val 5;
BA_ "UserSigValidity" SG_ 309 BAT_Crc1Val 7;
BA_ "GenSigStartValue" SG_ 309 BAT_Crc1Val 65535;
BA_ "Description" SG_ 309 BAT_Crc1Val "The data area for CRC calculation is based on the data length (DLC) of the message DB.

The CRC shall be calculated over the entire data block (excluding the CRC bytes) including the user data, alive counter and Data ID



- CRC Polynomial (0x1021) , Ini";
BA_ "Version" SG_ 309 BAT_AlvCnt1Val "21.09.03";
BA_ "RoutingFactor" SG_ 309 BAT_AlvCnt1Val 5;
BA_ "UserSigValidity" SG_ 309 BAT_AlvCnt1Val 7;
BA_ "Description" SG_ 309 BAT_AlvCnt1Val "For the first transmission request for a data element the counter shall be initialized with 0 and shall be incremented by 1 for every subsequent send request. 

When the counter reaches the maximum value(0xFF), then it shall restart with 0 for the next s";
BA_ "Version" SG_ 309 BAT_CurrVal "25.07.00";
BA_ "RoutingFactor" SG_ 309 BAT_CurrVal 5;
BA_ "UserSigValidity" SG_ 309 BAT_CurrVal 7;
BA_ "GenSigStartValue" SG_ 309 BAT_CurrVal 65535;
BA_ "Description" SG_ 309 BAT_CurrVal "[For 12V Lithium Battery vehicle model]

This is Battery current as measured by battery sensor.

This value is  

   - IRANGE : 1 (medium current)

   - Resolution : 10mA";
BA_ "Version" SG_ 309 BAT_SocVal "25.07.00";
BA_ "RoutingFactor" SG_ 309 BAT_SocVal 5;
BA_ "UserSigValidity" SG_ 309 BAT_SocVal 7;
BA_ "Description" SG_ 309 BAT_SocVal "[For 12V Lithium Battery vehicle model]

This signal is battery State of Charge as calculated by battery sensor.";
BA_ "Version" SG_ 309 BAT_VoltVal "25.07.00";
BA_ "RoutingFactor" SG_ 309 BAT_VoltVal 5;
BA_ "UserSigValidity" SG_ 309 BAT_VoltVal 7;
BA_ "GenSigStartValue" SG_ 309 BAT_VoltVal 16383;
BA_ "Description" SG_ 309 BAT_VoltVal "[For 12V Lithium Battery vehicle model]

This is the actual battery voltage as measured on the battery pole by battery sensor.

The Resolution is 1mV.";
BA_ "Version" SG_ 309 BAT_AuxBattOpt "21.10.05";
BA_ "RoutingFactor" SG_ 309 BAT_AuxBattOpt 5;
BA_ "UserSigValidity" SG_ 309 BAT_AuxBattOpt 7;
BA_ "Description" SG_ 309 BAT_AuxBattOpt "12V Battery Option Value(LFP 12V Battery)";
BA_ "Version" SG_ 309 BAT_TempVal "25.07.00";
BA_ "RoutingFactor" SG_ 309 BAT_TempVal 5;
BA_ "UserSigValidity" SG_ 309 BAT_TempVal 7;
BA_ "GenSigStartValue" SG_ 309 BAT_TempVal 511;
BA_ "Description" SG_ 309 BAT_TempVal "This is actual battery electrolyte temperature value by battery sensor.

The value is calculated by a Battery Temperature Model, depending on measured temperature of the battery pole.

The resolution is 0.5℃.";
BA_ "Version" SG_ 309 BAT_SocErrSta "19.01.00";
BA_ "RoutingFactor" SG_ 309 BAT_SocErrSta 5;
BA_ "UserSigValidity" SG_ 309 BAT_SocErrSta 7;
BA_ "GenSigStartValue" SG_ 309 BAT_SocErrSta 1;
BA_ "Description" SG_ 309 BAT_SocErrSta "[For 12V Lithium Battery vehicle model]

This bit is flags for indication whether battery SOC detection value is plausible or not by battery sensor.

If it is set to value 0, then it means battery SOC is normal state.

If it is set to value 1, then it me";
BA_ "Version" SG_ 309 BAT_SohVal "25.07.00";
BA_ "RoutingFactor" SG_ 309 BAT_SohVal 5;
BA_ "UserSigValidity" SG_ 309 BAT_SohVal 7;
BA_ "GenSigStartValue" SG_ 309 BAT_SohVal 127;
BA_ "Description" SG_ 309 BAT_SohVal "[For 12V Lithium Battery vehicle model]

This signal is battery State of Health(SOH) as calculated by battery sensor.

This value shows reduction rate of nominal capacity.

This value can be used for diagnosis information of application system.";
BA_ "Version" SG_ 309 BAT_SnsrInvldSta "17.11.00";
BA_ "RoutingFactor" SG_ 309 BAT_SnsrInvldSta 5;
BA_ "UserSigValidity" SG_ 309 BAT_SnsrInvldSta 7;
BA_ "GenSigStartValue" SG_ 309 BAT_SnsrInvldSta 1;
BA_ "Description" SG_ 309 BAT_SnsrInvldSta "[For 12V Lithium Battery vehicle model]

This bit is Battery Sensor Invalid flag and setting condition is depending on Battery Sensor self diagnosis information.

 BS Invalid = 0 : BS is Valid Condition

 BS Invalid = 1 : BS is Invalid Condition";
BA_ "Version" SG_ 309 BAT_SofVal "25.07.00";
BA_ "RoutingFactor" SG_ 309 BAT_SofVal 5;
BA_ "UserSigValidity" SG_ 309 BAT_SofVal 7;
BA_ "GenSigStartValue" SG_ 309 BAT_SofVal 127;
BA_ "Description" SG_ 309 BAT_SofVal "[For 12V Lithium Battery vehicle model]

This signal is battery State of Function(SOF) as calculated by battery sensor.

This value shows information about the battery ability to crank the engine (both of warm & cold cranking).

This value is prediction ";
BA_ "Version" SG_ 309 BAT_RspErrSta "17.11.00";
BA_ "RoutingFactor" SG_ 309 BAT_RspErrSta 5;
BA_ "UserSigValidity" SG_ 309 BAT_RspErrSta 7;
BA_ "GenSigStartValue" SG_ 309 BAT_RspErrSta 1;
BA_ "Description" SG_ 309 BAT_RspErrSta "[For 12V Lithium Battery vehicle model]

Battery Sensor shall send one status bit signal, Response_Error. Response_Error shall be set whenever a frame received by the node or a frame transmitted by the node contains an error in the response field.

Respo";
BA_ "Version" SG_ 309 BAT_CapacityVal "25.07.00";
BA_ "RoutingFactor" SG_ 309 BAT_CapacityVal 5;
BA_ "UserSigValidity" SG_ 309 BAT_CapacityVal 7;
BA_ "Description" SG_ 309 BAT_CapacityVal "12V Battery Capacity Value";
BA_REL_ "GenSigTimeoutTime" BU_SG_REL_ BLTN_CAM_FD SG_ 676 LapTimer_LapNumber_HU 1500;
BA_REL_ "GenSigTimeoutTime" BU_SG_REL_ BLTN_CAM_FD SG_ 676 LapTimer_Hour_HU 1500;
BA_REL_ "GenSigTimeoutTime" BU_SG_REL_ BLTN_CAM_FD SG_ 676 LapTimer_Minute_HU 1500;
BA_REL_ "GenSigTimeoutTime" BU_SG_REL_ BLTN_CAM_FD SG_ 676 LapTimer_Second_HU 1500;
BA_REL_ "GenSigTimeoutTime" BU_SG_REL_ BLTN_CAM_FD SG_ 676 LapTimer_milisecond_HU 1500;
BA_REL_ "GenSigTimeoutTime" BU_SG_REL_ BLTN_CAM_FD SG_ 676 LapTimer_CountStart 700;
BA_REL_ "GenSigTimeoutTime" BU_SG_REL_ GW_PSU_DRV_FD SG_ 813 SBCM_DRV_FD_Crc1Val 1500;
BA_REL_ "GenSigTimeoutTime" BU_SG_REL_ RWPC_FD SG_ 813 Latch_TypeOption_DRV 1500;
BA_REL_ "GenSigTimeoutTime" BU_SG_REL_ WPC2_FD SG_ 813 Latch_TypeOption_DRV 1500;
BA_REL_ "GenSigTimeoutTime" BU_SG_REL_ WPC_FD SG_ 813 Latch_TypeOption_DRV 1500;
BA_REL_ "GenSigTimeoutTime" BU_SG_REL_ ATS_FD SG_ 813 DRV_SWFailAlarm 1500;
BA_REL_ "GenSigTimeoutTime" BU_SG_REL_ ATS_FD SG_ 813 PDS_TypeOption_DRV 1500;
BA_REL_ "GenSigTimeoutTime" BU_SG_REL_ GW_PSU_DRV_FD SG_ 813 SBCM_DRV_FD_AlvCnt1Val 1500;
BA_REL_ "GenSigTimeoutTime" BU_SG_REL_ GW_PSU_DRV_FD SG_ 813 IMS_OSMirPlayBackSta_LH 1500;
BA_REL_ "GenSigTimeoutTime" BU_SG_REL_ GW_PSU_DRV_FD SG_ 813 IMS_OSMirPlayBackSta_LH_New 1500;
BA_REL_ "GenSigTimeoutTime" BU_SG_REL_ BLTN_CAM_FD SG_ 813 Warn_HoodSwSta_SBCM 1500;
BA_REL_ "GenSigTimeoutTime" BU_SG_REL_ BLTN_CAM_FD SG_ 813 Hood_TypeOption 1500;
BA_REL_ "GenSigTimeoutTime" BU_SG_REL_ ATS_FD SG_ 813 PwrDRClosingDRVDrSta 1500;
BA_REL_ "GenSigTimeoutTime" BU_SG_REL_ ATS_FD SG_ 813 DRV_DetectObj_warn_LH 1500;
BA_REL_ "GenSigTimeoutTime" BU_SG_REL_ ATS_FD SG_ 813 PwrDROpenClosingDdvSdDRSta 1500;
BA_REL_ "GenSigTimeoutTime" BU_SG_REL_ ATS_FD SG_ 813 Coach_TypeOption_DRV 1500;
BA_REL_ "GenSigTimeoutTime" BU_SG_REL_ GW_PSU_RL_FD SG_ 813 Coach_TypeOption_DRV 1500;
BA_REL_ "GenSigTimeoutTime" BU_SG_REL_ GW_PSU_RR_FD SG_ 813 Coach_TypeOption_DRV 1500;
BA_REL_ "GenSigTimeoutTime" BU_SG_REL_ ATS_FD SG_ 813 PwrDrSta_Drv 1500;
BA_REL_ "GenSigTimeoutTime" BU_SG_REL_ ATS_FD SG_ 813 PwrDrSta_DrvSd 1500;
BA_REL_ "GenSigTimeoutTime" BU_SG_REL_ ATS_FD SG_ 813 SBCM_DRV_DoorAngle 1500;
BA_REL_ "GenSigTimeoutTime" BU_SG_REL_ BLTN_CAM_FD SG_ 813 DRV_CrashUnlockCmd 1500;
BA_REL_ "GenSigTimeoutTime" BU_SG_REL_ ATS_FD SG_ 813 Warn_DrvDrSwSta_SBCM 1500;
BA_REL_ "GenSigTimeoutTime" BU_SG_REL_ BLTN_CAM_FD SG_ 813 Warn_DrvDrSwSta_SBCM 1500;
BA_REL_ "GenSigTimeoutTime" BU_SG_REL_ DCM_FD SG_ 813 Warn_DrvDrSwSta_SBCM 1500;
BA_REL_ "GenSigTimeoutTime" BU_SG_REL_ GW_PSU_DRV_FD SG_ 813 Warn_DrvDrSwSta_SBCM 1500;
BA_REL_ "GenSigTimeoutTime" BU_SG_REL_ PSB_FD SG_ 813 Warn_DrvDrSwSta_SBCM 1500;
BA_REL_ "GenSigTimeoutTime" BU_SG_REL_ RWPC_FD SG_ 813 Warn_DrvDrSwSta_SBCM 1500;
BA_REL_ "GenSigTimeoutTime" BU_SG_REL_ WPC2_FD SG_ 813 Warn_DrvDrSwSta_SBCM 1500;
BA_REL_ "GenSigTimeoutTime" BU_SG_REL_ WPC_FD SG_ 813 Warn_DrvDrSwSta_SBCM 1500;
BA_REL_ "GenSigTimeoutTime" BU_SG_REL_ ATS_FD SG_ 813 DoorLock_DrvDrUnLkSta_SBCM 1500;
BA_REL_ "GenSigTimeoutTime" BU_SG_REL_ FCS_FD SG_ 813 DoorLock_DrvDrUnLkSta_SBCM 1500;
BA_REL_ "GenSigTimeoutTime" BU_SG_REL_ GW_PSU_DRV_FD SG_ 813 DoorLock_DrvDrUnLkSta_SBCM 1500;
BA_REL_ "GenSigTimeoutTime" BU_SG_REL_ ATS_FD SG_ 813 DRV_SEAWarn_LH 1500;
BA_REL_ "GenSigTimeoutTime" BU_SG_REL_ vFD_B2 SG_ 2659690497 BLTN_CAM_WU_Crc1Val 5000;
BA_REL_ "GenSigTimeoutTime" BU_SG_REL_ vFD_B2 SG_ 2659690497 BLTN_CAM_WU_AlvCnt1Val 5000;
BA_REL_ "GenSigTimeoutTime" BU_SG_REL_ vFD_B2 SG_ 2659690497 BLTN_CAM_WU_NM_B2 5000;
BA_REL_ "GenSigTimeoutTime" BU_SG_REL_ vFD_B2 SG_ 2659690497 BLTN_CAM_WU_L_RecStpByBattEmpty 5000;
BA_REL_ "GenSigTimeoutTime" BU_SG_REL_ vFD_B2 SG_ 2659690497 BLTN_CAM_WU_L_RecStpByBLTNCAMErr 5000;
BA_REL_ "GenSigTimeoutTime" BU_SG_REL_ vFD_B2 SG_ 2659690497 BLTN_CAM_WU_L_RecStpBySDCardErr 5000;
BA_REL_ "GenSigTimeoutTime" BU_SG_REL_ vFD_B2 SG_ 2659690497 BLTN_CAM_WU_L_RecStpBySDCardEjec 5000;
BA_REL_ "GenSigTimeoutTime" BU_SG_REL_ vFD_B2 SG_ 2659690497 BLTN_CAM_WU_L_RecStpByUsrSetting 5000;
BA_REL_ "GenSigTimeoutTime" BU_SG_REL_ vFD_B2 SG_ 2659690497 BLTN_CAM_WU_L_ParkEvent 5000;
BA_REL_ "GenSigTimeoutTime" BU_SG_REL_ GW_PSU_DRV_FD SG_ 811 SBCM_AST_FD_Crc1Val 1500;
BA_REL_ "GenSigTimeoutTime" BU_SG_REL_ ATS_FD SG_ 811 AST_SWFailAlarm 1500;
BA_REL_ "GenSigTimeoutTime" BU_SG_REL_ GW_PSU_DRV_FD SG_ 811 SBCM_AST_FD_AlvCnt1Val 1500;
BA_REL_ "GenSigTimeoutTime" BU_SG_REL_ GW_PSU_DRV_FD SG_ 811 IMS_OSMirPlayBackSta_RH 1500;
BA_REL_ "GenSigTimeoutTime" BU_SG_REL_ ATS_FD SG_ 811 PwrDRClosingASTDrSta 1500;
BA_REL_ "GenSigTimeoutTime" BU_SG_REL_ GW_PSU_DRV_FD SG_ 811 IMS_OSMirPlayBackSta_RH_New 1500;
BA_REL_ "GenSigTimeoutTime" BU_SG_REL_ ATS_FD SG_ 811 PwrDrSta_Ast 1500;
BA_REL_ "GenSigTimeoutTime" BU_SG_REL_ ATS_FD SG_ 811 PwrDrSta_AstSd 1500;
BA_REL_ "GenSigTimeoutTime" BU_SG_REL_ ATS_FD SG_ 811 AST_DetectObj_warn_LH 1500;
BA_REL_ "GenSigTimeoutTime" BU_SG_REL_ ATS_FD SG_ 811 PwrDROpenClosingAstSdDRSta 1500;
BA_REL_ "GenSigTimeoutTime" BU_SG_REL_ ATS_FD SG_ 811 SBCM_AST_DoorAngle 1500;
BA_REL_ "GenSigTimeoutTime" BU_SG_REL_ BLTN_CAM_FD SG_ 811 AST_CrashUnlockCmd 1500;
BA_REL_ "GenSigTimeoutTime" BU_SG_REL_ ATS_FD SG_ 811 Warn_AsstDrSwSta_SBCM 1500;
BA_REL_ "GenSigTimeoutTime" BU_SG_REL_ BLTN_CAM_FD SG_ 811 Warn_AsstDrSwSta_SBCM 1500;
BA_REL_ "GenSigTimeoutTime" BU_SG_REL_ DCM_FD SG_ 811 Warn_AsstDrSwSta_SBCM 1500;
BA_REL_ "GenSigTimeoutTime" BU_SG_REL_ GW_PSU_AST_FD SG_ 811 Warn_AsstDrSwSta_SBCM 1500;
BA_REL_ "GenSigTimeoutTime" BU_SG_REL_ GW_SAU_DRV_FD SG_ 811 Warn_AsstDrSwSta_SBCM 1500;
BA_REL_ "GenSigTimeoutTime" BU_SG_REL_ PSB_FD SG_ 811 Warn_AsstDrSwSta_SBCM 1500;
BA_REL_ "GenSigTimeoutTime" BU_SG_REL_ RWPC_FD SG_ 811 Warn_AsstDrSwSta_SBCM 1500;
BA_REL_ "GenSigTimeoutTime" BU_SG_REL_ WPC2_FD SG_ 811 Warn_AsstDrSwSta_SBCM 1500;
BA_REL_ "GenSigTimeoutTime" BU_SG_REL_ WPC_FD SG_ 811 Warn_AsstDrSwSta_SBCM 1500;
BA_REL_ "GenSigTimeoutTime" BU_SG_REL_ ATS_FD SG_ 811 DoorLock_AsstDrUnLkSta_SBCM 1500;
BA_REL_ "GenSigTimeoutTime" BU_SG_REL_ FCS_FD SG_ 811 DoorLock_AsstDrUnLkSta_SBCM 1500;
BA_REL_ "GenSigTimeoutTime" BU_SG_REL_ ATS_FD SG_ 811 AST_SEAWarn_LH 1500;
BA_REL_ "GenSigTimeoutTime" BU_SG_REL_ BLTN_CAM_FD SG_ 930 CLU_LapTimer_LapNumber_MM 1500;
BA_REL_ "GenSigTimeoutTime" BU_SG_REL_ BLTN_CAM_FD SG_ 930 CLU_LapTimer_Hour_MM 1500;
BA_REL_ "GenSigTimeoutTime" BU_SG_REL_ BLTN_CAM_FD SG_ 930 CLU_LapTimer_Minute_MM 1500;
BA_REL_ "GenSigTimeoutTime" BU_SG_REL_ BLTN_CAM_FD SG_ 930 CLU_LapTimer_Second_MM 1500;
BA_REL_ "GenSigTimeoutTime" BU_SG_REL_ BLTN_CAM_FD SG_ 930 CLU_LapTimer_MeasuringStatus_MM 1500;
BA_REL_ "GenSigTimeoutTime" BU_SG_REL_ BLTN_CAM_FD SG_ 930 CLU_LapTimer_milisecond_MM 1500;
BA_REL_ "GenSigTimeoutTime" BU_SG_REL_ BLTN_CAM_FD SG_ 930 USM_LapTimerAutoMsreSetSta_MM 1500;
BA_REL_ "GenSigTimeoutTime" BU_SG_REL_ BLTN_CAM_FD SG_ 930 USM_LapTimerTimeGapSetSta_MM 1500;
BA_REL_ "GenSigTimeoutTime" BU_SG_REL_ BLTN_CAM_FD SG_ 518 HU_DR_Latitude 1500;
BA_REL_ "GenSigTimeoutTime" BU_SG_REL_ BLTN_CAM_FD SG_ 518 HU_DR_Longitude 1500;
BA_REL_ "GenSigTimeoutTime" BU_SG_REL_ BLTN_CAM_FD SG_ 518 HU_DR_Heading 1500;
BA_REL_ "GenSigTimeoutTime" BU_SG_REL_ BLTN_CAM_FD SG_ 518 HU_DR_Altitude 1500;
VAL_ 676 HU_CLU_Crc3Val 0 "0x0~0xFFFF:CRCValue" 65535 "0x0~0xFFFF:CRCValue" ;
VAL_ 676 AVNT_NModeSel2_Custom1SetVal 0 "Default" 1 "Off" 2 "On" 3 "Invalid" ;
VAL_ 676 AVNT_NModeSel2_Custom2SetVal 0 "Default" 1 "Off" 2 "On" 3 "Invalid" ;
VAL_ 676 AVNT_NHndlSel2_SportSetVal 0 "Default" 1 "Off" 2 "On" 3 "Invalid" ;
VAL_ 676 AVNT_NHndlSel2_TrackSetVal 0 "Default" 1 "Off" 2 "On" 3 "Invalid" ;
VAL_ 676 AVNT_NHndlSel2_DriftSetVal 0 "Default" 1 "Off" 2 "On" 3 "Invalid" ;
VAL_ 676 AVNT_NHndlSel2_WetSetVal 0 "Default" 1 "Off" 2 "On" 3 "Invalid" ;
VAL_ 676 HU_DispThmSetStaMem 0 "Default" 1 "Original" 2 "Memory 1" 3 "Memory 2" 4 "Memory 3" 5 "RESERVED" 6 "RESERVED" 7 "Invalid" ;
VAL_ 676 HU_DispThmMemSta 0 "Valid (See the description)" 1 "Valid (See the description)" 2 "Valid (See the description)" 3 "Valid (See the description)" 4 "Valid (See the description)" 5 "Valid (See the description)" 6 "Valid (See the description)" 7 "Valid (See the description)" ;
VAL_ 676 AVNT_NModeSel_NSetVal 0 "Default" 1 "Off" 2 "On" 3 "Invalid" ;
VAL_ 676 AVNT_NModeSel_Custom1SetVal 0 "Default" 1 "Off" 2 "On" 3 "Invalid" ;
VAL_ 676 AVNT_NModeSel_Custom2SetVal 0 "Default" 1 "Off" 2 "On" 3 "Invalid" ;
VAL_ 676 AVNT_NHndlSel_SportSetVal 0 "Default" 1 "Off" 2 "On" 3 "Invalid" ;
VAL_ 676 HD_SPS_ChannelNo 0 "Off" 1 "HD" 2 "HD1" 3 "HD2" 4 "HD3" 5 "HD4" 6 "HD5" 7 "HD6" 8 "HD7" 9 "HD8" 10 "RESERVED" 11 "RESERVED" 12 "RESERVED" 13 "RESERVED" 14 "RESERVED" 15 "Invalid" ;
VAL_ 676 HU_CLU_BlueLightLvl 0 "Bluelight Filter level" 1 "Bluelight Filter level" 2 "Bluelight Filter level" 3 "Bluelight Filter level" 4 "Bluelight Filter level" 5 "Bluelight Filter level" 6 "Bluelight Filter level" 7 "Bluelight Filter level" 8 "Bluelight Filter level" 9 "Bluelight Filter level" 10 "RESERVED" 11 "RESERVED" 12 "RESERVED" 13 "RESERVED" 14 "RESERVED" 15 "Invalid" ;
VAL_ 676 HU_CLU_BlueLightSta 0 "Default" 1 "Off" 2 "On" 3 "Invalid" ;
VAL_ 676 SXM_ChannelNo 1023 "Invalid" ;
VAL_ 676 HU_CLU_AlvCnt3Val 0 "0x0~0xFF:AlvCntValue" 255 "0x0~0xFF:AlvCntValue" ;
VAL_ 676 AVNT_N1setVal 0 "Default" 1 "N Mode selection" 2 "NTC" 3 "Persistance Mode" 4 "Drift Optimizer" 5 "Lap Timer - Start/Lap" 6 "Lap Timer - Stop/Reset" 7 "e-ASD N" 8 "VGS" 9 "Launch Control" 10 "N pedal" 11 "RESERVED" 12 "RESERVED" 13 "RESERVED" 14 "RESERVED" 15 "RESERVED" 16 "RESERVED" 17 "RESERVED" 18 "RESERVED" 19 "RESERVED" 20 "RESERVED" 21 "RESERVED" 22 "RESERVED" 23 "RESERVED" 24 "RESERVED" 25 "RESERVED" 26 "RESERVED" 27 "RESERVED" 28 "RESERVED" 29 "RESERVED" 30 "RESERVED" 31 "Invalid" ;
VAL_ 676 AVNT_N2setVal 0 "Default" 1 "N Mode Selection" 2 "NTC" 3 "Persistance mode" 4 "Drift Optimizer" 5 "Lap Timer - Start/Lap" 6 "Lap Timer - Stop/Reset" 7 "e-ASD N" 8 "VGS" 9 "Launch Control" 10 "N Pedal" 11 "Rerseved" 12 "Rerseved" 13 "Rerseved" 14 "Rerseved" 15 "Rerseved" 16 "Rerseved" 17 "Rerseved" 18 "Rerseved" 19 "Rerseved" 20 "Rerseved" 21 "Rerseved" 22 "Rerseved" 23 "Rerseved" 24 "Rerseved" 25 "Rerseved" 26 "Rerseved" 27 "Rerseved" 28 "Rerseved" 29 "Rerseved" 30 "Rerseved" 31 "Invalid" ;
VAL_ 676 AVNT_NHndlSel_TrackSetVal 0 "Default" 1 "Off" 2 "On" 3 "Invalid" ;
VAL_ 676 AVNT_NHndlSel_DriftSetVal 0 "Default" 1 "Off" 2 "On" 3 "Invalid" ;
VAL_ 676 AVNT_NHndlSel_WetSetVal 0 "Default" 1 "Off" 2 "On" 3 "Invalid" ;
VAL_ 676 LapTimer_LapNumber_HU 0 "RESERVED" 1 "Lap Number" 2 "Lap Number" 3 "Lap Number" 4 "Lap Number" 5 "Lap Number" 6 "Lap Number" 7 "Lap Number" 8 "Lap Number" 9 "Lap Number" 10 "Lap Number" 11 "Lap Number" 12 "Lap Number" 13 "Lap Number" 14 "Lap Number" 15 "Lap Number" 16 "Lap Number" 17 "Lap Number" 18 "Lap Number" 19 "Lap Number" 20 "Lap Number" 21 "Lap Number" 22 "Lap Number" 23 "Lap Number" 24 "Lap Number" 25 "Lap Number" 26 "Lap Number" 27 "Lap Number" 28 "Lap Number" 29 "Lap Number" 30 "Lap Number" 31 "Lap Number" 32 "Lap Number" 33 "Lap Number" 34 "Lap Number" 35 "Lap Number" 36 "Lap Number" 37 "Lap Number" 38 "Lap Number" 39 "Lap Number" 40 "Lap Number" 41 "Lap Number" 42 "Lap Number" 43 "Lap Number" 44 "Lap Number" 45 "Lap Number" 46 "Lap Number" 47 "Lap Number" 48 "Lap Number" 49 "Lap Number" 50 "Lap Number" 51 "Lap Number" 52 "Lap Number" 53 "Lap Number" 54 "Lap Number" 55 "Lap Number" 56 "Lap Number" 57 "Lap Number" 58 "Lap Number" 59 "Lap Number" 60 "Lap Number" 61 "Lap Number" 62 "Lap Number" 63 "Lap Number" 64 "Lap Number" 65 "Lap Number" 66 "Lap Number" 67 "Lap Number" 68 "Lap Number" 69 "Lap Number" 70 "Lap Number" 71 "Lap Number" 72 "Lap Number" 73 "Lap Number" 74 "Lap Number" 75 "Lap Number" 76 "Lap Number" 77 "Lap Number" 78 "Lap Number" 79 "Lap Number" 80 "Lap Number" 81 "Lap Number" 82 "Lap Number" 83 "Lap Number" 84 "Lap Number" 85 "Lap Number" 86 "Lap Number" 87 "Lap Number" 88 "Lap Number" 89 "Lap Number" 90 "Lap Number" 91 "Lap Number" 92 "Lap Number" 93 "Lap Number" 94 "Lap Number" 95 "Lap Number" 96 "Lap Number" 97 "Lap Number" 98 "Lap Number" 99 "Lap Number" 100 "RESERVED" 101 "RESERVED" 102 "RESERVED" 103 "RESERVED" 104 "RESERVED" 105 "RESERVED" 106 "RESERVED" 107 "RESERVED" 108 "RESERVED" 109 "RESERVED" 110 "RESERVED" 111 "RESERVED" 112 "RESERVED" 113 "RESERVED" 114 "RESERVED" 115 "RESERVED" 116 "RESERVED" 117 "RESERVED" 118 "RESERVED" 119 "RESERVED" 120 "RESERVED" 121 "RESERVED" 122 "RESERVED" 123 "RESERVED" 124 "RESERVED" 125 "RESERVED" 126 "RESERVED" 127 "invalid" ;
VAL_ 676 LapTimer_Hour_HU 0 "refer to signal description" 1 "refer to signal description" 2 "refer to signal description" 3 "refer to signal description" 4 "refer to signal description" 5 "refer to signal description" 6 "refer to signal description" 7 "refer to signal description" 8 "refer to signal description" 9 "refer to signal description" 10 "refer to signal description" 11 "refer to signal description" 12 "refer to signal description" 13 "refer to signal description" 14 "refer to signal description" 15 "refer to signal description" 16 "refer to signal description" 17 "refer to signal description" 18 "refer to signal description" 19 "refer to signal description" 20 "refer to signal description" 21 "refer to signal description" 22 "refer to signal description" 23 "refer to signal description" 24 "refer to signal description" 25 "refer to signal description" 26 "refer to signal description" 27 "refer to signal description" 28 "refer to signal description" 29 "refer to signal description" 30 "refer to signal description" 31 "refer to signal description" 32 "refer to signal description" 33 "refer to signal description" 34 "refer to signal description" 35 "refer to signal description" 36 "refer to signal description" 37 "refer to signal description" 38 "refer to signal description" 39 "refer to signal description" 40 "refer to signal description" 41 "refer to signal description" 42 "refer to signal description" 43 "refer to signal description" 44 "refer to signal description" 45 "refer to signal description" 46 "refer to signal description" 47 "refer to signal description" 48 "refer to signal description" 49 "refer to signal description" 50 "refer to signal description" 51 "refer to signal description" 52 "refer to signal description" 53 "refer to signal description" 54 "refer to signal description" 55 "refer to signal description" 56 "refer to signal description" 57 "refer to signal description" 58 "refer to signal description" 59 "refer to signal description" 60 "refer to signal description" 61 "refer to signal description" 62 "refer to signal description" 63 "refer to signal description" 64 "refer to signal description" 65 "refer to signal description" 66 "refer to signal description" 67 "refer to signal description" 68 "refer to signal description" 69 "refer to signal description" 70 "refer to signal description" 71 "refer to signal description" 72 "refer to signal description" 73 "refer to signal description" 74 "refer to signal description" 75 "refer to signal description" 76 "refer to signal description" 77 "refer to signal description" 78 "refer to signal description" 79 "refer to signal description" 80 "refer to signal description" 81 "refer to signal description" 82 "refer to signal description" 83 "refer to signal description" 84 "refer to signal description" 85 "refer to signal description" 86 "refer to signal description" 87 "refer to signal description" 88 "refer to signal description" 89 "refer to signal description" 90 "refer to signal description" 91 "refer to signal description" 92 "refer to signal description" 93 "refer to signal description" 94 "refer to signal description" 95 "refer to signal description" 96 "refer to signal description" 97 "refer to signal description" 98 "refer to signal description" 99 "refer to signal description" 100 "RESERVED" 101 "RESERVED" 102 "RESERVED" 103 "RESERVED" 104 "RESERVED" 105 "RESERVED" 106 "RESERVED" 107 "RESERVED" 108 "RESERVED" 109 "RESERVED" 110 "RESERVED" 111 "RESERVED" 112 "RESERVED" 113 "RESERVED" 114 "RESERVED" 115 "RESERVED" 116 "RESERVED" 117 "RESERVED" 118 "RESERVED" 119 "RESERVED" 120 "RESERVED" 121 "RESERVED" 122 "RESERVED" 123 "RESERVED" 124 "RESERVED" 125 "RESERVED" 126 "RESERVED" 127 "invalid" ;
VAL_ 676 LapTimer_Minute_HU 0 "refer to signal description" 1 "refer to signal description" 2 "refer to signal description" 3 "refer to signal description" 4 "refer to signal description" 5 "refer to signal description" 6 "refer to signal description" 7 "refer to signal description" 8 "refer to signal description" 9 "refer to signal description" 10 "refer to signal description" 11 "refer to signal description" 12 "refer to signal description" 13 "refer to signal description" 14 "refer to signal description" 15 "refer to signal description" 16 "refer to signal description" 17 "refer to signal description" 18 "refer to signal description" 19 "refer to signal description" 20 "refer to signal description" 21 "refer to signal description" 22 "refer to signal description" 23 "refer to signal description" 24 "refer to signal description" 25 "refer to signal description" 26 "refer to signal description" 27 "refer to signal description" 28 "refer to signal description" 29 "refer to signal description" 30 "refer to signal description" 31 "refer to signal description" 32 "refer to signal description" 33 "refer to signal description" 34 "refer to signal description" 35 "refer to signal description" 36 "refer to signal description" 37 "refer to signal description" 38 "refer to signal description" 39 "refer to signal description" 40 "refer to signal description" 41 "refer to signal description" 42 "refer to signal description" 43 "refer to signal description" 44 "refer to signal description" 45 "refer to signal description" 46 "refer to signal description" 47 "refer to signal description" 48 "refer to signal description" 49 "refer to signal description" 50 "refer to signal description" 51 "refer to signal description" 52 "refer to signal description" 53 "refer to signal description" 54 "refer to signal description" 55 "refer to signal description" 56 "refer to signal description" 57 "refer to signal description" 58 "refer to signal description" 59 "refer to signal description" 60 "RESERVED" 61 "RESERVED" 62 "RESERVED" 63 "invalid" ;
VAL_ 676 LapTimer_Second_HU 0 "refer to signal description" 1 "refer to signal description" 2 "refer to signal description" 3 "refer to signal description" 4 "refer to signal description" 5 "refer to signal description" 6 "refer to signal description" 7 "refer to signal description" 8 "refer to signal description" 9 "refer to signal description" 10 "refer to signal description" 11 "refer to signal description" 12 "refer to signal description" 13 "refer to signal description" 14 "refer to signal description" 15 "refer to signal description" 16 "refer to signal description" 17 "refer to signal description" 18 "refer to signal description" 19 "refer to signal description" 20 "refer to signal description" 21 "refer to signal description" 22 "refer to signal description" 23 "refer to signal description" 24 "refer to signal description" 25 "refer to signal description" 26 "refer to signal description" 27 "refer to signal description" 28 "refer to signal description" 29 "refer to signal description" 30 "refer to signal description" 31 "refer to signal description" 32 "refer to signal description" 33 "refer to signal description" 34 "refer to signal description" 35 "refer to signal description" 36 "refer to signal description" 37 "refer to signal description" 38 "refer to signal description" 39 "refer to signal description" 40 "refer to signal description" 41 "refer to signal description" 42 "refer to signal description" 43 "refer to signal description" 44 "refer to signal description" 45 "refer to signal description" 46 "refer to signal description" 47 "refer to signal description" 48 "refer to signal description" 49 "refer to signal description" 50 "refer to signal description" 51 "refer to signal description" 52 "refer to signal description" 53 "refer to signal description" 54 "refer to signal description" 55 "refer to signal description" 56 "refer to signal description" 57 "refer to signal description" 58 "refer to signal description" 59 "refer to signal description" 60 "RESERVED" 61 "RESERVED" 62 "RESERVED" 63 "invalid" ;
VAL_ 676 LapTimer_milisecond_HU 0 "refer to signal description" 1 "refer to signal description" 2 "refer to signal description" 3 "refer to signal description" 4 "refer to signal description" 5 "refer to signal description" 6 "refer to signal description" 7 "refer to signal description" 8 "refer to signal description" 9 "refer to signal description" 10 "refer to signal description" 11 "refer to signal description" 12 "refer to signal description" 13 "refer to signal description" 14 "refer to signal description" 15 "refer to signal description" 16 "refer to signal description" 17 "refer to signal description" 18 "refer to signal description" 19 "refer to signal description" 20 "refer to signal description" 21 "refer to signal description" 22 "refer to signal description" 23 "refer to signal description" 24 "refer to signal description" 25 "refer to signal description" 26 "refer to signal description" 27 "refer to signal description" 28 "refer to signal description" 29 "refer to signal description" 30 "refer to signal description" 31 "refer to signal description" 32 "refer to signal description" 33 "refer to signal description" 34 "refer to signal description" 35 "refer to signal description" 36 "refer to signal description" 37 "refer to signal description" 38 "refer to signal description" 39 "refer to signal description" 40 "refer to signal description" 41 "refer to signal description" 42 "refer to signal description" 43 "refer to signal description" 44 "refer to signal description" 45 "refer to signal description" 46 "refer to signal description" 47 "refer to signal description" 48 "refer to signal description" 49 "refer to signal description" 50 "refer to signal description" 51 "refer to signal description" 52 "refer to signal description" 53 "refer to signal description" 54 "refer to signal description" 55 "refer to signal description" 56 "refer to signal description" 57 "refer to signal description" 58 "refer to signal description" 59 "refer to signal description" 60 "refer to signal description" 61 "refer to signal description" 62 "refer to signal description" 63 "refer to signal description" 64 "refer to signal description" 65 "refer to signal description" 66 "refer to signal description" 67 "refer to signal description" 68 "refer to signal description" 69 "refer to signal description" 70 "refer to signal description" 71 "refer to signal description" 72 "refer to signal description" 73 "refer to signal description" 74 "refer to signal description" 75 "refer to signal description" 76 "refer to signal description" 77 "refer to signal description" 78 "refer to signal description" 79 "refer to signal description" 80 "refer to signal description" 81 "refer to signal description" 82 "refer to signal description" 83 "refer to signal description" 84 "refer to signal description" 85 "refer to signal description" 86 "refer to signal description" 87 "refer to signal description" 88 "refer to signal description" 89 "refer to signal description" 90 "refer to signal description" 91 "refer to signal description" 92 "refer to signal description" 93 "refer to signal description" 94 "refer to signal description" 95 "refer to signal description" 96 "refer to signal description" 97 "refer to signal description" 98 "refer to signal description" 99 "refer to signal description" 100 "RESERVED" 101 "RESERVED" 102 "RESERVED" 103 "RESERVED" 104 "RESERVED" 105 "RESERVED" 106 "RESERVED" 107 "RESERVED" 108 "RESERVED" 109 "RESERVED" 110 "RESERVED" 111 "RESERVED" 112 "RESERVED" 113 "RESERVED" 114 "RESERVED" 115 "RESERVED" 116 "RESERVED" 117 "RESERVED" 118 "RESERVED" 119 "RESERVED" 120 "RESERVED" 121 "RESERVED" 122 "RESERVED" 123 "RESERVED" 124 "RESERVED" 125 "RESERVED" 126 "RESERVED" 127 "invalid" ;
VAL_ 676 LapTimer_CountStart 0 "Stop_HU_Lap Timer" 1 "Start_HU_Lap Timer" 2 "Ready_HU_Lap_Timer" 3 "Invalid" ;
VAL_ 676 AVNT_NModeSel2_NSetVal 0 "Default" 1 "Off" 2 "On" 3 "Invalid" ;
VAL_ 256 EMS_Crc2Val 0 "0x0~0xFFFF:CRCValue" 65535 "0x0~0xFFFF:CRCValue" ;
VAL_ 256 ENG_CrwlSta 0 "Initial" 1 "Control Act" 2 "Override" 3 "Control Fail" 4 "Unsatisfied Condition" 5 "EMS Fail" 6 "CAN Fail" 7 "RESERVED" 8 "RESERVED" 9 "RESERVED" 10 "RESERVED" ;
VAL_ 256 ACC_CrsMainSwLmpSta 0 "Cruise MAIN switch indication lamp turn OFF" 1 "Cruise MAIN switch indication lamp turn ON" 2 "Not used" 3 "Error indicator" ;
VAL_ 256 ACC_CrsSetSwLmpSta 0 "Cruise SET switch indication lamp turn OFF" 1 "Cruise SET switch indication lamp turn ON" 2 "Not used" 3 "Error indicator" ;
VAL_ 256 ENG_LV_FUP_ENA_THD 0 "The pressure is too low to start engine" 1 "The pressure is enough high to start engine" ;
VAL_ 256 ENG_SoakTimeErrSta 0 "No Failure detected" 1 "Failure detected" 2 "Not used" 3 "Error indicator" ;
VAL_ 256 EMS_AlvCnt2Val 0 "0x0~0xFF:AlvCntValue" 255 "0x0~0xFF:AlvCntValue" ;
VAL_ 256 ENG_AppAccelPdlSta 0 "Accelerator pedal not pressed" 1 "Accelerator pedal pressed" 2 "Reserved" 3 "Accelerator pedal position sensor failure" ;
VAL_ 256 ENG_BrkCtrlReq 0 "Brake control request is not active" 1 "Brake control request is active" 2 "Not used" 3 "Error indicator" ;
VAL_ 256 ACC_DnShftCtrlReq 0 "Downshift control request is not active" 1 "Downshift request to 1st gear" 2 "Downshift request to 2nd gear" 3 "Downshift request to 3rd gear" 4 "Downshift request to 4th gear" 5 "Downshift request to 5th gear" 6 "Downshift request to 6th gear" 7 "Downshift request to 7th gear" 8 "Downshift request to 8th gear" 9 "Reserved" 10 "Reserved" 11 "Reserved" 12 "Reserved" 13 "Reserved" 14 "Reserved" 15 "Error indicator" ;
VAL_ 256 ENG_DclBrkCntrlReq 4095 "Error indicator" ;
VAL_ 256 ENG_BstPrsrVal 4095 "Error indicator" ;
VAL_ 256 ENG_EngOilTempVal 255 "Error indicator" ;
VAL_ 256 ENG_DpfWrngSta 0 "DPF Normal State" 1 "DPF Warning State Level 1" 2 "DPF Warning State Level 2" 3 "Reserved" ;
VAL_ 256 ENG_BattWrngLmpSta 0 "Battery Warning Lamp OFF" 1 "Battery Warning Lamp ON" 2 "Not used" 3 "Error indicator" ;
VAL_ 256 ENG_OilPrsrWrngLmpSta 0 "Oil Pressure Warning Lamp OFF" 1 "Oil Pressure Warning Lamp ON" 2 "Not used" 3 "Error indicator" ;
VAL_ 256 ENG_IsgInhbtLmpSta 0 "ISG Inhibit Lamp OFF" 1 "ISG Inhibit Lamp ON" 2 "ISG Inhibit Lamp Blinking" 3 "Error indicator" ;
VAL_ 256 ENG_BrkSwSta 0 "Brake switch is not pressed (OFF)" 1 "Brake switch is pressed (ON)" 2 "EMS does not support this function." 3 "Brake switch failure" ;
VAL_ 256 ENG_EngClntTempVal 255 "Error indicator" ;
VAL_ 256 ENG_MafCrctVal 128 "Error indicator" ;
VAL_ 256 ENG_BattDscnctSta 0 "no battery disconnection detected" 1 "battery disconnection detected and failure memory erased" 2 "Not used" 3 "Error indicator" ;
VAL_ 256 OBD_MilConfgVal 0 "no MIL, Failure Memory Management OBD-I" 1 "MIL Treatment OBD-I, Failure Memory Management OBD-I" 2 "MIL Treatment OBD-II, Exception" 3 "MIL Treatment OBD-II, Failure Memory Management OBD-II" 4 "MIL Treatment E-OBD, Failure Memory Management E-OBD" 5 "MIL Treatment K-OBD, Failure Memory Management K-OBD" ;
VAL_ 256 ENG_EngSta 0 "Engine Stop" 1 "Cranking" 2 "Stalled" 3 "Running" 4 "Reserved" 5 "Reserved" 6 "Reserved" 7 "Fault" ;
VAL_ 256 ENG_Ack4EngStpSta 0 "No acknowledgement" 1 "Acknowledgement engine stopped" 2 "Not used" 3 "Error indicator" ;
VAL_ 256 ENG_OverDrvOffReq 0 "Normal operation" 1 "Over drive off request to TCU by the cruise control function" 2 "Not used" 3 "Error indicator" ;
VAL_ 256 ENG_AccActSta 0 "Auto cruise control is not active" 1 "Auto cruise control is active" 2 "Not used" 3 "Error indicator" ;
VAL_ 256 ENG_CltchOpSta 0 "Clutch is not operating" 1 "Clutch is operating" 2 "Not used" 3 "Error indicator" ;
VAL_ 256 EMS_BrkReq_Slope 0 "No Request" 1 "Brake Request" ;
VAL_ 256 ENG_AccDrvAlertDisp 0 "Default" 1 "Auto cruise Disengaged" 2 "No Auto cruise Engaged" 3 "Error indicator" ;
VAL_ 256 DSL_GlowCtrlReq 0 "Glow plug off request" 1 "Glow plug on request" 2 "System Error" 3 "Reserved" ;
VAL_ 256 ENG_GlowLmpSta 0 "Lamp Off" 1 "Lamp On" 2 "Not used" 3 "Error indicator" ;
VAL_ 256 ENG_ThrPosVal 32 "Idle (port value is learnt)" 245 "Throttle perpendicular" 255 "Throttle defective" ;
VAL_ 256 ENG_AccelPdlVal 0 "Accelerator Pedal not activated" 1022 "Accelerator Pedal fully activated" 1023 "Accelerator Pedal is defective (fail state) or Non-ETC system (APS is not installed), Error indicator" ;
VAL_ 261 EMS_Crc7Val 0 "0x0~0xFFFF:CRCValue" 65535 "0x0~0xFFFF:CRCValue" ;
VAL_ 261 HEV_AccelPdlVal 0 "Accelerator Pedal not activated" 1022 "Accelerator Pedal fully activated" 1023 "Accelerator Pedal is defective (fail state) or Non-ETC system (APS is not installed)" ;
VAL_ 261 HEV_IndTqVal_Extd 0 "0x0000~0x3FFF:Physical Value (0~1638.3Nm)" 16383 "0x0000~0x3FFF:Physical Value (0~1638.3Nm)" ;
VAL_ 261 ENG_CSModeReq 0 "OFF" 1 "ON" 2 "Not Used" 3 "Error Indicator" ;
VAL_ 261 EMS_AlvCnt7Val 0 "0x0~0xFF:AlvCntValue" 255 "0x0~0xFF:AlvCntValue" ;
VAL_ 261 HEV_OilDilution_IncICELoad 0 "OFF" 1 "ON" ;
VAL_ 261 HEV_OilDilution_ServMode 0 "OFF" 1 "Healing I" 2 "Healing II" 3 "RESERVED" ;
VAL_ 261 EMS_TqLmtSta 0 "Default/Normal" 1 "O2 Sensor Pre-Heating - To be Started" 2 "O2 Sensor Pre-Heating - Can be Started" 3 "Torque Limit for Low Temperature (Catalyst Heating)" 4 "Torque Ramping" 5 "Warming up" 6 "Torque Limit for High Temperature (Catalyst Overheating Protection)" 7 "Error" ;
VAL_ 261 EMS_EU7 0 "Not EU7 vehicle" 1 "EU7 vehicle" ;
VAL_ 261 HEV_EngOpSta 0 "ES(Engine Stop)" 1 "ST(Start)" 2 "IS(Idle speed)" 3 "PL(Part Load)" 4 "PU(Pull)" 5 "PUC(Fuel Cut off)" ;
VAL_ 813 SBCM_DRV_FD_Crc1Val 0 "0x0~0xFFFF:CRCValue" 65535 "0x0~0xFFFF:CRCValue" ;
VAL_ 813 Latch_TypeOption_DRV 0 "Off" 1 "On" 2 "RESERVED" 3 "Error Indicator" ;
VAL_ 813 DRV_SWFailAlarm 0 "Off" 1 "On" 2 "RESERVED" 3 "Error Indicator" ;
VAL_ 813 USM_PwrDRApprOpnSetSta 0 "Default" 1 "Off" 2 "On" 3 "RESERVED" ;
VAL_ 813 USM_PwrDRCloseByRKELockSta 0 "Default" 1 "Off" 2 "On" 3 "RESERVED" ;
VAL_ 813 USM_PwrDRCloseByRKELockOpt 0 "Default" 1 "Off" 2 "On" 3 "RESERVED" ;
VAL_ 813 USM_PwrDRCloseByBrakeSta 0 "Default" 1 "Off" 2 "On" 3 "RESERVED" ;
VAL_ 813 USM_PwrDRBuzzerSta 0 "Default" 1 "Off" 2 "On" 3 "RESERVED" ;
VAL_ 813 PDS_TypeOption_DRV 0 "Off" 1 "All Door" 2 "Front Only" 3 "Rear Only" ;
VAL_ 813 C_DrvDoorApproachOpen 0 "Default" 1 "Approach Open Request" 2 "Approach Open Stop" 3 "RESERVED" ;
VAL_ 813 C_DrvDoorApproachClose 0 "Default" 1 "Approach Close Request" 2 "Approach Close Stop" 3 "RESERVED" ;
VAL_ 813 DoorLock_PDSLkSwSta_DRV 0 "Default" 1 "Lock" 2 "RESERVED" 3 "Error Indicator" ;
VAL_ 813 SBCM_DRV_DiagSta 0 "Default" 1 "Normal Operation" 2 "DRV Indicator Circuit Failure" 3 "RESERVED" ;
VAL_ 813 DoorLock_CtrlDrLkUnLkSwSta_SBCM 0 "Off" 1 "On" 2 "RESERVED" 3 "Error Indicator" ;
VAL_ 813 SBCM_PsvDrLkReq 0 "None" 1 "Lock" 2 "Passive Trunk Lock" 3 "RESERVED" ;
VAL_ 813 CDMAutoWashModeSet_SBCM 0 "Default" 1 "CDM Auto Wash Mode Off" 2 "CDM Auto Wash Mode On" 3 "RESERVED" 4 "RESERVED" 5 "RESERVED" 6 "RESERVED" 7 "Invalid" ;
VAL_ 813 USM_DrvGhostDoorSta 0 "Default" 1 "Off" 2 "On" 3 "RESERVED" ;
VAL_ 813 Mirror_LH_FoldingSta 0 "Off" 1 "Folding" 2 "RESERVED" 3 "Error Indicator" ;
VAL_ 813 Mirror_LH_UnfoldingSta 0 "Off" 1 "Unfolding" 2 "RESERVED" 3 "Error Indicator" ;
VAL_ 813 DRV_CrashMRActAlarm 0 "Off" 1 "On" 2 "RESERVED" 3 "Error Indicator" ;
VAL_ 813 AFH_DRV_FldUnFldSta 0 "Invalid" 1 "Fold" 2 "Unfold" 3 "Inprogress" ;
VAL_ 813 SBCM_DRV_FD_AlvCnt1Val 0 "0x0~0xFF:AlvCntValue" 255 "0x0~0xFF:AlvCntValue" ;
VAL_ 813 MirrorFldReq 0 "Default" 1 "Folding Request" 2 "Unfolding Request" 3 "RESERVED" ;
VAL_ 813 OMU_TypeOption_DRV 0 "Off" 1 "On" 2 "RESERVED" 3 "Error Indicator" ;
VAL_ 813 IMS_OSMirPlayBackSta_LH 0 "Stop" 1 "Play 1" 2 "Play 2" 3 "Play 3" 4 "SmartIMS" 5 "Profile 1" 6 "Profile 2" 7 "Guest" 8 "RESERVED" 9 "RESERVED" 10 "RESERVED" 11 "RESERVED" 12 "RESERVED" 13 "RESERVED" 14 "RESERVED" 15 "Error Indicator" ;
VAL_ 813 ECMMRR_PLUS 0 "0x0~0x7D:0~1.25 V" 125 "0x0~0x7D:0~1.25 V" 126 "7E~0xFE:RESERVED" 254 "7E~0xFE:RESERVED" 255 "RESERVED" ;
VAL_ 813 EHL_TxInfo_SBCM_DRV 0 "Default" 1 "EHL_DRV_Close" 2 "EHL_DRV_Half" 3 "EHL_DRV_Open" 4 "EHL_DRV_RetryFlag" 5 "EHL_DRV_ErrorIndicator" 6 "EHL_DRV_Opening" 7 "Invalid" ;
VAL_ 813 IMS_OSMirPlayBackSta_LH_New 0 "Stop" 1 "Play 1" 2 "Play 2" 3 "Play 3" 4 "Smart IMS" 5 "Profile 1" 6 "Profile 2" 7 "Profile 3" 8 "Profile 4" 9 "Profile 5" 10 "Profile 6" 11 "Profile 7" 12 "Profile 8" 13 "Profile 9" 14 "Guest" 15 "Error Indicator" ;
VAL_ 813 CDM_InsideOpnSwSta 0 "Off" 1 "On" 2 "RESERVED" 3 "Error Indicator" ;
VAL_ 813 CDM_TypeOption 0 "Off" 1 "On" 2 "On_2EA" 3 "Error Indicator" ;
VAL_ 813 CDM_ImmeChgSw_SBCM 0 "Default" 1 "Off" 2 "On" 3 "RESERVED" ;
VAL_ 813 CDM_FobSrchReq_DRV 0 "Off" 1 "On" 2 "RESERVED" 3 "Error Indicator" ;
VAL_ 813 CDM_OpnClsState_SBCM 0 "Default" 1 "Open" 2 "Close" 3 "RESERVED" ;
VAL_ 813 CDM_WarnMsg_SBCM 0 "Default" 1 "Normal" 2 "ChargeDoorErrorState" 3 "RESERVED" ;
VAL_ 813 CDM_AutoWashModeSta 0 "Default" 1 "CDM Auto Wash Mode Off (Ready)" 2 "CDM Auto Wash Mode Off (Error)" 3 "CDM Auto Wash Mode On" 4 "RESERVED" 5 "RESERVED" 6 "RESERVED" 7 "Invalid" ;
VAL_ 813 CDM_CmdStatus_SBCM 0 "Open (AVN)" 1 "Open (SMK)" 2 "Open (Sensor Switch)" 3 "Open (Command Hard Switch)" 4 "Open (Anti - Pinch)" 5 "Close (AVN)" 6 "Close (SMK)" 7 "Close (Assist Mode)" 8 "Close (Command Hard Switch)" 9 "Close (Connector)" 10 "Close (Gear Position)" 11 "Close (Time Over)" 12 "Close (Anti - Pinch)" 13 "Close (Sensor Switch)" 14 "Stall (Stop)" 15 "Invalid" ;
VAL_ 813 CDM_OutsideOpnSwSta 0 "Default" 1 "Push" 2 "RESERVED" 3 "Invalid" ;
VAL_ 813 SBCM_ExtnlWaringReq 0 "OFF" 1 "RESERVED" 2 "RESERVED" 3 "Warning" ;
VAL_ 813 Warn_HoodSwSta_SBCM 0 "Off" 1 "On" 2 "RESERVED" 3 "Error Indicator" ;
VAL_ 813 Hood_TypeOption 0 "Off (Mechanical hood latch is applied)" 1 "On (E-Hood latch is applied)" 2 "RESERVED" 3 "Error Indicator" ;
VAL_ 813 SBCM_FrunkSta 0 "Default" 1 "Valid" 2 "RESERVED" 3 "Error Indicator" ;
VAL_ 813 Warn_HoodSwFullSta_SBCM 0 "Off" 1 "On" 2 "RESERVED" 3 "Error Indicator" ;
VAL_ 813 FrunkWarning_SBCM 0 "Off" 1 "On" 2 "RESERVED" 3 "Error Indicator" ;
VAL_ 813 FrunkReleaseSwSta_SBCM 0 "Off" 1 "HalfRelease" 2 "FullRelease" 3 "SwitchError" ;
VAL_ 813 PwrDRClosingDRVDrSta 0 "Default" 1 "Close" 2 "Open" 3 "Stop(during Close)" 4 "Stop(during Open)" 5 "RESERVED" 6 "RESERVED" 7 "Invalid" ;
VAL_ 813 Drv_DrLkRetryFail_SBCM 0 "Normal" 1 "Fail" 2 "RESERVED" 3 "RESERVED" ;
VAL_ 813 CDM_GbtImmeChgSw_SBCM 0 "Default" 1 "Off" 2 "On" 3 "RESERVED" ;
VAL_ 813 CDM_GbtOpnClsState_SBCM 0 "Default" 1 "Open" 2 "Close" 3 "RESERVED" ;
VAL_ 813 CDM_GbtWarnMsg_SBCM 0 "Default" 1 "Normal" 2 "ChargeDoorErrorState" 3 "RESERVED" ;
VAL_ 813 CDM_GbtOutsideOpnSwSta 0 "Default" 1 "Push" 2 "RESERVED" 3 "Invalid" ;
VAL_ 813 DoorLock_DrvLkOutSta_SBCM 0 "Off" 1 "On" 2 "Not Used" 3 "Error Indicator" ;
VAL_ 813 FrunkEmergencySwSta_SBCM 0 "Off" 1 "On" 2 "Not Used" 3 "Error Indicator" ;
VAL_ 813 DRV_DetectObj_warn_LH 0 "Detect Left Warning OFF" 1 "Detect Left Warning ON" 2 "Detect Left Warning ERROR" 3 "RESERVED" ;
VAL_ 813 PwrDROpenClosingDdvSdDRSta 0 "Default" 1 "Close" 2 "Open" 3 "Stop(during Close)" 4 "Stop(during Open)" 5 "RESERVED" 6 "RESERVED" 7 "Invalid" ;
VAL_ 813 PwrDRBuzzerOut_DRV_New 0 "OFF" 1 "Open" 2 "Close" 3 "Warning1" 4 "Warning2" 5 "Open(RHD)" 6 "Close(RHD)" ;
VAL_ 813 Coach_TypeOption_DRV 0 "Off" 1 "On" 2 "Not Used" 3 "Error Indicator" ;
VAL_ 813 PwrDrSta_Drv 0 "Unavailable" 1 "Available" 2 "RESERVED" 3 "Error Indicator" ;
VAL_ 813 PwrDrSta_DrvSd 0 "Unavailable" 1 "Available" 2 "RESERVED" 3 "Error Indicator" ;
VAL_ 813 USM_PwrDrOpnTypSta 0 "Default" 1 "Pop-up" 2 "Full Open" 3 "RESERVED" ;
VAL_ 813 DischrgDr_OpnClsState_SBCM 0 "Default" 1 "Open" 2 "Close" 3 "Invalid" ;
VAL_ 813 SBCM_DRV_DoorAngle 0 "0° - 90°" 1 "0° - 90°" 2 "0° - 90°" 3 "0° - 90°" 4 "0° - 90°" 5 "0° - 90°" 6 "0° - 90°" 7 "0° - 90°" 8 "0° - 90°" 9 "0° - 90°" 10 "0° - 90°" 11 "0° - 90°" 12 "0° - 90°" 13 "0° - 90°" 14 "0° - 90°" 15 "0° - 90°" 16 "0° - 90°" 17 "0° - 90°" 18 "0° - 90°" 19 "0° - 90°" 20 "0° - 90°" 21 "0° - 90°" 22 "0° - 90°" 23 "0° - 90°" 24 "0° - 90°" 25 "0° - 90°" 26 "0° - 90°" 27 "0° - 90°" 28 "0° - 90°" 29 "0° - 90°" 30 "0° - 90°" 31 "0° - 90°" 32 "0° - 90°" 33 "0° - 90°" 34 "0° - 90°" 35 "0° - 90°" 36 "0° - 90°" 37 "0° - 90°" 38 "0° - 90°" 39 "0° - 90°" 40 "0° - 90°" 41 "0° - 90°" 42 "0° - 90°" 43 "0° - 90°" 44 "0° - 90°" 45 "0° - 90°" 46 "0° - 90°" 47 "0° - 90°" 48 "0° - 90°" 49 "0° - 90°" 50 "0° - 90°" 51 "0° - 90°" 52 "0° - 90°" 53 "0° - 90°" 54 "0° - 90°" 55 "0° - 90°" 56 "0° - 90°" 57 "0° - 90°" 58 "0° - 90°" 59 "0° - 90°" 60 "0° - 90°" 61 "0° - 90°" 62 "0° - 90°" 63 "0° - 90°" 64 "0° - 90°" 65 "0° - 90°" 66 "0° - 90°" 67 "0° - 90°" 68 "0° - 90°" 69 "0° - 90°" 70 "0° - 90°" 71 "0° - 90°" 72 "0° - 90°" 73 "0° - 90°" 74 "0° - 90°" 75 "0° - 90°" 76 "0° - 90°" 77 "0° - 90°" 78 "0° - 90°" 79 "0° - 90°" 80 "0° - 90°" 81 "0° - 90°" 82 "0° - 90°" 83 "0° - 90°" 84 "0° - 90°" 85 "0° - 90°" 86 "0° - 90°" 87 "0° - 90°" 88 "0° - 90°" 89 "0° - 90°" 90 "0° - 90°" 91 "Invalid" 92 "Invalid" 93 "Invalid" 94 "Invalid" 95 "Invalid" 96 "Invalid" 97 "Invalid" 98 "Invalid" 99 "Invalid" 100 "Unknown" 101 "Invalid" 102 "Invalid" 103 "Invalid" 104 "Invalid" 105 "Invalid" 106 "Invalid" 107 "Invalid" 108 "Invalid" 109 "Invalid" 110 "Invalid" 111 "Invalid" 112 "Invalid" 113 "Invalid" 114 "Invalid" 115 "Invalid" 116 "Invalid" 117 "Invalid" 118 "Invalid" 119 "Invalid" 120 "Invalid" 121 "Invalid" 122 "Invalid" 123 "Invalid" 124 "Invalid" 125 "Invalid" 126 "Invalid" 127 "Invalid" ;
VAL_ 813 SBCM_DoorType_DRV 0 "Two Door" 1 "Four Door" 2 "Not Used" 3 "Error Indicator" ;
VAL_ 813 CDM_DrType_DRV 0 "None" 1 "Electric" 2 "Manual" 3 "RESERVED" ;
VAL_ 813 DRVDoorPushAlarm 0 "Off" 1 "On" 2 "RESERVED" 3 "Error Indicator" ;
VAL_ 813 DRV_CrashUnlockCmd 0 "Off" 1 "Unlock(Crash)" ;
VAL_ 813 C_ApprOpenStatus 0 "Approach Open Off" 1 "Approach Open On" ;
VAL_ 813 DoorLock_DrvKeyLkSwSta_SBCM 0 "Off" 1 "Lock" 2 "RESERVED" 3 "Error Indicator" ;
VAL_ 813 DoorLock_DrvKeyUnLkSwSta_SBCM 0 "Off" 1 "Unlock" 2 "RESERVED" 3 "Error Indicator" ;
VAL_ 813 Warn_DrvDrSwSta_SBCM 0 "Close" 1 "Open" 2 "RESERVED" 3 "Error Indicator" ;
VAL_ 813 DoorLock_DrvDrUnLkSta_SBCM 0 "Lock" 1 "Unlock" 2 "RESERVED" 3 "Error Indicator" ;
VAL_ 813 DRV_SEAWarn_LH 0 "SEA Left Warning OFF" 1 "SEA Left Warning ON" 2 "RESERVED" 3 "RESERVED" ;
VAL_ 813 DRV_SEAWarn_RH 0 "SEA Right Warning OFF" 1 "SEA Right  Warning ON" 2 "RESERVED" 3 "RESERVED" ;
VAL_ 813 DRV_SEWWarn_LH 0 "SEW Left Warning OFF" 1 "SEW Left Warning ON" 2 "RESERVED" 3 "RESERVED" ;
VAL_ 813 DRV_SEWWarn_RH 0 "SEW Right Warning OFF" 1 "SEW Right Warning ON" 2 "RESERVED" 3 "RESERVED" ;
VAL_ 813 DRV_MRActivationAlarm 0 "Off" 1 "On" 2 "RESERVED" 3 "Error Indicator" ;
VAL_ 813 DRV_ReleaseWarn 0 "Release Warning OFF" 1 "Release Warning ON" 2 "RESERVED" 3 "RESERVED" ;
VAL_ 2659690497 BLTN_CAM_WU_Crc1Val 0 "0x0~0xFFFF:CRCValue" 65535 "0x0~0xFFFF:CRCValue" ;
VAL_ 2659690497 BLTN_CAM_WU_AlvCnt1Val 0 "0x0~0xFF:AlvCntValue" 255 "0x0~0xFF:AlvCntValue" ;
VAL_ 2659690497 BLTN_CAM_WU_NM_B2 0 "Not Triggered" 1 "Triggerd" ;
VAL_ 2659690497 BLTN_CAM_WU_L_RecStpByBattEmpty 0 "Not Triggered" 1 "Triggerd" ;
VAL_ 2659690497 BLTN_CAM_WU_L_RecStpByBLTNCAMErr 0 "Not Triggered" 1 "Triggerd" ;
VAL_ 2659690497 BLTN_CAM_WU_L_RecStpBySDCardErr 0 "Not Triggered" 1 "Triggerd" ;
VAL_ 2659690497 BLTN_CAM_WU_L_RecStpBySDCardEjec 0 "Not Triggered" 1 "Triggerd" ;
VAL_ 2659690497 BLTN_CAM_WU_L_RecStpByUsrSetting 0 "Not Triggered" 1 "Triggerd" ;
VAL_ 2659690497 BLTN_CAM_WU_L_ParkEvent 0 "Not Triggered" 1 "Triggerd" ;
VAL_ 811 SBCM_AST_FD_Crc1Val 0 "0x0~0xFFFF:CRCValue" 65535 "0x0~0xFFFF:CRCValue" ;
VAL_ 811 USM_AstGhostDoorSta 0 "Default" 1 "Off" 2 "On" 3 "RESERVED" ;
VAL_ 811 AST_SWFailAlarm 0 "Off" 1 "On" 2 "RESERVED" 3 "Error Indicator" ;
VAL_ 811 DoorLock_PDSLkSwSta_AST 0 "Lock" 1 "Unlock" 2 "RESERVED" 3 "Error Indicator" ;
VAL_ 811 PDS_TypeOption_AST 0 "Off" 1 "On" 2 "RESERVED" 3 "Error Indicator" ;
VAL_ 811 AFCU_AutoWashModeSta_SBCM_AST 0 "Default" 1 "AFCU Auto Wash Mode Off (Ready)" 2 "AFCU Auto Wash Mode Off (Error)" 3 "AFCU Auto Wash Mode On" 4 "RESERVED" 5 "RESERVED" 6 "RESERVED" 7 "Invalid" ;
VAL_ 811 CDM_AutoWashModeSta_SBCM_AST 0 "Default" 1 "CDM Auto Wash Mode Off (Ready)" 2 "CDM Auto Wash Mode Off (Error)" 3 "CDM Auto Wash Mode On" 4 "RESERVED" 5 "RESERVED" 6 "RESERVED" 7 "Invalid" ;
VAL_ 811 AFH_AST_FldUnFldSta 0 "Invalid" 1 "Fold" 2 "Unfold" 3 "Inprogress" ;
VAL_ 811 SBCM_AST_DiagSta 0 "Default" 1 "Normal Operation" 2 "AST Indicator Circuit Failure" 3 "RESERVED" ;
VAL_ 811 CDM_TypeOption_AST 0 "Off" 1 "On" 2 "On_2EA" 3 "Error Indicator" ;
VAL_ 811 CDM_ImmeChgSw_AST 0 "Default" 1 "Off" 2 "On" 3 "RESERVED" ;
VAL_ 811 CDM_FobSrchReq_AST 0 "Off" 1 "On" 2 "RESERVED" 3 "Error Indicator" ;
VAL_ 811 CDM_OpnClsState_AST 0 "Default" 1 "Open" 2 "Close" 3 "RESERVED" ;
VAL_ 811 CDM_WarnMsg_AST 0 "Default" 1 "Normal" 2 "ChargeDoorErrorState" 3 "RESERVED" ;
VAL_ 811 Mirror_RH_FoldingSta 0 "Off" 1 "Folding" 2 "RESERVED" 3 "Error Indicator" ;
VAL_ 811 Mirror_RH_UnfoldingSta 0 "Off" 1 "Unfolding" 2 "RESERVED" 3 "Error Indicator" ;
VAL_ 811 CDM_CmdStatus_AST 0 "Open (AVN)" 1 "Open (SMK)" 2 "Open (Sensor Switch)" 3 "Open (Command Hard Switch)" 4 "Open (Anti - Pinch)" 5 "Close (AVN)" 6 "Close (SMK)" 7 "Close (Assist Mode)" 8 "Close (Command Hard Switch)" 9 "Close (Connector)" 10 "Close (Gear Position)" 11 "Close (Time Over)" 12 "Close (Anti - Pinch)" 13 "Close (Sensor Switch)" 14 "Stall (Stop)" 15 "Invalid" ;
VAL_ 811 SBCM_AST_FD_AlvCnt1Val 0 "0x0~0xFF:AlvCntValue" 255 "0x0~0xFF:AlvCntValue" ;
VAL_ 811 AST_CrashMRActAlarm 0 "Off" 1 "On" 2 "RESERVED" 3 "Error Indicator" ;
VAL_ 811 PwrDRBuzzerOut_AST 0 "OFF" 1 "Open" 2 "Close" 3 "Warning" ;
VAL_ 811 IMS_OSMirPlayBackSta_RH 0 "Stop" 1 "Play 1" 2 "Play 2" 3 "Play 3" 4 "Smart IMS" 5 "Profile 1" 6 "Profile 2" 7 "Guest" 8 "RESERVED" 9 "RESERVED" 10 "RESERVED" 11 "RESERVED" 12 "RESERVED" 13 "RESERVED" 14 "RESERVED" 15 "Error Indicator" ;
VAL_ 811 PwrDRClosingASTDrSta 0 "Default" 1 "Close" 2 "Open" 3 "Stop(during Close)" 4 "Stop(during Open)" 5 "RESERVED" 6 "RESERVED" 7 "Invalid" ;
VAL_ 811 CDM_OutsideOpnSwSta_AST 0 "Default" 1 "Push" 2 "RESERVED" 3 "Invalid" ;
VAL_ 811 Hood_TypeOption_AST 0 "Off (Mechanical hood latch is applied)" 1 "On (E-Hood latch is applied)" 2 "RESERVED" 3 "Error Indicator" ;
VAL_ 811 Warn_HoodSwSta_AST 0 "Off" 1 "On" 2 "RESERVED" 3 "Error Indicator" ;
VAL_ 811 FrunkWarning_AST 0 "Off" 1 "On" 2 "RESERVED" 3 "Error Indicator" ;
VAL_ 811 SBCM_FrunkSta_AST 0 "Default" 1 "Valid" 2 "RESERVED" 3 "Error Indicator" ;
VAL_ 811 IMS_OSMirPlayBackSta_RH_New 0 "Stop" 1 "Play 1" 2 "Play 2" 3 "Play 3" 4 "Smart IMS" 5 "Profile 1" 6 "Profile 2" 7 "Profile 3" 8 "Profile 4" 9 "Profile 5" 10 "Profile 6" 11 "Profile 7" 12 "Profile 8" 13 "Profile 9" 14 "Guest" 15 "Error Indicator" ;
VAL_ 811 Ast_DrLkRetryFail_SBCM 0 "Normal" 1 "Fail" 2 "RESERVED" 3 "RESERVED" ;
VAL_ 811 DoorLock_AstLkOutSta_SBCM 0 "Off" 1 "On" 2 "Not Used" 3 "Error Indicator" ;
VAL_ 811 FrunkReleaseSwSta_SBCM_AST 0 "Off" 1 "HalfRelease" 2 "FullRelease" 3 "SwitchError" ;
VAL_ 811 FrunkInsideRelSwSta_SBCM_AST 0 "Off" 1 "On" 2 "Not Used" 3 "Error Indicator" ;
VAL_ 811 FrunkEmergencySwSta_SBCM_AST 0 "Off" 1 "On" 2 "Not Used" 3 "Error Indicator" ;
VAL_ 811 PwrDrSta_Ast 0 "Unavailable" 1 "Available" 2 "RESERVED" 3 "Error Indicator" ;
VAL_ 811 PwrDrSta_AstSd 0 "Unavailable" 1 "Available" 2 "RESERVED" 3 "Error Indicator" ;
VAL_ 811 DischrgDr_OpnClsState_SBCM_AST 0 "Default" 1 "Open" 2 "Close" 3 "Invalid" ;
VAL_ 811 AST_DetectObj_warn_LH 0 "Detect Left Warning OFF" 1 "Detect Left Warning ON" 2 "Detect Left Warning ERROR" 3 "RESERVED" ;
VAL_ 811 PwrDROpenClosingAstSdDRSta 0 "Default" 1 "Close" 2 "Open" 3 "Stop(during Close)" 4 "Stop(during Open)" 5 "RESERVED" 6 "RESERVED" 7 "Invalid" ;
VAL_ 811 PwrDRBuzzerOut_AST_New 0 "OFF" 1 "Open" 2 "Close" 3 "Warning1" 4 "Warning2" 5 "Open(RHD)" 6 "Close(RHD)" ;
VAL_ 811 SBCM_AST_DoorAngle 0 "0° - 90°" 1 "0° - 90°" 2 "0° - 90°" 3 "0° - 90°" 4 "0° - 90°" 5 "0° - 90°" 6 "0° - 90°" 7 "0° - 90°" 8 "0° - 90°" 9 "0° - 90°" 10 "0° - 90°" 11 "0° - 90°" 12 "0° - 90°" 13 "0° - 90°" 14 "0° - 90°" 15 "0° - 90°" 16 "0° - 90°" 17 "0° - 90°" 18 "0° - 90°" 19 "0° - 90°" 20 "0° - 90°" 21 "0° - 90°" 22 "0° - 90°" 23 "0° - 90°" 24 "0° - 90°" 25 "0° - 90°" 26 "0° - 90°" 27 "0° - 90°" 28 "0° - 90°" 29 "0° - 90°" 30 "0° - 90°" 31 "0° - 90°" 32 "0° - 90°" 33 "0° - 90°" 34 "0° - 90°" 35 "0° - 90°" 36 "0° - 90°" 37 "0° - 90°" 38 "0° - 90°" 39 "0° - 90°" 40 "0° - 90°" 41 "0° - 90°" 42 "0° - 90°" 43 "0° - 90°" 44 "0° - 90°" 45 "0° - 90°" 46 "0° - 90°" 47 "0° - 90°" 48 "0° - 90°" 49 "0° - 90°" 50 "0° - 90°" 51 "0° - 90°" 52 "0° - 90°" 53 "0° - 90°" 54 "0° - 90°" 55 "0° - 90°" 56 "0° - 90°" 57 "0° - 90°" 58 "0° - 90°" 59 "0° - 90°" 60 "0° - 90°" 61 "0° - 90°" 62 "0° - 90°" 63 "0° - 90°" 64 "0° - 90°" 65 "0° - 90°" 66 "0° - 90°" 67 "0° - 90°" 68 "0° - 90°" 69 "0° - 90°" 70 "0° - 90°" 71 "0° - 90°" 72 "0° - 90°" 73 "0° - 90°" 74 "0° - 90°" 75 "0° - 90°" 76 "0° - 90°" 77 "0° - 90°" 78 "0° - 90°" 79 "0° - 90°" 80 "0° - 90°" 81 "0° - 90°" 82 "0° - 90°" 83 "0° - 90°" 84 "0° - 90°" 85 "0° - 90°" 86 "0° - 90°" 87 "0° - 90°" 88 "0° - 90°" 89 "0° - 90°" 90 "0° - 90°" 91 "Invalid" 92 "Invalid" 93 "Invalid" 94 "Invalid" 95 "Invalid" 96 "Invalid" 97 "Invalid" 98 "Invalid" 99 "Invalid" 100 "Unknown" 101 "Invalid" 102 "Invalid" 103 "Invalid" 104 "Invalid" 105 "Invalid" 106 "Invalid" 107 "Invalid" 108 "Invalid" 109 "Invalid" 110 "Invalid" 111 "Invalid" 112 "Invalid" 113 "Invalid" 114 "Invalid" 115 "Invalid" 116 "Invalid" 117 "Invalid" 118 "Invalid" 119 "Invalid" 120 "Invalid" 121 "Invalid" 122 "Invalid" 123 "Invalid" 124 "Invalid" 125 "Invalid" 126 "Invalid" 127 "Invalid" ;
VAL_ 811 EHL_TxInfo_SBCM_AST 0 "Default" 1 "EHL_AST_Close" 2 "EHL_AST_Half" 3 "EHL_AST_Open" 4 "EHL_AST_RetryFlag" 5 "EHL_AST_ErrorIndicator" 6 "EHL_AST_Opening" 7 "Invalid" ;
VAL_ 811 CDM_DrType_AST 0 "None" 1 "Electric" 2 "Manual" 3 "RESERVED" ;
VAL_ 811 ASTDoorPushAlarm 0 "Off" 1 "On" 2 "RESERVED" 3 "Error Indicator" ;
VAL_ 811 AST_CrashUnlockCmd 0 "Off" 1 "Unlock (Crash)" ;
VAL_ 811 DoorLock_CtrlDrLkSwSta_SBCM 0 "Off" 1 "On (Lock On)" 2 "RESERVED" 3 "Error Indicator" ;
VAL_ 811 DoorLock_CtrlDrUnLkSwSta_SBCM 0 "Off" 1 "On (Unlock On)" 2 "RESERVED" 3 "Error Indicator" ;
VAL_ 811 Warn_AsstDrSwSta_SBCM 0 "Close" 1 "Open" 2 "RESERVED" 3 "Error Indicator" ;
VAL_ 811 DoorLock_AsstDrUnLkSta_SBCM 0 "Lock" 1 "Unlock" 2 "RESERVED" 3 "Error Indicator" ;
VAL_ 811 AST_SEAWarn_RH 0 "SEA Right Warning OFF" 1 "SEA Right Warning ON" 2 "RESERVED" 3 "RESERVED" ;
VAL_ 811 AST_SEAWarn_LH 0 "SEA Left Warning OFF" 1 "SEA Left Warning ON" 2 "RESERVED" 3 "RESERVED" ;
VAL_ 811 AST_SEWWarn_LH 0 "SEW Left Warning OFF" 1 "SEW Left Warning ON" 2 "RESERVED" 3 "RESERVED" ;
VAL_ 811 AST_SEWWarn_RH 0 "SEW Right Warning OFF" 1 "SEW Right Warning ON" 2 "RESERVED" 3 "RESERVED" ;
VAL_ 811 AST_MRActivationAlarm 0 "Off" 1 "On" 2 "RESERVED" 3 "Error Indicator" ;
VAL_ 811 AST_ReleaseWarn 0 "Release Warning OFF" 1 "Release Warning ON" 2 "RESERVED" 3 "RESERVED" ;
VAL_ 930 CLU_HU_Crc3Val 0 "0x0~0xFFFF:CRCValue" 65535 "0x0~0xFFFF:CRCValue" ;
VAL_ 930 CLU_TermAvgSync_MM 0 "During the first 2.5 minutes" 1 "During another 2.5 minutes" 2 "During another 2.5 minutes" 3 "During another 2.5 minutes" ;
VAL_ 930 CLU_TermAvgFCL_Digit_MM 0 "2 Digit" 1 "3 Digit" 2 "RESERVED" 3 "Invalid" ;
VAL_ 930 CLU_TermAvgFuelCnsmptnVal_MM 0 "0x0~0x3E7:00.0~99.9(PH)=0.1*HEX or 100~999(PH)=HEX" 999 "0x0~0x3E7:00.0~99.9(PH)=0.1*HEX or 100~999(PH)=HEX" 1000 "RESERVED" 1001 "RESERVED" 1002 "RESERVED" 1003 "RESERVED" 1004 "RESERVED" 1005 "RESERVED" 1006 "RESERVED" 1007 "RESERVED" 1008 "RESERVED" 1009 "RESERVED" 1010 "RESERVED" 1011 "RESERVED" 1012 "RESERVED" 1013 "RESERVED" 1014 "RESERVED" 1015 "RESERVED" 1016 "RESERVED" 1017 "RESERVED" 1018 "RESERVED" 1019 "RESERVED" 1020 "RESERVED" 1021 "RESERVED" 1022 "RESERVED" 1023 "Error" ;
VAL_ 930 CLU_DispThmSetRdy 0 "Default" 1 "Not Ready" 2 "Ready" 3 "Invalid" ;
VAL_ 930 CLU_DispThmMemSta 0 "0x00~0x7F:Valid" 127 "0x00~0x7F:Valid" 128 "80~0xFF:Invalid" 255 "80~0xFF:Invalid" ;
VAL_ 930 CLU_HU_AlvCnt3Val 0 "0x0~0xFF:AlvCntValue" 255 "0x0~0xFF:AlvCntValue" ;
VAL_ 930 CLU_DispThmDeleteSta 0 "Default" 1 "Deleting" 2 "Delete Complete (Min. 600ms on)" 3 "Delete Fail (Min. 600ms on)" 4 "RESERVED" 5 "RESERVED" 6 "RESERVED" 7 "Invalid" ;
VAL_ 930 CLU_DispThmCopySta 0 "Default" 1 "Copying" 2 "Copy Complete (Min. 600ms on)" 3 "Copy Fail (Min. 600ms on)" 4 "RESERVED" 5 "RESERVED" 6 "RESERVED" 7 "Invalid" ;
VAL_ 930 CLU_DispThmSetStaMem 0 "Default" 1 "Original" 2 "Memory1" 3 "Memory2" 4 "Memory3" 5 "RESERVED" 6 "RESERVED" 7 "Invalid" ;
VAL_ 930 CLU_LapTimer_LapNumber_MM 0 "Default" 1 "Lap Number" 2 "Lap Number" 3 "Lap Number" 4 "Lap Number" 5 "Lap Number" 6 "Lap Number" 7 "Lap Number" 8 "Lap Number" 9 "Lap Number" 10 "Lap Number" 11 "Lap Number" 12 "Lap Number" 13 "Lap Number" 14 "Lap Number" 15 "Lap Number" 16 "Lap Number" 17 "Lap Number" 18 "Lap Number" 19 "Lap Number" 20 "Lap Number" 21 "Lap Number" 22 "Lap Number" 23 "Lap Number" 24 "Lap Number" 25 "Lap Number" 26 "Lap Number" 27 "Lap Number" 28 "Lap Number" 29 "Lap Number" 30 "Lap Number" 31 "Lap Number" 32 "Lap Number" 33 "Lap Number" 34 "Lap Number" 35 "Lap Number" 36 "Lap Number" 37 "Lap Number" 38 "Lap Number" 39 "Lap Number" 40 "Lap Number" 41 "Lap Number" 42 "Lap Number" 43 "Lap Number" 44 "Lap Number" 45 "Lap Number" 46 "Lap Number" 47 "Lap Number" 48 "Lap Number" 49 "Lap Number" 50 "Lap Number" 51 "Lap Number" 52 "Lap Number" 53 "Lap Number" 54 "Lap Number" 55 "Lap Number" 56 "Lap Number" 57 "Lap Number" 58 "Lap Number" 59 "Lap Number" 60 "Lap Number" 61 "Lap Number" 62 "Lap Number" 63 "Lap Number" 64 "Lap Number" 65 "Lap Number" 66 "Lap Number" 67 "Lap Number" 68 "Lap Number" 69 "Lap Number" 70 "Lap Number" 71 "Lap Number" 72 "Lap Number" 73 "Lap Number" 74 "Lap Number" 75 "Lap Number" 76 "Lap Number" 77 "Lap Number" 78 "Lap Number" 79 "Lap Number" 80 "Lap Number" 81 "Lap Number" 82 "Lap Number" 83 "Lap Number" 84 "Lap Number" 85 "Lap Number" 86 "Lap Number" 87 "Lap Number" 88 "Lap Number" 89 "Lap Number" 90 "Lap Number" 91 "Lap Number" 92 "Lap Number" 93 "Lap Number" 94 "Lap Number" 95 "Lap Number" 96 "Lap Number" 97 "Lap Number" 98 "Lap Number" 99 "Lap Number" 100 "RESERVED" 101 "RESERVED" 102 "RESERVED" 103 "RESERVED" 104 "RESERVED" 105 "RESERVED" 106 "RESERVED" 107 "RESERVED" 108 "RESERVED" 109 "RESERVED" 110 "RESERVED" 111 "RESERVED" 112 "RESERVED" 113 "RESERVED" 114 "RESERVED" 115 "RESERVED" 116 "RESERVED" 117 "RESERVED" 118 "RESERVED" 119 "RESERVED" 120 "RESERVED" 121 "RESERVED" 122 "RESERVED" 123 "RESERVED" 124 "RESERVED" 125 "RESERVED" 126 "RESERVED" 127 "RESERVED" ;
VAL_ 930 CLU_LapTimer_Hour_MM 0 "0x00~0x7F:Values(refer to Signal Description)" 127 "0x00~0x7F:Values(refer to Signal Description)" ;
VAL_ 930 CLU_LapTimer_Minute_MM 0 "Values(refer to Signal Description)" 1 "Values(refer to Signal Description)" 2 "Values(refer to Signal Description)" 3 "Values(refer to Signal Description)" 4 "Values(refer to Signal Description)" 5 "Values(refer to Signal Description)" 6 "Values(refer to Signal Description)" 7 "Values(refer to Signal Description)" 8 "Values(refer to Signal Description)" 9 "Values(refer to Signal Description)" 10 "Values(refer to Signal Description)" 11 "Values(refer to Signal Description)" 12 "Values(refer to Signal Description)" 13 "Values(refer to Signal Description)" 14 "Values(refer to Signal Description)" 15 "Values(refer to Signal Description)" 16 "Values(refer to Signal Description)" 17 "Values(refer to Signal Description)" 18 "Values(refer to Signal Description)" 19 "Values(refer to Signal Description)" 20 "Values(refer to Signal Description)" 21 "Values(refer to Signal Description)" 22 "Values(refer to Signal Description)" 23 "Values(refer to Signal Description)" 24 "Values(refer to Signal Description)" 25 "Values(refer to Signal Description)" 26 "Values(refer to Signal Description)" 27 "Values(refer to Signal Description)" 28 "Values(refer to Signal Description)" 29 "Values(refer to Signal Description)" 30 "Values(refer to Signal Description)" 31 "Values(refer to Signal Description)" 32 "Values(refer to Signal Description)" 33 "Values(refer to Signal Description)" 34 "Values(refer to Signal Description)" 35 "Values(refer to Signal Description)" 36 "Values(refer to Signal Description)" 37 "Values(refer to Signal Description)" 38 "Values(refer to Signal Description)" 39 "Values(refer to Signal Description)" 40 "Values(refer to Signal Description)" 41 "Values(refer to Signal Description)" 42 "Values(refer to Signal Description)" 43 "Values(refer to Signal Description)" 44 "Values(refer to Signal Description)" 45 "Values(refer to Signal Description)" 46 "Values(refer to Signal Description)" 47 "Values(refer to Signal Description)" 48 "Values(refer to Signal Description)" 49 "Values(refer to Signal Description)" 50 "Values(refer to Signal Description)" 51 "Values(refer to Signal Description)" 52 "Values(refer to Signal Description)" 53 "Values(refer to Signal Description)" 54 "Values(refer to Signal Description)" 55 "Values(refer to Signal Description)" 56 "Values(refer to Signal Description)" 57 "Values(refer to Signal Description)" 58 "Values(refer to Signal Description)" 59 "Values(refer to Signal Description)" 60 "Values(refer to Signal Description)" 61 "Values(refer to Signal Description)" 62 "Values(refer to Signal Description)" 63 "Values(refer to Signal Description)" ;
VAL_ 930 CLU_LapTimer_Second_MM 0 "Values(refer to Signal Description)" 1 "Values(refer to Signal Description)" 2 "Values(refer to Signal Description)" 3 "Values(refer to Signal Description)" 4 "Values(refer to Signal Description)" 5 "Values(refer to Signal Description)" 6 "Values(refer to Signal Description)" 7 "Values(refer to Signal Description)" 8 "Values(refer to Signal Description)" 9 "Values(refer to Signal Description)" 10 "Values(refer to Signal Description)" 11 "Values(refer to Signal Description)" 12 "Values(refer to Signal Description)" 13 "Values(refer to Signal Description)" 14 "Values(refer to Signal Description)" 15 "Values(refer to Signal Description)" 16 "Values(refer to Signal Description)" 17 "Values(refer to Signal Description)" 18 "Values(refer to Signal Description)" 19 "Values(refer to Signal Description)" 20 "Values(refer to Signal Description)" 21 "Values(refer to Signal Description)" 22 "Values(refer to Signal Description)" 23 "Values(refer to Signal Description)" 24 "Values(refer to Signal Description)" 25 "Values(refer to Signal Description)" 26 "Values(refer to Signal Description)" 27 "Values(refer to Signal Description)" 28 "Values(refer to Signal Description)" 29 "Values(refer to Signal Description)" 30 "Values(refer to Signal Description)" 31 "Values(refer to Signal Description)" 32 "Values(refer to Signal Description)" 33 "Values(refer to Signal Description)" 34 "Values(refer to Signal Description)" 35 "Values(refer to Signal Description)" 36 "Values(refer to Signal Description)" 37 "Values(refer to Signal Description)" 38 "Values(refer to Signal Description)" 39 "Values(refer to Signal Description)" 40 "Values(refer to Signal Description)" 41 "Values(refer to Signal Description)" 42 "Values(refer to Signal Description)" 43 "Values(refer to Signal Description)" 44 "Values(refer to Signal Description)" 45 "Values(refer to Signal Description)" 46 "Values(refer to Signal Description)" 47 "Values(refer to Signal Description)" 48 "Values(refer to Signal Description)" 49 "Values(refer to Signal Description)" 50 "Values(refer to Signal Description)" 51 "Values(refer to Signal Description)" 52 "Values(refer to Signal Description)" 53 "Values(refer to Signal Description)" 54 "Values(refer to Signal Description)" 55 "Values(refer to Signal Description)" 56 "Values(refer to Signal Description)" 57 "Values(refer to Signal Description)" 58 "Values(refer to Signal Description)" 59 "Values(refer to Signal Description)" 60 "Values(refer to Signal Description)" 61 "Values(refer to Signal Description)" 62 "Values(refer to Signal Description)" 63 "Values(refer to Signal Description)" ;
VAL_ 930 CLU_LapTimer_MeasuringStatus_MM 0 "Stop Lap Timer" 1 "Under Lap Timer measurement" 2 "Reser Lap Time" 3 "RESERVED" ;
VAL_ 930 CLU_LapTimer_milisecond_MM 0 "0x00~0x7F:Values(refer to Signal Description)" 127 "0x00~0x7F:Values(refer to Signal Description)" ;
VAL_ 930 CLU_N1SetVal_MM 0 "None" 1 "N" 2 "CUSTOM1" 3 "CUSTOM2" 4 "N-CUSTOM1" 5 "N-CUSTOM2" 6 "Drive mode" 7 "LapTimer Start/Lap" 8 "LapTimer Stop" 9 "RESERVED" 10 "RESERVED" 11 "RESERVED" 12 "RESERVED" 13 "RESERVED" 14 "Unselected" 15 "Invalid" ;
VAL_ 930 CLU_N2SetVal_MM 0 "None" 1 "N" 2 "CUSTOM1" 3 "CUSTOM2" 4 "N-CUSTOM1" 5 "N-CUSTOM2" 6 "Drive mode" 7 "LapTimer Start/Lap" 8 "LapTimer Stop" 9 "RESERVED" 10 "RESERVED" 11 "RESERVED" 12 "RESERVED" 13 "RESERVED" 14 "Unselected" 15 "Invalid" ;
VAL_ 930 Usm_TorqueUnitSetSta_MM 0 "Default" 1 "Nm" 2 "lb_ft" 3 "RESERVED" ;
VAL_ 930 Usm_TurboPressureUnitSetSta_MM 0 "Default" 1 "Psi" 2 "kPa" 3 "bar" 4 "RESERVED" 5 "RESERVED" 6 "RESERVED" 7 "Invalid" ;
VAL_ 930 USM_ShiftLightNmodeSetSta_MM 0 "Default" 1 "Off" 2 "On" 3 "Invalid" ;
VAL_ 930 USM_ShiftLightCustomSetSta_MM 0 "Default" 1 "Off" 2 "On" 3 "Invalid" ;
VAL_ 930 USM_ShiftLightSportSetSta_MM 0 "Default" 1 "Off" 2 "On" 3 "Invalid" ;
VAL_ 930 USM_ShiftLightNormalSetSta_MM 0 "Default" 1 "Off" 2 "On" 3 "Invalid" ;
VAL_ 930 USM_ShiftLightEcoSetSta_MM 0 "Default" 1 "Off" 2 "On" 3 "Invalid" ;
VAL_ 930 USM_ShiftLightBeepSndSetSta_MM 0 "Default" 1 "Off" 2 "On" 3 "Invalid" ;
VAL_ 930 USM_ShiftLightCustom2SetSta_MM 0 "Default" 1 "Off" 2 "On" 3 "Invalid" ;
VAL_ 930 USM_LapTimerAutoMsreSetSta_MM 0 "Default(Not Applied)" 1 "Off" 2 "On(Auto Measure)" 3 "Invalid" ;
VAL_ 930 USM_LapTimerTimeGapSetSta_MM 0 "Default(Not Applied)" 1 "Compare with Best Lap" 2 "Compare with Last Lap" 3 "Invalid" ;
VAL_ 518 GNSS_Crc7Val 0 "0x0~0xFFFF:CRCValue" 65535 "0x0~0xFFFF:CRCValue" ;
VAL_ 518 GNSS_AlvCnt7Val 0 "0x0~0xFF:AlvCntValue" 255 "0x0~0xFF:AlvCntValue" ;
VAL_ 518 HU_DR_Position_Status 1 "Valid" ;
VAL_ 518 HU_DR_Altitude_Status 1 "valid" ;
VAL_ 518 HU_DR_Heading_Status 1 "Valid" ;
VAL_ 518 HU_DR_Speed_Status 1 "Valid" ;
VAL_ 518 HU_DR_DirectionSwitch_Sta 1 "Valid" ;
VAL_ 518 HU_DR_Direction 1 "Backward" ;
VAL_ 518 HU_DR_GyroCalib_Sta 1 "Calibrated" ;
VAL_ 518 HU_DR_TachoCalib_Sta 1 "Calibrated" ;
VAL_ 518 HU_DR_Solution_Sta 0 "invalid" 1 "DR valid" ;
VAL_ 518 HU_DR_GNSS_Fix_Age 1 "0x1~0xFE:time since last GNSS fix" 254 "0x1~0xFE:time since last GNSS fix" 255 "No GNSS fix yet" ;
VAL_ 309 BAT_Crc1Val 0 "0x0~0xFFFF:CRCValue" 65535 "0x0~0xFFFF:CRCValue" ;
VAL_ 309 BAT_AlvCnt1Val 0 "0x0~0xFF:AlvCntValue" 255 "0x0~0xFF:AlvCntValue" ;
VAL_ 309 BAT_CurrVal 0 "0x0~0xFFFE:Valid" 65534 "0x0~0xFFFE:Valid" 65535 "Error indicator" ;
VAL_ 309 BAT_SocVal 0 "0x0~0x64:Valid" 100 "0x0~0x64:Valid" 255 "Error indicator" ;
VAL_ 309 BAT_VoltVal 0 "0x0~0x3FFE:Valid" 16382 "0x0~0x3FFE:Valid" 16383 "Error indicator" ;
VAL_ 309 BAT_AuxBattOpt 0 "Not used" 1 "12V LFP Battery is applied" 2 "12V LFP Battery is not applied" 3 "Error indicator" ;
VAL_ 309 BAT_TempVal 0 "0x0~0x1FE:Valid" 510 "0x0~0x1FE:Valid" 511 "Error indicator" ;
VAL_ 309 BAT_SocErrSta 0 "Nomal State" 1 "Implausible State" 2 "Not used" 3 "Error indicator" ;
VAL_ 309 BAT_SohVal 0 "0x0~0x7E:Valid" 126 "0x0~0x7E:Valid" 127 "Error indicator" ;
VAL_ 309 BAT_SnsrInvldSta 0 "Valid Condition" 1 "Invalid Condition" 2 "Not used" 3 "Error indicator" ;
VAL_ 309 BAT_SofVal 0 "0x0~0x7E:Valid" 126 "0x0~0x7E:Valid" 127 "Error indicator" ;
VAL_ 309 BAT_RspErrSta 0 "Operating correctly" 1 "Response error" 2 "Not used" 3 "Error indicator" ;
VAL_ 309 BAT_CapacityVal 0 "0x0~0x64:Valid" 100 "0x0~0x64:Valid" 255 "Error" ;
