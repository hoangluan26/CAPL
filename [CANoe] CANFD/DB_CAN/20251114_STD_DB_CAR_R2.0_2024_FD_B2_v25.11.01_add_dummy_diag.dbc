VERSION ""

NS_ :

BS_:

BU_: SHVU_CCS_FD ARS_FD WPC_FD WPC2_FD SCM_FD SHVU_FRNT_FD FLLR_FD vDummy_FD_B2 GW_SAU_DRV_FD ATS_FD PSB_FD GW_PSU_RR_FD SHVU_RL_FD RWPC_FD CGW_CCU OHCL_FD SHVU_REAR_FD BLTN_CAM_FD GW_PSU_DRV_FD FCS_FD GW_PSU_AST_FD GW_PSU_3RD_FD RCS_FD GW_PSU_RL_FD SHVU_3RD_FD SHVU_RR_FD RCM_FD DCM_FD SGU_FD vFD_B2

BO_ 870 HU_GW_03_200ms: 24 CGW_CCU
 SG_ HU_GW_Crc3Val : 0|16@1+ (1,0) [0|0] ""  GW_PSU_DRV_FD
 SG_ HU_FrGlsHtdSW : 100|2@1+ (1,0) [0|0] "" Vector__XXX
 SG_ AVN_RSPA_Disp_Rdy : 102|2@1+ (1,0) [0|0] "" Vector__XXX
 SG_ CF_AVN_ProfileIDRValue : 104|4@1+ (1,0) [0|0] ""  BLTN_CAM_FD,GW_PSU_DRV_FD,GW_SAU_DRV_FD,RCM_FD,RWPC_FD,SGU_FD,WPC2_FD,WPC_FD
 SG_ HazardFromHUSVM : 108|2@1+ (1,0) [0|0] "" Vector__XXX
 SG_ OMUOSMirCtrl : 110|2@1+ (1,0) [0|0] "" Vector__XXX
 SG_ OTAUIStatus : 120|2@1+ (1,0) [0|0] "" Vector__XXX
 SG_ C_TeleActiveStatus : 122|2@1+ (1,0) [0|0] "" Vector__XXX
 SG_ HU_RTCCheck : 126|2@1+ (1,0) [0|0] ""  GW_PSU_AST_FD
 SG_ HU_GW_AlvCnt3Val : 16|8@1+ (1,0) [0|0] ""  GW_PSU_DRV_FD
 SG_ HU_SWRCWarmerSet : 182|2@1+ (1,0) [0|0] "" Vector__XXX
 SG_ HU_TrModeReq_PE : 24|3@1+ (1,0) [0|0] "" Vector__XXX
 SG_ HU_TrBrakeTypeReq_PE : 27|3@1+ (1,0) [0|0] "" Vector__XXX
 SG_ HU_STA_Req_PE : 30|2@1+ (1,0) [0|0] "" Vector__XXX
 SG_ HU_PopUpDnSafetyModeState : 32|2@1+ (1,0) [0|0] "" Vector__XXX
 SG_ HU_LghtDnSafetyModState : 34|2@1+ (1,0) [0|0] "" Vector__XXX
 SG_ HU_FullScrSafetyModeState : 36|2@1+ (1,0) [0|0] "" Vector__XXX
 SG_ HU_DispAvailable : 38|2@1+ (1,0) [0|0] "" Vector__XXX
 SG_ HU_ISG_OFF_Set_Req_PE : 40|2@1+ (1,0) [0|0] "" Vector__XXX
 SG_ AVN_MPA_SelBtnSta : 48|6@1+ (1,0) [0|0] "" Vector__XXX
 SG_ AVN_PRK_Cam_Status : 54|2@1+ (1,0) [0|0] "" Vector__XXX
 SG_ AVN_MRA_Disp_Rdy : 56|2@1+ (1,0) [0|0] "" Vector__XXX
 SG_ AVN_PRK_Func_Selected : 58|4@1+ (1,0) [0|0] "" Vector__XXX
 SG_ AVN_MRA_CancelInput : 62|2@1+ (1,0) [0|0] "" Vector__XXX
 SG_ HU_DistanceUnit : 64|2@1+ (1,0) [0|0] "" Vector__XXX
 SG_ HU_Scheduled_Setting : 66|4@1+ (1,0) [0|0] "" Vector__XXX
 SG_ HU_AliveStatus : 70|2@1+ (1,0) [0|0] ""  ATS_FD
 SG_ HU_ThemeType : 74|6@1+ (1,0) [0|0] ""  ATS_FD,BLTN_CAM_FD
 SG_ HU_MicActivity : 81|2@1+ (1,0) [0|0] "" Vector__XXX
 SG_ AVN_RSPA_ModeSelect : 84|4@1+ (1,0) [0|0] "" Vector__XXX
 SG_ CF_HU_GPSFlt : 88|2@1+ (1,0) [0|0] "" Vector__XXX
 SG_ AVN_RSPA_CancelInput : 90|2@1+ (1,0) [0|3] "" Vector__XXX

BO_ 993 PDC_FD_02_200ms: 24 CGW_CCU
 SG_ PDC_FD_Crc2Val : 0|16@1+ (1,0) [0|0] ""  GW_PSU_DRV_FD
 SG_ Lamp_StpLmpLftOpnSta : 100|2@1+ (1,0) [0|0] "" Vector__XXX
 SG_ Lamp_StpLmpRtOpnSta : 102|2@1+ (1,0) [0|0] "" Vector__XXX
 SG_ Lamp_HmslLmpOpnSta : 104|2@1+ (1,0) [0|0] "" Vector__XXX
 SG_ Lamp_DrlLmpLftOpnSta : 106|2@1+ (1,0) [0|0] "" Vector__XXX
 SG_ Lamp_DrlLmpRtOpnSta : 108|2@1+ (1,0) [0|0] "" Vector__XXX
 SG_ Lamp_FrFgLmpLftOpnSta : 110|2@1+ (1,0) [0|0] "" Vector__XXX
 SG_ Lamp_FrFgLmpRtOpnSta : 112|2@1+ (1,0) [0|0] "" Vector__XXX
 SG_ Lamp_CorneringLmpLftOpnSta : 114|2@1+ (1,0) [0|0] "" Vector__XXX
 SG_ Lamp_CorneringLmpRtOpnSta : 116|2@1+ (1,0) [0|0] "" Vector__XXX
 SG_ Lamp_StcBendingLmpLftOpnSta : 118|2@1+ (1,0) [0|0] "" Vector__XXX
 SG_ Lamp_StcBendingLmpRtOpnSta : 120|2@1+ (1,0) [0|0] "" Vector__XXX
 SG_ Lamp_FrTurnSigLmpLftPCLSta : 122|2@1+ (1,0) [0|0] "" Vector__XXX
 SG_ Lamp_FrTurnSigLmpRtPCLSta : 124|2@1+ (1,0) [0|0] "" Vector__XXX
 SG_ Lamp_RrTurnSigLmpLftPCLSta : 126|2@1+ (1,0) [0|0] "" Vector__XXX
 SG_ Lamp_RrTurnSigLmpRtPCLSta : 128|2@1+ (1,0) [0|0] "" Vector__XXX
 SG_ HzrdSwPushSta : 130|2@1+ (1,0) [0|0] "" Vector__XXX
 SG_ Lamp_LftTrnFaultSta : 132|2@1+ (1,0) [0|0] "" Vector__XXX
 SG_ Lamp_RtTrnFaultSta : 134|2@1+ (1,0) [0|0] "" Vector__XXX
 SG_ FrtTurnLampOptSta : 136|2@1+ (1,0) [0|0] "" Vector__XXX
 SG_ RrTurnLampOptSta : 138|2@1+ (1,0) [0|0] "" Vector__XXX
 SG_ VAPI_TurnSigLampEnable_Get : 140|2@1+ (1,0) [0|0] "" Vector__XXX
 SG_ PDC_RearFogLmpOpt : 142|2@1+ (1,0) [0|0] "" Vector__XXX
 SG_ PDC_FrontFogLmpOpt : 144|2@1+ (1,0) [0|0] "" Vector__XXX
 SG_ PDC_TrunkTgateWarnLampMode : 146|2@1+ (1,0) [0|0] "" Vector__XXX
 SG_ PDC_FD_AlvCnt2Val : 16|8@1+ (1,0) [0|0] ""  GW_PSU_DRV_FD
 SG_ IntLamp_InlTailLmpSta : 64|2@1+ (1,0) [0|0] ""  BLTN_CAM_FD,FCS_FD,GW_PSU_3RD_FD,GW_PSU_AST_FD,GW_PSU_DRV_FD,GW_PSU_RL_FD,GW_PSU_RR_FD,OHCL_FD,WPC2_FD
 SG_ Lamp_FootLampOnReq : 66|2@1+ (1,0) [0|0] "" Vector__XXX
 SG_ Lamp_MoodLampOnReq : 68|3@1+ (1,0) [0|0] "" Vector__XXX
 SG_ USM_FuncForMdLmpBrgtSta : 71|3@1+ (1,0) [0|0] "" Vector__XXX
 SG_ Lamp_HdLmpLoLftOpnSta : 74|2@1+ (1,0) [0|0] "" Vector__XXX
 SG_ Lamp_HdLmpLoRtOpnSta : 76|2@1+ (1,0) [0|0] "" Vector__XXX
 SG_ Lamp_HdLmpBiFuncLftOpnSta : 78|2@1+ (1,0) [0|0] "" Vector__XXX
 SG_ Lamp_HdLmpBiFuncRtOpnSta : 80|2@1+ (1,0) [0|0] "" Vector__XXX
 SG_ Lamp_HdLmpHiLftOpnSta : 82|2@1+ (1,0) [0|0] "" Vector__XXX
 SG_ Lamp_HdLmpHiRtOpnSta : 84|2@1+ (1,0) [0|0] "" Vector__XXX
 SG_ ExtLamp_HzrdSwSta : 86|2@1+ (1,0) [0|0] "" Vector__XXX
 SG_ Lamp_FrTrnSigLmpLftOpnSta : 88|2@1+ (1,0) [0|0] "" Vector__XXX
 SG_ Lamp_FrTrnSigLmpRtOpnSta : 90|2@1+ (1,0) [0|0] "" Vector__XXX
 SG_ Lamp_RrTrnSigLmpLftOpnSta : 92|2@1+ (1,0) [0|0] "" Vector__XXX
 SG_ Lamp_RrTrnSigLmpRtOpnSta : 94|2@1+ (1,0) [0|0] "" Vector__XXX
 SG_ Brake_SwSta_ICU : 96|2@1+ (1,0) [0|0] "" Vector__XXX
 SG_ BrkLmpCmd : 98|2@1+ (1,0) [0|0] "" Vector__XXX

BO_ 992 PDC_FD_01_200ms: 24 CGW_CCU
 SG_ PDC_FD_Crc1Val : 0|16@1+ (1,0) [0|0] ""  GW_PSU_DRV_FD
 SG_ C_3rdRCSeatBeltSW : 100|1@1+ (1,0) [0|0] ""  ARS_FD,GW_PSU_RL_FD,GW_PSU_RR_FD,PSB_FD,WPC2_FD
 SG_ C_3rdRRSeatBeltSW : 101|1@1+ (1,0) [0|0] ""  ARS_FD,GW_PSU_RR_FD,PSB_FD,WPC2_FD
 SG_ C_1stCTRSeatBeltSW : 102|1@1+ (1,0) [0|0] "" Vector__XXX
 SG_ Warn_DrvStOccSta : 103|3@1+ (1,0) [0|0] "" Vector__XXX
 SG_ Warn_PassStOccSta : 111|2@1+ (1,0) [0|0] ""  GW_PSU_AST_FD,PSB_FD
 SG_ Warn_RrLftSBRMATSwSta : 113|2@1+ (1,0) [0|0] ""  GW_PSU_DRV_FD
 SG_ Warn_RrRhtSBRMATSwSta : 115|2@1+ (1,0) [0|0] ""  GW_PSU_DRV_FD
 SG_ C_3rdRLSBRMatSw : 117|1@1+ (1,0) [0|0] ""  ARS_FD,GW_PSU_RL_FD,WPC2_FD
 SG_ C_3rdRRSBRMatSw : 118|1@1+ (1,0) [0|0] ""  ARS_FD,GW_PSU_RR_FD,WPC2_FD
 SG_ C_1stCTRSBRMatSw : 119|1@1+ (1,0) [0|0] "" Vector__XXX
 SG_ StrWhlWrmrSwState : 120|2@1+ (1,0) [0|0] "" Vector__XXX
 SG_ StrWhlWrmrFlModDetail : 122|3@1+ (1,0) [0|0] "" Vector__XXX
 SG_ FrHtdGlsSwState : 125|2@1+ (1,0) [0|0] "" Vector__XXX
 SG_ RrGlsHtSwState : 127|2@1+ (1,0) [0|0] "" Vector__XXX
 SG_ RLChldLkLatchSwState : 129|2@1+ (1,0) [0|0] "" Vector__XXX
 SG_ RRChldLkLatchSwState : 131|2@1+ (1,0) [0|0] "" Vector__XXX
 SG_ ChildLock_ActnFlSta : 133|2@1+ (1,0) [0|0] "" Vector__XXX
 SG_ DoorLock_LkOutSta : 135|2@1+ (1,0) [0|0] "" Vector__XXX
 SG_ VSAutoDrLkRetryFailSta : 137|2@1+ (1,0) [0|0] "" Vector__XXX
 SG_ Trunk_TrnkTlgtOutReleaseSwSta : 139|2@1+ (1,0) [0|0] "" Vector__XXX
 SG_ Trunk_TrnkInReleaseSwSta : 141|2@1+ (1,0) [0|0] "" Vector__XXX
 SG_ Trunk_GlvBxTrnkLkSwSta : 143|2@1+ (1,0) [0|0] "" Vector__XXX
 SG_ Trunk_TrnkTlgtSwSta : 145|2@1+ (1,0) [0|0] ""  BLTN_CAM_FD,GW_PSU_3RD_FD,GW_PSU_AST_FD,GW_PSU_RL_FD,GW_PSU_RR_FD,SHVU_RL_FD,SHVU_RR_FD
 SG_ Trunk_TlgtFullOpnSwSta : 147|2@1+ (1,0) [0|0] "" Vector__XXX
 SG_ Trunk_TrnkTlgtReleaseRlySta : 149|2@1+ (1,0) [0|0] "" Vector__XXX
 SG_ FrtWiper_ParkingSwState : 151|2@1+ (1,0) [0|0] "" Vector__XXX
 SG_ PDC_TlgtUnLkSta : 153|2@1+ (1,0) [0|0] "" Vector__XXX
 SG_ PDC_PSDPwrModeOffSwSta : 155|2@1+ (1,0) [0|0] "" Vector__XXX
 SG_ PDC_FuelDrOpenSta : 157|2@1+ (1,0) [0|0] "" Vector__XXX
 SG_ PDC_FD_AlvCnt1Val : 16|8@1+ (1,0) [0|0] ""  GW_PSU_DRV_FD
 SG_ OBCWakeupDrLock : 161|2@1+ (1,0) [0|0] "" Vector__XXX
 SG_ OBCWakeupDrUnlock : 163|2@1+ (1,0) [0|0] "%" Vector__XXX
 SG_ Trunk_BgtOpnHzrdReq : 165|2@1+ (1,0) [0|0] "" Vector__XXX
 SG_ Trunk_BgtOpnBzrReq : 167|2@1+ (1,0) [0|0] "" Vector__XXX
 SG_ IGN3State : 169|2@1+ (1,0) [0|0] ""  FCS_FD,GW_PSU_3RD_FD,GW_PSU_AST_FD,GW_PSU_DRV_FD,GW_PSU_RL_FD,GW_PSU_RR_FD,GW_SAU_DRV_FD,SHVU_3RD_FD,SHVU_CCS_FD,SHVU_FRNT_FD,SHVU_REAR_FD,SHVU_RL_FD,SHVU_RR_FD
 SG_ IGN3State_By_BMS : 171|2@1+ (1,0) [0|0] "" Vector__XXX
 SG_ IGN3State_By_VCMS_HMU : 173|2@1+ (1,0) [0|0] "" Vector__XXX
 SG_ IGN3State_By_AfterBlow : 175|2@1+ (1,0) [0|0] "" Vector__XXX
 SG_ IGN3State_By_Bat : 177|2@1+ (1,0) [0|0] "" Vector__XXX
 SG_ IGN3State_By_VCU_HCU_FCU : 179|2@1+ (1,0) [0|0] "" Vector__XXX
 SG_ IGN3State_By_HU : 181|2@1+ (1,0) [0|0] "" Vector__XXX
 SG_ IGN3CutOffState : 183|3@1+ (1,0) [0|0] ""  GW_PSU_3RD_FD,GW_PSU_AST_FD,GW_PSU_DRV_FD,GW_PSU_RL_FD,GW_PSU_RR_FD,SHVU_3RD_FD,SHVU_CCS_FD,SHVU_FRNT_FD,SHVU_REAR_FD,SHVU_RL_FD,SHVU_RR_FD
 SG_ IGN3State_By_ActiveOn : 186|2@1+ (1,0) [0|0] ""  BLTN_CAM_FD
 SG_ SeatBeltSwSta_Drv : 24|2@1+ (1,0) [0|0] "" Vector__XXX
 SG_ SeatBeltSwSta_1stCtr : 26|2@1+ (1,0) [0|0] "" Vector__XXX
 SG_ SeatBeltSwSta_Asst : 28|2@1+ (1,0) [0|0] ""  GW_SAU_DRV_FD
 SG_ SeatBeltSwSta_2ndLft : 30|2@1+ (1,0) [0|0] "" Vector__XXX
 SG_ SeatBeltSwSta_2ndCtr : 32|2@1+ (1,0) [0|0] "" Vector__XXX
 SG_ SeatBeltSwSta_2ndRt : 34|2@1+ (1,0) [0|0] "" Vector__XXX
 SG_ SeatBeltSwSta_3rdLft : 36|2@1+ (1,0) [0|0] "" Vector__XXX
 SG_ SeatBeltSwSta_3rdCtr : 38|2@1+ (1,0) [0|0] "" Vector__XXX
 SG_ SeatBeltSwSta_3rdRt : 40|2@1+ (1,0) [0|0] "" Vector__XXX
 SG_ SeatBelt4th_InstallInfo : 42|3@1+ (1,0) [0|0] "" Vector__XXX
 SG_ PDCex_CurtainOpt : 45|2@1+ (1,0) [0|0] ""  ATS_FD
 SG_ Reprogram_State_PDC2 : 47|2@1+ (1,0) [0|0] "" Vector__XXX
 SG_ PDC_DataLog_GetCanLog : 49|3@1+ (1,0) [0|0] "" Vector__XXX
 SG_ Warn_RrCTRSBRMATSwSta : 56|2@1+ (1,0) [0|0] "" Vector__XXX
 SG_ C_3rdRCSBRMatSw : 58|1@1+ (1,0) [0|0] "" Vector__XXX
 SG_ DriveTypeOption : 64|2@1+ (1,0) [0|0] ""  ATS_FD,BLTN_CAM_FD,FCS_FD,FLLR_FD,GW_PSU_AST_FD,GW_PSU_DRV_FD,GW_PSU_RL_FD,GW_PSU_RR_FD,GW_SAU_DRV_FD,PSB_FD,SGU_FD,SHVU_3RD_FD,SHVU_FRNT_FD,SHVU_REAR_FD
 SG_ AutoLtOpt : 66|2@1+ (1,0) [0|0] "" Vector__XXX
 SG_ HLmpLoHiOptLtSrcTyp : 68|3@1+ (1,0) [0|0] "" Vector__XXX
 SG_ C_StrgWhlHeatingOpt : 71|2@1+ (1,0) [0|0] "" Vector__XXX
 SG_ C_StrgWhlHeatingSWInf : 73|2@1+ (1,0) [0|0] "" Vector__XXX
 SG_ ICU_MtGearPosRSta : 75|2@1+ (1,0) [0|0] ""  BLTN_CAM_FD
 SG_ C_AutoLeverManualSW : 77|2@1+ (1,0) [0|0] "" Vector__XXX
 SG_ Warn_HoodSwMemorySta : 79|2@1+ (1,0) [0|0] "" Vector__XXX
 SG_ Warn_PrkngBrkSwSta : 81|2@1+ (1,0) [0|0] ""  GW_PSU_3RD_FD,GW_PSU_AST_FD,GW_PSU_RL_FD,GW_PSU_RR_FD,SHVU_RL_FD,SHVU_RR_FD
 SG_ PrkngBrkNotchSwState : 83|2@1+ (1,0) [0|0] "" Vector__XXX
 SG_ Warn_BrkFldSwSta : 85|2@1+ (1,0) [0|0] "" Vector__XXX
 SG_ Warn_WshrFldSwSta : 87|2@1+ (1,0) [0|0] "" Vector__XXX
 SG_ Warn_DrvStBltSwSta : 89|2@1+ (1,0) [0|0] ""  ATS_FD,GW_PSU_DRV_FD,GW_SAU_DRV_FD,PSB_FD
 SG_ Warn_AsstStBltSwSta : 91|2@1+ (1,0) [0|0] ""  GW_PSU_AST_FD,GW_PSU_RL_FD,GW_SAU_DRV_FD,PSB_FD
 SG_ Warn_RrLftStBltSwSta : 93|2@1+ (1,0) [0|0] ""  GW_PSU_AST_FD,GW_PSU_DRV_FD,GW_PSU_RL_FD,PSB_FD
 SG_ Warn_RrCtrStBltSwSta : 95|2@1+ (1,0) [0|0] ""  PSB_FD
 SG_ Warn_RrRtStBltSwSta : 97|2@1+ (1,0) [0|0] ""  GW_PSU_AST_FD,GW_PSU_DRV_FD,GW_PSU_RR_FD,PSB_FD
 SG_ C_3rdRLSeatBeltSW : 99|1@1+ (1,0) [0|0] ""  ARS_FD,GW_PSU_RL_FD,PSB_FD,WPC2_FD

BO_ 995 PDC_FD_04_200ms: 16 CGW_CCU
 SG_ PDC_FD_Crc4Val : 0|16@1+ (1,0) [0|0] "" Vector__XXX
 SG_ PDC_FD_AlvCnt4Val : 16|8@1+ (1,0) [0|0] "" Vector__XXX
 SG_ ICU_Haptic_OPT : 64|2@1+ (1,0) [0|0] "" Vector__XXX
 SG_ HSWS_SysWrngSta_ICU : 66|2@1+ (1,0) [0|0] "" Vector__XXX
 SG_ ICU_PwrWdwMvInhbtSta : 68|1@1+ (1,0) [0|0] "" Vector__XXX
 SG_ Warn_OSMirrFoldSwState : 69|2@1+ (1,0) [0|0] "" Vector__XXX
 SG_ USM_OneTouchTrnSigFuncSta : 71|3@1+ (1,0) [0|0] "" Vector__XXX
 SG_ ExtLamp_TrnSigLmpLftSwSta : 74|2@1+ (1,0) [0|0] "" Vector__XXX
 SG_ ExtLamp_TrnSigLmpRtSwSta : 76|2@1+ (1,0) [0|0] "" Vector__XXX
 SG_ Lamp_LaneChgTrnSigLftSwSta_ICU : 78|2@1+ (1,0) [0|0] "" Vector__XXX
 SG_ Lamp_LaneChgTrnSigRtSwSta_ICU : 80|2@1+ (1,0) [0|0] "" Vector__XXX
 SG_ Lamp_TrnSigLmpLftOnReq : 89|2@1+ (1,0) [0|0] ""  BLTN_CAM_FD
 SG_ Lamp_TrnSigLmpRtOnReq : 91|2@1+ (1,0) [0|0] ""  BLTN_CAM_FD
 SG_ Lamp_TrnSigLmpLftActiveSt : 93|2@1+ (1,0) [0|0] "" Vector__XXX
 SG_ Lamp_TrnSigLmpRtActiveSt : 95|2@1+ (1,0) [0|0] "" Vector__XXX
 SG_ TrnLmpSeqEnblCmd : 97|2@1+ (1,0) [0|0] "" Vector__XXX
 SG_ CrashHazardLampOnReq : 99|2@1+ (1,0) [0|0] "" Vector__XXX

BO_ 994 PDC_FD_03_200ms: 16 CGW_CCU
 SG_ PDC_FD_Crc3Val : 0|16@1+ (1,0) [0|0] ""  GW_PSU_DRV_FD
 SG_ DoorLock_SoftKeySysFailSta : 100|4@1+ (1,0) [0|0] "" Vector__XXX
 SG_ PDC_FD_AlvCnt3Val : 16|8@1+ (1,0) [0|0] ""  GW_PSU_DRV_FD
 SG_ Warn_DrvDrSwSta : 64|2@1+ (1,0) [0|0] ""  BLTN_CAM_FD,DCM_FD,FLLR_FD,GW_PSU_DRV_FD,PSB_FD,RWPC_FD,WPC2_FD,WPC_FD
 SG_ Warn_AsstDrSwSta : 66|2@1+ (1,0) [0|0] ""  BLTN_CAM_FD,DCM_FD,FLLR_FD,GW_PSU_AST_FD,GW_PSU_RL_FD,GW_SAU_DRV_FD,PSB_FD,RWPC_FD,WPC2_FD,WPC_FD
 SG_ Warn_RrLftDrSwSta : 68|2@1+ (1,0) [0|0] ""  BLTN_CAM_FD,DCM_FD,FLLR_FD,GW_PSU_AST_FD,GW_PSU_RL_FD,GW_PSU_RR_FD,PSB_FD,RWPC_FD,SHVU_RL_FD,WPC2_FD,WPC_FD
 SG_ Warn_RrRtDrSwSta : 70|2@1+ (1,0) [0|0] ""  BLTN_CAM_FD,DCM_FD,FLLR_FD,GW_PSU_AST_FD,GW_PSU_RL_FD,GW_PSU_RR_FD,PSB_FD,RWPC_FD,SHVU_RR_FD,WPC2_FD,WPC_FD
 SG_ Warn_HoodSwSta : 72|2@1+ (1,0) [0|0] ""  BLTN_CAM_FD
 SG_ DoorLock_DrvDrUnLkSta : 74|2@1+ (1,0) [0|0] ""  GW_PSU_DRV_FD
 SG_ DoorLock_AsstDrUnLkSta : 76|2@1+ (1,0) [0|0] "" Vector__XXX
 SG_ DoorLock_RrLftDrUnLkSta : 78|2@1+ (1,0) [0|0] "" Vector__XXX
 SG_ DoorLock_RrRtDrUnLkSta : 80|2@1+ (1,0) [0|0] "" Vector__XXX
 SG_ DoorLock_DrvKeyLkSwSta : 82|2@1+ (1,0) [0|0] "" Vector__XXX
 SG_ DoorLock_DrvKeyUnLkSwSta : 84|2@1+ (1,0) [0|0] "" Vector__XXX
 SG_ DoorLock_CtrlDrLkSwSta_ICU : 86|2@1+ (1,0) [0|0] "" Vector__XXX
 SG_ DoorLock_CtrlDrUnLkSwSta_ICU : 88|2@1+ (1,0) [0|0] "" Vector__XXX
 SG_ DoorLock_CtrlDrLkUnLkSwSta_ICU : 90|2@1+ (1,0) [0|0] "" Vector__XXX
 SG_ C_CrashUnlockState : 92|2@1+ (1,0) [0|0] ""  BLTN_CAM_FD
 SG_ Lamp_LedHdLmpSta : 94|2@1+ (1,0) [0|0] "" Vector__XXX
 SG_ Warn_ChaDrSwFrtSta : 96|2@1+ (1,0) [0|0] "" Vector__XXX
 SG_ Warn_ChaDrSwRrSta : 98|2@1+ (1,0) [0|0] "" Vector__XXX

BO_ 997 PDC_FD_11_200ms: 24 CGW_CCU
 SG_ PDC_FD_Crc11Val : 0|16@1+ (1,0) [0|0] "" Vector__XXX
 SG_ ICU_BS1ValFlagSta : 105|2@1+ (1,0) [0|0] "" Vector__XXX
 SG_ ICU_BS1ErrRes : 107|2@1+ (1,0) [0|0] "" Vector__XXX
 SG_ ICU_BS2SoC : 109|8@1+ (1,0) [0|0] ""  BLTN_CAM_FD
 SG_ ICU_BS2NCap : 117|8@1+ (1,0) [0|0] "" Vector__XXX
 SG_ ICU_BS2OpnCirVol : 125|12@1+ (0.001,10) [0|0] "" Vector__XXX
 SG_ ICU_BS2_FSOC : 137|1@1+ (1,0) [0|0] "" Vector__XXX
 SG_ ICU_BS2_FSOH : 138|1@1+ (1,0) [0|0] "" Vector__XXX
 SG_ ICU_BS2_FSOF : 139|1@1+ (1,0) [0|0] "" Vector__XXX
 SG_ ICU_BS2_FQSTAT : 140|1@1+ (1,0) [0|0] "" Vector__XXX
 SG_ ICU_BS2SoH : 141|8@1+ (1,0) [0|0] "" Vector__XXX
 SG_ ICU_BS2SoF : 149|8@1+ (0.05,0) [0|0] "" Vector__XXX
 SG_ PDC_EasyPwrOffSpprt : 157|1@1+ (1,0) [0|0] "" Vector__XXX
 SG_ PDC_FD_AlvCnt11Val : 16|8@1+ (1,0) [0|0] "" Vector__XXX
 SG_ ICU_BS1BatVol_Dis : 50|14@1+ (0.001,6) [0|0] "V" Vector__XXX
 SG_ ICU_BS1IBAT_Conversion : 64|18@1+ (10,-1200000) [-1200000|1200000] "mA" Vector__XXX
 SG_ ICU_BS1BatVol : 82|14@1+ (0.001,6) [0|0] "" Vector__XXX
 SG_ ICU_BS1BatTemp : 96|9@1+ (0.5,-40) [0|0] "" Vector__XXX

BO_ 996 PDC_FD_10_200ms: 16 CGW_CCU
 SG_ PDC_FD_Crc10Val : 0|16@1+ (1,0) [0|0] ""  GW_PSU_DRV_FD
 SG_ PDC_PwrOnModePowerReq : 107|2@1+ (1,0) [0|0] "" Vector__XXX
 SG_ PDC_LeadAcidBatType : 109|5@1+ (1,0) [0|0] "" Vector__XXX
 SG_ PDC_BatPwrClassOpt : 114|2@1+ (1,0) [0|0] "" Vector__XXX
 SG_ PDC_MainLBMOpt : 116|2@1+ (1,0) [0|0] ""  BLTN_CAM_FD
 SG_ PDC_FD_AlvCnt10Val : 16|8@1+ (1,0) [0|0] ""  GW_PSU_DRV_FD
 SG_ ICU_PowerAutoCutModSta : 64|2@1+ (1,0) [0|0] ""  BLTN_CAM_FD,GW_PSU_3RD_FD,GW_PSU_AST_FD,GW_PSU_DRV_FD,GW_PSU_RL_FD,GW_PSU_RR_FD,SHVU_3RD_FD,SHVU_CCS_FD,SHVU_FRNT_FD,SHVU_REAR_FD,SHVU_RL_FD,SHVU_RR_FD
 SG_ Autocut_DlvryModSta : 66|2@1+ (1,0) [0|0] "" Vector__XXX
 SG_ ICU_SoCBattStaMsgReq : 68|2@1+ (1,0) [0|0] "" Vector__XXX
 SG_ Batt_SoCWarningValue : 70|8@1+ (1,0) [0|0] "%" Vector__XXX
 SG_ ICU_BattAutoCutPreWrng : 78|2@1+ (1,0) [0|0] ""  BLTN_CAM_FD
 SG_ OTAModeACCOffReq : 80|2@1+ (1,0) [0|0] "" Vector__XXX
 SG_ C_ICUIGNOffReq : 82|2@1+ (1,0) [0|0] "" Vector__XXX
 SG_ IGN_AutoOff_WarnSta : 84|2@1+ (1,0) [0|0] "" Vector__XXX
 SG_ IGN_AutoOff_WarnSta_CLU : 86|2@1+ (1,0) [0|0] "" Vector__XXX
 SG_ PDC_BatPwrStateClassA : 88|2@1+ (1,0) [0|0] "" Vector__XXX
 SG_ PDC_BatPwrStateClassB : 90|2@1+ (1,0) [0|0] "" Vector__XXX
 SG_ PDC_BatPwrStateClassC : 92|2@1+ (1,0) [0|0] "" Vector__XXX
 SG_ PLBMAvailableState : 94|1@1+ (1,0) [0|0] "" Vector__XXX
 SG_ Bat_dischrg : 95|2@1+ (1,0) [0|0] "" Vector__XXX
 SG_ Bat12V_Chr_Req : 97|2@1+ (1,0) [0|0] ""  BLTN_CAM_FD
 SG_ ICU_BattMngAlert : 99|8@1+ (1,0) [0|0] "" Vector__XXX

BO_ 1047 GNSS_05_1000ms: 32 CGW_CCU
 SG_ GNSS_Crc5Val : 0|16@1+ (1,0) [0|0] "" Vector__XXX
 SG_ HU_GNSS_UTC_min : 104|8@1+ (1,0) [0|0] ""  BLTN_CAM_FD
 SG_ HU_GNSS_UTC_sec : 112|8@1+ (1,0) [0|0] ""  BLTN_CAM_FD
 SG_ HU_GNSS_UTC_offset : 120|8@1+ (1,0) [0|0] "Sec"  BLTN_CAM_FD
 SG_ HU_GNSS_PDOP : 128|16@1+ (0.00390625,0) [0|0] "" Vector__XXX
 SG_ HU_GNSS_HDOP : 144|16@1+ (0.00390625,0) [0|0] "" Vector__XXX
 SG_ GNSS_AlvCnt5Val : 16|8@1+ (1,0) [0|0] "" Vector__XXX
 SG_ HU_GNSS_VDOP : 160|16@1+ (0.00390625,0) [0|0] "" Vector__XXX
 SG_ HU_GNSS_DGPS_age : 192|8@1+ (1,0) [0|0] "Sec" Vector__XXX
 SG_ HU_GNSS_Fix_status : 200|4@1+ (1,0) [0|0] "" Vector__XXX
 SG_ HU_GNSS_TimeSource : 204|2@1+ (1,0) [0|0] "" Vector__XXX
 SG_ HU_GNSS_search : 206|2@1+ (1,0) [0|0] "" Vector__XXX
 SG_ HU_GNSS_DST : 208|2@1+ (1,0) [0|0] ""  BLTN_CAM_FD
 SG_ HU_GNSS_SV_count : 210|8@1+ (1,0) [0|0] "" Vector__XXX
 SG_ HU_GNSS_TimezoneOffset : 218|8@1- (15,0) [0|0] "minute"  BLTN_CAM_FD
 SG_ HU_GNSS_UTC_year : 64|16@1+ (1,0) [0|0] ""  BLTN_CAM_FD
 SG_ HU_GNSS_UTC_month : 80|8@1+ (1,0) [0|0] ""  BLTN_CAM_FD
 SG_ HU_GNSS_UTC_day : 88|8@1+ (1,0) [0|0] ""  BLTN_CAM_FD
 SG_ HU_GNSS_UTC_hour : 96|8@1+ (1,0) [0|0] ""  BLTN_CAM_FD

BO_ 849 IAU_FD_04_200ms: 32 CGW_CCU
 SG_ IAU_FD_Crc4Val : 0|16@1+ (1,0) [0|0] "0"  GW_PSU_DRV_FD
 SG_ IAU_DISPWrng : 104|4@1+ (1,0) [0|0] "" Vector__XXX
 SG_ IAU_DigitalKey2Opt : 120|3@1+ (1,0) [0|0] ""  WPC2_FD,WPC_FD
 SG_ IAUwFRULearnState : 124|2@1+ (1,0) [0|0] "" Vector__XXX
 SG_ IAUwFPMLearnState : 126|2@1+ (1,0) [0|0] "" Vector__XXX
 SG_ IAU_ValetDigitalkey : 128|2@1+ (1,0) [0|0] "" Vector__XXX
 SG_ IAU_DigitalKeyNumberOpt : 130|3@1+ (1,0) [0|0] "" Vector__XXX
 SG_ IAU_eSEReprogramSta : 133|2@1+ (1,0) [0|0] "" Vector__XXX
 SG_ IAU_DKOwnerSwapOption : 136|2@1+ (1,0) [0|0] "" Vector__XXX
 SG_ IAU_DgtKeyGrpPrflRval2 : 139|5@1+ (1,0) [0|0] "" Vector__XXX
 SG_ IAU_StartIdentifiedProfile : 144|3@1+ (1,0) [0|0] "" Vector__XXX
 SG_ IAU_DigitalKeyProfileRval2 : 147|5@1+ (1,0) [0|0] "" Vector__XXX
 SG_ IAU_NFCCard1SN : 152|32@1+ (1,0) [0|0] "" Vector__XXX
 SG_ IAU_FD_AlvCnt4Val : 16|8@1+ (1,0) [0|0] "0"  GW_PSU_DRV_FD
 SG_ IAU_DigitalKeyProcessingSta2 : 184|4@1+ (1,0) [0|0] "" Vector__XXX
 SG_ IAU_DigitalKeyExit2 : 188|4@1+ (1,0) [0|0] "" Vector__XXX
 SG_ IAU_UWBOnOffOpt : 200|2@1+ (1,0) [0|0] "" Vector__XXX
 SG_ IAU_UWBOnOffRVal : 202|2@1+ (1,0) [0|0] "" Vector__XXX
 SG_ IAU_StartIdentifiedProfile_Ext : 24|4@1+ (1,0) [0|0] "" Vector__XXX
 SG_ RSPA_UWBRspaExtRngSta : 246|2@1+ (1,0) [0|0] "" Vector__XXX
 SG_ RSPA_CanFltSta : 250|2@1+ (1,0) [0|0] "" Vector__XXX
 SG_ RSPA_BLESigErrSta : 252|2@1+ (1,0) [0|0] "" Vector__XXX
 SG_ RSPA_ConStat : 254|2@1+ (1,0) [0|0] "" Vector__XXX
 SG_ IAU_NewEVTerminalPhase2Opt : 29|1@1+ (1,0) [0|0] "" Vector__XXX
 SG_ IAU_ProfileIDRVal : 74|4@1+ (1,0) [0|0] ""  BLTN_CAM_FD,GW_PSU_DRV_FD,GW_SAU_DRV_FD,RCM_FD,RWPC_FD,SGU_FD,WPC2_FD,WPC_FD
 SG_ IAU_DigitalKeyProcessingSta : 80|4@1+ (1,0) [0|0] "" Vector__XXX
 SG_ IAU_DigitalKeyExit : 84|4@1+ (1,0) [0|0] "" Vector__XXX
 SG_ IAU_DigitalKeyEnblRVal : 88|2@1+ (1,0) [0|0] "" Vector__XXX
 SG_ IAU_OwnerPhnRegRVal : 90|2@1+ (1,0) [0|0] "" Vector__XXX
 SG_ IAU_NFCCard1RegRVal : 92|2@1+ (1,0) [0|0] "" Vector__XXX
 SG_ IAU_NFCCard2RegRVal : 94|2@1+ (1,0) [0|0] "" Vector__XXX

CM_ BO_ 870 "[PE] Periodic and On Event";
CM_ SG_ 870 HU_GW_Crc3Val "HU_GW_CyclicRedundancyCheck3Value";
CM_ SG_ 870 AVN_RSPA_Disp_Rdy "Signal to inform RSPA of AVN's display ready status
(RSPA 화면 표시 가능/불가능 상태를 알리기 위한 신호)";
CM_ SG_ 870 CF_AVN_ProfileIDRValue "This signal is User ID value in H/Unit.";
CM_ SG_ 870 HazardFromHUSVM "This signal is for Hazard control";
CM_ SG_ 870 OMUOSMirCtrl "This signal is for the OutSide Mirror Control (Fold or Unfold)";
CM_ SG_ 870 OTAUIStatus "Information of the status of Head Unit";
CM_ SG_ 870 C_TeleActiveStatus "This signal is for check TMS active status";
CM_ SG_ 870 HU_RTCCheck "Checking whether RTC of AVN and HCU is operationg normally.";
CM_ SG_ 870 HU_GW_AlvCnt3Val "HU_GW_AliveCounter3Value";
CM_ SG_ 870 HU_SWRCWarmerSet "HU SW button touch command for SWRC Warmer";
CM_ SG_ 870 HU_TrModeReq_PE "Trailer/Carrier Mode On/Off request";
CM_ SG_ 870 HU_TrBrakeTypeReq_PE "Trailer Brake Type request";
CM_ SG_ 870 HU_PopUpDnSafetyModeState "Safety Mode On/Off State by Popupdn";
CM_ SG_ 870 HU_ISG_OFF_Set_Req_PE "ISF OFF Set Request";
CM_ SG_ 870 AVN_MPA_SelBtnSta "Button input signal from HU to ADAS_PRK to request MPA operation";
CM_ SG_ 870 AVN_PRK_Cam_Status "If camera displaying meets error condition(red, green, black screen)";
CM_ SG_ 870 HU_DistanceUnit "Request to set CLU Distance Unit";
CM_ SG_ 870 HU_AliveStatus "Information of the status of Head Unit
0x00 : Headunit is booting so, Headunit cant display any state
0x01 : Headunit is normal state, Headunit could display according to MM CAN  command.
0x02 : Headunit is doing their internal process, so Headunit cant communicate with other node.
For CLU/SCC/eCall
-AVN System transmission signal";
CM_ SG_ 870 HU_MicActivity "HU send this signal to eCall for MIC using status.
eCall unit stop the diagonosis when received 0x1:Activated from HU
Otherwise, eCall unit keep diagnosis every 1 sec. and HU can not use MIC";
CM_ SG_ 870 CF_HU_GPSFlt "Information of GPS Fault 

0x0: Normal
0x1 : Fault operation
0x2 : RESERVED
0x3:Invalid";
CM_ SG_ 870 AVN_RSPA_CancelInput "Request Signal to cancel RSPA function";
CM_ BO_ 993 "[PE] Periodic and On Event";
CM_ SG_ 993 PDC_FD_Crc2Val "PDC_FD_CyclicRedundancyCheck2Value";
CM_ SG_ 993 Lamp_StpLmpLftOpnSta "Lamp_StopLampLeftOpenStatus ##2G## -  - C_StopLampLhOpenSts";
CM_ SG_ 993 Lamp_StpLmpRtOpnSta "Lamp_StopLampRightOpenStatus ##2G## -  - C_StopLampRhOpenSts";
CM_ SG_ 993 Lamp_HmslLmpOpnSta "HMSL_OpenStatus ##2G## -  - C_HMSLOpenSts";
CM_ SG_ 993 Lamp_DrlLmpLftOpnSta "Lamp_DrlLampLeftOpenStatus ##2G## -  - C_DRLLampLhOpenSts";
CM_ SG_ 993 Lamp_DrlLmpRtOpnSta "Lamp_DrlLampRightOpenStatus ##2G## -  - C_DRLLampRhOpenSts";
CM_ SG_ 993 Lamp_FrFgLmpLftOpnSta "Lamp_FrontFogLampLeftOpenStatus ##2G## -  - C_FrontFOGLhOpenSts";
CM_ SG_ 993 Lamp_FrFgLmpRtOpnSta "Lamp_FrontFogLampRightOpenStatus ##2G## -  - C_FrontFOGRhOpenSts";
CM_ SG_ 993 Lamp_CorneringLmpLftOpnSta "ExtLamp_CorneringLampLeftOpenStatus ##2G## -  - C_CorneringLpLhOpenState";
CM_ SG_ 993 Lamp_CorneringLmpRtOpnSta "ExtLamp_CorneringLampRightOpenStatus ##2G## -  - C_CorneringLpRhOpenState";
CM_ SG_ 993 Lamp_StcBendingLmpLftOpnSta "Lamp_StaticBendingLampLeftOpenStatus ##2G## -  - C_SBendingLhOpenSts";
CM_ SG_ 993 Lamp_StcBendingLmpRtOpnSta "Lamp_StaticBendingLampRightOpenStatus ##2G## -  - C_SBendingRhOpenSts";
CM_ SG_ 993 Lamp_FrTurnSigLmpLftPCLSta "T/SIG Lamp Front Left PCL Status";
CM_ SG_ 993 Lamp_FrTurnSigLmpRtPCLSta "T/SIG Lamp Front Right PCL Status";
CM_ SG_ 993 Lamp_RrTurnSigLmpLftPCLSta "T/SIG Lamp Rear Left PCL Status";
CM_ SG_ 993 Lamp_RrTurnSigLmpRtPCLSta "T/SIG Lamp Rear Right PCL Status";
CM_ SG_ 993 HzrdSwPushSta "Hazard Switch(self return type) Push State";
CM_ SG_ 993 Lamp_LftTrnFaultSta "Left Turn Lamp Fault Status";
CM_ SG_ 993 Lamp_RtTrnFaultSta "Right Turn Lamp Fault Status";
CM_ SG_ 993 FrtTurnLampOptSta "Front Turn Signal Lamp EOL Option State";
CM_ SG_ 993 RrTurnLampOptSta "Rear Turn Signal Lamp EOL Option State";
CM_ SG_ 993 PDC_TrunkTgateWarnLampMode "Trunk Tailgate Warning Lamp Emergency Mode Status";
CM_ SG_ 993 PDC_FD_AlvCnt2Val "PDC_FD_AliveCounter2Value";
CM_ SG_ 993 IntLamp_InlTailLmpSta "IntLamp_InternalTailLampStatus ##2G## -  - C_IntTailAct,CF_Gway_IntTailAct";
CM_ SG_ 993 Lamp_FootLampOnReq "##2G## -  - C_FootLpOn";
CM_ SG_ 993 Lamp_MoodLampOnReq "##2G## -  - C_MoodLpOn";
CM_ SG_ 993 USM_FuncForMdLmpBrgtSta "USM_FunctionForMoodLampBrightStatus ##2G## -  - CF_Gway_MoodLpBrightRValue";
CM_ SG_ 993 Lamp_HdLmpLoLftOpnSta "Lamp_HeadLampLowLeftOpenStatus ##2G## -  - C_HLampLowLhOpenSts";
CM_ SG_ 993 Lamp_HdLmpLoRtOpnSta "Lamp_HeadLampLowRightOpenStatus ##2G## -  - C_HLampLowRhOpenSts";
CM_ SG_ 993 Lamp_HdLmpBiFuncLftOpnSta "Lamp_HeadLampBiFunctionLeftOpenStatus ##2G## -  - C_HLampBifuncLhOpenSts";
CM_ SG_ 993 Lamp_HdLmpBiFuncRtOpnSta "Lamp_HeadLampBiFunctionRightOpenStatus ##2G## -  - C_HLampBifuncRhOpenSts";
CM_ SG_ 993 Lamp_HdLmpHiLftOpnSta "Lamp_HeadLampHighLeftOpenStatus ##2G## -  - C_HLampHighLhOpenSts";
CM_ SG_ 993 Lamp_HdLmpHiRtOpnSta "Lamp_HeadLampHighRightOpenStatus ##2G## -  - C_HLampHighRhOpenSts";
CM_ SG_ 993 ExtLamp_HzrdSwSta "ExtLamp_HazardSwitchStatus ##2G## -  - C_HazardSw,CF_Gway_HazardSw";
CM_ SG_ 993 Lamp_FrTrnSigLmpLftOpnSta "Lamp_FrontTurnSignalLampLeftOpenStatus ##2G## -  - C_FrontTSIGLhOpenSts";
CM_ SG_ 993 Lamp_FrTrnSigLmpRtOpnSta "Lamp_FrontTurnSignalLampRightOpenStatus ##2G## -  - C_FrontTSIGRhOpenSts";
CM_ SG_ 993 Lamp_RrTrnSigLmpLftOpnSta "Lamp_RearTurnSignalLampLeftOpenStatus ##2G## -  - C_RearTSIGLhOpenSts";
CM_ SG_ 993 Lamp_RrTrnSigLmpRtOpnSta "Lamp_RearTurnSignalLampRightOpenStatus ##2G## -  - C_RearTSIGRhOpenSts";
CM_ SG_ 993 Brake_SwSta_ICU "Brake Switch Status ##2G## -  - C_BrakeSw";
CM_ BO_ 992 "[PE] Periodic and On Event";
CM_ SG_ 992 PDC_FD_Crc1Val "PDC_FD_CyclicRedundancyCheck1Value";
CM_ SG_ 992 C_3rdRRSeatBeltSW "3rd Rear Right Seat Belt Switch Status";
CM_ SG_ 992 Warn_PassStOccSta "Warn_PassengerSeatOccupyStatus ##2G## -  - C_SBRMatSw";
CM_ SG_ 992 Warn_RrLftSBRMATSwSta "##2G## -  - C_RLSBRMatSw";
CM_ SG_ 992 Warn_RrRhtSBRMATSwSta "##2G## -  - C_RRSBRMatSw";
CM_ SG_ 992 ChildLock_ActnFlSta "ChildLock_ActuationFailedStatus ##2G## -  - C_ChildLockFail";
CM_ SG_ 992 DoorLock_LkOutSta "DoorLock_LockOutputStatus ##2G## -  - C_LockUnlockOutState";
CM_ SG_ 992 VSAutoDrLkRetryFailSta "Door lock fail status after vehicle speed auto door lock retry 3 times";
CM_ SG_ 992 Trunk_TrnkTlgtOutReleaseSwSta "Trunk_TrunkTailgateOutReleaseSwitchStatus ##2G## -  - C_TrunkTgOtrReleaseSW";
CM_ SG_ 992 Trunk_TrnkInReleaseSwSta "Trunk_TrunkInnerReleaseSwitchStatus ##2G## -  - C_TrunkInnerReleaseSw";
CM_ SG_ 992 Trunk_GlvBxTrnkLkSwSta "Trunk_GloveBoxTrunkLockSwitchStatus ##2G## -  - C_GloveBoxTrunkLockSw";
CM_ SG_ 992 Trunk_TrnkTlgtSwSta "Trunk_TrunkTailgateSwitchStatus ##2G## -  - C_TrunkTgSw,CF_Gway_TrunkTgSw,Trunk_TrnkTlgtSwSta";
CM_ SG_ 992 Trunk_TlgtFullOpnSwSta "Trunk_TailGateFullOpenSwitchStatus ##2G## -  - C_TgFullOpenSW";
CM_ SG_ 992 Trunk_TrnkTlgtReleaseRlySta "Trunk_TrunkTailgateReleaseRelayStatus ##2G## -  - C_TrunkTgReleaseRlyAct";
CM_ SG_ 992 FrtWiper_ParkingSwState "Front wiper parking switch state";
CM_ SG_ 992 PDC_FD_AlvCnt1Val "PDC_FD_AliveCounter1Value";
CM_ SG_ 992 OBCWakeupDrLock "This signal is for OBC wake-up";
CM_ SG_ 992 OBCWakeupDrUnlock "This signal is for OBC wake-up";
CM_ SG_ 992 Trunk_BgtOpnHzrdReq "Hazzard Request by Bedgate Open";
CM_ SG_ 992 Trunk_BgtOpnBzrReq "Buzzer Request by Bedgate Open";
CM_ SG_ 992 IGN3State "Output status of ignition 3";
CM_ SG_ 992 IGN3State_By_BMS "Output status of ignition 3 by BMS request";
CM_ SG_ 992 IGN3State_By_VCMS_HMU "Output status of ignition 3 by VCMS(PHEV/EV) or HMU(FCEV) request";
CM_ SG_ 992 IGN3State_By_AfterBlow "Output status of ignition 3 by DATC(FATC/MTC) request for after blow";
CM_ SG_ 992 IGN3State_By_Bat "Output status of ignition 3 by IBS or BMS request for HEV 12V auxiliary battery charging";
CM_ SG_ 992 IGN3State_By_VCU_HCU_FCU "Output status of ignition 3 by VCU(EV) or HCU(HEV/PHEV) or FCU(FCEV) request";
CM_ SG_ 992 IGN3State_By_HU "Output status of ignition 3 by HU(AVNT) or CCU request for CCS";
CM_ SG_ 992 IGN3CutOffState "Output status of ignition 3 Cut Off";
CM_ SG_ 992 IGN3State_By_ActiveOn "Output status of ignition 3 by Active On";
CM_ SG_ 992 Reprogram_State_PDC2 "PDC's reprogramming state";
CM_ SG_ 992 PDC_DataLog_GetCanLog "Request to get CAN logs to CCU";
CM_ SG_ 992 DriveTypeOption "##2G## -  - C_DriveTypeOption,CF_Gway_DriveTypeOption";
CM_ SG_ 992 AutoLtOpt "Auto Light 사양 적용 여부 및 적용 옵션 정보 출력 (미적용/적용)";
CM_ SG_ 992 HLmpLoHiOptLtSrcTyp "Head Low&High Lamp 사양 적용 여부 및 Light Source Type, 옵션 정보 출력";
CM_ SG_ 992 ICU_MtGearPosRSta "##2G## -  - C_InhibitRMT,CF_Gway_InhibitRMT";
CM_ SG_ 992 C_AutoLeverManualSW "Auto Lever Manual Switch Status Information";
CM_ SG_ 992 Warn_HoodSwMemorySta "Warn_HoodSwitchMemoryStatus ##2G## -  - CF_Hoodsw_memory,C_HoodSwMemory";
CM_ SG_ 992 Warn_PrkngBrkSwSta "Warn_ParkingBrakeSwitchStatus ##2G## -  - C_ParkBrakeSw";
CM_ SG_ 992 Warn_BrkFldSwSta "Warn_BrakeFluidSwitchStatus ##2G## -  - C_BrakeFluidSw,CF_Gway_BrakeFluidSw";
CM_ SG_ 992 Warn_WshrFldSwSta "Washer Fluid Switch Signal ##2G## -  - CF_Gway_WasherFluidSw";
CM_ SG_ 992 Warn_DrvStBltSwSta "Warn_DriverSeatbeltSwitchStatus ##2G## -  - C_DrvSeatBeltSw,CF_Gway_DrvSeatBeltSw";
CM_ SG_ 992 Warn_AsstStBltSwSta "Warn_AssistSeatBeltSwitchStatus ##2G## -  - C_AstSeatBeltSw,CF_Gway_AstSeatBeltSw";
CM_ SG_ 992 Warn_RrLftStBltSwSta "Warn_RearLeftSeatBeltSwitchStatus ##2G## -  - C_RLSeatBeltSw";
CM_ SG_ 992 Warn_RrCtrStBltSwSta "Warn_RearCenterSeatBeltSwitchStatus ##2G## -  - C_RCSeatBeltSw";
CM_ SG_ 992 Warn_RrRtStBltSwSta "Warn_RearRightSeatBeltSwitchStatus ##2G## -  - C_RRSeatBeltSw";
CM_ SG_ 992 C_3rdRLSeatBeltSW "3rd Rear Left Seat Belt Switch Status";
CM_ BO_ 995 "[PE] Periodic and On Event";
CM_ SG_ 995 PDC_FD_Crc4Val "PDC_FD_CyclicRedundancyCheck4Value";
CM_ SG_ 995 PDC_FD_AlvCnt4Val "PDC_FD_AliveCounter4Value";
CM_ SG_ 995 ICU_Haptic_OPT "Steering Wheel Haptic Warning Option Infomation ##2G## -  - C_ICU_Haptic_OPT";
CM_ SG_ 995 HSWS_SysWrngSta_ICU "HSWS Status ##2G## -  - C_HSWSSysStat";
CM_ SG_ 995 ICU_PwrWdwMvInhbtSta "ICU_PowerWindowMoveInhibitStatus ##2G##DDM -  - C_PwdwInhibit";
CM_ SG_ 995 Warn_OSMirrFoldSwState "Outside Mirror Folding Swtich Status";
CM_ SG_ 995 USM_OneTouchTrnSigFuncSta "USM_OneTouchTurnSignalFunctionStatus ##2G## -  - CF_Gway_OTTurnRValue,C_OTTurnRValue";
CM_ SG_ 995 ExtLamp_TrnSigLmpLftSwSta "ExtLamp_TurnSignalLampLeftSwitchStatus ##2G## -  - C_TsigLhSw";
CM_ SG_ 995 ExtLamp_TrnSigLmpRtSwSta "ExtLamp_TurnSignalLampRightSwitchStatus ##2G## -  - C_TsigRhSw";
CM_ SG_ 995 Lamp_LaneChgTrnSigLftSwSta_ICU "Lamp_LaneChangeTurnSignalLeftSwitchStatus##2G##CGW -CGW8 - 
CF_Gway_HDAIILaneChangeLh";
CM_ SG_ 995 Lamp_LaneChgTrnSigRtSwSta_ICU "Lamp_LaneChangeTurnSignalRightSwitchStatus##2G##CGW -CGW8 - 
CF_Gway_HDAIILaneChangeRh";
CM_ SG_ 995 Lamp_TrnSigLmpLftOnReq "Lamp_TurnSignalLampLeftOnRequest ##2G## -  - Lamp_TsigLmpFrtLftOnReq";
CM_ SG_ 995 Lamp_TrnSigLmpRtOnReq "Lamp_TurnSignalLampRightOnRequest ##2G## -  - Lamp_TSigLmpRtLftOnReq";
CM_ SG_ 995 Lamp_TrnSigLmpLftActiveSt "Lamp_TurnSignalLampLeftActiveState";
CM_ SG_ 995 Lamp_TrnSigLmpRtActiveSt "Lamp_TurnSignalLampRightActiveState";
CM_ BO_ 994 "[PE] Periodic and On Event";
CM_ SG_ 994 PDC_FD_Crc3Val "PDC_FD_CyclicRedundancyCheck3Value";
CM_ SG_ 994 PDC_FD_AlvCnt3Val "PDC_FD_AliveCounter3Value";
CM_ SG_ 994 Warn_DrvDrSwSta "DoorLock_DriverDoorSwitchStatus ##2G## -  - C_DrvDrSw,CF_Gway_DrvDrSw,Warn_DrvDrSwSta";
CM_ SG_ 994 Warn_AsstDrSwSta "Warn_AssistDoorSwitchStatus ##2G## -  - C_AstDrSw,CF_Gway_AstDrSw,Warn_AsstDrSwSta";
CM_ SG_ 994 Warn_RrLftDrSwSta "Warn_RearLeftDoorSwitchStatus ##2G## -  - C_RLDrSw,CF_Gway_RLDrSw,Warn_RrLftDrSwSta";
CM_ SG_ 994 Warn_RrRtDrSwSta "Warn_RearRightDoorSwitchStatus ##2G## -  - C_RRDrSw,CF_Gway_RRDrSw,Warn_RrRtDrSwSta";
CM_ SG_ 994 Warn_HoodSwSta "Warn_HoodSwitchStatus ##2G## -  - C_HoodSw,CF_Gway_HoodSw";
CM_ SG_ 994 DoorLock_DrvDrUnLkSta "DoorLock_DriverDoorUnLockStatus ##2G## -  - C_DrvUnlockState,CF_Gway_DrvUnlockState";
CM_ SG_ 994 DoorLock_AsstDrUnLkSta "DoorLock_AssistDoorUnLockStatus ##2G## -  - C_AstUnlockState,DoorLock_AsstDrUnLkSta";
CM_ SG_ 994 DoorLock_RrLftDrUnLkSta "DoorLock_RearLeftDoorUnLockStatus ##2G## -  - C_RLUnlockState,DoorLock_RrLftDrUnLkSta";
CM_ SG_ 994 DoorLock_RrRtDrUnLkSta "DoorLock_RearRightDoorUnLockStatus ##2G## -  - C_RRUnlockState,DoorLock_RrRtDrUnLkSta";
CM_ SG_ 994 DoorLock_DrvKeyLkSwSta "DoorLock_DriverKeyLockSwitchStatus ##2G## -  - C_DrvKeyLockSw";
CM_ SG_ 994 DoorLock_DrvKeyUnLkSwSta "DoorLock_DriverKeyUnLockSwitchStatus ##2G## -  - C_DrvKeyUnlockSw";
CM_ SG_ 994 DoorLock_CtrlDrLkSwSta_ICU "Central Door Lock Switch State(DRV or AST or RL or RR Door trim)";
CM_ SG_ 994 DoorLock_CtrlDrUnLkSwSta_ICU "Central Door Unlock Switch State(DRV or AST or RL or RR Door trim)";
CM_ SG_ 994 DoorLock_CtrlDrLkUnLkSwSta_ICU "Central Door Lock/Unlock Switch State(C/PAD, Integrated & self return type)";
CM_ SG_ 994 C_CrashUnlockState "Crash Unlock Active State";
CM_ SG_ 994 Lamp_LedHdLmpSta "Lamp_LedHeadLampStatus ##2G## -  - CF_Afs_LedHLStat";
CM_ SG_ 994 Warn_ChaDrSwFrtSta "##2G## - -  CF_Gway_ChaDrSwFrt";
CM_ SG_ 994 Warn_ChaDrSwRrSta "##2G## -  - CF_Gway_ChaDrSwRr";
CM_ BO_ 997 "[PE] Periodic and On Event";
CM_ SG_ 997 PDC_FD_Crc11Val "PDC_FD_CyclicRedundancyCheck11Value";
CM_ SG_ 997 ICU_BS1ValFlagSta "setting condition is depending on battery sensor self diagnosis information ##2G## -  - BS1_BSInvalidFlag";
CM_ SG_ 997 ICU_BS1ErrRes "Response_Error shall be set whenever a frame received by the node or a frame transmitted by the node contains an error in the response field. ##2G## -  - BS1_ErrorResp";
CM_ SG_ 997 ICU_BS2SoC "This signal is battery State of Charge as calculated by battery sensor. ##2G## -  - BS2_SOC,Batt_SoC";
CM_ SG_ 997 ICU_BS2NCap "Nominal capacity ##2G## -  - BS2_CNOM";
CM_ SG_ 997 ICU_BS2OpnCirVol "Last open circuit voltage ##2G## -  - BS2_OCV";
CM_ SG_ 997 ICU_BS2_FSOC "Fault State of SOC";
CM_ SG_ 997 ICU_BS2_FSOH "Fault State of SOH";
CM_ SG_ 997 ICU_BS2_FSOF "Fault State of SOF";
CM_ SG_ 997 ICU_BS2_FQSTAT "State of quiescent current";
CM_ SG_ 997 ICU_BS2SoH "This signal is battery State of Health(SOH) as calculated by battery sensor. ##2G## -  - BAT_SOH";
CM_ SG_ 997 ICU_BS2SoF "This signal is battery State of Function(SOF) as calculated by battery sensor. ##2G## -  - BAT_SOF";
CM_ SG_ 997 PDC_FD_AlvCnt11Val "PDC_FD_AliveCounter11Value";
CM_ SG_ 997 ICU_BS1BatVol_Dis "This is the battery voltage for displaying on the ANVT, CLU as measured on the battery pole by battery sensor.";
CM_ SG_ 997 ICU_BS1IBAT_Conversion "Actual battery current (resolution: 10mA)";
CM_ SG_ 997 ICU_BS1BatVol "This is the actual battery voltage as measured on the battery pole by battery sensor. ##2G## -  - BS1_VBAT";
CM_ SG_ 997 ICU_BS1BatTemp "This is actual battery electrolyte temperature value by battery sensor. ##2G## -  - BS1_TBAT";
CM_ BO_ 996 "[PE] Periodic and On Event";
CM_ SG_ 996 PDC_FD_Crc10Val "PDC_FD_CyclicRedundancyCheck10Value";
CM_ SG_ 996 PDC_PwrOnModePowerReq "This is for high voltage battery discharge request at Power On mode of EV";
CM_ SG_ 996 PDC_LeadAcidBatType "Lead Acid Battery Type Information";
CM_ SG_ 996 PDC_MainLBMOpt "M-LBM(Main LBM) Option";
CM_ SG_ 996 PDC_FD_AlvCnt10Val "PDC_FD_AliveCounter10Value";
CM_ SG_ 996 ICU_PowerAutoCutModSta "##2G## -  - CF_Gway_ICUPowerAutoCutMode";
CM_ SG_ 996 Autocut_DlvryModSta "Autocut_DeliveryModeStatus ##2G## -  - C_SJBDeliveryMode,CF_Gway_SJBDeliveryMode";
CM_ SG_ 996 ICU_SoCBattStaMsgReq "##2G## -  - Batt_SoCWarningAlertMsgReq";
CM_ SG_ 996 Batt_SoCWarningValue "Value of SoC warning level. ##2G## -  - Batt_SoCWarningValue";
CM_ SG_ 996 ICU_BattAutoCutPreWrng "This is a warning signal before blocking the dark current of the ICU by the battery SOC.";
CM_ SG_ 996 OTAModeACCOffReq "ACC off request during OTA mode for battery saver";
CM_ SG_ 996 C_ICUIGNOffReq "IGN off request(Not engine running state only) for battery saver";
CM_ SG_ 996 IGN_AutoOff_WarnSta "this signal is defined as the warning signal related with battery discharge";
CM_ SG_ 996 IGN_AutoOff_WarnSta_CLU "this signal is defined as the warning signal related with battery discharge";
CM_ SG_ 996 PDC_BatPwrStateClassA "Vehicle Low-Voltage Power State Class A";
CM_ SG_ 996 PDC_BatPwrStateClassB "Vehicle Low-Voltage Power State Class  B";
CM_ SG_ 996 PDC_BatPwrStateClassC "Vehicle Low-Voltage Power State Class  C";
CM_ SG_ 996 Bat_dischrg "Battery discharge notification flag #2G# Bat_dischrg";
CM_ SG_ 996 Bat12V_Chr_Req "12V lead acid battery charging request signal";
CM_ SG_ 996 ICU_BattMngAlert "This signal is for battery discharge warning.";
CM_ BO_ 1047 "[P] Periodic";
CM_ SG_ 1047 GNSS_Crc5Val "GNSS_CyclicRedundancyCheck5Value";
CM_ SG_ 1047 GNSS_AlvCnt5Val "GNSS_AliveCounter5Value";
CM_ SG_ 1047 HU_GNSS_Fix_status "GNSS fix status";
CM_ SG_ 1047 HU_GNSS_TimeSource "Time Source란 일종의 Module이 출력할 수 있는 시간정보의 유효성레벨을 타나내며, User는 RTC  or GPS(<1ms)  일때만 시간 정보 사용 가능";
CM_ SG_ 1047 HU_GNSS_DST "DST setting";
CM_ SG_ 1047 HU_GNSS_TimezoneOffset "Timezone Offset";
CM_ SG_ 1047 HU_GNSS_UTC_year "UTC year";
CM_ SG_ 1047 HU_GNSS_UTC_hour "UTC_HOUR";
CM_ BO_ 849 "[PE] Periodic and On Event";
CM_ SG_ 849 IAU_FD_Crc4Val "IAU_FD_CyclicRedundancyCheck4Value";
CM_ SG_ 849 IAU_DigitalKey2Opt "Digital Key2 Option Signal";
CM_ SG_ 849 IAU_ValetDigitalkey "Digital Key Valet Mode";
CM_ SG_ 849 IAU_DigitalKeyNumberOpt "This signal is for the digital key number type.";
CM_ SG_ 849 IAU_eSEReprogramSta "this signal is to mornitor the state of eSE reprograming.";
CM_ SG_ 849 IAU_DgtKeyGrpPrflRval2 "This signal indiactes digital key group number paired with selected profile";
CM_ SG_ 849 IAU_StartIdentifiedProfile "This signal Indicate Profile of vehicle start Identified";
CM_ SG_ 849 IAU_DigitalKeyProfileRval2 "This signal indiactes digital key number paired with selected profile";
CM_ SG_ 849 IAU_FD_AlvCnt4Val "IAU_FD_AliveCounter4Value";
CM_ SG_ 849 IAU_DigitalKeyProcessingSta2 "Digital Key USM settitng Process State 2";
CM_ SG_ 849 IAU_DigitalKeyExit2 "Digital Key USM setting Exit 2 Condition";
CM_ SG_ 849 IAU_StartIdentifiedProfile_Ext "This signal indicate Profile of vehicle start Identified";
CM_ SG_ 849 RSPA_UWBRspaExtRngSta "RSPA remote control range of UWB";
CM_ SG_ 849 RSPA_CanFltSta "RSPA_CANErrorState";
CM_ SG_ 849 RSPA_BLESigErrSta "RSPA_RFSignalErrorState";
CM_ SG_ 849 IAU_ProfileIDRVal "This signal Indicate the Current detected Profile ID by IAU.";
CM_ SG_ 849 IAU_DigitalKeyProcessingSta "Digital Key USM settitng Process State";
CM_ SG_ 849 IAU_DigitalKeyExit "Digital Key USM setting Exit Condition";
CM_ SG_ 849 IAU_DigitalKeyEnblRVal "Digital Key Function Enable / Disable flag (Fob is required for changing flag)";
CM_ SG_ 849 IAU_OwnerPhnRegRVal "Vehicle Owner's Phone is Registered for Digital Key function";
CM_ SG_ 849 IAU_NFCCard1RegRVal "NFC Card 1 is Registered for Digital Key function";
CM_ SG_ 849 IAU_NFCCard2RegRVal "NFC Card 2 is Registered for Digital Key function";
BA_DEF_ BO_  "GenMsgEVName" STRING ;
BA_DEF_ BO_  "NmAsrMessage" ENUM  "No","Yes";
BA_DEF_ BO_  "DiagState" ENUM  "No","Yes";
BA_DEF_ BO_  "DiagRequest" ENUM  "No","Yes";
BA_DEF_ BO_  "TpMessage" ENUM  "No","Yes";
BA_DEF_ BO_  "UsrMsgIDSforwardDeviation" INT 0 100;
BA_DEF_ BO_  "UsrMsgIDSbackwardDeviation" INT 50 1000;
BA_DEF_ BO_  "GenMsgCycleTime" INT 0 2000;
BA_DEF_ BO_  "GenMsgStartDelayTime" INT 0 2000;
BA_DEF_ BO_  "GenMsgSendType" ENUM  "Cyclic","NoMsgSendType";
BA_DEF_ BO_  "GenMsgCycleTimeFast" INT 0 500;
BA_DEF_ BO_  "GenMsgDelayTime" INT 0 20;
BA_DEF_ BO_  "GenMsgILSupport" ENUM  "No","Yes";
BA_DEF_ BO_  "GenMsgNrOfRepetition" INT 0 3;
BA_DEF_ BO_  "VFrameFormat" ENUM  "StandardCAN","ExtendedCAN","reserved","reserved","reserved","reserved","reserved","reserved","reserved","reserved","reserved","reserved","reserved","reserved","StandardCAN_FD","ExtendedCAN_FD";
BA_DEF_ SG_  "UserSigValidity" ENUM  "B+","ACC","IG","IG1","IG2","IG3","IG1 or IG2","IG1 or IG3","Undef";
BA_DEF_ SG_  "TimeoutValue" STRING ;
BA_DEF_ SG_  "UsrSigPurpose" ENUM  "Undef","FN","DIAG","DIAG(Req)","DIAG(Res)","DIAG(Func)","DEV","CCP","NM","TP";
BA_DEF_ SG_  "GenSigStartValue" INT 0 1215752192;
BA_DEF_ SG_  "NetworkRequest" ENUM  "Yes","No";
BA_DEF_ SG_  "NetworkRequestHoldingTime" INT 0 65535;
BA_DEF_ SG_  "Description" STRING ;
BA_DEF_ SG_  "Version" STRING ;
BA_DEF_ SG_  "GenSigEnvVarType" ENUM  "Int","Float","Undef";
BA_DEF_ SG_  "GenSigSendType" ENUM  "Cyclic","OnWrite","OnWriteWithRepetition","OnChange","OnChangeWithRepetition","IfActive","IfActiveWithRepetition","NoSigSendType","OnChangeAndIfActive","OnChangeAndIfActiveWithRepetition";
BA_DEF_ SG_  "GwSigLatencyTime" INT 0 65536;
BA_DEF_ SG_  "GwSigMissingSourceType" ENUM  "Undef","OldValue","DefaultValue","InitialValue";
BA_DEF_ SG_  "NWM-WakeupAllowed" ENUM  "<n.a.>";
BA_DEF_ SG_  "RoutingFactor" INT 1 1215752192;
BA_DEF_ SG_  "SystemSignalLongSymbol" STRING ;
BA_DEF_REL_ BU_SG_REL_  "GenSigTimeoutTime" INT 0 7000;
BA_DEF_DEF_  "GenMsgEVName" "@Signame";
BA_DEF_DEF_  "NmAsrMessage" "No";
BA_DEF_DEF_  "DiagState" "No";
BA_DEF_DEF_  "DiagRequest" "No";
BA_DEF_DEF_  "TpMessage" "No";
BA_DEF_DEF_  "UsrMsgIDSforwardDeviation" 10;
BA_DEF_DEF_  "UsrMsgIDSbackwardDeviation" 100;
BA_DEF_DEF_  "GenMsgCycleTime" 200;
BA_DEF_DEF_  "GenMsgStartDelayTime" 0;
BA_DEF_DEF_  "GenMsgSendType" "NoMsgSendType";
BA_DEF_DEF_  "GenMsgCycleTimeFast" 40;
BA_DEF_DEF_  "GenMsgDelayTime" 20;
BA_DEF_DEF_  "GenMsgILSupport" "Yes";
BA_DEF_DEF_  "GenMsgNrOfRepetition" 3;
BA_DEF_DEF_  "VFrameFormat" "StandardCAN";
BA_DEF_DEF_  "UserSigValidity" "IG";
BA_DEF_DEF_  "TimeoutValue" "";
BA_DEF_DEF_  "UsrSigPurpose" "FN";
BA_DEF_DEF_  "GenSigStartValue" 0;
BA_DEF_DEF_  "NetworkRequest" "No";
BA_DEF_DEF_  "NetworkRequestHoldingTime" 0;
BA_DEF_DEF_  "Description" "";
BA_DEF_DEF_  "Version" "";
BA_DEF_DEF_  "GenSigEnvVarType" "Undef";
BA_DEF_DEF_  "GenSigSendType" "NoSigSendType";
BA_DEF_DEF_  "GwSigLatencyTime" 40;
BA_DEF_DEF_  "GwSigMissingSourceType" "Undef";
BA_DEF_DEF_  "NWM-WakeupAllowed" "<n.a.>";
BA_DEF_DEF_  "RoutingFactor" 1;
BA_DEF_DEF_REL_ "GenSigTimeoutTime" 500;
BA_DEF_DEF_  "SystemSignalLongSymbol" "";
BA_ "GenMsgStartDelayTime" BO_ 870 50;
BA_ "GenMsgSendType" BO_ 870 0;
BA_ "VFrameFormat" BO_ 870 14;
BA_ "GenMsgSendType" BO_ 993 0;
BA_ "VFrameFormat" BO_ 993 14;
BA_ "GenMsgSendType" BO_ 992 0;
BA_ "VFrameFormat" BO_ 992 14;
BA_ "GenMsgSendType" BO_ 995 0;
BA_ "VFrameFormat" BO_ 995 14;
BA_ "GenMsgSendType" BO_ 994 0;
BA_ "VFrameFormat" BO_ 994 14;
BA_ "GenMsgStartDelayTime" BO_ 997 10;
BA_ "GenMsgSendType" BO_ 997 0;
BA_ "VFrameFormat" BO_ 997 14;
BA_ "GenMsgStartDelayTime" BO_ 996 10;
BA_ "GenMsgSendType" BO_ 996 0;
BA_ "VFrameFormat" BO_ 996 14;
BA_ "GenMsgNrOfRepetition" BO_ 1047 0;
BA_ "GenMsgCycleTimeFast" BO_ 1047 0;
BA_ "GenMsgCycleTime" BO_ 1047 1000;
BA_ "GenMsgSendType" BO_ 1047 0;
BA_ "VFrameFormat" BO_ 1047 14;
BA_ "GenMsgStartDelayTime" BO_ 849 40;
BA_ "GenMsgSendType" BO_ 849 0;
BA_ "VFrameFormat" BO_ 849 14;
BA_ "Version" SG_ 870 HU_GW_Crc3Val "22.10.20";
BA_ "UserSigValidity" SG_ 870 HU_GW_Crc3Val 3;
BA_ "GenSigStartValue" SG_ 870 HU_GW_Crc3Val 65535;
BA_ "GenSigSendType" SG_ 870 HU_GW_Crc3Val 4;
BA_ "Description" SG_ 870 HU_GW_Crc3Val "The data area for CRC calculation is based on the data length (DLC) of the message DB.

The CRC shall be calculated over the entire data block (excluding the CRC bytes) including the user data, alive counter and Data ID



- CRC Polynomial (0x1021) , Ini";
BA_ "Version" SG_ 870 HU_FrGlsHtdSW "25.08.00";
BA_ "UserSigValidity" SG_ 870 HU_FrGlsHtdSW 7;
BA_ "GenSigSendType" SG_ 870 HU_FrGlsHtdSW 4;
BA_ "Description" SG_ 870 HU_FrGlsHtdSW "This signal is for the W/S GLASS HEATER control";
BA_ "Version" SG_ 870 AVN_RSPA_Disp_Rdy "22.06.01";
BA_ "UserSigValidity" SG_ 870 AVN_RSPA_Disp_Rdy 0;
BA_ "GenSigStartValue" SG_ 870 AVN_RSPA_Disp_Rdy 3;
BA_ "GenSigSendType" SG_ 870 AVN_RSPA_Disp_Rdy 4;
BA_ "Version" SG_ 870 CF_AVN_ProfileIDRValue "22.11.24";
BA_ "UserSigValidity" SG_ 870 CF_AVN_ProfileIDRValue 0;
BA_ "GenSigStartValue" SG_ 870 CF_AVN_ProfileIDRValue 15;
BA_ "GenSigSendType" SG_ 870 CF_AVN_ProfileIDRValue 4;
BA_ "Description" SG_ 870 CF_AVN_ProfileIDRValue "Profile 3~Profile9 value is only used from Vehicle Architecture 2.0 (STD_DB_CAR_R2, SV 24.6~) vehicle models

Vehicle Architecture 1.0 (STD_DB_CAR) vehicle models can use Guest, Profile1, Profile 2 only.";
BA_ "Version" SG_ 870 HazardFromHUSVM "22.06.01";
BA_ "UserSigValidity" SG_ 870 HazardFromHUSVM 0;
BA_ "GenSigStartValue" SG_ 870 HazardFromHUSVM 3;
BA_ "GenSigSendType" SG_ 870 HazardFromHUSVM 4;
BA_ "Version" SG_ 870 OMUOSMirCtrl "22.06.01";
BA_ "UserSigValidity" SG_ 870 OMUOSMirCtrl 0;
BA_ "GenSigStartValue" SG_ 870 OMUOSMirCtrl 3;
BA_ "GenSigSendType" SG_ 870 OMUOSMirCtrl 4;
BA_ "Version" SG_ 870 OTAUIStatus "22.06.01";
BA_ "UserSigValidity" SG_ 870 OTAUIStatus 0;
BA_ "GenSigSendType" SG_ 870 OTAUIStatus 4;
BA_ "Description" SG_ 870 OTAUIStatus "0x00 : Headunit is booting so, Headunit can't display any state

0x01 : Headunit is normal state, Headunit could display according to CCU command.";
BA_ "Version" SG_ 870 C_TeleActiveStatus "22.06.01";
BA_ "UserSigValidity" SG_ 870 C_TeleActiveStatus 0;
BA_ "GenSigStartValue" SG_ 870 C_TeleActiveStatus 3;
BA_ "GenSigSendType" SG_ 870 C_TeleActiveStatus 4;
BA_ "Version" SG_ 870 HU_RTCCheck "22.06.01";
BA_ "UserSigValidity" SG_ 870 HU_RTCCheck 3;
BA_ "TimeoutValue" SG_ 870 HU_RTCCheck "0x3";
BA_ "GenSigStartValue" SG_ 870 HU_RTCCheck 3;
BA_ "GenSigSendType" SG_ 870 HU_RTCCheck 4;
BA_ "Version" SG_ 870 HU_GW_AlvCnt3Val "22.10.20";
BA_ "UserSigValidity" SG_ 870 HU_GW_AlvCnt3Val 3;
BA_ "GenSigSendType" SG_ 870 HU_GW_AlvCnt3Val 4;
BA_ "Description" SG_ 870 HU_GW_AlvCnt3Val "For the first transmission request for a data element the counter shall be initialized with 0 and shall be incremented by 1 for every subsequent send request. 

When the counter reaches the maximum value(0xFF), then it shall restart with 0 for the next s";
BA_ "Version" SG_ 870 HU_SWRCWarmerSet "22.06.01";
BA_ "UserSigValidity" SG_ 870 HU_SWRCWarmerSet 3;
BA_ "GenSigSendType" SG_ 870 HU_SWRCWarmerSet 4;
BA_ "Description" SG_ 870 HU_SWRCWarmerSet "send 0x1(On) value while button press to ICU";
BA_ "Version" SG_ 870 HU_TrModeReq_PE "25.04.01";
BA_ "UserSigValidity" SG_ 870 HU_TrModeReq_PE 3;
BA_ "GenSigStartValue" SG_ 870 HU_TrModeReq_PE 7;
BA_ "GenSigSendType" SG_ 870 HU_TrModeReq_PE 4;
BA_ "Description" SG_ 870 HU_TrModeReq_PE "Trailer/Carrier Mode On/Off request";
BA_ "Version" SG_ 870 HU_TrBrakeTypeReq_PE "24.07.06";
BA_ "UserSigValidity" SG_ 870 HU_TrBrakeTypeReq_PE 3;
BA_ "GenSigStartValue" SG_ 870 HU_TrBrakeTypeReq_PE 7;
BA_ "GenSigSendType" SG_ 870 HU_TrBrakeTypeReq_PE 4;
BA_ "Description" SG_ 870 HU_TrBrakeTypeReq_PE "Trailer Brake Type request";
BA_ "Version" SG_ 870 HU_STA_Req_PE "25.07.03";
BA_ "UserSigValidity" SG_ 870 HU_STA_Req_PE 3;
BA_ "GenSigSendType" SG_ 870 HU_STA_Req_PE 4;
BA_ "Description" SG_ 870 HU_STA_Req_PE "Connect Dynamic Control

- STA on/off request (trasmit PE for functional safety)";
BA_ "Version" SG_ 870 HU_PopUpDnSafetyModeState "25.06.01";
BA_ "UserSigValidity" SG_ 870 HU_PopUpDnSafetyModeState 7;
BA_ "GenSigSendType" SG_ 870 HU_PopUpDnSafetyModeState 4;
BA_ "Description" SG_ 870 HU_PopUpDnSafetyModeState "Safety Mode On/Off State by Popupdn";
BA_ "Version" SG_ 870 HU_LghtDnSafetyModState "25.06.00";
BA_ "UserSigValidity" SG_ 870 HU_LghtDnSafetyModState 7;
BA_ "GenSigSendType" SG_ 870 HU_LghtDnSafetyModState 4;
BA_ "Description" SG_ 870 HU_LghtDnSafetyModState "H_U Safety State (for CampMode/Interior Light brightness down) State signal";
BA_ "Version" SG_ 870 HU_FullScrSafetyModeState "25.06.01";
BA_ "UserSigValidity" SG_ 870 HU_FullScrSafetyModeState 7;
BA_ "GenSigSendType" SG_ 870 HU_FullScrSafetyModeState 4;
BA_ "Description" SG_ 870 HU_FullScrSafetyModeState "State for the safety on/off (In case of Full Screen)";
BA_ "Version" SG_ 870 HU_DispAvailable "25.07.03";
BA_ "UserSigValidity" SG_ 870 HU_DispAvailable 0;
BA_ "GenSigSendType" SG_ 870 HU_DispAvailable 4;
BA_ "Description" SG_ 870 HU_DispAvailable "Send when HU display is available.";
BA_ "Version" SG_ 870 HU_ISG_OFF_Set_Req_PE "25.10.00";
BA_ "UserSigValidity" SG_ 870 HU_ISG_OFF_Set_Req_PE 3;
BA_ "GenSigSendType" SG_ 870 HU_ISG_OFF_Set_Req_PE 4;
BA_ "Description" SG_ 870 HU_ISG_OFF_Set_Req_PE "AAOS IVI Soft Key for ISG OFF";
BA_ "Version" SG_ 870 AVN_MPA_SelBtnSta "24.10.03";
BA_ "UserSigValidity" SG_ 870 AVN_MPA_SelBtnSta 3;
BA_ "GenSigSendType" SG_ 870 AVN_MPA_SelBtnSta 4;
BA_ "Version" SG_ 870 AVN_PRK_Cam_Status "24.10.00";
BA_ "UserSigValidity" SG_ 870 AVN_PRK_Cam_Status 1;
BA_ "GenSigSendType" SG_ 870 AVN_PRK_Cam_Status 4;
BA_ "Description" SG_ 870 AVN_PRK_Cam_Status "Status of camera displaying when operating a pakring function(RSPA, MRA, MPA).";
BA_ "Version" SG_ 870 AVN_MRA_Disp_Rdy "24.01.04";
BA_ "UserSigValidity" SG_ 870 AVN_MRA_Disp_Rdy 0;
BA_ "GenSigSendType" SG_ 870 AVN_MRA_Disp_Rdy 4;
BA_ "Description" SG_ 870 AVN_MRA_Disp_Rdy "AVN status notification for ADAS_PRK

- status notification whether AVN can display on the navigation screen";
BA_ "Version" SG_ 870 AVN_PRK_Func_Selected "24.07.03";
BA_ "UserSigValidity" SG_ 870 AVN_PRK_Func_Selected 3;
BA_ "GenSigSendType" SG_ 870 AVN_PRK_Func_Selected 4;
BA_ "Description" SG_ 870 AVN_PRK_Func_Selected "MRA function activation button selection result feedback";
BA_ "Version" SG_ 870 AVN_MRA_CancelInput "24.01.04";
BA_ "UserSigValidity" SG_ 870 AVN_MRA_CancelInput 0;
BA_ "GenSigSendType" SG_ 870 AVN_MRA_CancelInput 4;
BA_ "Description" SG_ 870 AVN_MRA_CancelInput "Information of exit button input on the navigation screen from MRA activation to control stage";
BA_ "Version" SG_ 870 HU_DistanceUnit "22.06.01";
BA_ "NetworkRequest" SG_ 870 HU_DistanceUnit 0;
BA_ "UserSigValidity" SG_ 870 HU_DistanceUnit 1;
BA_ "GenSigStartValue" SG_ 870 HU_DistanceUnit 3;
BA_ "GenSigSendType" SG_ 870 HU_DistanceUnit 4;
BA_ "Version" SG_ 870 HU_Scheduled_Setting "22.06.01";
BA_ "UserSigValidity" SG_ 870 HU_Scheduled_Setting 3;
BA_ "GenSigSendType" SG_ 870 HU_Scheduled_Setting 4;
BA_ "Description" SG_ 870 HU_Scheduled_Setting "Information of scheduled update charge setting

The signal means that scheduled update charaging information send to BMS for BMS SOC control";
BA_ "Version" SG_ 870 HU_AliveStatus "22.06.01";
BA_ "NetworkRequest" SG_ 870 HU_AliveStatus 0;
BA_ "UserSigValidity" SG_ 870 HU_AliveStatus 0;
BA_ "GenSigStartValue" SG_ 870 HU_AliveStatus 3;
BA_ "GenSigSendType" SG_ 870 HU_AliveStatus 4;
BA_ "Version" SG_ 870 HU_ThemeType "22.06.01";
BA_ "UserSigValidity" SG_ 870 HU_ThemeType 0;
BA_ "GenSigStartValue" SG_ 870 HU_ThemeType 15;
BA_ "GenSigSendType" SG_ 870 HU_ThemeType 4;
BA_ "Description" SG_ 870 HU_ThemeType "This signal indicates current H/Unit GUI theme value. 

 

Detail value -GUI Theme matching table, refer to attachement and ES SPEC";
BA_ "Version" SG_ 870 HU_MicActivity "22.06.01";
BA_ "UserSigValidity" SG_ 870 HU_MicActivity 0;
BA_ "GenSigStartValue" SG_ 870 HU_MicActivity 3;
BA_ "GenSigSendType" SG_ 870 HU_MicActivity 4;
BA_ "Version" SG_ 870 AVN_RSPA_ModeSelect "23.10.01";
BA_ "UserSigValidity" SG_ 870 AVN_RSPA_ModeSelect 0;
BA_ "GenSigStartValue" SG_ 870 AVN_RSPA_ModeSelect 15;
BA_ "GenSigSendType" SG_ 870 AVN_RSPA_ModeSelect 4;
BA_ "Description" SG_ 870 AVN_RSPA_ModeSelect "Signal for User's RSPAⅡ mode setting

RSPAⅡ 모드 선택 메뉴 CCP Focus 및 CCP Confirm or Touch 결과";
BA_ "Version" SG_ 870 CF_HU_GPSFlt "22.06.01";
BA_ "UserSigValidity" SG_ 870 CF_HU_GPSFlt 0;
BA_ "TimeoutValue" SG_ 870 CF_HU_GPSFlt "0x2";
BA_ "GenSigStartValue" SG_ 870 CF_HU_GPSFlt 2;
BA_ "GenSigSendType" SG_ 870 CF_HU_GPSFlt 4;
BA_ "Version" SG_ 870 AVN_RSPA_CancelInput "22.06.01";
BA_ "UserSigValidity" SG_ 870 AVN_RSPA_CancelInput 0;
BA_ "GenSigSendType" SG_ 870 AVN_RSPA_CancelInput 4;
BA_ "Version" SG_ 993 PDC_FD_Crc2Val "22.10.20";
BA_ "UserSigValidity" SG_ 993 PDC_FD_Crc2Val 3;
BA_ "GenSigStartValue" SG_ 993 PDC_FD_Crc2Val 65535;
BA_ "GenSigSendType" SG_ 993 PDC_FD_Crc2Val 4;
BA_ "Description" SG_ 993 PDC_FD_Crc2Val "The data area for CRC calculation is based on the data length (DLC) of the message DB.

The CRC shall be calculated over the entire data block (excluding the CRC bytes) including the user data, alive counter and Data ID



- CRC Polynomial (0x1021) , Ini";
BA_ "Version" SG_ 993 Lamp_StpLmpLftOpnSta "17.12.00";
BA_ "NetworkRequestHoldingTime" SG_ 993 Lamp_StpLmpLftOpnSta 5000;
BA_ "NetworkRequest" SG_ 993 Lamp_StpLmpLftOpnSta 0;
BA_ "UserSigValidity" SG_ 993 Lamp_StpLmpLftOpnSta 0;
BA_ "GenSigSendType" SG_ 993 Lamp_StpLmpLftOpnSta 4;
BA_ "Description" SG_ 993 Lamp_StpLmpLftOpnSta "Stop Lamp



Left Open Status";
BA_ "Version" SG_ 993 Lamp_StpLmpRtOpnSta "17.12.00";
BA_ "NetworkRequestHoldingTime" SG_ 993 Lamp_StpLmpRtOpnSta 5000;
BA_ "NetworkRequest" SG_ 993 Lamp_StpLmpRtOpnSta 0;
BA_ "UserSigValidity" SG_ 993 Lamp_StpLmpRtOpnSta 0;
BA_ "GenSigSendType" SG_ 993 Lamp_StpLmpRtOpnSta 4;
BA_ "Description" SG_ 993 Lamp_StpLmpRtOpnSta "Stop Lamp



Right Open Status";
BA_ "Version" SG_ 993 Lamp_HmslLmpOpnSta "19.11.09";
BA_ "NetworkRequestHoldingTime" SG_ 993 Lamp_HmslLmpOpnSta 5000;
BA_ "NetworkRequest" SG_ 993 Lamp_HmslLmpOpnSta 0;
BA_ "UserSigValidity" SG_ 993 Lamp_HmslLmpOpnSta 0;
BA_ "GenSigSendType" SG_ 993 Lamp_HmslLmpOpnSta 4;
BA_ "Description" SG_ 993 Lamp_HmslLmpOpnSta "HMSL OpenStatus";
BA_ "Version" SG_ 993 Lamp_DrlLmpLftOpnSta "17.12.00";
BA_ "NetworkRequestHoldingTime" SG_ 993 Lamp_DrlLmpLftOpnSta 5000;
BA_ "NetworkRequest" SG_ 993 Lamp_DrlLmpLftOpnSta 0;
BA_ "UserSigValidity" SG_ 993 Lamp_DrlLmpLftOpnSta 0;
BA_ "GenSigSendType" SG_ 993 Lamp_DrlLmpLftOpnSta 4;
BA_ "Description" SG_ 993 Lamp_DrlLmpLftOpnSta "DRL Lamp



Left OpenStatus";
BA_ "Version" SG_ 993 Lamp_DrlLmpRtOpnSta "17.12.00";
BA_ "NetworkRequestHoldingTime" SG_ 993 Lamp_DrlLmpRtOpnSta 5000;
BA_ "NetworkRequest" SG_ 993 Lamp_DrlLmpRtOpnSta 0;
BA_ "UserSigValidity" SG_ 993 Lamp_DrlLmpRtOpnSta 0;
BA_ "GenSigSendType" SG_ 993 Lamp_DrlLmpRtOpnSta 4;
BA_ "Description" SG_ 993 Lamp_DrlLmpRtOpnSta "DRL Lamp



Right OpenStatus";
BA_ "Version" SG_ 993 Lamp_FrFgLmpLftOpnSta "17.12.00";
BA_ "NetworkRequestHoldingTime" SG_ 993 Lamp_FrFgLmpLftOpnSta 5000;
BA_ "NetworkRequest" SG_ 993 Lamp_FrFgLmpLftOpnSta 0;
BA_ "UserSigValidity" SG_ 993 Lamp_FrFgLmpLftOpnSta 0;
BA_ "GenSigSendType" SG_ 993 Lamp_FrFgLmpLftOpnSta 4;
BA_ "Description" SG_ 993 Lamp_FrFgLmpLftOpnSta "Front FOG Lamp



Left OpenStatus";
BA_ "Version" SG_ 993 Lamp_FrFgLmpRtOpnSta "17.12.00";
BA_ "NetworkRequestHoldingTime" SG_ 993 Lamp_FrFgLmpRtOpnSta 5000;
BA_ "NetworkRequest" SG_ 993 Lamp_FrFgLmpRtOpnSta 0;
BA_ "UserSigValidity" SG_ 993 Lamp_FrFgLmpRtOpnSta 0;
BA_ "GenSigSendType" SG_ 993 Lamp_FrFgLmpRtOpnSta 4;
BA_ "Description" SG_ 993 Lamp_FrFgLmpRtOpnSta "Front FOG Lamp



Right OpenStatus";
BA_ "Version" SG_ 993 Lamp_CorneringLmpLftOpnSta "19.11.11";
BA_ "NetworkRequestHoldingTime" SG_ 993 Lamp_CorneringLmpLftOpnSta 5000;
BA_ "NetworkRequest" SG_ 993 Lamp_CorneringLmpLftOpnSta 0;
BA_ "UserSigValidity" SG_ 993 Lamp_CorneringLmpLftOpnSta 0;
BA_ "GenSigSendType" SG_ 993 Lamp_CorneringLmpLftOpnSta 4;
BA_ "Description" SG_ 993 Lamp_CorneringLmpLftOpnSta "Cornering Lamp Left Open Status";
BA_ "Version" SG_ 993 Lamp_CorneringLmpRtOpnSta "19.11.11";
BA_ "NetworkRequestHoldingTime" SG_ 993 Lamp_CorneringLmpRtOpnSta 5000;
BA_ "NetworkRequest" SG_ 993 Lamp_CorneringLmpRtOpnSta 0;
BA_ "UserSigValidity" SG_ 993 Lamp_CorneringLmpRtOpnSta 0;
BA_ "GenSigSendType" SG_ 993 Lamp_CorneringLmpRtOpnSta 4;
BA_ "Description" SG_ 993 Lamp_CorneringLmpRtOpnSta "Cornering Lamp Right Open Status";
BA_ "Version" SG_ 993 Lamp_StcBendingLmpLftOpnSta "17.12.00";
BA_ "NetworkRequestHoldingTime" SG_ 993 Lamp_StcBendingLmpLftOpnSta 5000;
BA_ "NetworkRequest" SG_ 993 Lamp_StcBendingLmpLftOpnSta 0;
BA_ "UserSigValidity" SG_ 993 Lamp_StcBendingLmpLftOpnSta 0;
BA_ "GenSigSendType" SG_ 993 Lamp_StcBendingLmpLftOpnSta 4;
BA_ "Description" SG_ 993 Lamp_StcBendingLmpLftOpnSta "Static Bending Lamp



Left OpenStatus";
BA_ "Version" SG_ 993 Lamp_StcBendingLmpRtOpnSta "17.12.00";
BA_ "NetworkRequestHoldingTime" SG_ 993 Lamp_StcBendingLmpRtOpnSta 5000;
BA_ "NetworkRequest" SG_ 993 Lamp_StcBendingLmpRtOpnSta 0;
BA_ "UserSigValidity" SG_ 993 Lamp_StcBendingLmpRtOpnSta 0;
BA_ "GenSigSendType" SG_ 993 Lamp_StcBendingLmpRtOpnSta 4;
BA_ "Description" SG_ 993 Lamp_StcBendingLmpRtOpnSta "Static Bending Lamp



Right OpenStatus";
BA_ "Version" SG_ 993 Lamp_FrTurnSigLmpLftPCLSta "22.07.05";
BA_ "NetworkRequestHoldingTime" SG_ 993 Lamp_FrTurnSigLmpLftPCLSta 5000;
BA_ "NetworkRequest" SG_ 993 Lamp_FrTurnSigLmpLftPCLSta 0;
BA_ "UserSigValidity" SG_ 993 Lamp_FrTurnSigLmpLftPCLSta 0;
BA_ "GenSigSendType" SG_ 993 Lamp_FrTurnSigLmpLftPCLSta 4;
BA_ "Description" SG_ 993 Lamp_FrTurnSigLmpLftPCLSta "T/SIG Lamp Front Left PCL Status";
BA_ "Version" SG_ 993 Lamp_FrTurnSigLmpRtPCLSta "22.07.05";
BA_ "NetworkRequestHoldingTime" SG_ 993 Lamp_FrTurnSigLmpRtPCLSta 5000;
BA_ "NetworkRequest" SG_ 993 Lamp_FrTurnSigLmpRtPCLSta 0;
BA_ "UserSigValidity" SG_ 993 Lamp_FrTurnSigLmpRtPCLSta 0;
BA_ "GenSigSendType" SG_ 993 Lamp_FrTurnSigLmpRtPCLSta 4;
BA_ "Description" SG_ 993 Lamp_FrTurnSigLmpRtPCLSta "T/SIG Lamp Front Right PCL Status";
BA_ "Version" SG_ 993 Lamp_RrTurnSigLmpLftPCLSta "22.07.05";
BA_ "NetworkRequestHoldingTime" SG_ 993 Lamp_RrTurnSigLmpLftPCLSta 5000;
BA_ "NetworkRequest" SG_ 993 Lamp_RrTurnSigLmpLftPCLSta 0;
BA_ "UserSigValidity" SG_ 993 Lamp_RrTurnSigLmpLftPCLSta 0;
BA_ "GenSigSendType" SG_ 993 Lamp_RrTurnSigLmpLftPCLSta 4;
BA_ "Description" SG_ 993 Lamp_RrTurnSigLmpLftPCLSta "T/SIG Lamp Rear Left PCL Status";
BA_ "Version" SG_ 993 Lamp_RrTurnSigLmpRtPCLSta "22.07.05";
BA_ "NetworkRequestHoldingTime" SG_ 993 Lamp_RrTurnSigLmpRtPCLSta 5000;
BA_ "NetworkRequest" SG_ 993 Lamp_RrTurnSigLmpRtPCLSta 0;
BA_ "UserSigValidity" SG_ 993 Lamp_RrTurnSigLmpRtPCLSta 0;
BA_ "GenSigSendType" SG_ 993 Lamp_RrTurnSigLmpRtPCLSta 4;
BA_ "Description" SG_ 993 Lamp_RrTurnSigLmpRtPCLSta "T/SIG Lamp Rear Right PCL Status";
BA_ "Version" SG_ 993 HzrdSwPushSta "23.02.13";
BA_ "NetworkRequestHoldingTime" SG_ 993 HzrdSwPushSta 5000;
BA_ "NetworkRequest" SG_ 993 HzrdSwPushSta 0;
BA_ "UserSigValidity" SG_ 993 HzrdSwPushSta 0;
BA_ "GenSigSendType" SG_ 993 HzrdSwPushSta 4;
BA_ "Description" SG_ 993 HzrdSwPushSta "Hazard Switch(self return type) Push State";
BA_ "Version" SG_ 993 Lamp_LftTrnFaultSta "23.02.13";
BA_ "NetworkRequestHoldingTime" SG_ 993 Lamp_LftTrnFaultSta 5000;
BA_ "NetworkRequest" SG_ 993 Lamp_LftTrnFaultSta 0;
BA_ "UserSigValidity" SG_ 993 Lamp_LftTrnFaultSta 0;
BA_ "GenSigSendType" SG_ 993 Lamp_LftTrnFaultSta 4;
BA_ "Description" SG_ 993 Lamp_LftTrnFaultSta "Left Turn Lamp Fault Status";
BA_ "Version" SG_ 993 Lamp_RtTrnFaultSta "23.02.13";
BA_ "NetworkRequestHoldingTime" SG_ 993 Lamp_RtTrnFaultSta 5000;
BA_ "NetworkRequest" SG_ 993 Lamp_RtTrnFaultSta 0;
BA_ "UserSigValidity" SG_ 993 Lamp_RtTrnFaultSta 0;
BA_ "GenSigSendType" SG_ 993 Lamp_RtTrnFaultSta 4;
BA_ "Description" SG_ 993 Lamp_RtTrnFaultSta "Right Turn Lamp Fault Status";
BA_ "Version" SG_ 993 FrtTurnLampOptSta "23.04.00";
BA_ "NetworkRequestHoldingTime" SG_ 993 FrtTurnLampOptSta 5000;
BA_ "NetworkRequest" SG_ 993 FrtTurnLampOptSta 0;
BA_ "UserSigValidity" SG_ 993 FrtTurnLampOptSta 0;
BA_ "GenSigSendType" SG_ 993 FrtTurnLampOptSta 4;
BA_ "Description" SG_ 993 FrtTurnLampOptSta "Front Turn Signal Lamp EOL Option State";
BA_ "Version" SG_ 993 RrTurnLampOptSta "23.04.00";
BA_ "NetworkRequestHoldingTime" SG_ 993 RrTurnLampOptSta 5000;
BA_ "NetworkRequest" SG_ 993 RrTurnLampOptSta 0;
BA_ "UserSigValidity" SG_ 993 RrTurnLampOptSta 0;
BA_ "GenSigSendType" SG_ 993 RrTurnLampOptSta 4;
BA_ "Description" SG_ 993 RrTurnLampOptSta "Rear Turn Signal Lamp EOL Option State";
BA_ "Version" SG_ 993 VAPI_TurnSigLampEnable_Get "25.07.03";
BA_ "NetworkRequestHoldingTime" SG_ 993 VAPI_TurnSigLampEnable_Get 5000;
BA_ "NetworkRequest" SG_ 993 VAPI_TurnSigLampEnable_Get 0;
BA_ "UserSigValidity" SG_ 993 VAPI_TurnSigLampEnable_Get 0;
BA_ "GenSigSendType" SG_ 993 VAPI_TurnSigLampEnable_Get 4;
BA_ "Description" SG_ 993 VAPI_TurnSigLampEnable_Get "Turn singal control disable state in pet mode";
BA_ "Version" SG_ 993 PDC_RearFogLmpOpt "25.07.04";
BA_ "NetworkRequestHoldingTime" SG_ 993 PDC_RearFogLmpOpt 5000;
BA_ "NetworkRequest" SG_ 993 PDC_RearFogLmpOpt 0;
BA_ "UserSigValidity" SG_ 993 PDC_RearFogLmpOpt 0;
BA_ "GenSigSendType" SG_ 993 PDC_RearFogLmpOpt 4;
BA_ "Description" SG_ 993 PDC_RearFogLmpOpt "Rear Fog Lamp EOL Option State

Notapplied means that PDC does not control the rear fog lamp, and even if the rear fog lamp is applied, it can be expressed as Notapplied in the case of IRCU control the rear fog lamp";
BA_ "Version" SG_ 993 PDC_FrontFogLmpOpt "25.07.04";
BA_ "NetworkRequestHoldingTime" SG_ 993 PDC_FrontFogLmpOpt 5000;
BA_ "NetworkRequest" SG_ 993 PDC_FrontFogLmpOpt 0;
BA_ "UserSigValidity" SG_ 993 PDC_FrontFogLmpOpt 0;
BA_ "GenSigSendType" SG_ 993 PDC_FrontFogLmpOpt 4;
BA_ "Description" SG_ 993 PDC_FrontFogLmpOpt "Front Fog Lamp EOL Option State";
BA_ "Version" SG_ 993 PDC_TrunkTgateWarnLampMode "25.10.00";
BA_ "NetworkRequestHoldingTime" SG_ 993 PDC_TrunkTgateWarnLampMode 5000;
BA_ "NetworkRequest" SG_ 993 PDC_TrunkTgateWarnLampMode 0;
BA_ "UserSigValidity" SG_ 993 PDC_TrunkTgateWarnLampMode 0;
BA_ "GenSigSendType" SG_ 993 PDC_TrunkTgateWarnLampMode 4;
BA_ "Description" SG_ 993 PDC_TrunkTgateWarnLampMode "Trunk Tailgate Warning Lamp Emergency Mode Status";
BA_ "Version" SG_ 993 PDC_FD_AlvCnt2Val "22.10.20";
BA_ "UserSigValidity" SG_ 993 PDC_FD_AlvCnt2Val 3;
BA_ "GenSigSendType" SG_ 993 PDC_FD_AlvCnt2Val 4;
BA_ "Description" SG_ 993 PDC_FD_AlvCnt2Val "For the first transmission request for a data element the counter shall be initialized with 0 and shall be incremented by 1 for every subsequent send request. 

When the counter reaches the maximum value(0xFF), then it shall restart with 0 for the next s";
BA_ "Version" SG_ 993 IntLamp_InlTailLmpSta "17.12.00";
BA_ "NetworkRequestHoldingTime" SG_ 993 IntLamp_InlTailLmpSta 5000;
BA_ "NetworkRequest" SG_ 993 IntLamp_InlTailLmpSta 0;
BA_ "UserSigValidity" SG_ 993 IntLamp_InlTailLmpSta 0;
BA_ "GenSigSendType" SG_ 993 IntLamp_InlTailLmpSta 4;
BA_ "Description" SG_ 993 IntLamp_InlTailLmpSta "-(Old)C_INTTail_Act";
BA_ "Version" SG_ 993 Lamp_FootLampOnReq "17.12.00";
BA_ "NetworkRequestHoldingTime" SG_ 993 Lamp_FootLampOnReq 5000;
BA_ "NetworkRequest" SG_ 993 Lamp_FootLampOnReq 0;
BA_ "UserSigValidity" SG_ 993 Lamp_FootLampOnReq 0;
BA_ "GenSigSendType" SG_ 993 Lamp_FootLampOnReq 4;
BA_ "Description" SG_ 993 Lamp_FootLampOnReq "Foot Lamp Command";
BA_ "Version" SG_ 993 Lamp_MoodLampOnReq "21.07.05";
BA_ "NetworkRequestHoldingTime" SG_ 993 Lamp_MoodLampOnReq 5000;
BA_ "NetworkRequest" SG_ 993 Lamp_MoodLampOnReq 0;
BA_ "UserSigValidity" SG_ 993 Lamp_MoodLampOnReq 0;
BA_ "GenSigSendType" SG_ 993 Lamp_MoodLampOnReq 4;
BA_ "Description" SG_ 993 Lamp_MoodLampOnReq "Mood lamp command";
BA_ "Version" SG_ 993 USM_FuncForMdLmpBrgtSta "21.11.00";
BA_ "NetworkRequestHoldingTime" SG_ 993 USM_FuncForMdLmpBrgtSta 5000;
BA_ "NetworkRequest" SG_ 993 USM_FuncForMdLmpBrgtSta 0;
BA_ "UserSigValidity" SG_ 993 USM_FuncForMdLmpBrgtSta 3;
BA_ "GenSigSendType" SG_ 993 USM_FuncForMdLmpBrgtSta 4;
BA_ "Description" SG_ 993 USM_FuncForMdLmpBrgtSta "USM Function for Mood Lamp bright";
BA_ "Version" SG_ 993 Lamp_HdLmpLoLftOpnSta "17.12.00";
BA_ "NetworkRequestHoldingTime" SG_ 993 Lamp_HdLmpLoLftOpnSta 5000;
BA_ "NetworkRequest" SG_ 993 Lamp_HdLmpLoLftOpnSta 0;
BA_ "UserSigValidity" SG_ 993 Lamp_HdLmpLoLftOpnSta 0;
BA_ "GenSigSendType" SG_ 993 Lamp_HdLmpLoLftOpnSta 4;
BA_ "Description" SG_ 993 Lamp_HdLmpLoLftOpnSta "Head Lamp Low



Left OpenStatus";
BA_ "Version" SG_ 993 Lamp_HdLmpLoRtOpnSta "17.12.00";
BA_ "NetworkRequestHoldingTime" SG_ 993 Lamp_HdLmpLoRtOpnSta 5000;
BA_ "NetworkRequest" SG_ 993 Lamp_HdLmpLoRtOpnSta 0;
BA_ "UserSigValidity" SG_ 993 Lamp_HdLmpLoRtOpnSta 0;
BA_ "GenSigSendType" SG_ 993 Lamp_HdLmpLoRtOpnSta 4;
BA_ "Description" SG_ 993 Lamp_HdLmpLoRtOpnSta "Head Lamp Low Right OpenStatus";
BA_ "Version" SG_ 993 Lamp_HdLmpBiFuncLftOpnSta "19.11.10";
BA_ "NetworkRequestHoldingTime" SG_ 993 Lamp_HdLmpBiFuncLftOpnSta 5000;
BA_ "NetworkRequest" SG_ 993 Lamp_HdLmpBiFuncLftOpnSta 0;
BA_ "UserSigValidity" SG_ 993 Lamp_HdLmpBiFuncLftOpnSta 0;
BA_ "GenSigSendType" SG_ 993 Lamp_HdLmpBiFuncLftOpnSta 4;
BA_ "Description" SG_ 993 Lamp_HdLmpBiFuncLftOpnSta "Bi Function Head Lamp Left Open Status";
BA_ "Version" SG_ 993 Lamp_HdLmpBiFuncRtOpnSta "19.11.10";
BA_ "NetworkRequestHoldingTime" SG_ 993 Lamp_HdLmpBiFuncRtOpnSta 5000;
BA_ "NetworkRequest" SG_ 993 Lamp_HdLmpBiFuncRtOpnSta 0;
BA_ "UserSigValidity" SG_ 993 Lamp_HdLmpBiFuncRtOpnSta 0;
BA_ "GenSigSendType" SG_ 993 Lamp_HdLmpBiFuncRtOpnSta 4;
BA_ "Description" SG_ 993 Lamp_HdLmpBiFuncRtOpnSta "Bi Function Head Lamp Right Open Status";
BA_ "Version" SG_ 993 Lamp_HdLmpHiLftOpnSta "17.12.00";
BA_ "NetworkRequestHoldingTime" SG_ 993 Lamp_HdLmpHiLftOpnSta 5000;
BA_ "NetworkRequest" SG_ 993 Lamp_HdLmpHiLftOpnSta 0;
BA_ "UserSigValidity" SG_ 993 Lamp_HdLmpHiLftOpnSta 0;
BA_ "GenSigSendType" SG_ 993 Lamp_HdLmpHiLftOpnSta 4;
BA_ "Description" SG_ 993 Lamp_HdLmpHiLftOpnSta "Head Lamp High



Left OpenStatus";
BA_ "Version" SG_ 993 Lamp_HdLmpHiRtOpnSta "17.12.00";
BA_ "NetworkRequestHoldingTime" SG_ 993 Lamp_HdLmpHiRtOpnSta 5000;
BA_ "NetworkRequest" SG_ 993 Lamp_HdLmpHiRtOpnSta 0;
BA_ "UserSigValidity" SG_ 993 Lamp_HdLmpHiRtOpnSta 0;
BA_ "GenSigSendType" SG_ 993 Lamp_HdLmpHiRtOpnSta 4;
BA_ "Description" SG_ 993 Lamp_HdLmpHiRtOpnSta "Head Lamp High Right OpenStatus";
BA_ "Version" SG_ 993 ExtLamp_HzrdSwSta "17.12.00";
BA_ "NetworkRequestHoldingTime" SG_ 993 ExtLamp_HzrdSwSta 5000;
BA_ "NetworkRequest" SG_ 993 ExtLamp_HzrdSwSta 0;
BA_ "UserSigValidity" SG_ 993 ExtLamp_HzrdSwSta 0;
BA_ "GenSigSendType" SG_ 993 ExtLamp_HzrdSwSta 4;
BA_ "Version" SG_ 993 Lamp_FrTrnSigLmpLftOpnSta "17.12.00";
BA_ "NetworkRequestHoldingTime" SG_ 993 Lamp_FrTrnSigLmpLftOpnSta 5000;
BA_ "NetworkRequest" SG_ 993 Lamp_FrTrnSigLmpLftOpnSta 0;
BA_ "UserSigValidity" SG_ 993 Lamp_FrTrnSigLmpLftOpnSta 0;
BA_ "GenSigSendType" SG_ 993 Lamp_FrTrnSigLmpLftOpnSta 4;
BA_ "Description" SG_ 993 Lamp_FrTrnSigLmpLftOpnSta "Front T/SIG Lamp



Left OpenStatus";
BA_ "Version" SG_ 993 Lamp_FrTrnSigLmpRtOpnSta "17.12.00";
BA_ "NetworkRequestHoldingTime" SG_ 993 Lamp_FrTrnSigLmpRtOpnSta 5000;
BA_ "NetworkRequest" SG_ 993 Lamp_FrTrnSigLmpRtOpnSta 0;
BA_ "UserSigValidity" SG_ 993 Lamp_FrTrnSigLmpRtOpnSta 0;
BA_ "GenSigSendType" SG_ 993 Lamp_FrTrnSigLmpRtOpnSta 4;
BA_ "Description" SG_ 993 Lamp_FrTrnSigLmpRtOpnSta "Front T/SIG Lamp



Right OpenStatus";
BA_ "Version" SG_ 993 Lamp_RrTrnSigLmpLftOpnSta "17.12.00";
BA_ "NetworkRequestHoldingTime" SG_ 993 Lamp_RrTrnSigLmpLftOpnSta 5000;
BA_ "NetworkRequest" SG_ 993 Lamp_RrTrnSigLmpLftOpnSta 0;
BA_ "UserSigValidity" SG_ 993 Lamp_RrTrnSigLmpLftOpnSta 0;
BA_ "GenSigSendType" SG_ 993 Lamp_RrTrnSigLmpLftOpnSta 4;
BA_ "Description" SG_ 993 Lamp_RrTrnSigLmpLftOpnSta "Rear T/SIG Lamp



Left OpenStatus";
BA_ "Version" SG_ 993 Lamp_RrTrnSigLmpRtOpnSta "17.12.00";
BA_ "NetworkRequestHoldingTime" SG_ 993 Lamp_RrTrnSigLmpRtOpnSta 5000;
BA_ "NetworkRequest" SG_ 993 Lamp_RrTrnSigLmpRtOpnSta 0;
BA_ "UserSigValidity" SG_ 993 Lamp_RrTrnSigLmpRtOpnSta 0;
BA_ "GenSigSendType" SG_ 993 Lamp_RrTrnSigLmpRtOpnSta 4;
BA_ "Description" SG_ 993 Lamp_RrTrnSigLmpRtOpnSta "Rear T/SIG Lamp



Right OpenStatus";
BA_ "Version" SG_ 993 Brake_SwSta_ICU "21.07.05";
BA_ "NetworkRequestHoldingTime" SG_ 993 Brake_SwSta_ICU 5000;
BA_ "NetworkRequest" SG_ 993 Brake_SwSta_ICU 0;
BA_ "UserSigValidity" SG_ 993 Brake_SwSta_ICU 0;
BA_ "GenSigSendType" SG_ 993 Brake_SwSta_ICU 4;
BA_ "Description" SG_ 993 Brake_SwSta_ICU "Brake Switch Status";
BA_ "Version" SG_ 993 BrkLmpCmd "20.08.07";
BA_ "NetworkRequestHoldingTime" SG_ 993 BrkLmpCmd 5000;
BA_ "NetworkRequest" SG_ 993 BrkLmpCmd 0;
BA_ "UserSigValidity" SG_ 993 BrkLmpCmd 0;
BA_ "GenSigSendType" SG_ 993 BrkLmpCmd 4;
BA_ "Description" SG_ 993 BrkLmpCmd "Brake Lamp Control Command";
BA_ "Version" SG_ 992 PDC_FD_Crc1Val "22.10.20";
BA_ "UserSigValidity" SG_ 992 PDC_FD_Crc1Val 3;
BA_ "GenSigStartValue" SG_ 992 PDC_FD_Crc1Val 65535;
BA_ "GenSigSendType" SG_ 992 PDC_FD_Crc1Val 4;
BA_ "Description" SG_ 992 PDC_FD_Crc1Val "The data area for CRC calculation is based on the data length (DLC) of the message DB.

The CRC shall be calculated over the entire data block (excluding the CRC bytes) including the user data, alive counter and Data ID



- CRC Polynomial (0x1021) , Ini";
BA_ "Version" SG_ 992 C_3rdRCSeatBeltSW "18.03.04";
BA_ "NetworkRequestHoldingTime" SG_ 992 C_3rdRCSeatBeltSW 5000;
BA_ "NetworkRequest" SG_ 992 C_3rdRCSeatBeltSW 0;
BA_ "UserSigValidity" SG_ 992 C_3rdRCSeatBeltSW 0;
BA_ "GenSigSendType" SG_ 992 C_3rdRCSeatBeltSW 4;
BA_ "Description" SG_ 992 C_3rdRCSeatBeltSW "3rd Rear Center Seat Belt Switch Status";
BA_ "Version" SG_ 992 C_3rdRRSeatBeltSW "18.03.04";
BA_ "NetworkRequestHoldingTime" SG_ 992 C_3rdRRSeatBeltSW 5000;
BA_ "NetworkRequest" SG_ 992 C_3rdRRSeatBeltSW 0;
BA_ "UserSigValidity" SG_ 992 C_3rdRRSeatBeltSW 0;
BA_ "GenSigSendType" SG_ 992 C_3rdRRSeatBeltSW 4;
BA_ "Description" SG_ 992 C_3rdRRSeatBeltSW "3rd Rear Right Seat Belt Switch Status";
BA_ "Version" SG_ 992 C_1stCTRSeatBeltSW "19.04.06";
BA_ "NetworkRequestHoldingTime" SG_ 992 C_1stCTRSeatBeltSW 5000;
BA_ "NetworkRequest" SG_ 992 C_1stCTRSeatBeltSW 0;
BA_ "UserSigValidity" SG_ 992 C_1stCTRSeatBeltSW 0;
BA_ "GenSigSendType" SG_ 992 C_1stCTRSeatBeltSW 4;
BA_ "Description" SG_ 992 C_1stCTRSeatBeltSW "1st Center Seat Belt Switch Status";
BA_ "Version" SG_ 992 Warn_DrvStOccSta "22.05.04";
BA_ "NetworkRequestHoldingTime" SG_ 992 Warn_DrvStOccSta 5000;
BA_ "NetworkRequest" SG_ 992 Warn_DrvStOccSta 0;
BA_ "UserSigValidity" SG_ 992 Warn_DrvStOccSta 0;
BA_ "GenSigSendType" SG_ 992 Warn_DrvStOccSta 4;
BA_ "Description" SG_ 992 Warn_DrvStOccSta "Driver Presence Detection MAT Switch Status";
BA_ "Version" SG_ 992 Warn_PassStOccSta "17.12.00";
BA_ "NetworkRequestHoldingTime" SG_ 992 Warn_PassStOccSta 5000;
BA_ "NetworkRequest" SG_ 992 Warn_PassStOccSta 0;
BA_ "UserSigValidity" SG_ 992 Warn_PassStOccSta 0;
BA_ "GenSigSendType" SG_ 992 Warn_PassStOccSta 4;
BA_ "Description" SG_ 992 Warn_PassStOccSta "Passenger Seated State







-Default value: 0x0 (미탑승)



-Initial value: 0x0 (미탑승)



-Timeout value: 0x0 (미탑승)";
BA_ "Version" SG_ 992 Warn_RrLftSBRMATSwSta "21.11.00";
BA_ "NetworkRequestHoldingTime" SG_ 992 Warn_RrLftSBRMATSwSta 5000;
BA_ "NetworkRequest" SG_ 992 Warn_RrLftSBRMATSwSta 0;
BA_ "UserSigValidity" SG_ 992 Warn_RrLftSBRMATSwSta 0;
BA_ "GenSigSendType" SG_ 992 Warn_RrLftSBRMATSwSta 4;
BA_ "Description" SG_ 992 Warn_RrLftSBRMATSwSta "Rear Left Seated State";
BA_ "Version" SG_ 992 Warn_RrRhtSBRMATSwSta "21.11.00";
BA_ "NetworkRequestHoldingTime" SG_ 992 Warn_RrRhtSBRMATSwSta 5000;
BA_ "NetworkRequest" SG_ 992 Warn_RrRhtSBRMATSwSta 0;
BA_ "UserSigValidity" SG_ 992 Warn_RrRhtSBRMATSwSta 0;
BA_ "GenSigSendType" SG_ 992 Warn_RrRhtSBRMATSwSta 4;
BA_ "Description" SG_ 992 Warn_RrRhtSBRMATSwSta "Rear Right Seated State";
BA_ "Version" SG_ 992 C_3rdRLSBRMatSw "18.03.04";
BA_ "NetworkRequestHoldingTime" SG_ 992 C_3rdRLSBRMatSw 5000;
BA_ "NetworkRequest" SG_ 992 C_3rdRLSBRMatSw 0;
BA_ "UserSigValidity" SG_ 992 C_3rdRLSBRMatSw 0;
BA_ "GenSigSendType" SG_ 992 C_3rdRLSBRMatSw 4;
BA_ "Description" SG_ 992 C_3rdRLSBRMatSw "3rd Rear Left Seated State



-Default value: 0x0 (미탑승)

-Initial value: 0x0 (미탑승)

-Timeout value: 0x0 (미탑승)";
BA_ "Version" SG_ 992 C_3rdRRSBRMatSw "18.03.04";
BA_ "NetworkRequestHoldingTime" SG_ 992 C_3rdRRSBRMatSw 5000;
BA_ "NetworkRequest" SG_ 992 C_3rdRRSBRMatSw 0;
BA_ "UserSigValidity" SG_ 992 C_3rdRRSBRMatSw 0;
BA_ "GenSigSendType" SG_ 992 C_3rdRRSBRMatSw 4;
BA_ "Description" SG_ 992 C_3rdRRSBRMatSw "3rd Rear Right Seated State



-Default value: 0x0 (미탑승)

-Initial value: 0x0 (미탑승)

-Timeout value: 0x0 (미탑승)";
BA_ "Version" SG_ 992 C_1stCTRSBRMatSw "19.04.06";
BA_ "NetworkRequestHoldingTime" SG_ 992 C_1stCTRSBRMatSw 5000;
BA_ "NetworkRequest" SG_ 992 C_1stCTRSBRMatSw 0;
BA_ "UserSigValidity" SG_ 992 C_1stCTRSBRMatSw 0;
BA_ "GenSigSendType" SG_ 992 C_1stCTRSBRMatSw 4;
BA_ "Description" SG_ 992 C_1stCTRSBRMatSw "1st Center Seated State



-Default value: 0x0 (미탑승)

-Initial value: 0x0 (미탑승)

-Timeout value: 0x0 (미탑승)";
BA_ "Version" SG_ 992 StrWhlWrmrSwState "20.08.07";
BA_ "UserSigValidity" SG_ 992 StrWhlWrmrSwState 4;
BA_ "GenSigSendType" SG_ 992 StrWhlWrmrSwState 4;
BA_ "Description" SG_ 992 StrWhlWrmrSwState "PDC Steering Wheel Warmer Self Return Type Manual Switch State";
BA_ "Version" SG_ 992 StrWhlWrmrFlModDetail "20.08.07";
BA_ "UserSigValidity" SG_ 992 StrWhlWrmrFlModDetail 4;
BA_ "GenSigSendType" SG_ 992 StrWhlWrmrFlModDetail 4;
BA_ "Description" SG_ 992 StrWhlWrmrFlModDetail "Steering Wheel Warmer Fail Mode Detail Information";
BA_ "Version" SG_ 992 FrHtdGlsSwState "20.08.07";
BA_ "UserSigValidity" SG_ 992 FrHtdGlsSwState 4;
BA_ "GenSigSendType" SG_ 992 FrHtdGlsSwState 4;
BA_ "Description" SG_ 992 FrHtdGlsSwState "Front Heated Glass Switch State";
BA_ "Version" SG_ 992 RrGlsHtSwState "21.01.06";
BA_ "UserSigValidity" SG_ 992 RrGlsHtSwState 4;
BA_ "GenSigSendType" SG_ 992 RrGlsHtSwState 4;
BA_ "Description" SG_ 992 RrGlsHtSwState "Rear Glass Heated Switch State";
BA_ "Version" SG_ 992 RLChldLkLatchSwState "20.08.07";
BA_ "NetworkRequestHoldingTime" SG_ 992 RLChldLkLatchSwState 5000;
BA_ "NetworkRequest" SG_ 992 RLChldLkLatchSwState 0;
BA_ "UserSigValidity" SG_ 992 RLChldLkLatchSwState 0;
BA_ "GenSigSendType" SG_ 992 RLChldLkLatchSwState 4;
BA_ "Description" SG_ 992 RLChldLkLatchSwState "Rear Left Electric Child Lock Latch Lock Unlock State";
BA_ "Version" SG_ 992 RRChldLkLatchSwState "20.08.07";
BA_ "NetworkRequestHoldingTime" SG_ 992 RRChldLkLatchSwState 5000;
BA_ "NetworkRequest" SG_ 992 RRChldLkLatchSwState 0;
BA_ "UserSigValidity" SG_ 992 RRChldLkLatchSwState 0;
BA_ "GenSigSendType" SG_ 992 RRChldLkLatchSwState 4;
BA_ "Description" SG_ 992 RRChldLkLatchSwState "Rear Right Electric Child Lock Latch Lock Unlock State";
BA_ "Version" SG_ 992 ChildLock_ActnFlSta "17.12.00";
BA_ "NetworkRequestHoldingTime" SG_ 992 ChildLock_ActnFlSta 5000;
BA_ "NetworkRequest" SG_ 992 ChildLock_ActnFlSta 0;
BA_ "UserSigValidity" SG_ 992 ChildLock_ActnFlSta 0;
BA_ "GenSigSendType" SG_ 992 ChildLock_ActnFlSta 4;
BA_ "Description" SG_ 992 ChildLock_ActnFlSta "Child Lock actuation failed";
BA_ "Version" SG_ 992 DoorLock_LkOutSta "17.12.00";
BA_ "NetworkRequestHoldingTime" SG_ 992 DoorLock_LkOutSta 5000;
BA_ "NetworkRequest" SG_ 992 DoorLock_LkOutSta 0;
BA_ "UserSigValidity" SG_ 992 DoorLock_LkOutSta 0;
BA_ "GenSigSendType" SG_ 992 DoorLock_LkOutSta 4;
BA_ "Description" SG_ 992 DoorLock_LkOutSta "- Door Lock or Unlock Output State 



0x0 : Off (Door lock/unlock output Off state)



0x1 : On (Door lock/unlock output On state)";
BA_ "Version" SG_ 992 VSAutoDrLkRetryFailSta "21.11.00";
BA_ "NetworkRequestHoldingTime" SG_ 992 VSAutoDrLkRetryFailSta 5000;
BA_ "NetworkRequest" SG_ 992 VSAutoDrLkRetryFailSta 0;
BA_ "UserSigValidity" SG_ 992 VSAutoDrLkRetryFailSta 6;
BA_ "TimeoutValue" SG_ 992 VSAutoDrLkRetryFailSta "0x0";
BA_ "GenSigSendType" SG_ 992 VSAutoDrLkRetryFailSta 4;
BA_ "Description" SG_ 992 VSAutoDrLkRetryFailSta "Door lock fail status after vehicle speed auto door lock retry 3 times";
BA_ "Version" SG_ 992 Trunk_TrnkTlgtOutReleaseSwSta "23.04.02";
BA_ "NetworkRequestHoldingTime" SG_ 992 Trunk_TrnkTlgtOutReleaseSwSta 5000;
BA_ "NetworkRequest" SG_ 992 Trunk_TrnkTlgtOutReleaseSwSta 0;
BA_ "UserSigValidity" SG_ 992 Trunk_TrnkTlgtOutReleaseSwSta 0;
BA_ "GenSigSendType" SG_ 992 Trunk_TrnkTlgtOutReleaseSwSta 4;
BA_ "Description" SG_ 992 Trunk_TrnkTlgtOutReleaseSwSta "-(Old)C_TRUNK_LID

-Trunk/Tailgate Outter Release SW";
BA_ "Version" SG_ 992 Trunk_TrnkInReleaseSwSta "23.04.02";
BA_ "NetworkRequestHoldingTime" SG_ 992 Trunk_TrnkInReleaseSwSta 5000;
BA_ "NetworkRequest" SG_ 992 Trunk_TrnkInReleaseSwSta 0;
BA_ "UserSigValidity" SG_ 992 Trunk_TrnkInReleaseSwSta 0;
BA_ "GenSigSendType" SG_ 992 Trunk_TrnkInReleaseSwSta 4;
BA_ "Description" SG_ 992 Trunk_TrnkInReleaseSwSta "-Trunk Inner Release SW";
BA_ "Version" SG_ 992 Trunk_GlvBxTrnkLkSwSta "17.12.00";
BA_ "NetworkRequestHoldingTime" SG_ 992 Trunk_GlvBxTrnkLkSwSta 5000;
BA_ "NetworkRequest" SG_ 992 Trunk_GlvBxTrnkLkSwSta 0;
BA_ "UserSigValidity" SG_ 992 Trunk_GlvBxTrnkLkSwSta 0;
BA_ "GenSigSendType" SG_ 992 Trunk_GlvBxTrnkLkSwSta 4;
BA_ "Description" SG_ 992 Trunk_GlvBxTrnkLkSwSta "- Glove Box Trunk Lock SW";
BA_ "Version" SG_ 992 Trunk_TrnkTlgtSwSta "17.12.00";
BA_ "NetworkRequestHoldingTime" SG_ 992 Trunk_TrnkTlgtSwSta 5000;
BA_ "NetworkRequest" SG_ 992 Trunk_TrnkTlgtSwSta 0;
BA_ "UserSigValidity" SG_ 992 Trunk_TrnkTlgtSwSta 0;
BA_ "GenSigSendType" SG_ 992 Trunk_TrnkTlgtSwSta 4;
BA_ "Description" SG_ 992 Trunk_TrnkTlgtSwSta "Full Lock SW Status Signal



(TailGate/TrunkLid Tpye all)



1. Luggage or Trunkroom Lamp On/Off



2. TailGate/TrunkLid Open Ind in cluster



3. Normal Open SW



  - SW Off: Full Lock(Full Close state)



  - SW On: ^Full Lock";
BA_ "Version" SG_ 992 Trunk_TlgtFullOpnSwSta "17.12.00";
BA_ "NetworkRequestHoldingTime" SG_ 992 Trunk_TlgtFullOpnSwSta 5000;
BA_ "NetworkRequest" SG_ 992 Trunk_TlgtFullOpnSwSta 0;
BA_ "UserSigValidity" SG_ 992 Trunk_TlgtFullOpnSwSta 0;
BA_ "GenSigSendType" SG_ 992 Trunk_TlgtFullOpnSwSta 4;
BA_ "Description" SG_ 992 Trunk_TlgtFullOpnSwSta "Full Open SW Status Signal



(Power TailGate/TrunkLid Tpye or tailgate latch 2sw type)



* Normal Open SW



  - SW Off: ^Full Open



  - SW On: Full Open(Full Open state)";
BA_ "Version" SG_ 992 Trunk_TrnkTlgtReleaseRlySta "17.12.00";
BA_ "NetworkRequestHoldingTime" SG_ 992 Trunk_TrnkTlgtReleaseRlySta 5000;
BA_ "NetworkRequest" SG_ 992 Trunk_TrnkTlgtReleaseRlySta 0;
BA_ "UserSigValidity" SG_ 992 Trunk_TrnkTlgtReleaseRlySta 0;
BA_ "GenSigSendType" SG_ 992 Trunk_TrnkTlgtReleaseRlySta 4;
BA_ "Version" SG_ 992 FrtWiper_ParkingSwState "23.04.06";
BA_ "UserSigValidity" SG_ 992 FrtWiper_ParkingSwState 0;
BA_ "TimeoutValue" SG_ 992 FrtWiper_ParkingSwState "0x0";
BA_ "GenSigSendType" SG_ 992 FrtWiper_ParkingSwState 4;
BA_ "Description" SG_ 992 FrtWiper_ParkingSwState "Front wiper parking switch state";
BA_ "Version" SG_ 992 PDC_TlgtUnLkSta "24.01.00";
BA_ "NetworkRequestHoldingTime" SG_ 992 PDC_TlgtUnLkSta 5000;
BA_ "NetworkRequest" SG_ 992 PDC_TlgtUnLkSta 0;
BA_ "UserSigValidity" SG_ 992 PDC_TlgtUnLkSta 0;
BA_ "GenSigSendType" SG_ 992 PDC_TlgtUnLkSta 4;
BA_ "Description" SG_ 992 PDC_TlgtUnLkSta "Tailgate unlocked status of MPV vehicle with twin swing tailgate";
BA_ "Version" SG_ 992 PDC_PSDPwrModeOffSwSta "24.01.00";
BA_ "NetworkRequestHoldingTime" SG_ 992 PDC_PSDPwrModeOffSwSta 5000;
BA_ "NetworkRequest" SG_ 992 PDC_PSDPwrModeOffSwSta 0;
BA_ "UserSigValidity" SG_ 992 PDC_PSDPwrModeOffSwSta 0;
BA_ "GenSigSendType" SG_ 992 PDC_PSDPwrModeOffSwSta 4;
BA_ "Description" SG_ 992 PDC_PSDPwrModeOffSwSta "PSD power mode off switch state(Self-return type)

-'On' value is output only during the time the switch is pressed";
BA_ "Version" SG_ 992 PDC_FuelDrOpenSta "24.04.03";
BA_ "NetworkRequestHoldingTime" SG_ 992 PDC_FuelDrOpenSta 5000;
BA_ "NetworkRequest" SG_ 992 PDC_FuelDrOpenSta 0;
BA_ "UserSigValidity" SG_ 992 PDC_FuelDrOpenSta 0;
BA_ "GenSigSendType" SG_ 992 PDC_FuelDrOpenSta 4;
BA_ "Description" SG_ 992 PDC_FuelDrOpenSta "Fuel door open status(Open/Close)

Fuel door switch located in fuel door, thus switch states means physical status of fuel door(Open/Close)";
BA_ "Version" SG_ 992 PDC_FD_AlvCnt1Val "22.10.20";
BA_ "UserSigValidity" SG_ 992 PDC_FD_AlvCnt1Val 3;
BA_ "GenSigSendType" SG_ 992 PDC_FD_AlvCnt1Val 4;
BA_ "Description" SG_ 992 PDC_FD_AlvCnt1Val "For the first transmission request for a data element the counter shall be initialized with 0 and shall be incremented by 1 for every subsequent send request. 

When the counter reaches the maximum value(0xFF), then it shall restart with 0 for the next s";
BA_ "Version" SG_ 992 OBCWakeupDrLock "19.04.06";
BA_ "UserSigValidity" SG_ 992 OBCWakeupDrLock 0;
BA_ "GenSigSendType" SG_ 992 OBCWakeupDrLock 4;
BA_ "Description" SG_ 992 OBCWakeupDrLock "This signal is for OBC wake-up, When ICU Lock event";
BA_ "Version" SG_ 992 OBCWakeupDrUnlock "19.04.06";
BA_ "UserSigValidity" SG_ 992 OBCWakeupDrUnlock 0;
BA_ "GenSigSendType" SG_ 992 OBCWakeupDrUnlock 4;
BA_ "Description" SG_ 992 OBCWakeupDrUnlock "This signal is for OBC wake-up, When ICU Unlock event";
BA_ "Version" SG_ 992 Trunk_BgtOpnHzrdReq "22.07.06";
BA_ "NetworkRequestHoldingTime" SG_ 992 Trunk_BgtOpnHzrdReq 5000;
BA_ "NetworkRequest" SG_ 992 Trunk_BgtOpnHzrdReq 0;
BA_ "UserSigValidity" SG_ 992 Trunk_BgtOpnHzrdReq 0;
BA_ "GenSigSendType" SG_ 992 Trunk_BgtOpnHzrdReq 4;
BA_ "Description" SG_ 992 Trunk_BgtOpnHzrdReq "Hazzard Request by Bedgate Open";
BA_ "Version" SG_ 992 Trunk_BgtOpnBzrReq "22.07.06";
BA_ "NetworkRequestHoldingTime" SG_ 992 Trunk_BgtOpnBzrReq 5000;
BA_ "NetworkRequest" SG_ 992 Trunk_BgtOpnBzrReq 0;
BA_ "UserSigValidity" SG_ 992 Trunk_BgtOpnBzrReq 0;
BA_ "GenSigSendType" SG_ 992 Trunk_BgtOpnBzrReq 4;
BA_ "Description" SG_ 992 Trunk_BgtOpnBzrReq "Buzzer Request by Bedgate Open";
BA_ "Version" SG_ 992 IGN3State "23.09.00";
BA_ "UserSigValidity" SG_ 992 IGN3State 7;
BA_ "TimeoutValue" SG_ 992 IGN3State "0x0";
BA_ "GenSigSendType" SG_ 992 IGN3State 4;
BA_ "Description" SG_ 992 IGN3State "Output status of ignition 3";
BA_ "Version" SG_ 992 IGN3State_By_BMS "25.11.00";
BA_ "UserSigValidity" SG_ 992 IGN3State_By_BMS 7;
BA_ "TimeoutValue" SG_ 992 IGN3State_By_BMS "0x0";
BA_ "GenSigSendType" SG_ 992 IGN3State_By_BMS 4;
BA_ "Description" SG_ 992 IGN3State_By_BMS "Output status of ignition 3 by BMS request";
BA_ "Version" SG_ 992 IGN3State_By_VCMS_HMU "23.02.02";
BA_ "UserSigValidity" SG_ 992 IGN3State_By_VCMS_HMU 7;
BA_ "TimeoutValue" SG_ 992 IGN3State_By_VCMS_HMU "0x0";
BA_ "GenSigSendType" SG_ 992 IGN3State_By_VCMS_HMU 4;
BA_ "Description" SG_ 992 IGN3State_By_VCMS_HMU "Output status of ignition 3 by VCMS(PHEV/EV) or HMU(FCEV) request";
BA_ "Version" SG_ 992 IGN3State_By_AfterBlow "23.02.02";
BA_ "UserSigValidity" SG_ 992 IGN3State_By_AfterBlow 7;
BA_ "TimeoutValue" SG_ 992 IGN3State_By_AfterBlow "0x0";
BA_ "GenSigSendType" SG_ 992 IGN3State_By_AfterBlow 4;
BA_ "Description" SG_ 992 IGN3State_By_AfterBlow "Output status of ignition 3 by DATC(FATC/MTC) request for after blow";
BA_ "Version" SG_ 992 IGN3State_By_Bat "23.02.01";
BA_ "UserSigValidity" SG_ 992 IGN3State_By_Bat 7;
BA_ "TimeoutValue" SG_ 992 IGN3State_By_Bat "0x0";
BA_ "GenSigSendType" SG_ 992 IGN3State_By_Bat 4;
BA_ "Description" SG_ 992 IGN3State_By_Bat "Output status of ignition 3 by IBS or BMS request for HEV 12V auxiliary battery charging";
BA_ "Version" SG_ 992 IGN3State_By_VCU_HCU_FCU "23.02.02";
BA_ "UserSigValidity" SG_ 992 IGN3State_By_VCU_HCU_FCU 7;
BA_ "TimeoutValue" SG_ 992 IGN3State_By_VCU_HCU_FCU "0x0";
BA_ "GenSigSendType" SG_ 992 IGN3State_By_VCU_HCU_FCU 4;
BA_ "Description" SG_ 992 IGN3State_By_VCU_HCU_FCU "Output status of ignition 3 by VCU(EV) or HCU(HEV/PHEV) or FCU(FCEV) request";
BA_ "Version" SG_ 992 IGN3State_By_HU "23.02.02";
BA_ "UserSigValidity" SG_ 992 IGN3State_By_HU 7;
BA_ "TimeoutValue" SG_ 992 IGN3State_By_HU "0x0";
BA_ "GenSigSendType" SG_ 992 IGN3State_By_HU 4;
BA_ "Description" SG_ 992 IGN3State_By_HU "Output status of ignition 3 by HU(AVNT) or CCU request for CCS";
BA_ "Version" SG_ 992 IGN3CutOffState "24.07.06";
BA_ "UserSigValidity" SG_ 992 IGN3CutOffState 7;
BA_ "TimeoutValue" SG_ 992 IGN3CutOffState "0x0";
BA_ "GenSigSendType" SG_ 992 IGN3CutOffState 4;
BA_ "Description" SG_ 992 IGN3CutOffState "Output status of ignition 3 Cut Off



0x0:CutOffNotApplied (Cut Off Funtion Not Applied in PDC)

0x1:NoRequest (No IGN3 Request)

0x2:Normal (IGN3 Request and Power State is OK)

0x3:PreWarn (IGN3 Request and Power State is NOK, IGN3 Cut Off PreWarning)";
BA_ "Version" SG_ 992 IGN3State_By_ActiveOn "25.01.01";
BA_ "UserSigValidity" SG_ 992 IGN3State_By_ActiveOn 0;
BA_ "GenSigSendType" SG_ 992 IGN3State_By_ActiveOn 4;
BA_ "Description" SG_ 992 IGN3State_By_ActiveOn "Output status of ignition 3 by Active On";
BA_ "Version" SG_ 992 SeatBeltSwSta_Drv "23.07.03";
BA_ "NetworkRequestHoldingTime" SG_ 992 SeatBeltSwSta_Drv 5000;
BA_ "NetworkRequest" SG_ 992 SeatBeltSwSta_Drv 0;
BA_ "UserSigValidity" SG_ 992 SeatBeltSwSta_Drv 0;
BA_ "GenSigSendType" SG_ 992 SeatBeltSwSta_Drv 4;
BA_ "Description" SG_ 992 SeatBeltSwSta_Drv "Driver Seat Belt Switch Status.

This signal is set as 'Not Supported' if the seat belt is not installed for EDR law(UN ECE R160.01) and EURO NCAP";
BA_ "Version" SG_ 992 SeatBeltSwSta_1stCtr "23.07.03";
BA_ "NetworkRequestHoldingTime" SG_ 992 SeatBeltSwSta_1stCtr 5000;
BA_ "NetworkRequest" SG_ 992 SeatBeltSwSta_1stCtr 0;
BA_ "UserSigValidity" SG_ 992 SeatBeltSwSta_1stCtr 0;
BA_ "GenSigSendType" SG_ 992 SeatBeltSwSta_1stCtr 4;
BA_ "Description" SG_ 992 SeatBeltSwSta_1stCtr "1st Center Seat Belt Switch Status

This signal is set as 'Not Supported' if the seat belt is not installed for EDR law(UN ECE R160.01) and EURO NCAP";
BA_ "Version" SG_ 992 SeatBeltSwSta_Asst "23.07.03";
BA_ "NetworkRequestHoldingTime" SG_ 992 SeatBeltSwSta_Asst 5000;
BA_ "NetworkRequest" SG_ 992 SeatBeltSwSta_Asst 0;
BA_ "UserSigValidity" SG_ 992 SeatBeltSwSta_Asst 0;
BA_ "GenSigSendType" SG_ 992 SeatBeltSwSta_Asst 4;
BA_ "Description" SG_ 992 SeatBeltSwSta_Asst "Assistance Seat Belt Switch Status

This signal is set as 'Not Supported' if the seat belt is not installed for EDR law(UN ECE R160.01) and EURO NCAP";
BA_ "Version" SG_ 992 SeatBeltSwSta_2ndLft "23.07.03";
BA_ "NetworkRequestHoldingTime" SG_ 992 SeatBeltSwSta_2ndLft 5000;
BA_ "NetworkRequest" SG_ 992 SeatBeltSwSta_2ndLft 0;
BA_ "UserSigValidity" SG_ 992 SeatBeltSwSta_2ndLft 0;
BA_ "GenSigSendType" SG_ 992 SeatBeltSwSta_2ndLft 4;
BA_ "Description" SG_ 992 SeatBeltSwSta_2ndLft "2nd Left Seat Belt Switch Status

This signal is set as 'Not Supported' if the seat belt is not installed for EDR law(UN ECE R160.01) and EURO NCAP";
BA_ "Version" SG_ 992 SeatBeltSwSta_2ndCtr "23.07.03";
BA_ "NetworkRequestHoldingTime" SG_ 992 SeatBeltSwSta_2ndCtr 5000;
BA_ "NetworkRequest" SG_ 992 SeatBeltSwSta_2ndCtr 0;
BA_ "UserSigValidity" SG_ 992 SeatBeltSwSta_2ndCtr 0;
BA_ "GenSigSendType" SG_ 992 SeatBeltSwSta_2ndCtr 4;
BA_ "Description" SG_ 992 SeatBeltSwSta_2ndCtr "2nd Center Seat Belt Switch Status

This signal is set as 'Not Supported' if the seat belt is not installed for EDR law(UN ECE R160.01) and EURO NCAP";
BA_ "Version" SG_ 992 SeatBeltSwSta_2ndRt "23.07.03";
BA_ "NetworkRequestHoldingTime" SG_ 992 SeatBeltSwSta_2ndRt 5000;
BA_ "NetworkRequest" SG_ 992 SeatBeltSwSta_2ndRt 0;
BA_ "UserSigValidity" SG_ 992 SeatBeltSwSta_2ndRt 0;
BA_ "GenSigSendType" SG_ 992 SeatBeltSwSta_2ndRt 4;
BA_ "Description" SG_ 992 SeatBeltSwSta_2ndRt "2nd Right Seat Belt Switch Status

This signal is set as 'Not Supported' if the seat belt is not installed for EDR law(UN ECE R160.01) and EURO NCAP";
BA_ "Version" SG_ 992 SeatBeltSwSta_3rdLft "23.07.03";
BA_ "NetworkRequestHoldingTime" SG_ 992 SeatBeltSwSta_3rdLft 5000;
BA_ "NetworkRequest" SG_ 992 SeatBeltSwSta_3rdLft 0;
BA_ "UserSigValidity" SG_ 992 SeatBeltSwSta_3rdLft 0;
BA_ "GenSigSendType" SG_ 992 SeatBeltSwSta_3rdLft 4;
BA_ "Description" SG_ 992 SeatBeltSwSta_3rdLft "3rd Left Seat Belt Switch Status

This signal is set as 'Not Supported' if the seat belt is not installed for EDR law(UN ECE R160.01) and EURO NCAP";
BA_ "Version" SG_ 992 SeatBeltSwSta_3rdCtr "23.07.03";
BA_ "NetworkRequestHoldingTime" SG_ 992 SeatBeltSwSta_3rdCtr 5000;
BA_ "NetworkRequest" SG_ 992 SeatBeltSwSta_3rdCtr 0;
BA_ "UserSigValidity" SG_ 992 SeatBeltSwSta_3rdCtr 0;
BA_ "GenSigSendType" SG_ 992 SeatBeltSwSta_3rdCtr 4;
BA_ "Description" SG_ 992 SeatBeltSwSta_3rdCtr "3rd Center Seat Belt Switch Status

This signal is set as 'Not Supported' if the seat belt is not installed for EDR law(UN ECE R160.01) and EURO NCAP";
BA_ "Version" SG_ 992 SeatBeltSwSta_3rdRt "23.07.03";
BA_ "NetworkRequestHoldingTime" SG_ 992 SeatBeltSwSta_3rdRt 5000;
BA_ "NetworkRequest" SG_ 992 SeatBeltSwSta_3rdRt 0;
BA_ "UserSigValidity" SG_ 992 SeatBeltSwSta_3rdRt 0;
BA_ "GenSigSendType" SG_ 992 SeatBeltSwSta_3rdRt 4;
BA_ "Description" SG_ 992 SeatBeltSwSta_3rdRt "3rd Right Seat Belt Switch Status

This signal is set as 'Not Supported' if the seat belt is not installed for EDR law(UN ECE R160.01) and EURO NCAP";
BA_ "Version" SG_ 992 SeatBelt4th_InstallInfo "23.07.05";
BA_ "NetworkRequestHoldingTime" SG_ 992 SeatBelt4th_InstallInfo 5000;
BA_ "NetworkRequest" SG_ 992 SeatBelt4th_InstallInfo 0;
BA_ "UserSigValidity" SG_ 992 SeatBelt4th_InstallInfo 0;
BA_ "GenSigSendType" SG_ 992 SeatBelt4th_InstallInfo 4;
BA_ "Description" SG_ 992 SeatBelt4th_InstallInfo "4th Seat Belt installation Information";
BA_ "Version" SG_ 992 PDCex_CurtainOpt "23.07.04";
BA_ "UserSigValidity" SG_ 992 PDCex_CurtainOpt 0;
BA_ "GenSigSendType" SG_ 992 PDCex_CurtainOpt 4;
BA_ "Description" SG_ 992 PDCex_CurtainOpt "PDCex Curtain Option Information

0x0 : No Curtain

0x1 : Rear Curtain Only

0x2 : Quarter Glass Curtain Only

0x3 : All Curtain(Rear+Quarter Glass Curtain)";
BA_ "Version" SG_ 992 Reprogram_State_PDC2 "24.04.09";
BA_ "NetworkRequestHoldingTime" SG_ 992 Reprogram_State_PDC2 5000;
BA_ "NetworkRequest" SG_ 992 Reprogram_State_PDC2 0;
BA_ "UserSigValidity" SG_ 992 Reprogram_State_PDC2 0;
BA_ "TimeoutValue" SG_ 992 Reprogram_State_PDC2 "0x1";
BA_ "GenSigStartValue" SG_ 992 Reprogram_State_PDC2 3;
BA_ "GenSigSendType" SG_ 992 Reprogram_State_PDC2 4;
BA_ "Description" SG_ 992 Reprogram_State_PDC2 "This signal indicates reprogramming progress of PDC.

0x0: normal operation / 0x1: reprogramming / 0x2: RESERVED /0x3: Invalid (default)";
BA_ "Version" SG_ 992 PDC_DataLog_GetCanLog "25.07.04";
BA_ "UserSigValidity" SG_ 992 PDC_DataLog_GetCanLog 0;
BA_ "GenSigSendType" SG_ 992 PDC_DataLog_GetCanLog 4;
BA_ "Description" SG_ 992 PDC_DataLog_GetCanLog "Request to get CAN logs to CCU";
BA_ "Version" SG_ 992 Warn_RrCTRSBRMATSwSta "24.05.00";
BA_ "NetworkRequestHoldingTime" SG_ 992 Warn_RrCTRSBRMATSwSta 5000;
BA_ "NetworkRequest" SG_ 992 Warn_RrCTRSBRMATSwSta 0;
BA_ "UserSigValidity" SG_ 992 Warn_RrCTRSBRMATSwSta 0;
BA_ "GenSigSendType" SG_ 992 Warn_RrCTRSBRMATSwSta 4;
BA_ "Description" SG_ 992 Warn_RrCTRSBRMATSwSta "2nd Center SBR MAT Switch State";
BA_ "Version" SG_ 992 C_3rdRCSBRMatSw "24.05.00";
BA_ "NetworkRequestHoldingTime" SG_ 992 C_3rdRCSBRMatSw 5000;
BA_ "NetworkRequest" SG_ 992 C_3rdRCSBRMatSw 0;
BA_ "UserSigValidity" SG_ 992 C_3rdRCSBRMatSw 0;
BA_ "GenSigSendType" SG_ 992 C_3rdRCSBRMatSw 4;
BA_ "Description" SG_ 992 C_3rdRCSBRMatSw "3rd Rear Center SBR MAT Switch State";
BA_ "Version" SG_ 992 DriveTypeOption "21.11.00";
BA_ "NetworkRequestHoldingTime" SG_ 992 DriveTypeOption 5000;
BA_ "NetworkRequest" SG_ 992 DriveTypeOption 0;
BA_ "UserSigValidity" SG_ 992 DriveTypeOption 0;
BA_ "GenSigSendType" SG_ 992 DriveTypeOption 4;
BA_ "Description" SG_ 992 DriveTypeOption "Drive Type Option

This signal is used to determine driver's seat position('Drive Type') about this vehicle.";
BA_ "Version" SG_ 992 AutoLtOpt "20.09.00";
BA_ "UserSigValidity" SG_ 992 AutoLtOpt 0;
BA_ "GenSigSendType" SG_ 992 AutoLtOpt 4;
BA_ "Description" SG_ 992 AutoLtOpt "Auto Light 사양 적용 여부 및 적용 옵션 정보 출력 (미적용/적용)";
BA_ "Version" SG_ 992 HLmpLoHiOptLtSrcTyp "20.09.00";
BA_ "UserSigValidity" SG_ 992 HLmpLoHiOptLtSrcTyp 0;
BA_ "GenSigSendType" SG_ 992 HLmpLoHiOptLtSrcTyp 4;
BA_ "Description" SG_ 992 HLmpLoHiOptLtSrcTyp "Head Low and High Lamp Option and Light Source Type";
BA_ "Version" SG_ 992 C_StrgWhlHeatingOpt "23.02.02";
BA_ "UserSigValidity" SG_ 992 C_StrgWhlHeatingOpt 0;
BA_ "GenSigSendType" SG_ 992 C_StrgWhlHeatingOpt 4;
BA_ "Description" SG_ 992 C_StrgWhlHeatingOpt "Steering wheel heating option signal";
BA_ "Version" SG_ 992 C_StrgWhlHeatingSWInf "19.11.11";
BA_ "UserSigValidity" SG_ 992 C_StrgWhlHeatingSWInf 3;
BA_ "GenSigSendType" SG_ 992 C_StrgWhlHeatingSWInf 4;
BA_ "Description" SG_ 992 C_StrgWhlHeatingSWInf "Steering wheel heating Step information signal";
BA_ "Version" SG_ 992 ICU_MtGearPosRSta "21.07.05";
BA_ "UserSigValidity" SG_ 992 ICU_MtGearPosRSta 3;
BA_ "GenSigSendType" SG_ 992 ICU_MtGearPosRSta 4;
BA_ "Description" SG_ 992 ICU_MtGearPosRSta "Manual Shift Lever R Switch Status 0x0:Off/0x1:On";
BA_ "Version" SG_ 992 C_AutoLeverManualSW "19.09.06";
BA_ "UserSigValidity" SG_ 992 C_AutoLeverManualSW 3;
BA_ "GenSigSendType" SG_ 992 C_AutoLeverManualSW 4;
BA_ "Description" SG_ 992 C_AutoLeverManualSW "This signal represents operating status of AT/CVT/DCT Lever Manual Switch";
BA_ "Version" SG_ 992 Warn_HoodSwMemorySta "21.11.00";
BA_ "NetworkRequestHoldingTime" SG_ 992 Warn_HoodSwMemorySta 5000;
BA_ "NetworkRequest" SG_ 992 Warn_HoodSwMemorySta 0;
BA_ "UserSigValidity" SG_ 992 Warn_HoodSwMemorySta 3;
BA_ "GenSigSendType" SG_ 992 Warn_HoodSwMemorySta 4;
BA_ "Description" SG_ 992 Warn_HoodSwMemorySta "Hood swtich open->close information(memory)



This signal is for oil level warning lamp reset In case hood open->close when IG-OFF, 0x01 sent for 5 sec at next IG-ON";
BA_ "Version" SG_ 992 Warn_PrkngBrkSwSta "17.12.00";
BA_ "NetworkRequestHoldingTime" SG_ 992 Warn_PrkngBrkSwSta 5000;
BA_ "NetworkRequest" SG_ 992 Warn_PrkngBrkSwSta 0;
BA_ "UserSigValidity" SG_ 992 Warn_PrkngBrkSwSta 0;
BA_ "GenSigSendType" SG_ 992 Warn_PrkngBrkSwSta 4;
BA_ "Version" SG_ 992 PrkngBrkNotchSwState "20.08.07";
BA_ "NetworkRequestHoldingTime" SG_ 992 PrkngBrkNotchSwState 5000;
BA_ "NetworkRequest" SG_ 992 PrkngBrkNotchSwState 0;
BA_ "UserSigValidity" SG_ 992 PrkngBrkNotchSwState 0;
BA_ "GenSigSendType" SG_ 992 PrkngBrkNotchSwState 4;
BA_ "Description" SG_ 992 PrkngBrkNotchSwState "Parking Brake High Notch Switch State";
BA_ "Version" SG_ 992 Warn_BrkFldSwSta "17.12.00";
BA_ "NetworkRequestHoldingTime" SG_ 992 Warn_BrkFldSwSta 5000;
BA_ "NetworkRequest" SG_ 992 Warn_BrkFldSwSta 0;
BA_ "UserSigValidity" SG_ 992 Warn_BrkFldSwSta 0;
BA_ "GenSigSendType" SG_ 992 Warn_BrkFldSwSta 4;
BA_ "Version" SG_ 992 Warn_WshrFldSwSta "21.07.05";
BA_ "NetworkRequestHoldingTime" SG_ 992 Warn_WshrFldSwSta 5000;
BA_ "NetworkRequest" SG_ 992 Warn_WshrFldSwSta 0;
BA_ "UserSigValidity" SG_ 992 Warn_WshrFldSwSta 3;
BA_ "GenSigSendType" SG_ 992 Warn_WshrFldSwSta 4;
BA_ "Description" SG_ 992 Warn_WshrFldSwSta "Washer Fluid Switch Signal

This signal indicates Washer Fluid Switch Signal

0x0:Off/0x1:On";
BA_ "Version" SG_ 992 Warn_DrvStBltSwSta "17.12.00";
BA_ "NetworkRequestHoldingTime" SG_ 992 Warn_DrvStBltSwSta 5000;
BA_ "NetworkRequest" SG_ 992 Warn_DrvStBltSwSta 0;
BA_ "UserSigValidity" SG_ 992 Warn_DrvStBltSwSta 0;
BA_ "GenSigSendType" SG_ 992 Warn_DrvStBltSwSta 4;
BA_ "Version" SG_ 992 Warn_AsstStBltSwSta "17.12.00";
BA_ "NetworkRequestHoldingTime" SG_ 992 Warn_AsstStBltSwSta 5000;
BA_ "NetworkRequest" SG_ 992 Warn_AsstStBltSwSta 0;
BA_ "UserSigValidity" SG_ 992 Warn_AsstStBltSwSta 0;
BA_ "GenSigStartValue" SG_ 992 Warn_AsstStBltSwSta 1;
BA_ "GenSigSendType" SG_ 992 Warn_AsstStBltSwSta 4;
BA_ "Description" SG_ 992 Warn_AsstStBltSwSta "-Default value: 0x1 (Belt)



-Initial value: 0x1 (Belt)



-Timeout value: 0x1 (Belt)";
BA_ "Version" SG_ 992 Warn_RrLftStBltSwSta "17.12.00";
BA_ "NetworkRequestHoldingTime" SG_ 992 Warn_RrLftStBltSwSta 5000;
BA_ "NetworkRequest" SG_ 992 Warn_RrLftStBltSwSta 0;
BA_ "UserSigValidity" SG_ 992 Warn_RrLftStBltSwSta 0;
BA_ "GenSigSendType" SG_ 992 Warn_RrLftStBltSwSta 4;
BA_ "Version" SG_ 992 Warn_RrCtrStBltSwSta "17.12.00";
BA_ "NetworkRequestHoldingTime" SG_ 992 Warn_RrCtrStBltSwSta 5000;
BA_ "NetworkRequest" SG_ 992 Warn_RrCtrStBltSwSta 0;
BA_ "UserSigValidity" SG_ 992 Warn_RrCtrStBltSwSta 0;
BA_ "GenSigSendType" SG_ 992 Warn_RrCtrStBltSwSta 4;
BA_ "Version" SG_ 992 Warn_RrRtStBltSwSta "17.12.00";
BA_ "NetworkRequestHoldingTime" SG_ 992 Warn_RrRtStBltSwSta 5000;
BA_ "NetworkRequest" SG_ 992 Warn_RrRtStBltSwSta 0;
BA_ "UserSigValidity" SG_ 992 Warn_RrRtStBltSwSta 0;
BA_ "GenSigSendType" SG_ 992 Warn_RrRtStBltSwSta 4;
BA_ "Version" SG_ 992 C_3rdRLSeatBeltSW "18.03.04";
BA_ "NetworkRequestHoldingTime" SG_ 992 C_3rdRLSeatBeltSW 5000;
BA_ "NetworkRequest" SG_ 992 C_3rdRLSeatBeltSW 0;
BA_ "UserSigValidity" SG_ 992 C_3rdRLSeatBeltSW 0;
BA_ "GenSigSendType" SG_ 992 C_3rdRLSeatBeltSW 4;
BA_ "Description" SG_ 992 C_3rdRLSeatBeltSW "3rd Rear Left Seat Belt Switch Status";
BA_ "Version" SG_ 995 PDC_FD_Crc4Val "22.10.20";
BA_ "UserSigValidity" SG_ 995 PDC_FD_Crc4Val 3;
BA_ "GenSigStartValue" SG_ 995 PDC_FD_Crc4Val 65535;
BA_ "GenSigSendType" SG_ 995 PDC_FD_Crc4Val 4;
BA_ "Description" SG_ 995 PDC_FD_Crc4Val "The data area for CRC calculation is based on the data length (DLC) of the message DB.

The CRC shall be calculated over the entire data block (excluding the CRC bytes) including the user data, alive counter and Data ID



- CRC Polynomial (0x1021) , Ini";
BA_ "Version" SG_ 995 PDC_FD_AlvCnt4Val "22.10.20";
BA_ "UserSigValidity" SG_ 995 PDC_FD_AlvCnt4Val 3;
BA_ "GenSigSendType" SG_ 995 PDC_FD_AlvCnt4Val 4;
BA_ "Description" SG_ 995 PDC_FD_AlvCnt4Val "For the first transmission request for a data element the counter shall be initialized with 0 and shall be incremented by 1 for every subsequent send request. 

When the counter reaches the maximum value(0xFF), then it shall restart with 0 for the next s";
BA_ "Version" SG_ 995 ICU_Haptic_OPT "18.07.07";
BA_ "NetworkRequestHoldingTime" SG_ 995 ICU_Haptic_OPT 5000;
BA_ "NetworkRequest" SG_ 995 ICU_Haptic_OPT 0;
BA_ "UserSigValidity" SG_ 995 ICU_Haptic_OPT 0;
BA_ "GenSigSendType" SG_ 995 ICU_Haptic_OPT 4;
BA_ "Description" SG_ 995 ICU_Haptic_OPT "Steering Wheel Haptic Warning Option Infomation (From ICU)";
BA_ "Version" SG_ 995 HSWS_SysWrngSta_ICU "21.11.00";
BA_ "UserSigValidity" SG_ 995 HSWS_SysWrngSta_ICU 4;
BA_ "GenSigSendType" SG_ 995 HSWS_SysWrngSta_ICU 4;
BA_ "Description" SG_ 995 HSWS_SysWrngSta_ICU "0x0 : Normal

0x1 : System Fail

0x2 : Reserved

0x3 : Invalid";
BA_ "Version" SG_ 995 ICU_PwrWdwMvInhbtSta "19.02.05";
BA_ "NetworkRequestHoldingTime" SG_ 995 ICU_PwrWdwMvInhbtSta 5000;
BA_ "NetworkRequest" SG_ 995 ICU_PwrWdwMvInhbtSta 0;
BA_ "UserSigValidity" SG_ 995 ICU_PwrWdwMvInhbtSta 0;
BA_ "GenSigSendType" SG_ 995 ICU_PwrWdwMvInhbtSta 4;
BA_ "Version" SG_ 995 Warn_OSMirrFoldSwState "18.12.01";
BA_ "NetworkRequestHoldingTime" SG_ 995 Warn_OSMirrFoldSwState 5000;
BA_ "NetworkRequest" SG_ 995 Warn_OSMirrFoldSwState 0;
BA_ "UserSigValidity" SG_ 995 Warn_OSMirrFoldSwState 0;
BA_ "GenSigSendType" SG_ 995 Warn_OSMirrFoldSwState 4;
BA_ "Description" SG_ 995 Warn_OSMirrFoldSwState "Outside Mirror folding Sw input signal. It has two type .

1) 0x0 : FOLD , 0x1: UNFOLD or Auto (Seasaw type folding SW)

2) 0x0 :OFF , 0x1 : ON (Self Return Type Folding SW)";
BA_ "Version" SG_ 995 USM_OneTouchTrnSigFuncSta "21.07.05";
BA_ "NetworkRequestHoldingTime" SG_ 995 USM_OneTouchTrnSigFuncSta 5000;
BA_ "NetworkRequest" SG_ 995 USM_OneTouchTrnSigFuncSta 0;
BA_ "UserSigValidity" SG_ 995 USM_OneTouchTrnSigFuncSta 0;
BA_ "GenSigSendType" SG_ 995 USM_OneTouchTrnSigFuncSta 4;
BA_ "Description" SG_ 995 USM_OneTouchTrnSigFuncSta "This signal is 



- For One Touch Turn Signal Function,



 the advanced version of One Touch triple turn signal



- Communicated with Cluster for setting USM



- Periodic Event Signal to notice current staus to USM of Cluster";
BA_ "Version" SG_ 995 ExtLamp_TrnSigLmpLftSwSta "18.08.07";
BA_ "NetworkRequestHoldingTime" SG_ 995 ExtLamp_TrnSigLmpLftSwSta 5000;
BA_ "NetworkRequest" SG_ 995 ExtLamp_TrnSigLmpLftSwSta 0;
BA_ "UserSigValidity" SG_ 995 ExtLamp_TrnSigLmpLftSwSta 0;
BA_ "GenSigSendType" SG_ 995 ExtLamp_TrnSigLmpLftSwSta 4;
BA_ "Version" SG_ 995 ExtLamp_TrnSigLmpRtSwSta "18.08.07";
BA_ "NetworkRequestHoldingTime" SG_ 995 ExtLamp_TrnSigLmpRtSwSta 5000;
BA_ "NetworkRequest" SG_ 995 ExtLamp_TrnSigLmpRtSwSta 0;
BA_ "UserSigValidity" SG_ 995 ExtLamp_TrnSigLmpRtSwSta 0;
BA_ "GenSigSendType" SG_ 995 ExtLamp_TrnSigLmpRtSwSta 4;
BA_ "Version" SG_ 995 Lamp_LaneChgTrnSigLftSwSta_ICU "18.09.05";
BA_ "NetworkRequestHoldingTime" SG_ 995 Lamp_LaneChgTrnSigLftSwSta_ICU 5000;
BA_ "NetworkRequest" SG_ 995 Lamp_LaneChgTrnSigLftSwSta_ICU 0;
BA_ "UserSigValidity" SG_ 995 Lamp_LaneChgTrnSigLftSwSta_ICU 0;
BA_ "GenSigSendType" SG_ 995 Lamp_LaneChgTrnSigLftSwSta_ICU 4;
BA_ "Description" SG_ 995 Lamp_LaneChgTrnSigLftSwSta_ICU "LANE CHANGE TURN SIGNAL FOR LH";
BA_ "Version" SG_ 995 Lamp_LaneChgTrnSigRtSwSta_ICU "18.09.05";
BA_ "NetworkRequestHoldingTime" SG_ 995 Lamp_LaneChgTrnSigRtSwSta_ICU 5000;
BA_ "NetworkRequest" SG_ 995 Lamp_LaneChgTrnSigRtSwSta_ICU 0;
BA_ "UserSigValidity" SG_ 995 Lamp_LaneChgTrnSigRtSwSta_ICU 0;
BA_ "GenSigSendType" SG_ 995 Lamp_LaneChgTrnSigRtSwSta_ICU 4;
BA_ "Description" SG_ 995 Lamp_LaneChgTrnSigRtSwSta_ICU "LANE CHANGE TURN SIGNAL FOR RH";
BA_ "Version" SG_ 995 Lamp_TrnSigLmpLftOnReq "22.05.04";
BA_ "NetworkRequestHoldingTime" SG_ 995 Lamp_TrnSigLmpLftOnReq 5000;
BA_ "NetworkRequest" SG_ 995 Lamp_TrnSigLmpLftOnReq 0;
BA_ "UserSigValidity" SG_ 995 Lamp_TrnSigLmpLftOnReq 0;
BA_ "GenSigSendType" SG_ 995 Lamp_TrnSigLmpLftOnReq 4;
BA_ "Version" SG_ 995 Lamp_TrnSigLmpRtOnReq "22.05.04";
BA_ "NetworkRequestHoldingTime" SG_ 995 Lamp_TrnSigLmpRtOnReq 5000;
BA_ "NetworkRequest" SG_ 995 Lamp_TrnSigLmpRtOnReq 0;
BA_ "UserSigValidity" SG_ 995 Lamp_TrnSigLmpRtOnReq 0;
BA_ "GenSigSendType" SG_ 995 Lamp_TrnSigLmpRtOnReq 4;
BA_ "Version" SG_ 995 Lamp_TrnSigLmpLftActiveSt "21.11.00";
BA_ "NetworkRequestHoldingTime" SG_ 995 Lamp_TrnSigLmpLftActiveSt 5000;
BA_ "NetworkRequest" SG_ 995 Lamp_TrnSigLmpLftActiveSt 0;
BA_ "UserSigValidity" SG_ 995 Lamp_TrnSigLmpLftActiveSt 0;
BA_ "GenSigSendType" SG_ 995 Lamp_TrnSigLmpLftActiveSt 4;
BA_ "Description" SG_ 995 Lamp_TrnSigLmpLftActiveSt "Turn Signal Lmap Blink Info";
BA_ "Version" SG_ 995 Lamp_TrnSigLmpRtActiveSt "21.11.00";
BA_ "NetworkRequestHoldingTime" SG_ 995 Lamp_TrnSigLmpRtActiveSt 5000;
BA_ "NetworkRequest" SG_ 995 Lamp_TrnSigLmpRtActiveSt 0;
BA_ "UserSigValidity" SG_ 995 Lamp_TrnSigLmpRtActiveSt 0;
BA_ "GenSigSendType" SG_ 995 Lamp_TrnSigLmpRtActiveSt 4;
BA_ "Description" SG_ 995 Lamp_TrnSigLmpRtActiveSt "Turn Signal Lamp Blink Info";
BA_ "Version" SG_ 995 TrnLmpSeqEnblCmd "20.08.07";
BA_ "NetworkRequestHoldingTime" SG_ 995 TrnLmpSeqEnblCmd 5000;
BA_ "NetworkRequest" SG_ 995 TrnLmpSeqEnblCmd 0;
BA_ "UserSigValidity" SG_ 995 TrnLmpSeqEnblCmd 0;
BA_ "GenSigSendType" SG_ 995 TrnLmpSeqEnblCmd 4;
BA_ "Description" SG_ 995 TrnLmpSeqEnblCmd "Turn Signal Sequential Enable CAN Command";
BA_ "Version" SG_ 995 CrashHazardLampOnReq "24.07.06";
BA_ "NetworkRequestHoldingTime" SG_ 995 CrashHazardLampOnReq 5000;
BA_ "NetworkRequest" SG_ 995 CrashHazardLampOnReq 0;
BA_ "UserSigValidity" SG_ 995 CrashHazardLampOnReq 0;
BA_ "GenSigSendType" SG_ 995 CrashHazardLampOnReq 4;
BA_ "Description" SG_ 995 CrashHazardLampOnReq "Hazard lamp on request by crash for EURO NCAP2030";
BA_ "Version" SG_ 994 PDC_FD_Crc3Val "22.10.20";
BA_ "UserSigValidity" SG_ 994 PDC_FD_Crc3Val 3;
BA_ "GenSigStartValue" SG_ 994 PDC_FD_Crc3Val 65535;
BA_ "GenSigSendType" SG_ 994 PDC_FD_Crc3Val 4;
BA_ "Description" SG_ 994 PDC_FD_Crc3Val "The data area for CRC calculation is based on the data length (DLC) of the message DB.

The CRC shall be calculated over the entire data block (excluding the CRC bytes) including the user data, alive counter and Data ID



- CRC Polynomial (0x1021) , Ini";
BA_ "Version" SG_ 994 DoorLock_SoftKeySysFailSta "25.04.01";
BA_ "UserSigValidity" SG_ 994 DoorLock_SoftKeySysFailSta 0;
BA_ "GenSigSendType" SG_ 994 DoorLock_SoftKeySysFailSta 4;
BA_ "Description" SG_ 994 DoorLock_SoftKeySysFailSta "Door Lock Unlock System Fail State for Connect Platform Soft Key";
BA_ "Version" SG_ 994 PDC_FD_AlvCnt3Val "22.10.20";
BA_ "UserSigValidity" SG_ 994 PDC_FD_AlvCnt3Val 3;
BA_ "GenSigSendType" SG_ 994 PDC_FD_AlvCnt3Val 4;
BA_ "Description" SG_ 994 PDC_FD_AlvCnt3Val "For the first transmission request for a data element the counter shall be initialized with 0 and shall be incremented by 1 for every subsequent send request. 

When the counter reaches the maximum value(0xFF), then it shall restart with 0 for the next s";
BA_ "Version" SG_ 994 Warn_DrvDrSwSta "17.12.00";
BA_ "NetworkRequestHoldingTime" SG_ 994 Warn_DrvDrSwSta 5000;
BA_ "NetworkRequest" SG_ 994 Warn_DrvDrSwSta 0;
BA_ "UserSigValidity" SG_ 994 Warn_DrvDrSwSta 0;
BA_ "GenSigSendType" SG_ 994 Warn_DrvDrSwSta 4;
BA_ "Version" SG_ 994 Warn_AsstDrSwSta "17.12.00";
BA_ "NetworkRequestHoldingTime" SG_ 994 Warn_AsstDrSwSta 5000;
BA_ "NetworkRequest" SG_ 994 Warn_AsstDrSwSta 0;
BA_ "UserSigValidity" SG_ 994 Warn_AsstDrSwSta 0;
BA_ "GenSigSendType" SG_ 994 Warn_AsstDrSwSta 4;
BA_ "Version" SG_ 994 Warn_RrLftDrSwSta "17.12.00";
BA_ "NetworkRequestHoldingTime" SG_ 994 Warn_RrLftDrSwSta 5000;
BA_ "NetworkRequest" SG_ 994 Warn_RrLftDrSwSta 0;
BA_ "UserSigValidity" SG_ 994 Warn_RrLftDrSwSta 0;
BA_ "GenSigSendType" SG_ 994 Warn_RrLftDrSwSta 4;
BA_ "Version" SG_ 994 Warn_RrRtDrSwSta "17.12.00";
BA_ "NetworkRequestHoldingTime" SG_ 994 Warn_RrRtDrSwSta 5000;
BA_ "NetworkRequest" SG_ 994 Warn_RrRtDrSwSta 0;
BA_ "UserSigValidity" SG_ 994 Warn_RrRtDrSwSta 0;
BA_ "GenSigSendType" SG_ 994 Warn_RrRtDrSwSta 4;
BA_ "Version" SG_ 994 Warn_HoodSwSta "17.12.00";
BA_ "NetworkRequestHoldingTime" SG_ 994 Warn_HoodSwSta 5000;
BA_ "NetworkRequest" SG_ 994 Warn_HoodSwSta 0;
BA_ "UserSigValidity" SG_ 994 Warn_HoodSwSta 0;
BA_ "GenSigSendType" SG_ 994 Warn_HoodSwSta 4;
BA_ "Version" SG_ 994 DoorLock_DrvDrUnLkSta "21.09.05";
BA_ "NetworkRequestHoldingTime" SG_ 994 DoorLock_DrvDrUnLkSta 5000;
BA_ "NetworkRequest" SG_ 994 DoorLock_DrvDrUnLkSta 0;
BA_ "UserSigValidity" SG_ 994 DoorLock_DrvDrUnLkSta 0;
BA_ "GenSigSendType" SG_ 994 DoorLock_DrvDrUnLkSta 4;
BA_ "Version" SG_ 994 DoorLock_AsstDrUnLkSta "17.12.00";
BA_ "NetworkRequestHoldingTime" SG_ 994 DoorLock_AsstDrUnLkSta 5000;
BA_ "NetworkRequest" SG_ 994 DoorLock_AsstDrUnLkSta 0;
BA_ "UserSigValidity" SG_ 994 DoorLock_AsstDrUnLkSta 0;
BA_ "GenSigSendType" SG_ 994 DoorLock_AsstDrUnLkSta 4;
BA_ "Version" SG_ 994 DoorLock_RrLftDrUnLkSta "17.12.00";
BA_ "NetworkRequestHoldingTime" SG_ 994 DoorLock_RrLftDrUnLkSta 5000;
BA_ "NetworkRequest" SG_ 994 DoorLock_RrLftDrUnLkSta 0;
BA_ "UserSigValidity" SG_ 994 DoorLock_RrLftDrUnLkSta 0;
BA_ "GenSigSendType" SG_ 994 DoorLock_RrLftDrUnLkSta 4;
BA_ "Version" SG_ 994 DoorLock_RrRtDrUnLkSta "17.12.00";
BA_ "NetworkRequestHoldingTime" SG_ 994 DoorLock_RrRtDrUnLkSta 5000;
BA_ "NetworkRequest" SG_ 994 DoorLock_RrRtDrUnLkSta 0;
BA_ "UserSigValidity" SG_ 994 DoorLock_RrRtDrUnLkSta 0;
BA_ "GenSigSendType" SG_ 994 DoorLock_RrRtDrUnLkSta 4;
BA_ "Version" SG_ 994 DoorLock_DrvKeyLkSwSta "17.12.00";
BA_ "NetworkRequestHoldingTime" SG_ 994 DoorLock_DrvKeyLkSwSta 5000;
BA_ "NetworkRequest" SG_ 994 DoorLock_DrvKeyLkSwSta 0;
BA_ "UserSigValidity" SG_ 994 DoorLock_DrvKeyLkSwSta 0;
BA_ "GenSigSendType" SG_ 994 DoorLock_DrvKeyLkSwSta 4;
BA_ "Version" SG_ 994 DoorLock_DrvKeyUnLkSwSta "17.12.00";
BA_ "NetworkRequestHoldingTime" SG_ 994 DoorLock_DrvKeyUnLkSwSta 5000;
BA_ "NetworkRequest" SG_ 994 DoorLock_DrvKeyUnLkSwSta 0;
BA_ "UserSigValidity" SG_ 994 DoorLock_DrvKeyUnLkSwSta 0;
BA_ "GenSigSendType" SG_ 994 DoorLock_DrvKeyUnLkSwSta 4;
BA_ "Version" SG_ 994 DoorLock_CtrlDrLkSwSta_ICU "19.07.01";
BA_ "NetworkRequestHoldingTime" SG_ 994 DoorLock_CtrlDrLkSwSta_ICU 5000;
BA_ "NetworkRequest" SG_ 994 DoorLock_CtrlDrLkSwSta_ICU 0;
BA_ "UserSigValidity" SG_ 994 DoorLock_CtrlDrLkSwSta_ICU 0;
BA_ "GenSigSendType" SG_ 994 DoorLock_CtrlDrLkSwSta_ICU 4;
BA_ "Description" SG_ 994 DoorLock_CtrlDrLkSwSta_ICU "Central Door Lock Switch State

(DRV or AST or RL or RR Door trim)";
BA_ "Version" SG_ 994 DoorLock_CtrlDrUnLkSwSta_ICU "19.07.01";
BA_ "NetworkRequestHoldingTime" SG_ 994 DoorLock_CtrlDrUnLkSwSta_ICU 5000;
BA_ "NetworkRequest" SG_ 994 DoorLock_CtrlDrUnLkSwSta_ICU 0;
BA_ "UserSigValidity" SG_ 994 DoorLock_CtrlDrUnLkSwSta_ICU 0;
BA_ "GenSigSendType" SG_ 994 DoorLock_CtrlDrUnLkSwSta_ICU 4;
BA_ "Description" SG_ 994 DoorLock_CtrlDrUnLkSwSta_ICU "Central Door Unlock Switch State

(DRV or AST or RL or RR Door trim)";
BA_ "Version" SG_ 994 DoorLock_CtrlDrLkUnLkSwSta_ICU "19.07.01";
BA_ "NetworkRequestHoldingTime" SG_ 994 DoorLock_CtrlDrLkUnLkSwSta_ICU 5000;
BA_ "NetworkRequest" SG_ 994 DoorLock_CtrlDrLkUnLkSwSta_ICU 0;
BA_ "UserSigValidity" SG_ 994 DoorLock_CtrlDrLkUnLkSwSta_ICU 0;
BA_ "GenSigSendType" SG_ 994 DoorLock_CtrlDrLkUnLkSwSta_ICU 4;
BA_ "Description" SG_ 994 DoorLock_CtrlDrLkUnLkSwSta_ICU "Central Door Lock/Unlock Switch State

(C/PAD, Integrated & self return type)";
BA_ "Version" SG_ 994 C_CrashUnlockState "21.07.05";
BA_ "NetworkRequest" SG_ 994 C_CrashUnlockState 0;
BA_ "UserSigValidity" SG_ 994 C_CrashUnlockState 0;
BA_ "GenSigSendType" SG_ 994 C_CrashUnlockState 4;
BA_ "Description" SG_ 994 C_CrashUnlockState "Crash Unlock Active State

-0x0:Off

-0x1:Unlock(crash)";
BA_ "Version" SG_ 994 Lamp_LedHdLmpSta "21.11.00";
BA_ "NetworkRequestHoldingTime" SG_ 994 Lamp_LedHdLmpSta 5000;
BA_ "NetworkRequest" SG_ 994 Lamp_LedHdLmpSta 0;
BA_ "UserSigValidity" SG_ 994 Lamp_LedHdLmpSta 3;
BA_ "GenSigSendType" SG_ 994 Lamp_LedHdLmpSta 4;
BA_ "Description" SG_ 994 Lamp_LedHdLmpSta "This signal is LED headlamp status inform whether LED fail or not which is regulation of ECE, Domestic.



If LED H/Lamp detects LED failure then a cluster shall be turn on to 'LED' indicator in the display panel and It should be to display the words 'Ch";
BA_ "Version" SG_ 994 Warn_ChaDrSwFrtSta "18.08.12";
BA_ "UserSigValidity" SG_ 994 Warn_ChaDrSwFrtSta 7;
BA_ "GenSigSendType" SG_ 994 Warn_ChaDrSwFrtSta 4;
BA_ "Description" SG_ 994 Warn_ChaDrSwFrtSta "Front Charging Door Open Switch";
BA_ "Version" SG_ 994 Warn_ChaDrSwRrSta "18.08.12";
BA_ "UserSigValidity" SG_ 994 Warn_ChaDrSwRrSta 7;
BA_ "GenSigSendType" SG_ 994 Warn_ChaDrSwRrSta 4;
BA_ "Description" SG_ 994 Warn_ChaDrSwRrSta "Rear Charging Door Open Switch";
BA_ "Version" SG_ 997 PDC_FD_Crc11Val "22.10.20";
BA_ "UserSigValidity" SG_ 997 PDC_FD_Crc11Val 3;
BA_ "GenSigStartValue" SG_ 997 PDC_FD_Crc11Val 65535;
BA_ "GenSigSendType" SG_ 997 PDC_FD_Crc11Val 4;
BA_ "Description" SG_ 997 PDC_FD_Crc11Val "The data area for CRC calculation is based on the data length (DLC) of the message DB.

The CRC shall be calculated over the entire data block (excluding the CRC bytes) including the user data, alive counter and Data ID



- CRC Polynomial (0x1021) , Ini";
BA_ "Version" SG_ 997 ICU_BS1ValFlagSta "21.11.00";
BA_ "UserSigValidity" SG_ 997 ICU_BS1ValFlagSta 3;
BA_ "GenSigStartValue" SG_ 997 ICU_BS1ValFlagSta 1;
BA_ "GenSigSendType" SG_ 997 ICU_BS1ValFlagSta 4;
BA_ "Description" SG_ 997 ICU_BS1ValFlagSta "setting condition is depending on battery sensor self diagnosis information";
BA_ "Version" SG_ 997 ICU_BS1ErrRes "21.11.00";
BA_ "UserSigValidity" SG_ 997 ICU_BS1ErrRes 3;
BA_ "GenSigStartValue" SG_ 997 ICU_BS1ErrRes 1;
BA_ "GenSigSendType" SG_ 997 ICU_BS1ErrRes 4;
BA_ "Version" SG_ 997 ICU_BS2SoC "21.09.05";
BA_ "UserSigValidity" SG_ 997 ICU_BS2SoC 3;
BA_ "GenSigStartValue" SG_ 997 ICU_BS2SoC 255;
BA_ "GenSigSendType" SG_ 997 ICU_BS2SoC 4;
BA_ "Description" SG_ 997 ICU_BS2SoC "This signal is battery State of Charge as calculated by battery sensor.";
BA_ "Version" SG_ 997 ICU_BS2NCap "21.07.05";
BA_ "UserSigValidity" SG_ 997 ICU_BS2NCap 3;
BA_ "GenSigStartValue" SG_ 997 ICU_BS2NCap 255;
BA_ "GenSigSendType" SG_ 997 ICU_BS2NCap 4;
BA_ "Description" SG_ 997 ICU_BS2NCap "Nominal capacity";
BA_ "Version" SG_ 997 ICU_BS2OpnCirVol "21.07.05";
BA_ "UserSigValidity" SG_ 997 ICU_BS2OpnCirVol 3;
BA_ "GenSigStartValue" SG_ 997 ICU_BS2OpnCirVol 4095;
BA_ "GenSigSendType" SG_ 997 ICU_BS2OpnCirVol 4;
BA_ "Description" SG_ 997 ICU_BS2OpnCirVol "Last open circuit voltage";
BA_ "Version" SG_ 997 ICU_BS2_FSOC "18.08.03";
BA_ "UserSigValidity" SG_ 997 ICU_BS2_FSOC 3;
BA_ "GenSigStartValue" SG_ 997 ICU_BS2_FSOC 1;
BA_ "GenSigSendType" SG_ 997 ICU_BS2_FSOC 4;
BA_ "Description" SG_ 997 ICU_BS2_FSOC "This signal indicates whether the state of SOC signal is fault or not";
BA_ "Version" SG_ 997 ICU_BS2_FSOH "18.08.03";
BA_ "UserSigValidity" SG_ 997 ICU_BS2_FSOH 3;
BA_ "GenSigStartValue" SG_ 997 ICU_BS2_FSOH 1;
BA_ "GenSigSendType" SG_ 997 ICU_BS2_FSOH 4;
BA_ "Description" SG_ 997 ICU_BS2_FSOH "This signal indicates whether the state of SOH signal is fault or not";
BA_ "Version" SG_ 997 ICU_BS2_FSOF "18.08.03";
BA_ "UserSigValidity" SG_ 997 ICU_BS2_FSOF 3;
BA_ "GenSigStartValue" SG_ 997 ICU_BS2_FSOF 1;
BA_ "GenSigSendType" SG_ 997 ICU_BS2_FSOF 4;
BA_ "Description" SG_ 997 ICU_BS2_FSOF "This signal indicates whether the state of SOF signal is fault or not";
BA_ "Version" SG_ 997 ICU_BS2_FQSTAT "18.08.03";
BA_ "UserSigValidity" SG_ 997 ICU_BS2_FQSTAT 3;
BA_ "GenSigStartValue" SG_ 997 ICU_BS2_FQSTAT 1;
BA_ "GenSigSendType" SG_ 997 ICU_BS2_FQSTAT 4;
BA_ "Description" SG_ 997 ICU_BS2_FQSTAT "This signal indicates whether quiescent current is high or not compared to pre-defined value";
BA_ "Version" SG_ 997 ICU_BS2SoH "21.07.05";
BA_ "UserSigValidity" SG_ 997 ICU_BS2SoH 3;
BA_ "GenSigStartValue" SG_ 997 ICU_BS2SoH 255;
BA_ "GenSigSendType" SG_ 997 ICU_BS2SoH 4;
BA_ "Description" SG_ 997 ICU_BS2SoH "This signal is battery State of Health(SOH) as calculated by battery sensor.



This value shows reduction rate of nominal capacity.



This value can be used for diagnosis information of application system.";
BA_ "Version" SG_ 997 ICU_BS2SoF "21.07.05";
BA_ "UserSigValidity" SG_ 997 ICU_BS2SoF 3;
BA_ "GenSigStartValue" SG_ 997 ICU_BS2SoF 255;
BA_ "GenSigSendType" SG_ 997 ICU_BS2SoF 4;
BA_ "Description" SG_ 997 ICU_BS2SoF "This signal is battery State of Function(SOF) as calculated by battery sensor.



This value shows information about the battery ability to crank the engine (both of warm & cold cranking).



This value is prediction value of the minimum voltage for the ";
BA_ "Version" SG_ 997 PDC_EasyPwrOffSpprt "25.08.00";
BA_ "UserSigValidity" SG_ 997 PDC_EasyPwrOffSpprt 0;
BA_ "GenSigSendType" SG_ 997 PDC_EasyPwrOffSpprt 4;
BA_ "Description" SG_ 997 PDC_EasyPwrOffSpprt "PDC-BDC Easy Power Off Support Option";
BA_ "Version" SG_ 997 PDC_FD_AlvCnt11Val "22.10.20";
BA_ "UserSigValidity" SG_ 997 PDC_FD_AlvCnt11Val 3;
BA_ "GenSigSendType" SG_ 997 PDC_FD_AlvCnt11Val 4;
BA_ "Description" SG_ 997 PDC_FD_AlvCnt11Val "For the first transmission request for a data element the counter shall be initialized with 0 and shall be incremented by 1 for every subsequent send request. 

When the counter reaches the maximum value(0xFF), then it shall restart with 0 for the next s";
BA_ "Version" SG_ 997 ICU_BS1BatVol_Dis "24.05.02";
BA_ "UserSigValidity" SG_ 997 ICU_BS1BatVol_Dis 3;
BA_ "GenSigStartValue" SG_ 997 ICU_BS1BatVol_Dis 16383;
BA_ "GenSigSendType" SG_ 997 ICU_BS1BatVol_Dis 4;
BA_ "Description" SG_ 997 ICU_BS1BatVol_Dis "This is the battery voltage for displaying on the ANVT, CLU as measured on the battery pole by battery sensor.";
BA_ "Version" SG_ 997 ICU_BS1IBAT_Conversion "22.06.05";
BA_ "UserSigValidity" SG_ 997 ICU_BS1IBAT_Conversion 3;
BA_ "GenSigSendType" SG_ 997 ICU_BS1IBAT_Conversion 4;
BA_ "Description" SG_ 997 ICU_BS1IBAT_Conversion "This is Battery current as measured by battery sensor.

The resolution is 10mA



- 0x3FFFF : 262,143 (Error) , 0x00000 ~ 0x3A980 : 0 ~ 240,000

- Physical value min. : (0 * 10mA) + (-1,200,000) = -1,200 A

- Physical value max. : (240,000 * 10mA) + (-1,";
BA_ "Version" SG_ 997 ICU_BS1BatVol "21.07.05";
BA_ "UserSigValidity" SG_ 997 ICU_BS1BatVol 3;
BA_ "GenSigStartValue" SG_ 997 ICU_BS1BatVol 16383;
BA_ "GenSigSendType" SG_ 997 ICU_BS1BatVol 4;
BA_ "Description" SG_ 997 ICU_BS1BatVol "This is the actual battery voltage as measured on the battery pole by battery sensor.



The resolution is 1mV.";
BA_ "Version" SG_ 997 ICU_BS1BatTemp "21.07.05";
BA_ "UserSigValidity" SG_ 997 ICU_BS1BatTemp 3;
BA_ "GenSigStartValue" SG_ 997 ICU_BS1BatTemp 511;
BA_ "GenSigSendType" SG_ 997 ICU_BS1BatTemp 4;
BA_ "Description" SG_ 997 ICU_BS1BatTemp "This is actual battery electrolyte temperature value by battery sensor.



The value is calculated by a Battery Temperature Model, depending on measured temperature of the battery pole.





The resolution is 0.5℃.";
BA_ "Version" SG_ 996 PDC_FD_Crc10Val "22.10.20";
BA_ "UserSigValidity" SG_ 996 PDC_FD_Crc10Val 3;
BA_ "GenSigStartValue" SG_ 996 PDC_FD_Crc10Val 65535;
BA_ "GenSigSendType" SG_ 996 PDC_FD_Crc10Val 4;
BA_ "Description" SG_ 996 PDC_FD_Crc10Val "The data area for CRC calculation is based on the data length (DLC) of the message DB.

The CRC shall be calculated over the entire data block (excluding the CRC bytes) including the user data, alive counter and Data ID



- CRC Polynomial (0x1021) , Ini";
BA_ "Version" SG_ 996 PDC_PwrOnModePowerReq "23.07.05";
BA_ "UserSigValidity" SG_ 996 PDC_PwrOnModePowerReq 0;
BA_ "TimeoutValue" SG_ 996 PDC_PwrOnModePowerReq "0x0";
BA_ "GenSigSendType" SG_ 996 PDC_PwrOnModePowerReq 4;
BA_ "Description" SG_ 996 PDC_PwrOnModePowerReq "This is for high voltage battery discharge request at Power On mode of EV";
BA_ "Version" SG_ 996 PDC_LeadAcidBatType "23.06.02";
BA_ "UserSigValidity" SG_ 996 PDC_LeadAcidBatType 0;
BA_ "GenSigSendType" SG_ 996 PDC_LeadAcidBatType 4;
BA_ "Description" SG_ 996 PDC_LeadAcidBatType "Lead Acid Battery Type Information

 - Validity

After EOL coding

 - Value Table

0x00:Not Applied

0x01:CMF 35Ah

0x02:CMF 40Ah

0x03:CMF 45Ah

0x04:CMF 50Ah

0x05:CMF 60Ah

0x06:CMF 68Ah

0x07:CMF 70Ah

0x08:CMF 80Ah

0x09:CMF 90Ah

0x0A:CMF 110Ah

0x";
BA_ "Version" SG_ 996 PDC_BatPwrClassOpt "23.07.05";
BA_ "UserSigValidity" SG_ 996 PDC_BatPwrClassOpt 0;
BA_ "GenSigSendType" SG_ 996 PDC_BatPwrClassOpt 4;
BA_ "Description" SG_ 996 PDC_BatPwrClassOpt "This signal informs which signal among soc and batpwrstateclass is regarded as the state of power.";
BA_ "Version" SG_ 996 PDC_MainLBMOpt "24.04.03";
BA_ "UserSigValidity" SG_ 996 PDC_MainLBMOpt 0;
BA_ "GenSigSendType" SG_ 996 PDC_MainLBMOpt 4;
BA_ "Description" SG_ 996 PDC_MainLBMOpt "This signal is always sended if PDC2 is appiled

it indicate whether MLBM is applied or not";
BA_ "Version" SG_ 996 PDC_FD_AlvCnt10Val "22.10.20";
BA_ "UserSigValidity" SG_ 996 PDC_FD_AlvCnt10Val 3;
BA_ "GenSigSendType" SG_ 996 PDC_FD_AlvCnt10Val 4;
BA_ "Description" SG_ 996 PDC_FD_AlvCnt10Val "For the first transmission request for a data element the counter shall be initialized with 0 and shall be incremented by 1 for every subsequent send request. 

When the counter reaches the maximum value(0xFF), then it shall restart with 0 for the next s";
BA_ "Version" SG_ 996 ICU_PowerAutoCutModSta "22.06.05";
BA_ "UserSigValidity" SG_ 996 ICU_PowerAutoCutModSta 0;
BA_ "GenSigSendType" SG_ 996 ICU_PowerAutoCutModSta 4;
BA_ "Description" SG_ 996 ICU_PowerAutoCutModSta "ICU Delivery Mode State";
BA_ "Version" SG_ 996 Autocut_DlvryModSta "17.12.00";
BA_ "NetworkRequestHoldingTime" SG_ 996 Autocut_DlvryModSta 5000;
BA_ "NetworkRequest" SG_ 996 Autocut_DlvryModSta 0;
BA_ "UserSigValidity" SG_ 996 Autocut_DlvryModSta 0;
BA_ "GenSigStartValue" SG_ 996 Autocut_DlvryModSta 1;
BA_ "GenSigSendType" SG_ 996 Autocut_DlvryModSta 4;
BA_ "Description" SG_ 996 Autocut_DlvryModSta "-(Old)C_SJB_DeliveryMode

-Initial value: 1";
BA_ "Version" SG_ 996 ICU_SoCBattStaMsgReq "17.12.00";
BA_ "UserSigValidity" SG_ 996 ICU_SoCBattStaMsgReq 0;
BA_ "GenSigStartValue" SG_ 996 ICU_SoCBattStaMsgReq 3;
BA_ "GenSigSendType" SG_ 996 ICU_SoCBattStaMsgReq 4;
BA_ "Description" SG_ 996 ICU_SoCBattStaMsgReq "Determine if soc level is warning or alert.";
BA_ "Version" SG_ 996 Batt_SoCWarningValue "21.11.00";
BA_ "UserSigValidity" SG_ 996 Batt_SoCWarningValue 0;
BA_ "GenSigStartValue" SG_ 996 Batt_SoCWarningValue 255;
BA_ "GenSigSendType" SG_ 996 Batt_SoCWarningValue 4;
BA_ "Description" SG_ 996 Batt_SoCWarningValue "This signal is Battery SOC from battery sensor.";
BA_ "Version" SG_ 996 ICU_BattAutoCutPreWrng "20.04.06";
BA_ "UserSigValidity" SG_ 996 ICU_BattAutoCutPreWrng 0;
BA_ "GenSigStartValue" SG_ 996 ICU_BattAutoCutPreWrng 3;
BA_ "GenSigSendType" SG_ 996 ICU_BattAutoCutPreWrng 4;
BA_ "Description" SG_ 996 ICU_BattAutoCutPreWrng "This is a warning signal before blocking the dark current of the ICU by the battery SOC.";
BA_ "Version" SG_ 996 OTAModeACCOffReq "21.11.00";
BA_ "NetworkRequest" SG_ 996 OTAModeACCOffReq 0;
BA_ "UserSigValidity" SG_ 996 OTAModeACCOffReq 0;
BA_ "TimeoutValue" SG_ 996 OTAModeACCOffReq "0x0";
BA_ "GenSigSendType" SG_ 996 OTAModeACCOffReq 4;
BA_ "Description" SG_ 996 OTAModeACCOffReq "ACC off request during OTA mode for battery saver";
BA_ "Version" SG_ 996 C_ICUIGNOffReq "21.11.00";
BA_ "NetworkRequest" SG_ 996 C_ICUIGNOffReq 0;
BA_ "UserSigValidity" SG_ 996 C_ICUIGNOffReq 0;
BA_ "TimeoutValue" SG_ 996 C_ICUIGNOffReq "0x0";
BA_ "GenSigSendType" SG_ 996 C_ICUIGNOffReq 4;
BA_ "Description" SG_ 996 C_ICUIGNOffReq "IGN off request(Not engine running state only) for battery saver";
BA_ "Version" SG_ 996 IGN_AutoOff_WarnSta "21.11.00";
BA_ "UserSigValidity" SG_ 996 IGN_AutoOff_WarnSta 3;
BA_ "GenSigSendType" SG_ 996 IGN_AutoOff_WarnSta 4;
BA_ "Description" SG_ 996 IGN_AutoOff_WarnSta "This signal is for battery discharge warning (engine not running && IGN/ACC on)

To prevent battery discharge, ICU requests the head unit to display warning and requests IBU to turn IGN/ACC off.";
BA_ "Version" SG_ 996 IGN_AutoOff_WarnSta_CLU "21.11.00";
BA_ "UserSigValidity" SG_ 996 IGN_AutoOff_WarnSta_CLU 3;
BA_ "GenSigSendType" SG_ 996 IGN_AutoOff_WarnSta_CLU 4;
BA_ "Description" SG_ 996 IGN_AutoOff_WarnSta_CLU "This signal is for battery discharge warning (engine not running && IGN/ACC on)

To prevent battery discharge, ICU requests the Cluster to display warning and requests IBU to turn IGN/ACC off.";
BA_ "Version" SG_ 996 PDC_BatPwrStateClassA "23.07.06";
BA_ "UserSigValidity" SG_ 996 PDC_BatPwrStateClassA 0;
BA_ "GenSigSendType" SG_ 996 PDC_BatPwrStateClassA 4;
BA_ "Description" SG_ 996 PDC_BatPwrStateClassA "This signal is used to inform whether the power state is good for the operation of the function using the low voltage.

0x1 : power state level is low

0x2: power staest level is good(high)";
BA_ "Version" SG_ 996 PDC_BatPwrStateClassB "23.07.06";
BA_ "UserSigValidity" SG_ 996 PDC_BatPwrStateClassB 0;
BA_ "GenSigSendType" SG_ 996 PDC_BatPwrStateClassB 4;
BA_ "Description" SG_ 996 PDC_BatPwrStateClassB "This signal is used to inform whether the power state is good for the operation of the function using the low voltage.

0x1 : power state level is low

0x2: power staest level is good(high)";
BA_ "Version" SG_ 996 PDC_BatPwrStateClassC "23.07.06";
BA_ "UserSigValidity" SG_ 996 PDC_BatPwrStateClassC 0;
BA_ "GenSigSendType" SG_ 996 PDC_BatPwrStateClassC 4;
BA_ "Description" SG_ 996 PDC_BatPwrStateClassC "This signal is used to inform whether the power state is good for the operation of the function using the low voltage.

0x1 : power state level is low

0x2: power staest level is good(high)";
BA_ "Version" SG_ 996 PLBMAvailableState "21.06.11";
BA_ "UserSigValidity" SG_ 996 PLBMAvailableState 0;
BA_ "GenSigSendType" SG_ 996 PLBMAvailableState 4;
BA_ "Description" SG_ 996 PLBMAvailableState "Power supply Available status notification at PLBM. If this value is Set, BMS can request Discharge-request to PDC during parking mode";
BA_ "Version" SG_ 996 Bat_dischrg "21.11.00";
BA_ "UserSigValidity" SG_ 996 Bat_dischrg 3;
BA_ "GenSigSendType" SG_ 996 Bat_dischrg 4;
BA_ "Description" SG_ 996 Bat_dischrg "Battery discharge notification flag";
BA_ "Version" SG_ 996 Bat12V_Chr_Req "22.02.04";
BA_ "UserSigValidity" SG_ 996 Bat12V_Chr_Req 0;
BA_ "TimeoutValue" SG_ 996 Bat12V_Chr_Req "0x0";
BA_ "GenSigSendType" SG_ 996 Bat12V_Chr_Req 4;
BA_ "Description" SG_ 996 Bat12V_Chr_Req "12V lead acid battery charging request signal 

0x0:Off (Default)

0x1:On_IBS

0x2:On_OTA

0x3:On_Load";
BA_ "Version" SG_ 996 ICU_BattMngAlert "21.07.05";
BA_ "UserSigValidity" SG_ 996 ICU_BattMngAlert 0;
BA_ "GenSigSendType" SG_ 996 ICU_BattMngAlert 4;
BA_ "Description" SG_ 996 ICU_BattMngAlert "This signal is for battery discharge warning.

1bit : Hazard

2bit : Tail

3bit~8bit : Reserved";
BA_ "Version" SG_ 1047 GNSS_Crc5Val "22.10.20";
BA_ "UserSigValidity" SG_ 1047 GNSS_Crc5Val 3;
BA_ "GenSigStartValue" SG_ 1047 GNSS_Crc5Val 65535;
BA_ "Description" SG_ 1047 GNSS_Crc5Val "The data area for CRC calculation is based on the data length (DLC) of the message DB.

The CRC shall be calculated over the entire data block (excluding the CRC bytes) including the user data, alive counter and Data ID



- CRC Polynomial (0x1021) , Ini";
BA_ "Version" SG_ 1047 HU_GNSS_UTC_min "22.07.05";
BA_ "UserSigValidity" SG_ 1047 HU_GNSS_UTC_min 1;
BA_ "Description" SG_ 1047 HU_GNSS_UTC_min "range : [0,59]";
BA_ "Version" SG_ 1047 HU_GNSS_UTC_sec "22.07.05";
BA_ "UserSigValidity" SG_ 1047 HU_GNSS_UTC_sec 1;
BA_ "Description" SG_ 1047 HU_GNSS_UTC_sec "ragne : [0, 60]  /  60 only for the leap second";
BA_ "Version" SG_ 1047 HU_GNSS_UTC_offset "22.07.05";
BA_ "UserSigValidity" SG_ 1047 HU_GNSS_UTC_offset 1;
BA_ "Description" SG_ 1047 HU_GNSS_UTC_offset "GPS = UTC + offset";
BA_ "Version" SG_ 1047 HU_GNSS_PDOP "22.07.05";
BA_ "UserSigValidity" SG_ 1047 HU_GNSS_PDOP 1;
BA_ "Description" SG_ 1047 HU_GNSS_PDOP "unit : 2^-8";
BA_ "Version" SG_ 1047 HU_GNSS_HDOP "22.07.05";
BA_ "UserSigValidity" SG_ 1047 HU_GNSS_HDOP 1;
BA_ "Description" SG_ 1047 HU_GNSS_HDOP "unit : 2^-8";
BA_ "Version" SG_ 1047 GNSS_AlvCnt5Val "22.10.20";
BA_ "UserSigValidity" SG_ 1047 GNSS_AlvCnt5Val 3;
BA_ "Description" SG_ 1047 GNSS_AlvCnt5Val "For the first transmission request for a data element the counter shall be initialized with 0 and shall be incremented by 1 for every subsequent send request. 

When the counter reaches the maximum value(0xFF), then it shall restart with 0 for the next s";
BA_ "Version" SG_ 1047 HU_GNSS_VDOP "22.07.05";
BA_ "UserSigValidity" SG_ 1047 HU_GNSS_VDOP 1;
BA_ "Description" SG_ 1047 HU_GNSS_VDOP "unit : 2^-8";
BA_ "Version" SG_ 1047 HU_GNSS_DGPS_age "22.07.05";
BA_ "UserSigValidity" SG_ 1047 HU_GNSS_DGPS_age 1;
BA_ "Description" SG_ 1047 HU_GNSS_DGPS_age "whed using DGPS, (DGPS time - current time.)";
BA_ "Version" SG_ 1047 HU_GNSS_Fix_status "22.07.05";
BA_ "UserSigValidity" SG_ 1047 HU_GNSS_Fix_status 1;
BA_ "Version" SG_ 1047 HU_GNSS_TimeSource "22.07.05";
BA_ "UserSigValidity" SG_ 1047 HU_GNSS_TimeSource 1;
BA_ "Version" SG_ 1047 HU_GNSS_search "22.07.05";
BA_ "UserSigValidity" SG_ 1047 HU_GNSS_search 1;
BA_ "Version" SG_ 1047 HU_GNSS_DST "22.07.05";
BA_ "UserSigValidity" SG_ 1047 HU_GNSS_DST 1;
BA_ "GenSigStartValue" SG_ 1047 HU_GNSS_DST 3;
BA_ "Description" SG_ 1047 HU_GNSS_DST "DST setting";
BA_ "Version" SG_ 1047 HU_GNSS_SV_count "22.07.05";
BA_ "UserSigValidity" SG_ 1047 HU_GNSS_SV_count 1;
BA_ "Version" SG_ 1047 HU_GNSS_TimezoneOffset "22.07.05";
BA_ "UserSigValidity" SG_ 1047 HU_GNSS_TimezoneOffset 1;
BA_ "Description" SG_ 1047 HU_GNSS_TimezoneOffset "offset = [ value * factor(15) ] min.";
BA_ "Version" SG_ 1047 HU_GNSS_UTC_year "23.08.10";
BA_ "UserSigValidity" SG_ 1047 HU_GNSS_UTC_year 1;
BA_ "Version" SG_ 1047 HU_GNSS_UTC_month "22.07.05";
BA_ "UserSigValidity" SG_ 1047 HU_GNSS_UTC_month 1;
BA_ "Description" SG_ 1047 HU_GNSS_UTC_month "range : [1, 12]";
BA_ "Version" SG_ 1047 HU_GNSS_UTC_day "22.07.05";
BA_ "UserSigValidity" SG_ 1047 HU_GNSS_UTC_day 1;
BA_ "Description" SG_ 1047 HU_GNSS_UTC_day "range : [1, 31]";
BA_ "Version" SG_ 1047 HU_GNSS_UTC_hour "22.07.05";
BA_ "UserSigValidity" SG_ 1047 HU_GNSS_UTC_hour 1;
BA_ "Description" SG_ 1047 HU_GNSS_UTC_hour "range : [0, 23]";
BA_ "Version" SG_ 849 IAU_FD_Crc4Val "22.11.04";
BA_ "UserSigValidity" SG_ 849 IAU_FD_Crc4Val 0;
BA_ "GenSigStartValue" SG_ 849 IAU_FD_Crc4Val 65535;
BA_ "GenSigSendType" SG_ 849 IAU_FD_Crc4Val 4;
BA_ "Description" SG_ 849 IAU_FD_Crc4Val "The data area for CRC calculation is based on the data length (DLC) of the message DB.

The CRC shall be calculated over the entire data block (excluding the CRC bytes) including the user data, alive counter and Data ID



- CRC Polynomial (0x1021) , Ini";
BA_ "Version" SG_ 849 IAU_DISPWrng "22.06.04";
BA_ "NetworkRequestHoldingTime" SG_ 849 IAU_DISPWrng 5000;
BA_ "NetworkRequest" SG_ 849 IAU_DISPWrng 0;
BA_ "UserSigValidity" SG_ 849 IAU_DISPWrng 0;
BA_ "GenSigSendType" SG_ 849 IAU_DISPWrng 4;
BA_ "Description" SG_ 849 IAU_DISPWrng "This siganl warning from IAU

- 0x9 (WPCNFC_PreStartAuth_Success) : CLU display when workaround or LPCD Start Auth succeeded (before SSB pressed).";
BA_ "Version" SG_ 849 IAU_DigitalKey2Opt "20.08.00";
BA_ "NetworkRequestHoldingTime" SG_ 849 IAU_DigitalKey2Opt 5000;
BA_ "NetworkRequest" SG_ 849 IAU_DigitalKey2Opt 0;
BA_ "UserSigValidity" SG_ 849 IAU_DigitalKey2Opt 0;
BA_ "GenSigSendType" SG_ 849 IAU_DigitalKey2Opt 4;
BA_ "Description" SG_ 849 IAU_DigitalKey2Opt "This signal describe Digital Key capability";
BA_ "Version" SG_ 849 IAUwFRULearnState "20.04.05";
BA_ "NetworkRequestHoldingTime" SG_ 849 IAUwFRULearnState 5000;
BA_ "NetworkRequest" SG_ 849 IAUwFRULearnState 0;
BA_ "UserSigValidity" SG_ 849 IAUwFRULearnState 0;
BA_ "GenSigSendType" SG_ 849 IAUwFRULearnState 4;
BA_ "Description" SG_ 849 IAUwFRULearnState "This signal indicates learning process stste between IAU and FRU";
BA_ "Version" SG_ 849 IAUwFPMLearnState "20.04.05";
BA_ "NetworkRequestHoldingTime" SG_ 849 IAUwFPMLearnState 5000;
BA_ "NetworkRequest" SG_ 849 IAUwFPMLearnState 0;
BA_ "UserSigValidity" SG_ 849 IAUwFPMLearnState 0;
BA_ "GenSigSendType" SG_ 849 IAUwFPMLearnState 4;
BA_ "Description" SG_ 849 IAUwFPMLearnState "This signal indicates learning process stste between IAU and FPM";
BA_ "Version" SG_ 849 IAU_ValetDigitalkey "20.08.05";
BA_ "NetworkRequestHoldingTime" SG_ 849 IAU_ValetDigitalkey 5000;
BA_ "NetworkRequest" SG_ 849 IAU_ValetDigitalkey 0;
BA_ "UserSigValidity" SG_ 849 IAU_ValetDigitalkey 0;
BA_ "GenSigSendType" SG_ 849 IAU_ValetDigitalkey 4;
BA_ "Version" SG_ 849 IAU_DigitalKeyNumberOpt "25.01.00";
BA_ "NetworkRequestHoldingTime" SG_ 849 IAU_DigitalKeyNumberOpt 5000;
BA_ "NetworkRequest" SG_ 849 IAU_DigitalKeyNumberOpt 0;
BA_ "UserSigValidity" SG_ 849 IAU_DigitalKeyNumberOpt 0;
BA_ "GenSigSendType" SG_ 849 IAU_DigitalKeyNumberOpt 4;
BA_ "Description" SG_ 849 IAU_DigitalKeyNumberOpt "This signal is for the digital key number type. 

(Ex. Max 16 of digital keys in total can be saved and shared)";
BA_ "Version" SG_ 849 IAU_eSEReprogramSta "22.07.04";
BA_ "NetworkRequestHoldingTime" SG_ 849 IAU_eSEReprogramSta 5000;
BA_ "NetworkRequest" SG_ 849 IAU_eSEReprogramSta 0;
BA_ "UserSigValidity" SG_ 849 IAU_eSEReprogramSta 0;
BA_ "TimeoutValue" SG_ 849 IAU_eSEReprogramSta "0";
BA_ "GenSigSendType" SG_ 849 IAU_eSEReprogramSta 4;
BA_ "Description" SG_ 849 IAU_eSEReprogramSta "eSE Reprograming Status";
BA_ "Version" SG_ 849 IAU_DKOwnerSwapOption "24.01.04";
BA_ "UserSigValidity" SG_ 849 IAU_DKOwnerSwapOption 0;
BA_ "GenSigSendType" SG_ 849 IAU_DKOwnerSwapOption 4;
BA_ "Description" SG_ 849 IAU_DKOwnerSwapOption "Digital key owner swap option signal";
BA_ "Version" SG_ 849 IAU_DgtKeyGrpPrflRval2 "25.01.00";
BA_ "NetworkRequestHoldingTime" SG_ 849 IAU_DgtKeyGrpPrflRval2 5000;
BA_ "NetworkRequest" SG_ 849 IAU_DgtKeyGrpPrflRval2 0;
BA_ "UserSigValidity" SG_ 849 IAU_DgtKeyGrpPrflRval2 0;
BA_ "GenSigSendType" SG_ 849 IAU_DgtKeyGrpPrflRval2 4;
BA_ "Description" SG_ 849 IAU_DgtKeyGrpPrflRval2 "Digital Key Group number(max : 16 )";
BA_ "Version" SG_ 849 IAU_StartIdentifiedProfile "20.05.02";
BA_ "NetworkRequestHoldingTime" SG_ 849 IAU_StartIdentifiedProfile 5000;
BA_ "NetworkRequest" SG_ 849 IAU_StartIdentifiedProfile 0;
BA_ "UserSigValidity" SG_ 849 IAU_StartIdentifiedProfile 0;
BA_ "TimeoutValue" SG_ 849 IAU_StartIdentifiedProfile "0x0";
BA_ "GenSigSendType" SG_ 849 IAU_StartIdentifiedProfile 4;
BA_ "Version" SG_ 849 IAU_DigitalKeyProfileRval2 "22.05.04";
BA_ "NetworkRequestHoldingTime" SG_ 849 IAU_DigitalKeyProfileRval2 5000;
BA_ "NetworkRequest" SG_ 849 IAU_DigitalKeyProfileRval2 0;
BA_ "UserSigValidity" SG_ 849 IAU_DigitalKeyProfileRval2 0;
BA_ "GenSigSendType" SG_ 849 IAU_DigitalKeyProfileRval2 4;
BA_ "Description" SG_ 849 IAU_DigitalKeyProfileRval2 "digital key number : max. 16";
BA_ "Version" SG_ 849 IAU_NFCCard1SN "21.07.05";
BA_ "NetworkRequestHoldingTime" SG_ 849 IAU_NFCCard1SN 5000;
BA_ "NetworkRequest" SG_ 849 IAU_NFCCard1SN 0;
BA_ "UserSigValidity" SG_ 849 IAU_NFCCard1SN 0;
BA_ "GenSigSendType" SG_ 849 IAU_NFCCard1SN 4;
BA_ "Version" SG_ 849 IAU_FD_AlvCnt4Val "22.11.04";
BA_ "UserSigValidity" SG_ 849 IAU_FD_AlvCnt4Val 0;
BA_ "GenSigSendType" SG_ 849 IAU_FD_AlvCnt4Val 4;
BA_ "Description" SG_ 849 IAU_FD_AlvCnt4Val "For the first transmission request for a data element the counter shall be initialized with 0 and shall be incremented by 1 for every subsequent send request. 

When the counter reaches the maximum value(0xFF), then it shall restart with 0 for the next s";
BA_ "Version" SG_ 849 IAU_DigitalKeyProcessingSta2 "23.07.04";
BA_ "NetworkRequestHoldingTime" SG_ 849 IAU_DigitalKeyProcessingSta2 5000;
BA_ "NetworkRequest" SG_ 849 IAU_DigitalKeyProcessingSta2 0;
BA_ "UserSigValidity" SG_ 849 IAU_DigitalKeyProcessingSta2 3;
BA_ "GenSigSendType" SG_ 849 IAU_DigitalKeyProcessingSta2 4;
BA_ "Description" SG_ 849 IAU_DigitalKeyProcessingSta2 "Digital Key USM setting Process State 2";
BA_ "Version" SG_ 849 IAU_DigitalKeyExit2 "25.09.02";
BA_ "NetworkRequestHoldingTime" SG_ 849 IAU_DigitalKeyExit2 5000;
BA_ "NetworkRequest" SG_ 849 IAU_DigitalKeyExit2 0;
BA_ "UserSigValidity" SG_ 849 IAU_DigitalKeyExit2 3;
BA_ "GenSigSendType" SG_ 849 IAU_DigitalKeyExit2 4;
BA_ "Description" SG_ 849 IAU_DigitalKeyExit2 "Digital Key USM setting Exit 2 Condition";
BA_ "Version" SG_ 849 IAU_UWBOnOffOpt "24.10.01";
BA_ "UserSigValidity" SG_ 849 IAU_UWBOnOffOpt 0;
BA_ "GenSigSendType" SG_ 849 IAU_UWBOnOffOpt 4;
BA_ "Description" SG_ 849 IAU_UWBOnOffOpt "Digital key UWB on off option signal";
BA_ "Version" SG_ 849 IAU_UWBOnOffRVal "24.10.01";
BA_ "UserSigValidity" SG_ 849 IAU_UWBOnOffRVal 0;
BA_ "GenSigSendType" SG_ 849 IAU_UWBOnOffRVal 4;
BA_ "Description" SG_ 849 IAU_UWBOnOffRVal "Digital key UWB on off set feedback signal";
BA_ "Version" SG_ 849 IAU_StartIdentifiedProfile_Ext "23.04.04";
BA_ "NetworkRequestHoldingTime" SG_ 849 IAU_StartIdentifiedProfile_Ext 5000;
BA_ "NetworkRequest" SG_ 849 IAU_StartIdentifiedProfile_Ext 0;
BA_ "UserSigValidity" SG_ 849 IAU_StartIdentifiedProfile_Ext 0;
BA_ "GenSigSendType" SG_ 849 IAU_StartIdentifiedProfile_Ext 4;
BA_ "Version" SG_ 849 RSPA_UWBRspaExtRngSta "20.03.05";
BA_ "NetworkRequestHoldingTime" SG_ 849 RSPA_UWBRspaExtRngSta 5000;
BA_ "NetworkRequest" SG_ 849 RSPA_UWBRspaExtRngSta 0;
BA_ "UserSigValidity" SG_ 849 RSPA_UWBRspaExtRngSta 0;
BA_ "GenSigSendType" SG_ 849 RSPA_UWBRspaExtRngSta 4;
BA_ "Version" SG_ 849 RSPA_CanFltSta "20.02.00";
BA_ "UserSigValidity" SG_ 849 RSPA_CanFltSta 0;
BA_ "GenSigSendType" SG_ 849 RSPA_CanFltSta 4;
BA_ "Description" SG_ 849 RSPA_CanFltSta "Error status of RSPA control signals.";
BA_ "Version" SG_ 849 RSPA_BLESigErrSta "20.02.00";
BA_ "NetworkRequestHoldingTime" SG_ 849 RSPA_BLESigErrSta 5000;
BA_ "NetworkRequest" SG_ 849 RSPA_BLESigErrSta 0;
BA_ "UserSigValidity" SG_ 849 RSPA_BLESigErrSta 0;
BA_ "GenSigSendType" SG_ 849 RSPA_BLESigErrSta 4;
BA_ "Description" SG_ 849 RSPA_BLESigErrSta "Error status of Digital Key BLE_BtnReq signal.



If BLE frame data from Digital Key defferent with CAN signal data, 

RSPA_BLESigErrSta signal send 0x1 Signal Invalid.";
BA_ "Version" SG_ 849 RSPA_ConStat "20.02.00";
BA_ "NetworkRequestHoldingTime" SG_ 849 RSPA_ConStat 5000;
BA_ "NetworkRequest" SG_ 849 RSPA_ConStat 0;
BA_ "UserSigValidity" SG_ 849 RSPA_ConStat 0;
BA_ "GenSigSendType" SG_ 849 RSPA_ConStat 4;
BA_ "Description" SG_ 849 RSPA_ConStat "Connection Status among RSPA, IAU, BLE and SmartPhone";
BA_ "Version" SG_ 849 IAU_NewEVTerminalPhase2Opt "25.04.01";
BA_ "UserSigValidity" SG_ 849 IAU_NewEVTerminalPhase2Opt 0;
BA_ "GenSigSendType" SG_ 849 IAU_NewEVTerminalPhase2Opt 4;
BA_ "Description" SG_ 849 IAU_NewEVTerminalPhase2Opt "New EV Terminal Phase2 Option State";
BA_ "Version" SG_ 849 IAU_ProfileIDRVal "23.02.02";
BA_ "NetworkRequestHoldingTime" SG_ 849 IAU_ProfileIDRVal 5000;
BA_ "NetworkRequest" SG_ 849 IAU_ProfileIDRVal 0;
BA_ "UserSigValidity" SG_ 849 IAU_ProfileIDRVal 0;
BA_ "GenSigSendType" SG_ 849 IAU_ProfileIDRVal 4;
BA_ "Version" SG_ 849 IAU_DigitalKeyProcessingSta "25.07.04";
BA_ "NetworkRequestHoldingTime" SG_ 849 IAU_DigitalKeyProcessingSta 5000;
BA_ "NetworkRequest" SG_ 849 IAU_DigitalKeyProcessingSta 0;
BA_ "UserSigValidity" SG_ 849 IAU_DigitalKeyProcessingSta 3;
BA_ "GenSigSendType" SG_ 849 IAU_DigitalKeyProcessingSta 4;
BA_ "Version" SG_ 849 IAU_DigitalKeyExit "23.07.03";
BA_ "NetworkRequestHoldingTime" SG_ 849 IAU_DigitalKeyExit 5000;
BA_ "NetworkRequest" SG_ 849 IAU_DigitalKeyExit 0;
BA_ "UserSigValidity" SG_ 849 IAU_DigitalKeyExit 3;
BA_ "GenSigSendType" SG_ 849 IAU_DigitalKeyExit 4;
BA_ "Description" SG_ 849 IAU_DigitalKeyExit "Digital Key USM setting Exit Condition";
BA_ "Version" SG_ 849 IAU_DigitalKeyEnblRVal "20.05.02";
BA_ "NetworkRequestHoldingTime" SG_ 849 IAU_DigitalKeyEnblRVal 5000;
BA_ "NetworkRequest" SG_ 849 IAU_DigitalKeyEnblRVal 0;
BA_ "UserSigValidity" SG_ 849 IAU_DigitalKeyEnblRVal 0;
BA_ "GenSigSendType" SG_ 849 IAU_DigitalKeyEnblRVal 4;
BA_ "Version" SG_ 849 IAU_OwnerPhnRegRVal "20.05.02";
BA_ "NetworkRequestHoldingTime" SG_ 849 IAU_OwnerPhnRegRVal 5000;
BA_ "NetworkRequest" SG_ 849 IAU_OwnerPhnRegRVal 0;
BA_ "UserSigValidity" SG_ 849 IAU_OwnerPhnRegRVal 0;
BA_ "GenSigSendType" SG_ 849 IAU_OwnerPhnRegRVal 4;
BA_ "Version" SG_ 849 IAU_NFCCard1RegRVal "17.12.08";
BA_ "NetworkRequestHoldingTime" SG_ 849 IAU_NFCCard1RegRVal 5000;
BA_ "NetworkRequest" SG_ 849 IAU_NFCCard1RegRVal 0;
BA_ "UserSigValidity" SG_ 849 IAU_NFCCard1RegRVal 0;
BA_ "GenSigSendType" SG_ 849 IAU_NFCCard1RegRVal 4;
BA_ "Version" SG_ 849 IAU_NFCCard2RegRVal "17.12.08";
BA_ "NetworkRequestHoldingTime" SG_ 849 IAU_NFCCard2RegRVal 5000;
BA_ "NetworkRequest" SG_ 849 IAU_NFCCard2RegRVal 0;
BA_ "UserSigValidity" SG_ 849 IAU_NFCCard2RegRVal 0;
BA_ "GenSigSendType" SG_ 849 IAU_NFCCard2RegRVal 4;
BA_REL_ "GenSigTimeoutTime" BU_SG_REL_ GW_PSU_DRV_FD SG_ 870 HU_GW_Crc3Val 1500;
BA_REL_ "GenSigTimeoutTime" BU_SG_REL_ BLTN_CAM_FD SG_ 870 CF_AVN_ProfileIDRValue 1500;
BA_REL_ "GenSigTimeoutTime" BU_SG_REL_ GW_PSU_DRV_FD SG_ 870 CF_AVN_ProfileIDRValue 1500;
BA_REL_ "GenSigTimeoutTime" BU_SG_REL_ GW_SAU_DRV_FD SG_ 870 CF_AVN_ProfileIDRValue 1500;
BA_REL_ "GenSigTimeoutTime" BU_SG_REL_ RCM_FD SG_ 870 CF_AVN_ProfileIDRValue 1500;
BA_REL_ "GenSigTimeoutTime" BU_SG_REL_ RWPC_FD SG_ 870 CF_AVN_ProfileIDRValue 1500;
BA_REL_ "GenSigTimeoutTime" BU_SG_REL_ SGU_FD SG_ 870 CF_AVN_ProfileIDRValue 1500;
BA_REL_ "GenSigTimeoutTime" BU_SG_REL_ WPC2_FD SG_ 870 CF_AVN_ProfileIDRValue 1500;
BA_REL_ "GenSigTimeoutTime" BU_SG_REL_ WPC_FD SG_ 870 CF_AVN_ProfileIDRValue 1500;
BA_REL_ "GenSigTimeoutTime" BU_SG_REL_ GW_PSU_AST_FD SG_ 870 HU_RTCCheck 1500;
BA_REL_ "GenSigTimeoutTime" BU_SG_REL_ GW_PSU_DRV_FD SG_ 870 HU_GW_AlvCnt3Val 1500;
BA_REL_ "GenSigTimeoutTime" BU_SG_REL_ ATS_FD SG_ 870 HU_AliveStatus 1500;
BA_REL_ "GenSigTimeoutTime" BU_SG_REL_ ATS_FD SG_ 870 HU_ThemeType 1500;
BA_REL_ "GenSigTimeoutTime" BU_SG_REL_ BLTN_CAM_FD SG_ 870 HU_ThemeType 1500;
BA_REL_ "GenSigTimeoutTime" BU_SG_REL_ GW_PSU_DRV_FD SG_ 993 PDC_FD_Crc2Val 1500;
BA_REL_ "GenSigTimeoutTime" BU_SG_REL_ GW_PSU_DRV_FD SG_ 993 PDC_FD_AlvCnt2Val 1500;
BA_REL_ "GenSigTimeoutTime" BU_SG_REL_ BLTN_CAM_FD SG_ 993 IntLamp_InlTailLmpSta 1500;
BA_REL_ "GenSigTimeoutTime" BU_SG_REL_ FCS_FD SG_ 993 IntLamp_InlTailLmpSta 1500;
BA_REL_ "GenSigTimeoutTime" BU_SG_REL_ GW_PSU_3RD_FD SG_ 993 IntLamp_InlTailLmpSta 1500;
BA_REL_ "GenSigTimeoutTime" BU_SG_REL_ GW_PSU_AST_FD SG_ 993 IntLamp_InlTailLmpSta 1500;
BA_REL_ "GenSigTimeoutTime" BU_SG_REL_ GW_PSU_DRV_FD SG_ 993 IntLamp_InlTailLmpSta 1500;
BA_REL_ "GenSigTimeoutTime" BU_SG_REL_ GW_PSU_RL_FD SG_ 993 IntLamp_InlTailLmpSta 1500;
BA_REL_ "GenSigTimeoutTime" BU_SG_REL_ GW_PSU_RR_FD SG_ 993 IntLamp_InlTailLmpSta 1500;
BA_REL_ "GenSigTimeoutTime" BU_SG_REL_ OHCL_FD SG_ 993 IntLamp_InlTailLmpSta 1500;
BA_REL_ "GenSigTimeoutTime" BU_SG_REL_ WPC2_FD SG_ 993 IntLamp_InlTailLmpSta 1500;
BA_REL_ "GenSigTimeoutTime" BU_SG_REL_ GW_PSU_DRV_FD SG_ 992 PDC_FD_Crc1Val 1500;
BA_REL_ "GenSigTimeoutTime" BU_SG_REL_ ARS_FD SG_ 992 C_3rdRCSeatBeltSW 1500;
BA_REL_ "GenSigTimeoutTime" BU_SG_REL_ GW_PSU_RL_FD SG_ 992 C_3rdRCSeatBeltSW 1500;
BA_REL_ "GenSigTimeoutTime" BU_SG_REL_ GW_PSU_RR_FD SG_ 992 C_3rdRCSeatBeltSW 1500;
BA_REL_ "GenSigTimeoutTime" BU_SG_REL_ PSB_FD SG_ 992 C_3rdRCSeatBeltSW 1500;
BA_REL_ "GenSigTimeoutTime" BU_SG_REL_ WPC2_FD SG_ 992 C_3rdRCSeatBeltSW 1500;
BA_REL_ "GenSigTimeoutTime" BU_SG_REL_ ARS_FD SG_ 992 C_3rdRRSeatBeltSW 1500;
BA_REL_ "GenSigTimeoutTime" BU_SG_REL_ GW_PSU_RR_FD SG_ 992 C_3rdRRSeatBeltSW 1500;
BA_REL_ "GenSigTimeoutTime" BU_SG_REL_ PSB_FD SG_ 992 C_3rdRRSeatBeltSW 1500;
BA_REL_ "GenSigTimeoutTime" BU_SG_REL_ WPC2_FD SG_ 992 C_3rdRRSeatBeltSW 1500;
BA_REL_ "GenSigTimeoutTime" BU_SG_REL_ GW_PSU_AST_FD SG_ 992 Warn_PassStOccSta 1500;
BA_REL_ "GenSigTimeoutTime" BU_SG_REL_ PSB_FD SG_ 992 Warn_PassStOccSta 1500;
BA_REL_ "GenSigTimeoutTime" BU_SG_REL_ GW_PSU_DRV_FD SG_ 992 Warn_RrLftSBRMATSwSta 1500;
BA_REL_ "GenSigTimeoutTime" BU_SG_REL_ GW_PSU_DRV_FD SG_ 992 Warn_RrRhtSBRMATSwSta 1500;
BA_REL_ "GenSigTimeoutTime" BU_SG_REL_ ARS_FD SG_ 992 C_3rdRLSBRMatSw 1500;
BA_REL_ "GenSigTimeoutTime" BU_SG_REL_ GW_PSU_RL_FD SG_ 992 C_3rdRLSBRMatSw 1500;
BA_REL_ "GenSigTimeoutTime" BU_SG_REL_ WPC2_FD SG_ 992 C_3rdRLSBRMatSw 1500;
BA_REL_ "GenSigTimeoutTime" BU_SG_REL_ ARS_FD SG_ 992 C_3rdRRSBRMatSw 1500;
BA_REL_ "GenSigTimeoutTime" BU_SG_REL_ GW_PSU_RR_FD SG_ 992 C_3rdRRSBRMatSw 1500;
BA_REL_ "GenSigTimeoutTime" BU_SG_REL_ WPC2_FD SG_ 992 C_3rdRRSBRMatSw 1500;
BA_REL_ "GenSigTimeoutTime" BU_SG_REL_ BLTN_CAM_FD SG_ 992 Trunk_TrnkTlgtSwSta 1500;
BA_REL_ "GenSigTimeoutTime" BU_SG_REL_ GW_PSU_3RD_FD SG_ 992 Trunk_TrnkTlgtSwSta 1500;
BA_REL_ "GenSigTimeoutTime" BU_SG_REL_ GW_PSU_AST_FD SG_ 992 Trunk_TrnkTlgtSwSta 1500;
BA_REL_ "GenSigTimeoutTime" BU_SG_REL_ GW_PSU_RL_FD SG_ 992 Trunk_TrnkTlgtSwSta 1500;
BA_REL_ "GenSigTimeoutTime" BU_SG_REL_ GW_PSU_RR_FD SG_ 992 Trunk_TrnkTlgtSwSta 1500;
BA_REL_ "GenSigTimeoutTime" BU_SG_REL_ SHVU_RL_FD SG_ 992 Trunk_TrnkTlgtSwSta 1500;
BA_REL_ "GenSigTimeoutTime" BU_SG_REL_ SHVU_RR_FD SG_ 992 Trunk_TrnkTlgtSwSta 1500;
BA_REL_ "GenSigTimeoutTime" BU_SG_REL_ GW_PSU_DRV_FD SG_ 992 PDC_FD_AlvCnt1Val 1500;
BA_REL_ "GenSigTimeoutTime" BU_SG_REL_ FCS_FD SG_ 992 IGN3State 1500;
BA_REL_ "GenSigTimeoutTime" BU_SG_REL_ GW_PSU_3RD_FD SG_ 992 IGN3State 1500;
BA_REL_ "GenSigTimeoutTime" BU_SG_REL_ GW_PSU_AST_FD SG_ 992 IGN3State 1500;
BA_REL_ "GenSigTimeoutTime" BU_SG_REL_ GW_PSU_DRV_FD SG_ 992 IGN3State 1500;
BA_REL_ "GenSigTimeoutTime" BU_SG_REL_ GW_PSU_RL_FD SG_ 992 IGN3State 1500;
BA_REL_ "GenSigTimeoutTime" BU_SG_REL_ GW_PSU_RR_FD SG_ 992 IGN3State 1500;
BA_REL_ "GenSigTimeoutTime" BU_SG_REL_ GW_SAU_DRV_FD SG_ 992 IGN3State 1500;
BA_REL_ "GenSigTimeoutTime" BU_SG_REL_ SHVU_3RD_FD SG_ 992 IGN3State 1500;
BA_REL_ "GenSigTimeoutTime" BU_SG_REL_ SHVU_CCS_FD SG_ 992 IGN3State 1500;
BA_REL_ "GenSigTimeoutTime" BU_SG_REL_ SHVU_FRNT_FD SG_ 992 IGN3State 1500;
BA_REL_ "GenSigTimeoutTime" BU_SG_REL_ SHVU_REAR_FD SG_ 992 IGN3State 1500;
BA_REL_ "GenSigTimeoutTime" BU_SG_REL_ SHVU_RL_FD SG_ 992 IGN3State 1500;
BA_REL_ "GenSigTimeoutTime" BU_SG_REL_ SHVU_RR_FD SG_ 992 IGN3State 1500;
BA_REL_ "GenSigTimeoutTime" BU_SG_REL_ GW_PSU_3RD_FD SG_ 992 IGN3CutOffState 1500;
BA_REL_ "GenSigTimeoutTime" BU_SG_REL_ GW_PSU_AST_FD SG_ 992 IGN3CutOffState 1500;
BA_REL_ "GenSigTimeoutTime" BU_SG_REL_ GW_PSU_DRV_FD SG_ 992 IGN3CutOffState 1500;
BA_REL_ "GenSigTimeoutTime" BU_SG_REL_ GW_PSU_RL_FD SG_ 992 IGN3CutOffState 1500;
BA_REL_ "GenSigTimeoutTime" BU_SG_REL_ GW_PSU_RR_FD SG_ 992 IGN3CutOffState 1500;
BA_REL_ "GenSigTimeoutTime" BU_SG_REL_ SHVU_3RD_FD SG_ 992 IGN3CutOffState 1500;
BA_REL_ "GenSigTimeoutTime" BU_SG_REL_ SHVU_CCS_FD SG_ 992 IGN3CutOffState 1500;
BA_REL_ "GenSigTimeoutTime" BU_SG_REL_ SHVU_FRNT_FD SG_ 992 IGN3CutOffState 1500;
BA_REL_ "GenSigTimeoutTime" BU_SG_REL_ SHVU_REAR_FD SG_ 992 IGN3CutOffState 1500;
BA_REL_ "GenSigTimeoutTime" BU_SG_REL_ SHVU_RL_FD SG_ 992 IGN3CutOffState 1500;
BA_REL_ "GenSigTimeoutTime" BU_SG_REL_ SHVU_RR_FD SG_ 992 IGN3CutOffState 1500;
BA_REL_ "GenSigTimeoutTime" BU_SG_REL_ BLTN_CAM_FD SG_ 992 IGN3State_By_ActiveOn 1500;
BA_REL_ "GenSigTimeoutTime" BU_SG_REL_ GW_SAU_DRV_FD SG_ 992 SeatBeltSwSta_Asst 1500;
BA_REL_ "GenSigTimeoutTime" BU_SG_REL_ ATS_FD SG_ 992 PDCex_CurtainOpt 1500;
BA_REL_ "GenSigTimeoutTime" BU_SG_REL_ ATS_FD SG_ 992 DriveTypeOption 1500;
BA_REL_ "GenSigTimeoutTime" BU_SG_REL_ BLTN_CAM_FD SG_ 992 DriveTypeOption 1500;
BA_REL_ "GenSigTimeoutTime" BU_SG_REL_ FCS_FD SG_ 992 DriveTypeOption 1500;
BA_REL_ "GenSigTimeoutTime" BU_SG_REL_ FLLR_FD SG_ 992 DriveTypeOption 1500;
BA_REL_ "GenSigTimeoutTime" BU_SG_REL_ GW_PSU_AST_FD SG_ 992 DriveTypeOption 1500;
BA_REL_ "GenSigTimeoutTime" BU_SG_REL_ GW_PSU_DRV_FD SG_ 992 DriveTypeOption 1500;
BA_REL_ "GenSigTimeoutTime" BU_SG_REL_ GW_PSU_RL_FD SG_ 992 DriveTypeOption 1500;
BA_REL_ "GenSigTimeoutTime" BU_SG_REL_ GW_PSU_RR_FD SG_ 992 DriveTypeOption 1500;
BA_REL_ "GenSigTimeoutTime" BU_SG_REL_ GW_SAU_DRV_FD SG_ 992 DriveTypeOption 1500;
BA_REL_ "GenSigTimeoutTime" BU_SG_REL_ PSB_FD SG_ 992 DriveTypeOption 1500;
BA_REL_ "GenSigTimeoutTime" BU_SG_REL_ SGU_FD SG_ 992 DriveTypeOption 1500;
BA_REL_ "GenSigTimeoutTime" BU_SG_REL_ SHVU_3RD_FD SG_ 992 DriveTypeOption 1500;
BA_REL_ "GenSigTimeoutTime" BU_SG_REL_ SHVU_FRNT_FD SG_ 992 DriveTypeOption 1500;
BA_REL_ "GenSigTimeoutTime" BU_SG_REL_ SHVU_REAR_FD SG_ 992 DriveTypeOption 1500;
BA_REL_ "GenSigTimeoutTime" BU_SG_REL_ BLTN_CAM_FD SG_ 992 ICU_MtGearPosRSta 1500;
BA_REL_ "GenSigTimeoutTime" BU_SG_REL_ GW_PSU_3RD_FD SG_ 992 Warn_PrkngBrkSwSta 1500;
BA_REL_ "GenSigTimeoutTime" BU_SG_REL_ GW_PSU_AST_FD SG_ 992 Warn_PrkngBrkSwSta 1500;
BA_REL_ "GenSigTimeoutTime" BU_SG_REL_ GW_PSU_RL_FD SG_ 992 Warn_PrkngBrkSwSta 1500;
BA_REL_ "GenSigTimeoutTime" BU_SG_REL_ GW_PSU_RR_FD SG_ 992 Warn_PrkngBrkSwSta 1500;
BA_REL_ "GenSigTimeoutTime" BU_SG_REL_ SHVU_RL_FD SG_ 992 Warn_PrkngBrkSwSta 1500;
BA_REL_ "GenSigTimeoutTime" BU_SG_REL_ SHVU_RR_FD SG_ 992 Warn_PrkngBrkSwSta 1500;
BA_REL_ "GenSigTimeoutTime" BU_SG_REL_ ATS_FD SG_ 992 Warn_DrvStBltSwSta 1500;
BA_REL_ "GenSigTimeoutTime" BU_SG_REL_ GW_PSU_DRV_FD SG_ 992 Warn_DrvStBltSwSta 1500;
BA_REL_ "GenSigTimeoutTime" BU_SG_REL_ GW_SAU_DRV_FD SG_ 992 Warn_DrvStBltSwSta 1500;
BA_REL_ "GenSigTimeoutTime" BU_SG_REL_ PSB_FD SG_ 992 Warn_DrvStBltSwSta 1500;
BA_REL_ "GenSigTimeoutTime" BU_SG_REL_ GW_PSU_AST_FD SG_ 992 Warn_AsstStBltSwSta 1500;
BA_REL_ "GenSigTimeoutTime" BU_SG_REL_ GW_PSU_RL_FD SG_ 992 Warn_AsstStBltSwSta 1500;
BA_REL_ "GenSigTimeoutTime" BU_SG_REL_ GW_SAU_DRV_FD SG_ 992 Warn_AsstStBltSwSta 1500;
BA_REL_ "GenSigTimeoutTime" BU_SG_REL_ PSB_FD SG_ 992 Warn_AsstStBltSwSta 1500;
BA_REL_ "GenSigTimeoutTime" BU_SG_REL_ GW_PSU_AST_FD SG_ 992 Warn_RrLftStBltSwSta 1500;
BA_REL_ "GenSigTimeoutTime" BU_SG_REL_ GW_PSU_DRV_FD SG_ 992 Warn_RrLftStBltSwSta 1500;
BA_REL_ "GenSigTimeoutTime" BU_SG_REL_ GW_PSU_RL_FD SG_ 992 Warn_RrLftStBltSwSta 1500;
BA_REL_ "GenSigTimeoutTime" BU_SG_REL_ PSB_FD SG_ 992 Warn_RrLftStBltSwSta 1500;
BA_REL_ "GenSigTimeoutTime" BU_SG_REL_ PSB_FD SG_ 992 Warn_RrCtrStBltSwSta 1500;
BA_REL_ "GenSigTimeoutTime" BU_SG_REL_ GW_PSU_AST_FD SG_ 992 Warn_RrRtStBltSwSta 1500;
BA_REL_ "GenSigTimeoutTime" BU_SG_REL_ GW_PSU_DRV_FD SG_ 992 Warn_RrRtStBltSwSta 1500;
BA_REL_ "GenSigTimeoutTime" BU_SG_REL_ GW_PSU_RR_FD SG_ 992 Warn_RrRtStBltSwSta 1500;
BA_REL_ "GenSigTimeoutTime" BU_SG_REL_ PSB_FD SG_ 992 Warn_RrRtStBltSwSta 1500;
BA_REL_ "GenSigTimeoutTime" BU_SG_REL_ ARS_FD SG_ 992 C_3rdRLSeatBeltSW 1500;
BA_REL_ "GenSigTimeoutTime" BU_SG_REL_ GW_PSU_RL_FD SG_ 992 C_3rdRLSeatBeltSW 1500;
BA_REL_ "GenSigTimeoutTime" BU_SG_REL_ PSB_FD SG_ 992 C_3rdRLSeatBeltSW 1500;
BA_REL_ "GenSigTimeoutTime" BU_SG_REL_ WPC2_FD SG_ 992 C_3rdRLSeatBeltSW 1500;
BA_REL_ "GenSigTimeoutTime" BU_SG_REL_ BLTN_CAM_FD SG_ 995 Lamp_TrnSigLmpLftOnReq 1500;
BA_REL_ "GenSigTimeoutTime" BU_SG_REL_ BLTN_CAM_FD SG_ 995 Lamp_TrnSigLmpRtOnReq 1500;
BA_REL_ "GenSigTimeoutTime" BU_SG_REL_ GW_PSU_DRV_FD SG_ 994 PDC_FD_Crc3Val 1500;
BA_REL_ "GenSigTimeoutTime" BU_SG_REL_ GW_PSU_DRV_FD SG_ 994 PDC_FD_AlvCnt3Val 1500;
BA_REL_ "GenSigTimeoutTime" BU_SG_REL_ BLTN_CAM_FD SG_ 994 Warn_DrvDrSwSta 1500;
BA_REL_ "GenSigTimeoutTime" BU_SG_REL_ DCM_FD SG_ 994 Warn_DrvDrSwSta 1500;
BA_REL_ "GenSigTimeoutTime" BU_SG_REL_ FLLR_FD SG_ 994 Warn_DrvDrSwSta 1500;
BA_REL_ "GenSigTimeoutTime" BU_SG_REL_ GW_PSU_DRV_FD SG_ 994 Warn_DrvDrSwSta 1500;
BA_REL_ "GenSigTimeoutTime" BU_SG_REL_ PSB_FD SG_ 994 Warn_DrvDrSwSta 1500;
BA_REL_ "GenSigTimeoutTime" BU_SG_REL_ RWPC_FD SG_ 994 Warn_DrvDrSwSta 1500;
BA_REL_ "GenSigTimeoutTime" BU_SG_REL_ WPC2_FD SG_ 994 Warn_DrvDrSwSta 1500;
BA_REL_ "GenSigTimeoutTime" BU_SG_REL_ WPC_FD SG_ 994 Warn_DrvDrSwSta 1500;
BA_REL_ "GenSigTimeoutTime" BU_SG_REL_ BLTN_CAM_FD SG_ 994 Warn_AsstDrSwSta 1500;
BA_REL_ "GenSigTimeoutTime" BU_SG_REL_ DCM_FD SG_ 994 Warn_AsstDrSwSta 1500;
BA_REL_ "GenSigTimeoutTime" BU_SG_REL_ FLLR_FD SG_ 994 Warn_AsstDrSwSta 1500;
BA_REL_ "GenSigTimeoutTime" BU_SG_REL_ GW_PSU_AST_FD SG_ 994 Warn_AsstDrSwSta 1500;
BA_REL_ "GenSigTimeoutTime" BU_SG_REL_ GW_PSU_RL_FD SG_ 994 Warn_AsstDrSwSta 1500;
BA_REL_ "GenSigTimeoutTime" BU_SG_REL_ GW_SAU_DRV_FD SG_ 994 Warn_AsstDrSwSta 1500;
BA_REL_ "GenSigTimeoutTime" BU_SG_REL_ PSB_FD SG_ 994 Warn_AsstDrSwSta 1500;
BA_REL_ "GenSigTimeoutTime" BU_SG_REL_ RWPC_FD SG_ 994 Warn_AsstDrSwSta 1500;
BA_REL_ "GenSigTimeoutTime" BU_SG_REL_ WPC2_FD SG_ 994 Warn_AsstDrSwSta 1500;
BA_REL_ "GenSigTimeoutTime" BU_SG_REL_ WPC_FD SG_ 994 Warn_AsstDrSwSta 1500;
BA_REL_ "GenSigTimeoutTime" BU_SG_REL_ BLTN_CAM_FD SG_ 994 Warn_RrLftDrSwSta 1500;
BA_REL_ "GenSigTimeoutTime" BU_SG_REL_ DCM_FD SG_ 994 Warn_RrLftDrSwSta 1500;
BA_REL_ "GenSigTimeoutTime" BU_SG_REL_ FLLR_FD SG_ 994 Warn_RrLftDrSwSta 1500;
BA_REL_ "GenSigTimeoutTime" BU_SG_REL_ GW_PSU_AST_FD SG_ 994 Warn_RrLftDrSwSta 1500;
BA_REL_ "GenSigTimeoutTime" BU_SG_REL_ GW_PSU_RL_FD SG_ 994 Warn_RrLftDrSwSta 1500;
BA_REL_ "GenSigTimeoutTime" BU_SG_REL_ GW_PSU_RR_FD SG_ 994 Warn_RrLftDrSwSta 1500;
BA_REL_ "GenSigTimeoutTime" BU_SG_REL_ PSB_FD SG_ 994 Warn_RrLftDrSwSta 1500;
BA_REL_ "GenSigTimeoutTime" BU_SG_REL_ RWPC_FD SG_ 994 Warn_RrLftDrSwSta 1500;
BA_REL_ "GenSigTimeoutTime" BU_SG_REL_ SHVU_RL_FD SG_ 994 Warn_RrLftDrSwSta 1500;
BA_REL_ "GenSigTimeoutTime" BU_SG_REL_ WPC2_FD SG_ 994 Warn_RrLftDrSwSta 1500;
BA_REL_ "GenSigTimeoutTime" BU_SG_REL_ WPC_FD SG_ 994 Warn_RrLftDrSwSta 1500;
BA_REL_ "GenSigTimeoutTime" BU_SG_REL_ BLTN_CAM_FD SG_ 994 Warn_RrRtDrSwSta 1500;
BA_REL_ "GenSigTimeoutTime" BU_SG_REL_ DCM_FD SG_ 994 Warn_RrRtDrSwSta 1500;
BA_REL_ "GenSigTimeoutTime" BU_SG_REL_ FLLR_FD SG_ 994 Warn_RrRtDrSwSta 1500;
BA_REL_ "GenSigTimeoutTime" BU_SG_REL_ GW_PSU_AST_FD SG_ 994 Warn_RrRtDrSwSta 1500;
BA_REL_ "GenSigTimeoutTime" BU_SG_REL_ GW_PSU_RL_FD SG_ 994 Warn_RrRtDrSwSta 1500;
BA_REL_ "GenSigTimeoutTime" BU_SG_REL_ GW_PSU_RR_FD SG_ 994 Warn_RrRtDrSwSta 1500;
BA_REL_ "GenSigTimeoutTime" BU_SG_REL_ PSB_FD SG_ 994 Warn_RrRtDrSwSta 1500;
BA_REL_ "GenSigTimeoutTime" BU_SG_REL_ RWPC_FD SG_ 994 Warn_RrRtDrSwSta 1500;
BA_REL_ "GenSigTimeoutTime" BU_SG_REL_ SHVU_RR_FD SG_ 994 Warn_RrRtDrSwSta 1500;
BA_REL_ "GenSigTimeoutTime" BU_SG_REL_ WPC2_FD SG_ 994 Warn_RrRtDrSwSta 1500;
BA_REL_ "GenSigTimeoutTime" BU_SG_REL_ WPC_FD SG_ 994 Warn_RrRtDrSwSta 1500;
BA_REL_ "GenSigTimeoutTime" BU_SG_REL_ BLTN_CAM_FD SG_ 994 Warn_HoodSwSta 1500;
BA_REL_ "GenSigTimeoutTime" BU_SG_REL_ GW_PSU_DRV_FD SG_ 994 DoorLock_DrvDrUnLkSta 1500;
BA_REL_ "GenSigTimeoutTime" BU_SG_REL_ BLTN_CAM_FD SG_ 994 C_CrashUnlockState 1500;
BA_REL_ "GenSigTimeoutTime" BU_SG_REL_ BLTN_CAM_FD SG_ 997 ICU_BS2SoC 1500;
BA_REL_ "GenSigTimeoutTime" BU_SG_REL_ GW_PSU_DRV_FD SG_ 996 PDC_FD_Crc10Val 1500;
BA_REL_ "GenSigTimeoutTime" BU_SG_REL_ BLTN_CAM_FD SG_ 996 PDC_MainLBMOpt 1500;
BA_REL_ "GenSigTimeoutTime" BU_SG_REL_ GW_PSU_DRV_FD SG_ 996 PDC_FD_AlvCnt10Val 1500;
BA_REL_ "GenSigTimeoutTime" BU_SG_REL_ BLTN_CAM_FD SG_ 996 ICU_PowerAutoCutModSta 1500;
BA_REL_ "GenSigTimeoutTime" BU_SG_REL_ GW_PSU_3RD_FD SG_ 996 ICU_PowerAutoCutModSta 1500;
BA_REL_ "GenSigTimeoutTime" BU_SG_REL_ GW_PSU_AST_FD SG_ 996 ICU_PowerAutoCutModSta 1500;
BA_REL_ "GenSigTimeoutTime" BU_SG_REL_ GW_PSU_DRV_FD SG_ 996 ICU_PowerAutoCutModSta 1500;
BA_REL_ "GenSigTimeoutTime" BU_SG_REL_ GW_PSU_RL_FD SG_ 996 ICU_PowerAutoCutModSta 1500;
BA_REL_ "GenSigTimeoutTime" BU_SG_REL_ GW_PSU_RR_FD SG_ 996 ICU_PowerAutoCutModSta 1500;
BA_REL_ "GenSigTimeoutTime" BU_SG_REL_ SHVU_3RD_FD SG_ 996 ICU_PowerAutoCutModSta 1500;
BA_REL_ "GenSigTimeoutTime" BU_SG_REL_ SHVU_CCS_FD SG_ 996 ICU_PowerAutoCutModSta 1500;
BA_REL_ "GenSigTimeoutTime" BU_SG_REL_ SHVU_FRNT_FD SG_ 996 ICU_PowerAutoCutModSta 1500;
BA_REL_ "GenSigTimeoutTime" BU_SG_REL_ SHVU_REAR_FD SG_ 996 ICU_PowerAutoCutModSta 1500;
BA_REL_ "GenSigTimeoutTime" BU_SG_REL_ SHVU_RL_FD SG_ 996 ICU_PowerAutoCutModSta 1500;
BA_REL_ "GenSigTimeoutTime" BU_SG_REL_ SHVU_RR_FD SG_ 996 ICU_PowerAutoCutModSta 1500;
BA_REL_ "GenSigTimeoutTime" BU_SG_REL_ BLTN_CAM_FD SG_ 996 ICU_BattAutoCutPreWrng 1500;
BA_REL_ "GenSigTimeoutTime" BU_SG_REL_ BLTN_CAM_FD SG_ 996 Bat12V_Chr_Req 1500;
BA_REL_ "GenSigTimeoutTime" BU_SG_REL_ BLTN_CAM_FD SG_ 1047 HU_GNSS_UTC_min 5000;
BA_REL_ "GenSigTimeoutTime" BU_SG_REL_ BLTN_CAM_FD SG_ 1047 HU_GNSS_UTC_sec 5000;
BA_REL_ "GenSigTimeoutTime" BU_SG_REL_ BLTN_CAM_FD SG_ 1047 HU_GNSS_UTC_offset 5000;
BA_REL_ "GenSigTimeoutTime" BU_SG_REL_ BLTN_CAM_FD SG_ 1047 HU_GNSS_DST 5000;
BA_REL_ "GenSigTimeoutTime" BU_SG_REL_ BLTN_CAM_FD SG_ 1047 HU_GNSS_TimezoneOffset 5000;
BA_REL_ "GenSigTimeoutTime" BU_SG_REL_ BLTN_CAM_FD SG_ 1047 HU_GNSS_UTC_year 5000;
BA_REL_ "GenSigTimeoutTime" BU_SG_REL_ BLTN_CAM_FD SG_ 1047 HU_GNSS_UTC_month 5000;
BA_REL_ "GenSigTimeoutTime" BU_SG_REL_ BLTN_CAM_FD SG_ 1047 HU_GNSS_UTC_day 5000;
BA_REL_ "GenSigTimeoutTime" BU_SG_REL_ BLTN_CAM_FD SG_ 1047 HU_GNSS_UTC_hour 5000;
BA_REL_ "GenSigTimeoutTime" BU_SG_REL_ GW_PSU_DRV_FD SG_ 849 IAU_FD_Crc4Val 1500;
BA_REL_ "GenSigTimeoutTime" BU_SG_REL_ WPC2_FD SG_ 849 IAU_DigitalKey2Opt 1500;
BA_REL_ "GenSigTimeoutTime" BU_SG_REL_ WPC_FD SG_ 849 IAU_DigitalKey2Opt 1500;
BA_REL_ "GenSigTimeoutTime" BU_SG_REL_ GW_PSU_DRV_FD SG_ 849 IAU_FD_AlvCnt4Val 1500;
BA_REL_ "GenSigTimeoutTime" BU_SG_REL_ BLTN_CAM_FD SG_ 849 IAU_ProfileIDRVal 1500;
BA_REL_ "GenSigTimeoutTime" BU_SG_REL_ GW_PSU_DRV_FD SG_ 849 IAU_ProfileIDRVal 1500;
BA_REL_ "GenSigTimeoutTime" BU_SG_REL_ GW_SAU_DRV_FD SG_ 849 IAU_ProfileIDRVal 1500;
BA_REL_ "GenSigTimeoutTime" BU_SG_REL_ RCM_FD SG_ 849 IAU_ProfileIDRVal 1500;
BA_REL_ "GenSigTimeoutTime" BU_SG_REL_ RWPC_FD SG_ 849 IAU_ProfileIDRVal 1500;
BA_REL_ "GenSigTimeoutTime" BU_SG_REL_ SGU_FD SG_ 849 IAU_ProfileIDRVal 1500;
BA_REL_ "GenSigTimeoutTime" BU_SG_REL_ WPC2_FD SG_ 849 IAU_ProfileIDRVal 1500;
BA_REL_ "GenSigTimeoutTime" BU_SG_REL_ WPC_FD SG_ 849 IAU_ProfileIDRVal 1500;
VAL_ 870 HU_GW_Crc3Val 0 "0x0~0xFFFF:CRCValue" 65535 "0x0~0xFFFF:CRCValue" ;
VAL_ 870 HU_FrGlsHtdSW 0 "Default" 1 "OFF" 2 "ON" 3 "Invalid" ;
VAL_ 870 AVN_RSPA_Disp_Rdy 0 "Impossible to display" 1 "Possible to display" 2 "RESERVED" 3 "Invalid" ;
VAL_ 870 CF_AVN_ProfileIDRValue 0 "Default" 1 "Guest" 2 "Profile 1" 3 "Profile 2" 4 "Profile 3" 5 "Profile 4" 6 "Profile 5" 7 "Profile 6" 8 "Profile 7" 9 "Profile 8" 10 "Profile 9" 11 "RESERVED" 12 "RESERVED" 13 "RESERVED" 14 "RESERVED" 15 "Invalid" ;
VAL_ 870 HazardFromHUSVM 0 "inactive" 1 "active" 2 "RESERVED" 3 "invalid" ;
VAL_ 870 OMUOSMirCtrl 0 "Off" 1 "Fold" 2 "Unfold" 3 "invalid" ;
VAL_ 870 OTAUIStatus 0 "Not Ready" 1 "Ready" 2 "RESERVED" 3 "Invalid" ;
VAL_ 870 C_TeleActiveStatus 0 "Active" 1 "Deactive" 2 "RESERVED" 3 "Invalid" ;
VAL_ 870 HU_RTCCheck 0 "Ready" 1 "Checking" 2 "RESERVED" 3 "Invalid" ;
VAL_ 870 HU_GW_AlvCnt3Val 0 "0x0~0xFF:AlvCntValue" 255 "0x0~0xFF:AlvCntValue" ;
VAL_ 870 HU_SWRCWarmerSet 0 "Off (Release)" 1 "On (Press)" 2 "RESERVED" 3 "Invalid" ;
VAL_ 870 HU_TrModeReq_PE 0 "Default" 1 "Trailer On" 2 "Carrier On" 3 "Off" 4 "RESERVED" 5 "Carrier On (Carrier App)" 6 "RESERVED" 7 "Invalid" ;
VAL_ 870 HU_TrBrakeTypeReq_PE 0 "Default" 1 "Off" 2 "Light Electric" 3 "Heavy Electric" 4 "EOH Light" 5 "EOH Heavy" 6 "RESERVED" 7 "Invalid" ;
VAL_ 870 HU_STA_Req_PE 0 "Default" 1 "STA Off Request" 2 "STA On Request" 3 "STA Temporary Disabled Request" ;
VAL_ 870 HU_PopUpDnSafetyModeState 0 "Default" 1 "Off" 2 "On" 3 "Invalid" ;
VAL_ 870 HU_LghtDnSafetyModState 0 "Default" 1 "Off" 2 "On" 3 "Invalid" ;
VAL_ 870 HU_FullScrSafetyModeState 0 "Default" 1 "Off" 2 "On" 3 "Invalid" ;
VAL_ 870 HU_DispAvailable 0 "Default" 1 "GNB" 2 "HOME" 3 "Invalid" ;
VAL_ 870 HU_ISG_OFF_Set_Req_PE 0 "Defualt" 1 "Pushed" 2 "RESERVED" 3 "Invalid" ;
VAL_ 870 AVN_MPA_SelBtnSta 0 "Init" 1 "Record new path button input" 2 "Cancel path edit PU input" 3 "RESERVED" 4 "RESERVED" 5 "RESERVED" 6 "RESERVED" 7 "RESERVED" 8 "Path_ID1 button input" 9 "Path_ID2 button input" 10 "Path_ID3 button input" 11 "Path_ID4 button input" 12 "Path_ID5 button input" 13 "Path_ID6 button input" 14 "Path_ID7 button input" 15 "Path_ID8 button input" 16 "Path_ID9 button input" 17 "Path_ID10 button input" 18 "RESERVED" 19 "RESERVED" 20 "RESERVED" 21 "RESERVED" 22 "Path_ID1 delete button input" 23 "Path_ID2 delete button input" 24 "Path_ID3 delete button input" 25 "Path_ID4 delete button input" 26 "Path_ID5 delete button input" 27 "Path_ID6 delete button input" 28 "Path_ID7 delete button input" 29 "Path_ID8 delete button input" 30 "Path_ID9 delete button input" 31 "Path_ID10 delete button input" 32 "RESERVED" 33 "RESERVED" 34 "RESERVED" 35 "RESERVED" 36 "RESERVED" 37 "RESERVED" 38 "RESERVED" 39 "RESERVED" 40 "RESERVED" 41 "RESERVED" 42 "RESERVED" 43 "RESERVED" 44 "RESERVED" 45 "RESERVED" 46 "RESERVED" 47 "RESERVED" 48 "RESERVED" 49 "RESERVED" 50 "RESERVED" 51 "RESERVED" 52 "RESERVED" 53 "RESERVED" 54 "RESERVED" 55 "RESERVED" 56 "RESERVED" 57 "RESERVED" 58 "RESERVED" 59 "RESERVED" 60 "RESERVED" 61 "RESERVED" 62 "RESERVED" 63 "Invalid" ;
VAL_ 870 AVN_PRK_Cam_Status 0 "Default" 1 "Normal" 2 "Error" 3 "Invalid" ;
VAL_ 870 AVN_MRA_Disp_Rdy 0 "Impossible to display" 1 "Possible to display" 2 "RESERVED" 3 "Invalid" ;
VAL_ 870 AVN_PRK_Func_Selected 0 "Init" 1 "No input" 2 "RSPA Soft Button input" 3 "MRA Soft Button input" 4 "MPA Soft Button input" 5 "Add New Route Soft Button input" 6 "Route Management Soft Button input" 7 "Search_Slot_along_way Soft Button input" 8 "SVM Soft Button input" 9 "Remote Forward/Backward Soft Button input" 10 "RESERVED" 11 "RESERVED" 12 "RESERVED" 13 "RESERVED" 14 "RESERVED" 15 "Invalid" ;
VAL_ 870 AVN_MRA_CancelInput 0 "Init" 1 "No input" 2 "Cancel input" 3 "Invalid" ;
VAL_ 870 HU_DistanceUnit 0 "Km" 1 "Mile" 2 "RESERVED" 3 "Invalid" ;
VAL_ 870 HU_Scheduled_Setting 0 "Scheduled not set" 1 "Scheduled set" 2 "RESERVED" 3 "RESERVED" 4 "RESERVED" 5 "RESERVED" 6 "60% SoC Requested" 7 "70% SoC Requested" 8 "80% SoC Requested" 9 "90% SoC Requested" 10 "100% SoC Requested" 11 "RESERVED" 12 "RESERVED" 13 "RESERVED" 14 "RESERVED" 15 "Invalid" ;
VAL_ 870 HU_AliveStatus 0 "Not Ready" 1 "On Mode" 2 "Head Unit Update Mode" 3 "Invalid" ;
VAL_ 870 HU_ThemeType 0 "Default" 1 "Aqua(Hyundai)" 2 "Magenta(Kia)" 3 "Eco White" 4 "Eco Black" 5 "Genesis(IKPE)" 6 "Magenta White" 7 "RESERVED" 8 "RESERVED" 9 "RESERVED" 10 "RESERVED" 11 "RESERVED" 12 "RESERVED" 13 "RESERVED" 14 "RESERVED" 15 "Invalid" 16 "Copper" 17 "Copper Rust" 18 "RESERVED" 19 "RESERVED" 20 "RESERVED" 21 "RESERVED" 22 "RESERVED" 23 "RESERVED" 24 "RESERVED" 25 "RESERVED" 26 "RESERVED" 27 "RESERVED" 28 "RESERVED" 29 "RESERVED" 30 "RESERVED" 31 "RESERVED" 32 "ccIC Light" 33 "ccIC Dark" 34 "RESERVED" 35 "RESERVED" 36 "RESERVED" 37 "RESERVED" 38 "RESERVED" 39 "RESERVED" 40 "RESERVED" 41 "RESERVED" 42 "RESERVED" 43 "RESERVED" 44 "RESERVED" 45 "RESERVED" 46 "RESERVED" 47 "RESERVED" 48 "RESERVED" 49 "RESERVED" 50 "RESERVED" 51 "RESERVED" 52 "RESERVED" 53 "RESERVED" 54 "RESERVED" 55 "RESERVED" 56 "RESERVED" 57 "RESERVED" 58 "RESERVED" 59 "RESERVED" 60 "RESERVED" 61 "RESERVED" 62 "RESERVED" 63 "RESERVED" ;
VAL_ 870 HU_MicActivity 0 "Deactivated" 1 "Activated" 2 "RESERVED" 3 "Invalid" ;
VAL_ 870 AVN_RSPA_ModeSelect 0 "None" 1 "CCP focus (1st menu on the left)" 2 "Touch or CCP confirm (1st menu on the left)" 3 "CCP focus (2nd menu on the left)" 4 "Touch or CCP confirm (2nd menu on the left)" 5 "CCP focus (1st menu on the right)" 6 "Touch or CCP confirm (1st menu on the right)" 7 "CCP focus (2nd menu on the right)" 8 "Touch or CCP confirm (2nd menu on the right)" 9 "Touch or CCP confirm (1st menu Forward perpendicular on the left)" 10 "Touch or CCP confirm (2nd menu Forward perpendicular on the left)" 11 "Touch or CCP confirm (1st menu Forward perpendicular on the right)" 12 "Touch or CCP confirm (2nd menu Forward perpendicular on the right)" 13 "RESERVED" 14 "RESERVED" 15 "Invalid" ;
VAL_ 870 CF_HU_GPSFlt 0 "Normal" 1 "Fault operation" 2 "TimeOut" 3 "Invalid" ;
VAL_ 870 AVN_RSPA_CancelInput 0 "Init" 1 "No Input" 2 "Cancel Input" 3 "Invalid" ;
VAL_ 993 PDC_FD_Crc2Val 0 "0x0~0xFFFF:CRCValue" 65535 "0x0~0xFFFF:CRCValue" ;
VAL_ 993 Lamp_StpLmpLftOpnSta 0 "Normal" 1 "Open Status" 2 "Not Used" 3 "Error Indicator" ;
VAL_ 993 Lamp_StpLmpRtOpnSta 0 "Normal" 1 "Open Status" 2 "Not Used" 3 "Error Indicator" ;
VAL_ 993 Lamp_HmslLmpOpnSta 0 "Normal" 1 "Open Status" 2 "Not Used" 3 "Error Indicator" ;
VAL_ 993 Lamp_DrlLmpLftOpnSta 0 "Normal" 1 "Open Status" 2 "Not Used" 3 "Error Indicator" ;
VAL_ 993 Lamp_DrlLmpRtOpnSta 0 "Normal" 1 "Open Status" 2 "Not Used" 3 "Error Indicator" ;
VAL_ 993 Lamp_FrFgLmpLftOpnSta 0 "Normal" 1 "Open Status" 2 "Not Used" 3 "Error Indicator" ;
VAL_ 993 Lamp_FrFgLmpRtOpnSta 0 "Normal" 1 "Open Status" 2 "Not Used" 3 "Error Indicator" ;
VAL_ 993 Lamp_CorneringLmpLftOpnSta 0 "Normal" 1 "Open Status" 2 "Not Used" 3 "Error Indicator" ;
VAL_ 993 Lamp_CorneringLmpRtOpnSta 0 "Normal" 1 "Open Status" 2 "Not Used" 3 "Error Indicator" ;
VAL_ 993 Lamp_StcBendingLmpLftOpnSta 0 "Normal" 1 "Open Status" 2 "Not Used" 3 "Error Indicator" ;
VAL_ 993 Lamp_StcBendingLmpRtOpnSta 0 "Normal" 1 "Open Status" 2 "Not Used" 3 "Error Indicator" ;
VAL_ 993 Lamp_FrTurnSigLmpLftPCLSta 0 "Normal" 1 "PCL Status" 2 "Not Used" 3 "Error Indicator" ;
VAL_ 993 Lamp_FrTurnSigLmpRtPCLSta 0 "Normal" 1 "PCL Status" 2 "Not Used" 3 "Error Indicator" ;
VAL_ 993 Lamp_RrTurnSigLmpLftPCLSta 0 "Normal" 1 "PCL Status" 2 "Not Used" 3 "Error Indicator" ;
VAL_ 993 Lamp_RrTurnSigLmpRtPCLSta 0 "Normal" 1 "PCL Status" 2 "Not Used" 3 "Error Indicator" ;
VAL_ 993 HzrdSwPushSta 0 "Off" 1 "On" 2 "Not Used" 3 "Error Indicator" ;
VAL_ 993 Lamp_LftTrnFaultSta 0 "Off" 1 "On" 2 "Not Used" 3 "Error Indicator" ;
VAL_ 993 Lamp_RtTrnFaultSta 0 "Off" 1 "On" 2 "Not Used" 3 "Error Indicator" ;
VAL_ 993 FrtTurnLampOptSta 0 "Not Applied" 1 "Bulb" 2 "LED" 3 "RESERVED" ;
VAL_ 993 RrTurnLampOptSta 0 "Not Applied" 1 "Bulb" 2 "LED" 3 "2Bulb" ;
VAL_ 993 VAPI_TurnSigLampEnable_Get 0 "Default" 1 "Enable" 2 "Disable" 3 "Error Indicator" ;
VAL_ 993 PDC_RearFogLmpOpt 0 "Not Applied" 1 "Applied" 2 "RESERVED" 3 "RESERVED" ;
VAL_ 993 PDC_FrontFogLmpOpt 0 "Not Applied" 1 "Applied" 2 "RESERVED" 3 "RESERVED" ;
VAL_ 993 PDC_TrunkTgateWarnLampMode 0 "Off" 1 "Normal Mode" 2 "Emergency Mode" 3 "RESERVED" ;
VAL_ 993 PDC_FD_AlvCnt2Val 0 "0x0~0xFF:AlvCntValue" 255 "0x0~0xFF:AlvCntValue" ;
VAL_ 993 IntLamp_InlTailLmpSta 0 "Off" 1 "On" 2 "Not Used" 3 "Error Indicator" ;
VAL_ 993 Lamp_FootLampOnReq 0 "Off" 1 "On" 2 "Dim Out" 3 "Error Indicator" ;
VAL_ 993 Lamp_MoodLampOnReq 0 "0%" 1 "FadeIn" 2 "MoodBrightPercent" 3 "FadeOut" 4 "100%" 5 "RESERVED" 6 "RESERVED" 7 "RESERVED" ;
VAL_ 993 USM_FuncForMdLmpBrgtSta 0 "Default Value" 1 "Off" 2 "step 1" 3 "step 2" 4 "step 3" 5 "step 4" 6 "RESERVED" 7 "Invalid" ;
VAL_ 993 Lamp_HdLmpLoLftOpnSta 0 "Normal" 1 "Open Status" 2 "Not Used" 3 "Error Indicator" ;
VAL_ 993 Lamp_HdLmpLoRtOpnSta 0 "Normal" 1 "Open Status" 2 "Not Used" 3 "Error Indicator" ;
VAL_ 993 Lamp_HdLmpBiFuncLftOpnSta 0 "Normal" 1 "Open Status" 2 "Not Used" 3 "Error Indicator" ;
VAL_ 993 Lamp_HdLmpBiFuncRtOpnSta 0 "Normal" 1 "Open Status" 2 "Not Used" 3 "Error Indicator" ;
VAL_ 993 Lamp_HdLmpHiLftOpnSta 0 "Normal" 1 "Open Status" 2 "Not Used" 3 "Error Indicator" ;
VAL_ 993 Lamp_HdLmpHiRtOpnSta 0 "Normal" 1 "Open Status" 2 "Not Used" 3 "Error Indicator" ;
VAL_ 993 ExtLamp_HzrdSwSta 0 "Off" 1 "On" 2 "Not Used" 3 "Error Indicator" ;
VAL_ 993 Lamp_FrTrnSigLmpLftOpnSta 0 "Normal" 1 "Open Status" 2 "Not Used" 3 "Error Indicator" ;
VAL_ 993 Lamp_FrTrnSigLmpRtOpnSta 0 "Normal" 1 "Open Status" 2 "Not Used" 3 "Error Indicator" ;
VAL_ 993 Lamp_RrTrnSigLmpLftOpnSta 0 "Normal" 1 "Open Status" 2 "Not Used" 3 "Error Indicator" ;
VAL_ 993 Lamp_RrTrnSigLmpRtOpnSta 0 "Normal" 1 "Open Status" 2 "Not Used" 3 "Error Indicator" ;
VAL_ 993 Brake_SwSta_ICU 0 "Off" 1 "On" 2 "RESERVED" 3 "RESERVED" ;
VAL_ 993 BrkLmpCmd 0 "Inactive" 1 "Blink Off" 2 "Blink On" 3 "Steady On" ;
VAL_ 992 PDC_FD_Crc1Val 0 "0x0~0xFFFF:CRCValue" 65535 "0x0~0xFFFF:CRCValue" ;
VAL_ 992 C_3rdRCSeatBeltSW 0 "Unbelted" 1 "Belted" ;
VAL_ 992 C_3rdRRSeatBeltSW 0 "Unbelted" 1 "Belted" ;
VAL_ 992 C_1stCTRSeatBeltSW 0 "Unbelted" 1 "Belted" ;
VAL_ 992 Warn_DrvStOccSta 0 "UnSeated" 1 "Seated" 2 "RESERVED" 3 "RESERVED" 4 "RESERVED" 5 "Fault 1 (Cable Cut-off)" 6 "Fault 2 (Cable Short)" 7 "Error Indicator" ;
VAL_ 992 Warn_PassStOccSta 0 "Off (UnSeated)" 1 "On (Seated)" 2 "Not Used" 3 "Error Indicator" ;
VAL_ 992 Warn_RrLftSBRMATSwSta 0 "Off (UnSeated)" 1 "On (Seated)" 2 "RESERVED" 3 "Error Indicator" ;
VAL_ 992 Warn_RrRhtSBRMATSwSta 0 "Off (UnSeated)" 1 "On (Seated)" 2 "RESERVED" 3 "Error Indicator" ;
VAL_ 992 C_3rdRLSBRMatSw 0 "Off (UnSeated)" 1 "On (Seated)" ;
VAL_ 992 C_3rdRRSBRMatSw 0 "Off (UnSeated)" 1 "On (Seated)" ;
VAL_ 992 C_1stCTRSBRMatSw 0 "Off (UnSeated)" 1 "On (Seated)" ;
VAL_ 992 StrWhlWrmrSwState 0 "Off" 1 "On" 2 "Not Used" 3 "Error Indicator" ;
VAL_ 992 StrWhlWrmrFlModDetail 0 "Off" 1 "OverVoltage" 2 "UnderVoltage" 3 "OverCurrent" 4 "CircuitOpen" 5 "OverLimitTemperature" 6 "LowLimitTemperature" 7 "Reserved" ;
VAL_ 992 FrHtdGlsSwState 0 "Off" 1 "On" 2 "Not Used" 3 "Error Indicator" ;
VAL_ 992 RrGlsHtSwState 0 "Off" 1 "On" 2 "Not Used" 3 "Error Indicator" ;
VAL_ 992 RLChldLkLatchSwState 0 "Unlock" 1 "Lock" 2 "Not Used" 3 "Error Indicator" ;
VAL_ 992 RRChldLkLatchSwState 0 "Unlock" 1 "Lock" 2 "Not Used" 3 "Error Indicator" ;
VAL_ 992 ChildLock_ActnFlSta 0 "OK" 1 "Failed" 2 "Not Used" 3 "Error Indicator" ;
VAL_ 992 DoorLock_LkOutSta 0 "Off" 1 "On" 2 "Not Used" 3 "Error Indicator" ;
VAL_ 992 VSAutoDrLkRetryFailSta 0 "Normal" 1 "Fail" 2 "RESERVED" 3 "RESERVED" ;
VAL_ 992 Trunk_TrnkTlgtOutReleaseSwSta 0 "Off" 1 "On" 2 "Stuck" 3 "Error Indicator" ;
VAL_ 992 Trunk_TrnkInReleaseSwSta 0 "Off" 1 "On" 2 "Stuck" 3 "Error Indicator" ;
VAL_ 992 Trunk_GlvBxTrnkLkSwSta 0 "Off" 1 "On" 2 "Not Used" 3 "Error Indicator" ;
VAL_ 992 Trunk_TrnkTlgtSwSta 0 "Close(Full Lock)" 1 "Open(Not Full Lock)" 2 "Not Used" 3 "Error Indicator" ;
VAL_ 992 Trunk_TlgtFullOpnSwSta 0 "Close(Not Full Open)" 1 "Open(Full Open)" 2 "Not Used" 3 "Error Indicator" ;
VAL_ 992 Trunk_TrnkTlgtReleaseRlySta 0 "OFF" 1 "ON" 2 "Not Used" 3 "Error Indicator" ;
VAL_ 992 FrtWiper_ParkingSwState 0 "Off" 1 "On" 2 "RESERVED" 3 "RESERVED" ;
VAL_ 992 PDC_TlgtUnLkSta 0 "Lock" 1 "Unlock" 2 "Not Used" 3 "Error Indicator" ;
VAL_ 992 PDC_PSDPwrModeOffSwSta 0 "Off" 1 "On" 2 "Not Used" 3 "Error Indicator" ;
VAL_ 992 PDC_FuelDrOpenSta 0 "Close" 1 "Open" 2 "Not Used" 3 "RESERVED" ;
VAL_ 992 PDC_FD_AlvCnt1Val 0 "0x0~0xFF:AlvCntValue" 255 "0x0~0xFF:AlvCntValue" ;
VAL_ 992 OBCWakeupDrLock 0 "Default" 1 "Off" 2 "On(DrLock)" 3 "Error Indicator" ;
VAL_ 992 OBCWakeupDrUnlock 0 "Default" 1 "Off" 2 "On(Unlock)" 3 "Error Indicator" ;
VAL_ 992 Trunk_BgtOpnHzrdReq 0 "Off" 1 "On" 2 "Not Used" 3 "Error Indicator" ;
VAL_ 992 Trunk_BgtOpnBzrReq 0 "Off" 1 "On" 2 "Not Used" 3 "Error Indicator" ;
VAL_ 992 IGN3State 0 "Off" 1 "On" 2 "RESERVED" 3 "RESERVED" ;
VAL_ 992 IGN3State_By_BMS 0 "Off" 1 "On" 2 "On By Heating" 3 "On By Cooling" ;
VAL_ 992 IGN3State_By_VCMS_HMU 0 "Off" 1 "On" 2 "RESERVED" 3 "RESERVED" ;
VAL_ 992 IGN3State_By_AfterBlow 0 "Off" 1 "On" 2 "RESERVED" 3 "RESERVED" ;
VAL_ 992 IGN3State_By_Bat 0 "Off" 1 "On" 2 "RESERVED" 3 "RESERVED" ;
VAL_ 992 IGN3State_By_VCU_HCU_FCU 0 "Off" 1 "On" 2 "RESERVED" 3 "RESERVED" ;
VAL_ 992 IGN3State_By_HU 0 "Off" 1 "On" 2 "RESERVED" 3 "RESERVED" ;
VAL_ 992 IGN3CutOffState 0 "CutOffNotApplied" 1 "NoRequest" 2 "Normal" 3 "PreWarn" 4 "CutOff" 5 "RESERVED" 6 "RESERVED" 7 "RESERVED" ;
VAL_ 992 IGN3State_By_ActiveOn 0 "Off(Default)" 1 "On" 2 "RESERVED" 3 "RESERVED" ;
VAL_ 992 SeatBeltSwSta_Drv 0 "Unbelted" 1 "Belted" 2 "Not Supported" 3 "Virgin Mode" ;
VAL_ 992 SeatBeltSwSta_1stCtr 0 "Unbelted" 1 "Belted" 2 "Not Supported" 3 "Virgin Mode" ;
VAL_ 992 SeatBeltSwSta_Asst 0 "Unbelted" 1 "Belted" 2 "Not Supported" 3 "Virgin Mode" ;
VAL_ 992 SeatBeltSwSta_2ndLft 0 "Unbelted" 1 "Belted" 2 "Not Supported" 3 "Virgin Mode" ;
VAL_ 992 SeatBeltSwSta_2ndCtr 0 "Unbelted" 1 "Belted" 2 "Not Supported" 3 "Virgin Mode" ;
VAL_ 992 SeatBeltSwSta_2ndRt 0 "Unbelted" 1 "Belted" 2 "Not Supported" 3 "Virgin Mode" ;
VAL_ 992 SeatBeltSwSta_3rdLft 0 "Unbelted" 1 "Belted" 2 "Not Supported" 3 "Virgin Mode" ;
VAL_ 992 SeatBeltSwSta_3rdCtr 0 "Unbelted" 1 "Belted" 2 "Not Supported" 3 "Virgin Mode" ;
VAL_ 992 SeatBeltSwSta_3rdRt 0 "Unbelted" 1 "Belted" 2 "Not Supported" 3 "Virgin Mode" ;
VAL_ 992 SeatBelt4th_InstallInfo 0 "Virgin Mode" 1 "No Seat" 2 "All Seat" 3 "Left and Right" 4 "RESERVED" 5 "RESERVED" 6 "RESERVED" 7 "RESERVED" ;
VAL_ 992 PDCex_CurtainOpt 0 "No Curtain" 1 "Rear Curtain" 2 "Quarter Glass Curtain" 3 "All Curtain" ;
VAL_ 992 Reprogram_State_PDC2 0 "normal operation" 1 "reprogramming" 2 "RESERVED" 3 "Invalid (default)" ;
VAL_ 992 PDC_DataLog_GetCanLog 0 "Idle" 1 "Trigger1" 2 "Trigger2" 3 "Trigger3" 4 "RESERVED" 5 "RESERVED" 6 "RESERVED" 7 "Invalid" ;
VAL_ 992 Warn_RrCTRSBRMATSwSta 0 "Off (Unseated)" 1 "On (Seated)" 2 "Not Used" 3 "Error Indicator" ;
VAL_ 992 C_3rdRCSBRMatSw 0 "Off (UnSeated)" 1 "On (Seated)" ;
VAL_ 992 DriveTypeOption 0 "Left Handle Drive Type" 1 "Right Handle Drive Type" 2 "RESERVED" 3 "Error Indicator" ;
VAL_ 992 AutoLtOpt 0 "Not Applied" 1 "Applied" 2 "Reserved" 3 "Reserved" ;
VAL_ 992 HLmpLoHiOptLtSrcTyp 0 "Not Applied" 1 "2 Light MFR Bulb" 2 "4 Light Bulb" 3 "4 Light Led Ldm" 4 "Bi-Function Bulb" 5 "Bi-Function Led Ldm" 6 "Reserved" 7 "Reserved" ;
VAL_ 992 C_StrgWhlHeatingOpt 0 "Not Applied" 1 "Applied(steering wheel applied)" 2 "RESERVED" 3 "Invalid" ;
VAL_ 992 C_StrgWhlHeatingSWInf 0 "Default" 1 "1step opt(On/Off)" 2 "2step opt(step1,step2,Off)" 3 "Invalid" ;
VAL_ 992 ICU_MtGearPosRSta 0 "Off" 1 "On" 2 "RESERVED" 3 "RESERVED" ;
VAL_ 992 C_AutoLeverManualSW 0 "Not Manual" 1 "Manual" 2 "Manual +" 3 "Manual -" ;
VAL_ 992 Warn_HoodSwMemorySta 0 "No event" 1 "hood_open_close" 2 "RESERVED" 3 "RESERVED" ;
VAL_ 992 Warn_PrkngBrkSwSta 0 "Off" 1 "On" 2 "Not Used" 3 "Error Indicator" ;
VAL_ 992 PrkngBrkNotchSwState 0 "Off" 1 "On" 2 "Reserved" 3 "InvalidState" ;
VAL_ 992 Warn_BrkFldSwSta 0 "Off" 1 "On" 2 "Not Used" 3 "Error Indicator" ;
VAL_ 992 Warn_WshrFldSwSta 0 "Off" 1 "On" 2 "RESERVED" 3 "RESERVED" ;
VAL_ 992 Warn_DrvStBltSwSta 0 "Unbelted" 1 "Belted" 2 "Not Used" 3 "Error Indicator" ;
VAL_ 992 Warn_AsstStBltSwSta 0 "Unbelted" 1 "Belted" 2 "Not Used" 3 "Error Indicator" ;
VAL_ 992 Warn_RrLftStBltSwSta 0 "Unbelted" 1 "Belted" 2 "Not Used" 3 "Error Indicator" ;
VAL_ 992 Warn_RrCtrStBltSwSta 0 "Unbelted" 1 "Belted" 2 "Not Used" 3 "Error Indicator" ;
VAL_ 992 Warn_RrRtStBltSwSta 0 "Unbelted" 1 "Belted" 2 "Not Used" 3 "Error Indicator" ;
VAL_ 992 C_3rdRLSeatBeltSW 0 "Unbelted" 1 "Belted" ;
VAL_ 995 PDC_FD_Crc4Val 0 "0x0~0xFFFF:CRCValue" 65535 "0x0~0xFFFF:CRCValue" ;
VAL_ 995 PDC_FD_AlvCnt4Val 0 "0x0~0xFF:AlvCntValue" 255 "0x0~0xFF:AlvCntValue" ;
VAL_ 995 ICU_Haptic_OPT 0 "Default" 1 "No option(None Haptic Option)" 2 "Option" 3 "Invalid" ;
VAL_ 995 HSWS_SysWrngSta_ICU 0 "Normal" 1 "System Fail" 2 "RESERVED" 3 "Invalid" ;
VAL_ 995 ICU_PwrWdwMvInhbtSta 0 "Off" 1 "Inhabit" ;
VAL_ 995 Warn_OSMirrFoldSwState 0 "OFF(Seasaw Type=Fold, Return Type=Off)" 1 "ON(Seasaw Type=Unfold or Auto, Return Type" 2 "Not Used" 3 "Error Indicator" ;
VAL_ 995 USM_OneTouchTrnSigFuncSta 0 "Default" 1 "One Touch Turn Off" 2 "3 Flashing" 3 "5 Flashing" 4 "7 Flashing" 5 "Invalid" 6 "RESERVED" 7 "RESERVED" ;
VAL_ 995 ExtLamp_TrnSigLmpLftSwSta 0 "Off" 1 "On" 2 "Not Used" 3 "Error Indicator" ;
VAL_ 995 ExtLamp_TrnSigLmpRtSwSta 0 "Off" 1 "On" 2 "Not Used" 3 "Error Indicator" ;
VAL_ 995 Lamp_LaneChgTrnSigLftSwSta_ICU 0 "Off" 1 "On" 2 "Not Used" 3 "Error Indicator" ;
VAL_ 995 Lamp_LaneChgTrnSigRtSwSta_ICU 0 "Off" 1 "On" 2 "Not Used" 3 "Error Indicator" ;
VAL_ 995 Lamp_TrnSigLmpLftOnReq 0 "Inactive" 1 "Active Off(Flasher Off)" 2 "Active On(Flasher On)" 3 "RESERVED" ;
VAL_ 995 Lamp_TrnSigLmpRtOnReq 0 "Inactive" 1 "Active Off(Flasher Off)" 2 "Active On(Flasher On)" 3 "RESERVED" ;
VAL_ 995 Lamp_TrnSigLmpLftActiveSt 0 "Off (Inactive)" 1 "On (Active)" 2 "RESERVED" 3 "Invalid" ;
VAL_ 995 Lamp_TrnSigLmpRtActiveSt 0 "Off (Inactive)" 1 "On (Active)" 2 "RESERVED" 3 "Invalid" ;
VAL_ 995 TrnLmpSeqEnblCmd 0 "Off" 1 "On" 2 "Reserved" 3 "Reserved" ;
VAL_ 995 CrashHazardLampOnReq 0 "No Request" 1 "Lamp On Request" 2 "RESERVED" 3 "Error Indicator" ;
VAL_ 994 PDC_FD_Crc3Val 0 "0x0~0xFFFF:CRCValue" 65535 "0x0~0xFFFF:CRCValue" ;
VAL_ 994 DoorLock_SoftKeySysFailSta 2 "RESERVED" 3 "RESERVED" 4 "RESERVED" 5 "RESERVED" 6 "RESERVED" 7 "RESERVED" 8 "RESERVED" 9 "RESERVED" 10 "RESERVED" 11 "RESERVED" 12 "RESERVED" 13 "RESERVED" 14 "RESERVED" 15 "RESERVED" 0 "Normal" 1 "SystemFail(LockRetryFail)" ;
VAL_ 994 PDC_FD_AlvCnt3Val 0 "0x0~0xFF:AlvCntValue" 255 "0x0~0xFF:AlvCntValue" ;
VAL_ 994 Warn_DrvDrSwSta 0 "Close" 1 "Open" 2 "Not Used" 3 "Error Indicator" ;
VAL_ 994 Warn_AsstDrSwSta 0 "Close" 1 "Open" 2 "Not Used" 3 "Error Indicator" ;
VAL_ 994 Warn_RrLftDrSwSta 0 "Close" 1 "Open" 2 "Not Used" 3 "Error Indicator" ;
VAL_ 994 Warn_RrRtDrSwSta 0 "Close" 1 "Open" 2 "Not Used" 3 "Error Indicator" ;
VAL_ 994 Warn_HoodSwSta 0 "Off" 1 "On" 2 "Not Used" 3 "Error Indicator" ;
VAL_ 994 DoorLock_DrvDrUnLkSta 0 "Lock" 1 "Unlock" 2 "Not Used" 3 "Error Indicator" ;
VAL_ 994 DoorLock_AsstDrUnLkSta 0 "Lock" 1 "Unlock" 2 "Not Used" 3 "Error Indicator" ;
VAL_ 994 DoorLock_RrLftDrUnLkSta 0 "Lock" 1 "Unlock" 2 "Not Used" 3 "Error Indicator" ;
VAL_ 994 DoorLock_RrRtDrUnLkSta 0 "Lock" 1 "Unlock" 2 "Not Used" 3 "Error Indicator" ;
VAL_ 994 DoorLock_DrvKeyLkSwSta 0 "Off" 1 "Lock" 2 "Not Used" 3 "Error Indicator" ;
VAL_ 994 DoorLock_DrvKeyUnLkSwSta 0 "Off" 1 "Unlock" 2 "Not Used" 3 "Error Indicator" ;
VAL_ 994 DoorLock_CtrlDrLkSwSta_ICU 0 "Off" 1 "On(Lock On)" 2 "Not Used" 3 "Error Indicator" ;
VAL_ 994 DoorLock_CtrlDrUnLkSwSta_ICU 0 "Off" 1 "On(Unlock On)" 2 "Not Used" 3 "Error Indicator" ;
VAL_ 994 DoorLock_CtrlDrLkUnLkSwSta_ICU 0 "Off" 1 "On" 2 "Not Used" 3 "Error Indicator" ;
VAL_ 994 C_CrashUnlockState 0 "Off" 1 "Unlock(Crash)" 2 "RESERVED" 3 "RESERVED" ;
VAL_ 994 Lamp_LedHdLmpSta 0 "LED Headlamp is in nornal condition" 1 "RESERVED" 2 "LED Fail" 3 "RESERVED" ;
VAL_ 994 Warn_ChaDrSwFrtSta 0 "Default" 1 "Close" 2 "Open" 3 "Error Indicator" ;
VAL_ 994 Warn_ChaDrSwRrSta 0 "Default" 1 "Close" 2 "Open" 3 "Error Indicator" ;
VAL_ 997 PDC_FD_Crc11Val 0 "0x0~0xFFFF:CRCValue" 65535 "0x0~0xFFFF:CRCValue" ;
VAL_ 997 ICU_BS1ValFlagSta 0 "Valid condition" 1 "Invalid condition" 2 "RESERVED" 3 "RESERVED" ;
VAL_ 997 ICU_BS1ErrRes 0 "opeartion correctly" 1 "response error" 2 "RESERVED" 3 "Error Indicator" ;
VAL_ 997 ICU_BS2SoC 0 "0x00~0x64:0% ~ 100 %" 100 "0x00~0x64:0% ~ 100 %" 101 "65~0xFE:Invalid" 254 "65~0xFE:Invalid" 255 "Error" ;
VAL_ 997 ICU_BS2NCap 0 "0x00~0xFA:0Ah ~ 250Ah" 250 "0x00~0xFA:0Ah ~ 250Ah" 251 "Invalid" 252 "Invalid" 253 "Invalid" 254 "Invalid" 255 "Error" ;
VAL_ 997 ICU_BS2OpnCirVol 0 "0x000~0xFA0:10.000V ~ 14.000V" 4000 "0x000~0xFA0:10.000V ~ 14.000V" 4001 "Invailid" 4002 "Invailid" 4003 "Invailid" 4004 "Invailid" 4005 "Invailid" 4006 "Invailid" 4007 "Invailid" 4008 "Invailid" 4009 "Invailid" 4010 "Invailid" 4011 "Invailid" 4012 "Invailid" 4013 "Invailid" 4014 "Invailid" 4015 "Invailid" 4016 "Invailid" 4017 "Invailid" 4018 "Invailid" 4019 "Invailid" 4020 "Invailid" 4021 "Invailid" 4022 "Invailid" 4023 "Invailid" 4024 "Invailid" 4025 "Invailid" 4026 "Invailid" 4027 "Invailid" 4028 "Invailid" 4029 "Invailid" 4030 "Invailid" 4031 "Invailid" 4032 "Invailid" 4033 "Invailid" 4034 "Invailid" 4035 "Invailid" 4036 "Invailid" 4037 "Invailid" 4038 "Invailid" 4039 "Invailid" 4040 "Invailid" 4041 "Invailid" 4042 "Invailid" 4043 "Invailid" 4044 "Invailid" 4045 "Invailid" 4046 "Invailid" 4047 "Invailid" 4048 "Invailid" 4049 "Invailid" 4050 "Invailid" 4051 "Invailid" 4052 "Invailid" 4053 "Invailid" 4054 "Invailid" 4055 "Invailid" 4056 "Invailid" 4057 "Invailid" 4058 "Invailid" 4059 "Invailid" 4060 "Invailid" 4061 "Invailid" 4062 "Invailid" 4063 "Invailid" 4064 "Invailid" 4065 "Invailid" 4066 "Invailid" 4067 "Invailid" 4068 "Invailid" 4069 "Invailid" 4070 "Invailid" 4071 "Invailid" 4072 "Invailid" 4073 "Invailid" 4074 "Invailid" 4075 "Invailid" 4076 "Invailid" 4077 "Invailid" 4078 "Invailid" 4079 "Invailid" 4080 "Invailid" 4081 "Invailid" 4082 "Invailid" 4083 "Invailid" 4084 "Invailid" 4085 "Invailid" 4086 "Invailid" 4087 "Invailid" 4088 "Invailid" 4089 "Invailid" 4090 "Invailid" 4091 "Invailid" 4092 "Invailid" 4093 "Invailid" 4094 "Invailid" 4095 "Error" ;
VAL_ 997 ICU_BS2_FSOC 0 "valid" 1 "invalid" ;
VAL_ 997 ICU_BS2_FSOH 0 "valid" 1 "invalid" ;
VAL_ 997 ICU_BS2_FSOF 0 "valid" 1 "invalid" ;
VAL_ 997 ICU_BS2_FQSTAT 0 "valid" 1 "invalid" ;
VAL_ 997 ICU_BS2SoH 0 "0x00~0x64:0% ~ 100 %" 100 "0x00~0x64:0% ~ 100 %" 101 "65~0xFE:Invalid" 254 "65~0xFE:Invalid" 255 "Error" ;
VAL_ 997 ICU_BS2SoF 0 "0x00~0xF0:0.00V ~ 12.00V" 240 "0x00~0xF0:0.00V ~ 12.00V" 241 "Invalid" 242 "Invalid" 243 "Invalid" 244 "Invalid" 245 "Invalid" 246 "Invalid" 247 "Invalid" 248 "Invalid" 249 "Invalid" 250 "Invalid" 251 "Invalid" 252 "Invalid" 253 "Invalid" 254 "Invalid" 255 "Error" ;
VAL_ 997 PDC_EasyPwrOffSpprt 0 "Not applied" 1 "Applied" ;
VAL_ 997 PDC_FD_AlvCnt11Val 0 "0x0~0xFF:AlvCntValue" 255 "0x0~0xFF:AlvCntValue" ;
VAL_ 997 ICU_BS1BatVol_Dis 0 "0x0000~0x2EE0:6.000V ~ 18.000V" 12000 "0x0000~0x2EE0:6.000V ~ 18.000V" 12001 "2EE1~0x3FFE:Invalid" 16382 "2EE1~0x3FFE:Invalid" 16383 "Error" ;
VAL_ 997 ICU_BS1IBAT_Conversion 0 "0x00000~0x3A980:-1,200,000mA ~ 1,200,000mA" 240000 "0x00000~0x3A980:-1,200,000mA ~ 1,200,000mA" 240001 "3A981~0x3FFFE:Invalid" 262142 "3A981~0x3FFFE:Invalid" 262143 "Error" ;
VAL_ 997 ICU_BS1BatVol 0 "0x0000~0x2EE0:6.000V ~ 18.000V" 12000 "0x0000~0x2EE0:6.000V ~ 18.000V" 12001 "2EE1~0x3FFE:Invalid" 16382 "2EE1~0x3FFE:Invalid" 16383 "Error" ;
VAL_ 997 ICU_BS1BatTemp 0 "0x000~0x14A:-40℃ ~ 125℃" 330 "0x000~0x14A:-40℃ ~ 125℃" 331 "14B~0x1FE:Invalid" 510 "14B~0x1FE:Invalid" 511 "Error" ;
VAL_ 996 PDC_FD_Crc10Val 0 "0x0~0xFFFF:CRCValue" 65535 "0x0~0xFFFF:CRCValue" ;
VAL_ 996 PDC_PwrOnModePowerReq 0 "Default" 1 "Request On" 2 "RESERVED" 3 "Error" ;
VAL_ 996 PDC_LeadAcidBatType 0 "Not Applied" 1 "CMF 35Ah" 2 "CMF 40Ah" 3 "CMF 45Ah" 4 "CMF 50Ah" 5 "CMF 60Ah" 6 "CMF 68Ah" 7 "CMF 70Ah" 8 "CMF 80Ah" 9 "CMF 90Ah" 10 "CMF 110Ah" 11 "MF 40Ah" 12 "MF 45Ah" 13 "MF 60Ah" 14 "MF 68Ah" 15 "MF 80Ah" 16 "MF 90Ah" 17 "MF 110Ah" 18 "AGM 60Ah" 19 "AGM 70Ah" 20 "AGM 80Ah" 21 "AGM 50Ah" 22 "AGM 105Ah" 23 "AGM 90Ah" 24 "EFB 50Ah" 25 "EFB 60Ah" 26 "EFB 70Ah" 27 "RESERVED" 28 "RESERVED" 29 "RESERVED" 30 "RESERVED" 31 "RESERVED" ;
VAL_ 996 PDC_BatPwrClassOpt 0 "Invalid" 1 "SOC type" 2 "Class type" 3 "RESERVED" ;
VAL_ 996 PDC_MainLBMOpt 0 "Not Applied" 1 "Applied" 2 "RESERVED" 3 "Invalid" ;
VAL_ 996 PDC_FD_AlvCnt10Val 0 "0x0~0xFF:AlvCntValue" 255 "0x0~0xFF:AlvCntValue" ;
VAL_ 996 ICU_PowerAutoCutModSta 0 "Factory Mode (default)" 1 "Dealer Mode" 2 "Customer Mode" 3 "Error Indicator" ;
VAL_ 996 Autocut_DlvryModSta 0 "Before Delivery(Welcome Off)" 1 "After Delivery(Welcome On)" 2 "Not Used" 3 "Error Indicator" ;
VAL_ 996 ICU_SoCBattStaMsgReq 0 "Default" 1 "Alert" 2 "Warning" 3 "Invalid" ;
VAL_ 996 Batt_SoCWarningValue 0 "0x0~0x64:0 ~ 100%" 100 "0x0~0x64:0 ~ 100%" 101 "65~0xFE:RESERVED" 254 "65~0xFE:RESERVED" 255 "Invalid" ;
VAL_ 996 ICU_BattAutoCutPreWrng 0 "No Warning" 1 "Warning" 2 "Not Used" 3 "Invalid" ;
VAL_ 996 OTAModeACCOffReq 0 "Default" 1 "Off(ACC Off Request)" 2 "RESERVED" 3 "RESERVED" ;
VAL_ 996 C_ICUIGNOffReq 0 "Default" 1 "Off(IGN Off Request)" 2 "RESERVED" 3 "RESERVED" ;
VAL_ 996 IGN_AutoOff_WarnSta 0 "No Warning" 1 "Power Off Warning" 2 "RESERVED" 3 "Error Indicator" ;
VAL_ 996 IGN_AutoOff_WarnSta_CLU 0 "No Warning" 1 "Power Off Warning" 2 "RESERVED" 3 "Error Indicator" ;
VAL_ 996 PDC_BatPwrStateClassA 0 "Invalid" 1 "Low power condition for ClassA-load operation" 2 "High power condition for ClassA-load operation" 3 "RESERVED" ;
VAL_ 996 PDC_BatPwrStateClassB 0 "Invalid" 1 "Low power condition for ClassB-load operation" 2 "High power condition for ClassB-load operation" 3 "RESERVED" ;
VAL_ 996 PDC_BatPwrStateClassC 0 "Invalid" 1 "Low power condition for ClassC-load operation" 2 "High power condition for ClassC-load operation" 3 "RESERVED" ;
VAL_ 996 PLBMAvailableState 0 "Invaild" 1 "PLBM Power is available" ;
VAL_ 996 Bat_dischrg 0 "Flag OFF" 1 "Flag ON" 2 "RESERVED" 3 "RESERVED" ;
VAL_ 996 Bat12V_Chr_Req 0 "Off (Default)" 1 "On_IBS" 2 "On_OTA" 3 "On_Load" ;
VAL_ 996 ICU_BattMngAlert 0 "No Warning(Default)" 1 "Hazard On" 2 "Tail On" 3 "Hazard/Tail On" 4 "4~0xFE:RESERVED" 254 "4~0xFE:RESERVED" 255 "Invalid" ;
VAL_ 1047 GNSS_Crc5Val 0 "0x0~0xFFFF:CRCValue" 65535 "0x0~0xFFFF:CRCValue" ;
VAL_ 1047 GNSS_AlvCnt5Val 0 "0x0~0xFF:AlvCntValue" 255 "0x0~0xFF:AlvCntValue" ;
VAL_ 1047 HU_GNSS_Fix_status 0 "Doing position fixes" 2 "need time" 3 "PDOP too high" 5 "No usable SVs" 6 "one usable SV" 7 "two usable SVs" 8 "three usable SVs" ;
VAL_ 1047 HU_GNSS_TimeSource 0 "none" 1 "RTC" 2 "GPS(<10ms)" 3 "GPS(<1ms)" ;
VAL_ 1047 HU_GNSS_search 0 "none" 1 "blind" 2 "anywhere" ;
VAL_ 1047 HU_GNSS_DST 0 "DST OFF" 1 "DST ON" 2 "RESERVED" 3 "Invalid" ;
VAL_ 849 IAU_FD_Crc4Val 0 "0x0~0xFFFF:CRCValue" 65535 "0x0~0xFFFF:CRCValue" ;
VAL_ 849 IAU_DISPWrng 0 "None" 1 "Auth_Fail2 (DigitalKey)" 2 "ReAuth_Warning" 3 "IAU Error" 4 "DigitalKey Saved" 5 "Auth_Fail2 (FP)" 6 "Auth_Fail2 (DigitalKey or FP)" 7 "BiometricKey Saved" 8 "DigitalKey and BiometricKey Saved" 9 "WPCNFC_PreStartAuth_Success" 10 "Reserved" 11 "Reserved" 12 "Reserved" 13 "Reserved" 14 "ReAuth_forRSPA" 15 "Invalid" ;
VAL_ 849 IAU_DigitalKey2Opt 0 "Default (Not applied)" 1 "Digital Key Light (NFC)" 2 "Digital Key Medium (NFC/BLE)" 3 "Digital Key Full (NFC/BLE/UWB)" 4 "Reserved" 5 "Reserved" 6 "Reserved" 7 "invalid" ;
VAL_ 849 IAUwFRULearnState 0 "Default (Normal)" 1 "Learning" 2 "Neutralizing" 3 "Invalid" ;
VAL_ 849 IAUwFPMLearnState 0 "Default(Normal)" 1 "Learning" 2 "Neutralizing" 3 "Invalid" ;
VAL_ 849 IAU_ValetDigitalkey 0 "Default" 1 "Valet Digitalkey" 2 "Resereved" 3 "invalid" ;
VAL_ 849 IAU_DigitalKeyNumberOpt 0 "Max8" 1 "Max16" 2 "Max16 with Grouping" 3 "Max29 with Grouping" 4 "RESERVED" 5 "RESERVED" 6 "RESERVED" 7 "Invalid" ;
VAL_ 849 IAU_eSEReprogramSta 0 "Default" 1 "Updating" 2 "RESERVED" 3 "Invalid" ;
VAL_ 849 IAU_DKOwnerSwapOption 0 "Default" 1 "Not applied" 2 "Applied" 3 "Invalid" ;
VAL_ 849 IAU_DgtKeyGrpPrflRval2 0 "Default" 1 "Group index 0x0" 2 "Group index 0x1" 3 "Group index 0x2" 4 "Group index 0x3" 5 "Group index 0x4" 6 "Group index 0x5" 7 "Group index 0x6" 8 "Group index 0x7" 9 "Group index 0x8" 10 "Group index 0x9" 11 "Group index 0xA" 12 "Group index 0xB" 13 "Group index 0xC" 14 "Group index 0xD" 15 "Group index 0xE" 16 "Group index 0xF" 17 "Group index 0x10" 18 "Group index 0x11" 19 "Group index 0x12" 20 "Group index 0x13" 21 "Group index 0x14" 22 "Group index 0x15" 23 "Group index 0x16" 24 "Group index 0x17" 25 "Group index 0x18" 26 "Group index 0x19" 27 "Group index 0x1A" 28 "Group index 0x1B" 29 "Group index 0x1C" 30 "RESERVED" 31 "Invalid" ;
VAL_ 849 IAU_StartIdentifiedProfile 0 "Default" 1 "Profile 1" 2 "Profile 2" 3 "Reserved" 4 "Reserved" 5 "Reserved" 6 "Reserved" 7 "Invalid" ;
VAL_ 849 IAU_DigitalKeyProfileRval2 0 "Default" 1 "1st digital key (owner)" 2 "2nd digital key" 3 "3rd digital key" 4 "4th digital key" 5 "5th digital key" 6 "6th digital key" 7 "7th digital key" 8 "8th digital key" 9 "9th digital key" 10 "10th digital key" 11 "11th digital key" 12 "12th digital key" 13 "13th digital key" 14 "14th digital key" 15 "15th digital key" 16 "16th digital key" 17 "reserved" 18 "reserved" 19 "reserved" 20 "reserved" 21 "reserved" 22 "reserved" 23 "reserved" 24 "reserved" 25 "reserved" 26 "reserved" 27 "reserved" 28 "reserved" 29 "reserved" 30 "reserved" 31 "Invalid" ;
VAL_ 849 IAU_NFCCard1SN 0 "0x00000000~0xFFFFFFFF:" 2147483647 "0x00000000~0xFFFFFFFF:" ;
VAL_ 849 IAU_FD_AlvCnt4Val 0 "0x0~0xFF:AlvCntValue" 255 "0x0~0xFF:AlvCntValue" ;
VAL_ 849 IAU_DigitalKeyProcessingSta2 0 "None" 1 "Reserved_Func_1" 2 "Reserved_Func_2" 3 "Reserved_Func_3" 4 "Reserved_Func_4" 5 "Reserved_Func_5" 6 "Reserved_Func_6" 7 "Reserved_Func_7" 8 "Reserved_Func_8" 9 "Reserved_Func_9" 10 "Reserved_Func_A" 11 "Reserved_Func_B" 12 "Reserved_Func_C" 13 "Reserved_Func_D" 14 "Reserved_Func_E" 15 "Invalid" ;
VAL_ 849 IAU_DigitalKeyExit2 0 "Normal" 1 "BDC Update" 2 "Reserved_Func_2" 3 "Reserved_Func_3" 4 "Reserved_Func_4" 5 "Reserved_Func_5" 6 "Reserved_Func_6" 7 "Reserved_Func_7" 8 "Reserved_Func_8" 9 "Reserved_Func_9" 10 "Reserved_Func_A" 11 "Reserved_Func_B" 12 "Reserved_Func_C" 13 "Reserved_Func_D" 14 "Reserved_Func_E" 15 "Invalid" ;
VAL_ 849 IAU_UWBOnOffOpt 0 "Default" 1 "Not applied" 2 "Applied" 3 "Invalid" ;
VAL_ 849 IAU_UWBOnOffRVal 0 "Default" 1 "Off" 2 "On" 3 "Invalid" ;
VAL_ 849 IAU_StartIdentifiedProfile_Ext 0 "Default" 1 "Profile1" 2 "Profile2" 3 "Profile3" 4 "Profile4" 5 "Profile5" 6 "Profile6" 7 "Profile7" 8 "Profile8" 9 "Profile9" 10 "RESERVED" 11 "RESERVED" 12 "RESERVED" 13 "RESERVED" 14 "RESERVED" 15 "INVALID" ;
VAL_ 849 RSPA_UWBRspaExtRngSta 0 "Initial" 1 "Out of range of RSPA remote control Region" 2 "In the range of RSPA remote control region" 3 "Reserved" ;
VAL_ 849 RSPA_CanFltSta 0 "Default" 1 "RSPA CAN Error" 2 "Not Used" 3 "Error Indicator" ;
VAL_ 849 RSPA_BLESigErrSta 0 "Default" 1 "Signal Invalid" 2 "In Progress" 3 "Error Indicator" ;
VAL_ 849 RSPA_ConStat 0 "Normal Status" 1 "Fail Status" 2 "Reserved" 3 "Reserved" ;
VAL_ 849 IAU_NewEVTerminalPhase2Opt 0 "Not Applied" 1 "Applied" ;
VAL_ 849 IAU_ProfileIDRVal 0 "Default" 1 "Guest" 2 "Profile1" 3 "Profile2" 4 "Profile3" 5 "Profile4" 6 "Profile5" 7 "Profile6" 8 "Profile7" 9 "Profile8" 10 "Profile9" 11 "RESERVED" 12 "RESERVED" 13 "RESERVED" 14 "RESERVED" 15 "INVALID" ;
VAL_ 849 IAU_DigitalKeyProcessingSta 13 "Send Link" 14 "RESERVED" 15 "Invalid" 0 "None" 1 "DeviceOnWPC" 2 "DeviceRegistering" 3 "PhoneRegistered" 4 "All Phone Key Deleted" 5 "NFCCard1Registered" 6 "Server Registering" 7 "NFCCard1Deleted" 8 "BLE Searching" 9 "Owner Phone key Deleted" 10 "Valet Off Searching" 11 "Server Registering Fail" 12 "All Digital Keys in group Deleted" ;
VAL_ 849 IAU_DigitalKeyExit 0 "Normal" 1 "Check System" 2 "NFC Not Detected" 3 "Fob Not Detected" 4 "Canceled by User (Timeout)" 5 "Device not Available" 6 "ProcessFail" 7 "Check Card Save" 8 "Certificate Update" 9 "Valet Off Fail" 10 "CardNotAvailable" 11 "DigitalKeyDisabled" 12 "Retry After Parking" 13 "Check Password" 14 "P position fail (not P)" 15 "Invalid" ;
VAL_ 849 IAU_DigitalKeyEnblRVal 0 "Default" 1 "Disable" 2 "Enable" 3 "Invalid" ;
VAL_ 849 IAU_OwnerPhnRegRVal 0 "Default" 1 "Disable" 2 "Enable" 3 "Invalid" ;
VAL_ 849 IAU_NFCCard1RegRVal 0 "Default" 1 "Disable" 2 "Enable" 3 "Invalid" ;
VAL_ 849 IAU_NFCCard2RegRVal 0 "Default" 1 "Disable" 2 "Enable" 3 "Invalid" ;
