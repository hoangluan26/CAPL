VERSION ""

NS_ :

BS_:

BU_: SHVU_CCS_FD ARS_FD WPC_FD WPC2_FD SCM_FD SHVU_FRNT_FD FLLR_FD vDummy_FD_B2 GW_SAU_DRV_FD ATS_FD PSB_FD GW_PSU_RR_FD SHVU_RL_FD RWPC_FD CGW_CCU OHCL_FD SHVU_REAR_FD BLTN_CAM_FD GW_PSU_DRV_FD FCS_FD GW_PSU_AST_FD GW_PSU_3RD_FD RCS_FD GW_PSU_RL_FD SHVU_3RD_FD SHVU_RR_FD RCM_FD DCM_FD SGU_FD vFD_B2

BO_ 101 IEB_01_10ms: 32 CGW_CCU
 SG_ IEB_Crc1Val : 0|16@1+ (1,0) [0|0] "" Vector__XXX
 SG_ IEB_StrkDpthPcVal : 104|8@1+ (0.39215,0) [0|0] "%"  BLTN_CAM_FD
 SG_ IEB_EstDpthPcVal : 112|8@1+ (0.390625,0) [0|0] "%" Vector__XXX
 SG_ IEB_AbsNGearReq : 120|2@1+ (1,0) [0|0] "" Vector__XXX
 SG_ IEB_EstBrkPdlValVldSta : 122|2@1+ (1,0) [0|0] "" Vector__XXX
 SG_ IEB_FRAmode_Req : 124|2@1+ (1,0) [0|0] "" Vector__XXX
 SG_ IEB_RegenTqLimitNmVal_Rear : 128|16@1+ (1,0) [0|0] "Nm" Vector__XXX
 SG_ IEB_DrvWhlSlipFlg_Frnt : 144|1@1+ (1,0) [0|0] "" Vector__XXX
 SG_ IEB_IndDriftMode : 145|3@1+ (1,0) [0|0] "" Vector__XXX
 SG_ IEB_RmcReqFrnt : 148|2@1+ (1,0) [0|0] "" Vector__XXX
 SG_ IEB_RmcReqRear : 150|2@1+ (1,0) [0|0] "" Vector__XXX
 SG_ IEB_TCS_Req : 152|2@1+ (1,0) [0|0] "" Vector__XXX
 SG_ IEB_RSC_Req : 154|2@1+ (1,0) [0|0] "" Vector__XXX
 SG_ TCS_TqFlag_Frnt : 156|1@1+ (1,0) [0|0] "" Vector__XXX
 SG_ TCS_TqFlag_Rear : 157|1@1+ (1,0) [0|0] "" Vector__XXX
 SG_ RSC_TqFlag_Frnt : 158|1@1+ (1,0) [0|0] "" Vector__XXX
 SG_ RSC_TqFlag_Rear : 159|1@1+ (1,0) [0|0] "" Vector__XXX
 SG_ IEB_AlvCnt1Val : 16|8@1+ (1,0) [0|0] "" Vector__XXX
 SG_ TCS_TqIntrvntnVal_Frnt : 160|8@1+ (0.390625,0) [0|0] "%" Vector__XXX
 SG_ TCS_TqIntrvntnVal_Rear : 168|8@1+ (0.390625,0) [0|0] "%" Vector__XXX
 SG_ RSC_TqIntrvntnVal_Frnt : 176|8@1+ (0.390625,0) [0|0] "%" Vector__XXX
 SG_ RSC_TqIntrvntnVal_Rear : 184|8@1+ (0.390625,0) [0|0] "%" Vector__XXX
 SG_ TCS_MtrTrgtRpm_Flag_Frnt : 192|1@1+ (1,0) [0|0] "" Vector__XXX
 SG_ TCS_MtrTrgtRpm_Flag_Rear : 193|1@1+ (1,0) [0|0] "" Vector__XXX
 SG_ IEB_DriftElsdModSta : 194|2@1+ (1,0) [0|0] "" Vector__XXX
 SG_ IEB_DriftEcsModSta : 196|2@1+ (1,0) [0|0] "" Vector__XXX
 SG_ IEB_DriftMdpsModSta : 198|2@1+ (1,0) [0|0] "" Vector__XXX
 SG_ TCS_MtrTrgtRpm_Frnt : 200|12@1+ (8,0) [0|0] "rpm" Vector__XXX
 SG_ TCS_MtrTrgtRpm_Rear : 212|12@1+ (8,0) [0|0] "rpm" Vector__XXX
 SG_ IEB_DriftModeSta : 224|2@1+ (1,0) [0|0] "" Vector__XXX
 SG_ IEB_DriftModeActSta : 226|2@1+ (1,0) [0|0] "" Vector__XXX
 SG_ MCU_AntiJerk_Inhbtsta : 230|1@1+ (1,0) [0|0] "" Vector__XXX
 SG_ IEB_Motor_ProtectModSta : 231|1@1+ (1,0) [0|0] "" Vector__XXX
 SG_ IEB_EstBrkSacFrcNmVal : 232|16@1+ (1,0) [0|0] "" Vector__XXX
 SG_ IEB_SrvLmpDis : 24|2@1+ (1,0) [0|0] "" Vector__XXX
 SG_ IEB_IndDriftEscModSta_TCS : 248|4@1+ (1,0) [0|0] "" Vector__XXX
 SG_ IEB_IndDriftEscModSta_VDC : 252|4@1+ (1,0) [0|0] "" Vector__XXX
 SG_ IEB_DfctvSta : 26|2@1+ (1,0) [0|0] "" Vector__XXX
 SG_ IEB_ActvSta : 28|2@1+ (1,0) [0|0] "" Vector__XXX
 SG_ IEB_DiagSta : 30|2@1+ (1,0) [0|0] "" Vector__XXX
 SG_ IEB_WrngLmpDis : 32|2@1+ (1,0) [0|0] "" Vector__XXX
 SG_ IEB_MILReq : 34|2@1+ (1,0) [0|0] "" Vector__XXX
 SG_ IEB_DriftModeStaDis : 36|3@1+ (1,0) [0|0] "" Vector__XXX
 SG_ RSC_Sta : 39|1@1+ (1,0) [0|0] "" Vector__XXX
 SG_ IEB_StrkDpthmmVal : 40|16@1- (0.1,0) [0|0] "mm" Vector__XXX
 SG_ IEB_BrkActvSta : 56|2@1+ (1,0) [0|0] ""  BLTN_CAM_FD
 SG_ IEB_PdlTrvlSnsrFailSta : 58|2@1+ (1,0) [0|0] "" Vector__XXX
 SG_ IEB_PdlCalibSta : 60|2@1+ (1,0) [0|0] "" Vector__XXX
 SG_ IEB_BzrSta : 62|2@1+ (1,0) [0|0] "" Vector__XXX
 SG_ IEB_Sta : 64|2@1+ (1,0) [0|0] "" Vector__XXX
 SG_ IEB_SnsrFailSta : 66|2@1+ (1,0) [0|0] "" Vector__XXX
 SG_ IEB_RbsWrngLmpSta : 68|2@1+ (1,0) [0|0] "" Vector__XXX
 SG_ IEB_VacSysDfctvSta : 70|2@1+ (1,0) [0|0] "" Vector__XXX
 SG_ IEB_RegenTqLimitNmVal_Frnt : 72|16@1+ (1,0) [0|0] "Nm" Vector__XXX
 SG_ IEB_EstTtlBrkFrcNmVal : 88|16@1+ (1,0) [0|0] "Nm" Vector__XXX

BO_ 1071 HU_AVM_03_600ms: 16 CGW_CCU
 SG_ HU_AVM_Crc3Val : 0|16@1+ (1,0) [0|0] "" Vector__XXX
 SG_ HU_SVM_ccp_pan : 120|4@1- (1,0) [0|0] "" Vector__XXX
 SG_ HU_AVM_AlvCnt3Val : 16|8@1+ (1,0) [0|0] "" Vector__XXX
 SG_ HU_SVMTopViewDispSta : 68|2@1+ (1,0) [0|0] "" Vector__XXX
 SG_ HU_SVM_ccp_pan_valid : 73|1@1+ (1,0) [0|0] "" Vector__XXX
 SG_ SVM_CaptureModeCMD : 74|2@1+ (1,0) [0|0] ""  BLTN_CAM_FD

BO_ 704 VCU_06_200ms: 32 CGW_CCU
 SG_ VCU_Crc6Val : 0|16@1+ (1,0) [0|0] ""  GW_PSU_DRV_FD
 SG_ VCU_BstWarnMsg : 105|2@1+ (1,0) [0|0] ""  GW_PSU_DRV_FD,GW_SAU_DRV_FD,PSB_FD
 SG_ VCU_BstAvailSta : 107|2@1+ (1,0) [0|0] ""  BLTN_CAM_FD,GW_SAU_DRV_FD
 SG_ VCU_BstAplySta : 109|2@1+ (1,0) [0|0] ""  BLTN_CAM_FD,GW_SAU_DRV_FD
 SG_ VCU_MxPwrMdSta : 112|2@1+ (1,0) [0|0] "" Vector__XXX
 SG_ VCU_MxPwrMdSegVal : 114|5@1+ (5,0) [0|0] "" Vector__XXX
 SG_ VCU_MxPwrMdOSD : 119|3@1+ (1,0) [0|0] "" Vector__XXX
 SG_ VCU_PwrDnByHoodOpenSta : 122|2@1+ (1,0) [0|0] "" Vector__XXX
 SG_ VCU_FlatTowModeConIndSta : 124|4@1+ (1,0) [0|0] "" Vector__XXX
 SG_ VCU_VgsVirAGIUpGear : 128|4@1+ (1,0) [0|0] "" Vector__XXX
 SG_ VCU_VgsVirAGIDnGear : 132|4@1+ (1,0) [0|0] "" Vector__XXX
 SG_ VCU_NCstmBrkOvrSta : 136|2@1+ (1,0) [0|0] "" Vector__XXX
 SG_ VCU_NCondDragSta : 138|2@1+ (1,0) [0|0] ""  BLTN_CAM_FD
 SG_ VCU_NCondDragSegVal : 140|5@1+ (5,0) [0|0] ""  BLTN_CAM_FD
 SG_ VCU_NCondTrackSta : 145|2@1+ (1,0) [0|0] ""  BLTN_CAM_FD
 SG_ VCU_NCondTrackTimeVal : 147|6@1+ (1,0) [0|0] ""  BLTN_CAM_FD
 SG_ VCU_NCondOSD : 153|3@1+ (1,0) [0|0] ""  BLTN_CAM_FD
 SG_ VCU_ExpUnitEnrgCnsmptnVal : 156|8@1+ (10,0) [0|0] "" Vector__XXX
 SG_ VCU_AlvCnt6Val : 16|8@1+ (1,0) [0|0] ""  GW_PSU_DRV_FD
 SG_ VCU_FlatTowModeChgPwrUsmSta : 164|3@1+ (1,0) [0|0] "" Vector__XXX
 SG_ VCU_NCstmHighPefMdWarnMsg : 167|4@1+ (1,0) [0|0] "" Vector__XXX
 SG_ VCU_NCstmNtdUsmSta : 171|2@1+ (1,0) [0|0] "" Vector__XXX
 SG_ VCU_EstRoadSlopeValue : 173|8@1- (1,0) [0|0] "%" Vector__XXX
 SG_ VCU_DteV2LVal : 181|11@1+ (1,0) [0|2047] "km" Vector__XXX
 SG_ VCU_TrgFuelEcoVal_PerkWh : 192|8@1+ (0.1,0) [0|0] "km/kWh" Vector__XXX
 SG_ VCU_FlatTowModeUsmSta : 200|3@1+ (1,0) [0|0] "" Vector__XXX
 SG_ VCU_FlatTowModeEquip : 203|2@1+ (1,0) [0|0] "" Vector__XXX
 SG_ VCU_MaintenanceSrvMd : 205|2@1+ (1,0) [0|0] "" Vector__XXX
 SG_ VCU_DteQcChrgStsVal : 207|11@1+ (1,0) [0|2047] "km" Vector__XXX
 SG_ VCU_CnvrtPermPwrVal : 218|10@1+ (20,0) [0|12700] "W" Vector__XXX
 SG_ VCU_CnvrtOpPermSta : 228|2@1+ (1,0) [0|3] "" Vector__XXX
 SG_ VCU_ARSPosition : 230|3@1+ (1,0) [0|0] "flag" Vector__XXX
 SG_ VCU_AccelBoostOnOffSta : 233|2@1+ (1,0) [0|0] "" Vector__XXX
 SG_ VCU_DteGuideVal : 235|11@1+ (1,0) [0|2047] "km" Vector__XXX
 SG_ VCU_Required_ADASMapMsg : 24|16@1+ (1,0) [0|0] "" Vector__XXX
 SG_ VCU_HvBatAutoDchOpSta : 246|2@1+ (1,0) [0|0] "" Vector__XXX
 SG_ VCU_UtilModeWarnAddMsgSta : 248|3@1+ (1,0) [0|0] ""  ATS_FD
 SG_ VCU_TowModSta : 251|2@1+ (1,0) [0|0] "" Vector__XXX
 SG_ VCU_TowLvlSta : 253|3@1+ (1,0) [0|0] "" Vector__XXX
 SG_ VCU_SwVer : 40|8@1+ (1,0) [0|0] "" Vector__XXX
 SG_ VCU_PwrAutoOffInfo : 48|2@1+ (1,0) [0|0] "" Vector__XXX
 SG_ VCU_PwrAutoOffTimerSta : 50|3@1+ (1,0) [0|0] "" Vector__XXX
 SG_ VCU_FlatTowModeTargetSocUsmSta : 53|3@1+ (1,0) [0|0] "" Vector__XXX
 SG_ VCU_AutoShutOffTimerMin : 56|8@1+ (1,0) [0|0] "" Vector__XXX
 SG_ VCU_AutoShutOffTimerSec : 64|6@1+ (1,0) [0|0] "" Vector__XXX
 SG_ VCU_PwrAutoOffTimerReset : 70|2@1+ (1,0) [0|0] "" Vector__XXX
 SG_ VCU_AutoShutOffReq : 72|4@1+ (1,0) [0|0] "" Vector__XXX
 SG_ VCU_DrvInfoPageOptSta : 76|2@1+ (1,0) [0|0] "" Vector__XXX
 SG_ VCU_TireSizeWrnMsgSta : 78|2@1+ (1,0) [0|0] "" Vector__XXX
 SG_ VCU_FrntTqDispPcVal : 80|8@1- (1,0) [0|0] ""  BLTN_CAM_FD
 SG_ VCU_RearTqDispPcVal : 88|8@1- (1,0) [0|0] ""  BLTN_CAM_FD
 SG_ VCU_BstOpSta : 96|3@1+ (1,0) [0|0] ""  BLTN_CAM_FD,GW_SAU_DRV_FD,PSB_FD
 SG_ VCU_BstTimerVal : 99|6@1+ (1,0) [0|0] ""  GW_SAU_DRV_FD,PSB_FD

BO_ 979 BDC_FD_04_200ms: 32 CGW_CCU
 SG_ BDC_FD_Crc4Val : 0|16@1+ (1,0) [0|0] "" Vector__XXX
 SG_ CPD_NotiReq_Reactivate : 101|2@1+ (1,0) [0|0] "" Vector__XXX
 SG_ CPD_CLU_IntDisplayRdyReq : 104|2@1+ (1,0) [0|0] "" Vector__XXX
 SG_ CPD_CLU_IntDisplayOnReq : 106|3@1+ (1,0) [0|0] "" Vector__XXX
 SG_ ROA_SnSrStat_1 : 109|3@1+ (1,0) [0|0] "" Vector__XXX
 SG_ Warn_ExtBuzzerOut : 112|2@1+ (1,0) [0|0] "" Vector__XXX
 SG_ SBR_AsstStBltWrngIndSta : 114|2@1+ (1,0) [0|0] ""  PSB_FD
 SG_ SBR_DrvStBltWrngIndSta : 116|2@1+ (1,0) [0|0] ""  PSB_FD
 SG_ SeatOccuPres_Drv : 118|2@1+ (1,0) [0|0] "" Vector__XXX
 SG_ SeatOccuPres_Asst : 120|2@1+ (1,0) [0|0] "" Vector__XXX
 SG_ SeatOccuPres_1stCtr : 122|2@1+ (1,0) [0|0] "" Vector__XXX
 SG_ SeatOccuPres_2ndLft : 124|2@1+ (1,0) [0|0] "" Vector__XXX
 SG_ SeatOccuPres_2ndRt : 126|2@1+ (1,0) [0|0] "" Vector__XXX
 SG_ SeatOccuPres_2ndCtr : 128|2@1+ (1,0) [0|0] "" Vector__XXX
 SG_ SeatOccuPres_3rdLft : 130|2@1+ (1,0) [0|0] "" Vector__XXX
 SG_ SeatOccuPres_3rdRt : 132|2@1+ (1,0) [0|0] "" Vector__XXX
 SG_ SeatOccuPres_3rdCtr : 134|2@1+ (1,0) [0|0] "" Vector__XXX
 SG_ SeatOccuPres_4thLft : 136|2@1+ (1,0) [0|0] "" Vector__XXX
 SG_ SeatOccuPres_4thRt : 138|2@1+ (1,0) [0|0] "" Vector__XXX
 SG_ SeatOccuPres_4thCtr : 140|2@1+ (1,0) [0|0] "" Vector__XXX
 SG_ CPD_VersionOpt : 142|4@1+ (1,0) [0|0] "" Vector__XXX
 SG_ BDC_FD_AlvCnt4Val : 16|8@1+ (1,0) [0|0] "" Vector__XXX
 SG_ BAlarm_BglrAlrm_CurrentSta : 24|4@1+ (1,0) [0|0] ""  BLTN_CAM_FD
 SG_ BAlarm_BglrAlrm_Sta : 28|2@1+ (1,0) [0|0] ""  DCM_FD
 SG_ BAlarm_PncAlrmSta : 30|2@1+ (1,0) [0|0] "" Vector__XXX
 SG_ SBR_StBltStpWrngBzrSta : 34|3@1+ (1,0) [0|0] "" Vector__XXX
 SG_ SBR_StBltWrngBzrSta : 37|3@1+ (1,0) [0|0] "" Vector__XXX
 SG_ BAlarm_BrglrHrnRlySta : 40|2@1+ (1,0) [0|0] "" Vector__XXX
 SG_ SBR_DrvStBltIndSta : 42|2@1+ (1,0) [0|0] ""  PSB_FD
 SG_ SBR_RrLftStBltWrngIndSta : 44|2@1+ (1,0) [0|0] ""  PSB_FD
 SG_ SBR_RrRtStBltWrngIndSta : 46|2@1+ (1,0) [0|0] ""  PSB_FD
 SG_ SBR_RrCtrStBltIndSta : 48|2@1+ (1,0) [0|0] ""  PSB_FD
 SG_ SBR_3rdLftStBltWrngIndSta : 50|2@1+ (1,0) [0|0] ""  PSB_FD
 SG_ SBR_3rdRtStBltWrngIndSta : 52|2@1+ (1,0) [0|0] ""  PSB_FD
 SG_ SBR_3rdCtrStBltWrngIndSta : 54|2@1+ (1,0) [0|0] ""  PSB_FD
 SG_ Warn_BzrWrngSta : 56|4@1+ (1,0) [0|0] "" Vector__XXX
 SG_ Warn_BCMWrngSta : 60|4@1+ (1,0) [0|0] "" Vector__XXX
 SG_ ROA_RrBlwAutoOffReq : 64|2@1+ (1,0) [0|0] "" Vector__XXX
 SG_ ROA_RegionOpt : 66|2@1+ (1,0) [0|0] "" Vector__XXX
 SG_ Warn_RrStRmndOpt : 68|2@1+ (1,0) [0|0] "" Vector__XXX
 SG_ Warn_RrStRmndAlrmOnReq : 70|2@1+ (1,0) [0|0] "" Vector__XXX
 SG_ Warn_RrStRmndSysSta : 72|2@1+ (1,0) [0|0] "" Vector__XXX
 SG_ Warn_RrStRmndAlrmInfo : 74|3@1+ (1,0) [0|0] "" Vector__XXX
 SG_ Warn_RoaErr : 77|3@1+ (1,0) [0|0] "" Vector__XXX
 SG_ Warn_RrStRmndDelay : 80|2@1+ (1,0) [0|0] "" Vector__XXX
 SG_ Warn_RrStRmndSysAct : 82|2@1+ (1,0) [0|0] "" Vector__XXX
 SG_ WAL_FobSearching : 84|2@1+ (1,0) [0|0] "" Vector__XXX
 SG_ Warn_RrStRmndSysOffIND : 86|2@1+ (1,0) [0|0] "" Vector__XXX
 SG_ Warn_VehNotPWrngSta : 88|3@1+ (1,0) [0|0] "" Vector__XXX
 SG_ Warn_RrStRmndAlrmInfo_1 : 91|3@1+ (1,0) [0|0] "" Vector__XXX
 SG_ CPD_WrngSta : 94|2@1+ (1,0) [0|0] "" Vector__XXX
 SG_ CPD_HU_IntDisplayRdyReq : 96|2@1+ (1,0) [0|0] "" Vector__XXX
 SG_ CPD_HU_IntDisplayOnReq : 98|3@1+ (1,0) [0|0] "" Vector__XXX

BO_ 1059 HU_GW_04_1000ms: 16 CGW_CCU
 SG_ HU_GW_Crc4Val : 0|16@1+ (1,0) [0|0] "" Vector__XXX
 SG_ CF_AVN_AutoWashModeSta : 101|3@1+ (1,0) [0|0] "" Vector__XXX
 SG_ HU_ResetOpSta : 104|2@1+ (1,0) [0|0] "" Vector__XXX
 SG_ CRS_BabyOnSeatstates : 106|2@1+ (1,0) [0|0] "" Vector__XXX
 SG_ OMUOSMirCtrl_Vr : 110|2@1+ (1,0) [0|0] "" Vector__XXX
 SG_ CF_AVN_ValetModeSta : 112|2@1+ (1,0) [0|0] ""  BLTN_CAM_FD,FCS_FD,GW_PSU_3RD_FD,GW_PSU_AST_FD,GW_PSU_DRV_FD,GW_PSU_RL_FD,GW_PSU_RR_FD,GW_SAU_DRV_FD,SCM_FD,SHVU_3RD_FD,SHVU_FRNT_FD,SHVU_REAR_FD
 SG_ CF_AVN_DTOPEnableNValueSet : 114|2@1+ (1,0) [0|0] "" Vector__XXX
 SG_ HU_GW_AlvCnt4Val : 16|8@1+ (1,0) [0|0] "" Vector__XXX
 SG_ HU_Customer_Action_Ind : 24|1@1+ (1,0) [0|0] "" Vector__XXX
 SG_ HU_IG3_Request : 76|2@1+ (1,0) [0|0] "" Vector__XXX
 SG_ HU_DigitalKeyGroupingSupport : 80|2@1+ (1,0) [0|0] "" Vector__XXX
 SG_ HU_Background : 82|3@1+ (1,0) [0|0] ""  ATS_FD,BLTN_CAM_FD
 SG_ HU_BackgroundFadeInOut : 88|10@1+ (0.1,0) [0|0] "%"  ATS_FD,BLTN_CAM_FD

BO_ 983 BDC_FD_08_200ms: 24 CGW_CCU
 SG_ BDC_FD_Crc8Val : 0|16@1+ (1,0) [0|0] "" Vector__XXX
 SG_ Mirror_MnlFldModSta : 102|2@1+ (1,0) [0|0] "" Vector__XXX
 SG_ Mirror_SelSwSta : 112|3@1+ (1,0) [0|0] "" Vector__XXX
 SG_ Mirror_LHPosMnlReq : 115|3@1+ (1,0) [0|0] "" Vector__XXX
 SG_ Mirror_AutoWashModeSta_TypeC : 118|2@1+ (1,0) [0|0] "" Vector__XXX
 SG_ Mirror_RHPosMnlReq : 120|3@1+ (1,0) [0|0] "" Vector__XXX
 SG_ Mirror_LHPosMnlCmd : 124|3@1+ (1,0) [0|0] "" Vector__XXX
 SG_ Mirror_RHPosMnlCmd : 128|3@1+ (1,0) [0|0] "" Vector__XXX
 SG_ Wiper_FrWiperLowAct : 132|2@1+ (1,0) [0|0] "" Vector__XXX
 SG_ Wiper_FrWiperHighAct : 134|2@1+ (1,0) [0|0] "" Vector__XXX
 SG_ Wiper_FrtWiperLowCmd : 136|2@1+ (1,0) [0|0] "" Vector__XXX
 SG_ Wiper_FrtWiperHighCmd : 138|2@1+ (1,0) [0|0] "" Vector__XXX
 SG_ Wiper_RrWiperCmd : 140|2@1+ (1,0) [0|0] "" Vector__XXX
 SG_ Wiper_PowerEnableCmd : 142|2@1+ (1,0) [0|0] "" Vector__XXX
 SG_ Wiper_FrtWasherCmd : 144|2@1+ (1,0) [0|0] "" Vector__XXX
 SG_ Wiper_RrWasherCmd : 146|2@1+ (1,0) [0|0] "" Vector__XXX
 SG_ Wiper_HeadLampWasherCmd : 148|2@1+ (1,0) [0|0] "" Vector__XXX
 SG_ Wiper_AutoWashModeSta_TypeC : 150|2@1+ (1,0) [0|0] "" Vector__XXX
 SG_ Mirror_LHPosMnlPlyCmd : 152|3@1+ (1,0) [0|0] "" Vector__XXX
 SG_ Mirror_RHPosMnlPlyCmd : 155|3@1+ (1,0) [0|0] "" Vector__XXX
 SG_ BDC_FD_AlvCnt8Val : 16|8@1+ (1,0) [0|0] "" Vector__XXX
 SG_ Mirror_LHPosAutoPlyCmd : 160|4@1+ (1,0) [0|0] "" Vector__XXX
 SG_ Mirror_RHPosAutoPlyCmd : 164|4@1+ (1,0) [0|0] "" Vector__XXX
 SG_ Mirror_IMSMemoryCmd : 168|3@1+ (1,0) [0|0] "" Vector__XXX
 SG_ ECW_Overload2 : 171|3@1+ (1,0) [0|0] "" Vector__XXX
 SG_ Mirror_AutoRevModSetSta : 174|2@1+ (1,0) [0|0] "" Vector__XXX
 SG_ IRS_Err_Type : 176|4@1+ (1,0) [0|0] "" Vector__XXX
 SG_ Wiper_RainAmount : 24|8@1+ (0.1,0) [0|0] "" Vector__XXX
 SG_ Wiper_AutoWashModeSta : 32|2@1+ (1,0) [0|0] "" Vector__XXX
 SG_ Wiper_PrkngPosSta : 34|2@1+ (1,0) [0|0] ""  BLTN_CAM_FD
 SG_ Wiper_RainSnsrOptionTyp : 36|2@1+ (1,0) [0|0] "" Vector__XXX
 SG_ Wiper_HtWshNzzlCmd : 38|2@1+ (1,0) [0|0] "" Vector__XXX
 SG_ Wiper_RainSnsrSta : 40|4@1+ (1,0) [0|0] ""  BLTN_CAM_FD
 SG_ Wiper_RainSnsrPartNum : 44|4@1+ (1,0) [0|0] "" Vector__XXX
 SG_ ECW_Fault : 48|2@1+ (1,0) [0|0] "" Vector__XXX
 SG_ ECW_FaultActv : 50|2@1+ (1,0) [0|0] "" Vector__XXX
 SG_ ECW_HiVolt : 52|2@1+ (1,0) [0|0] "" Vector__XXX
 SG_ ECW_HiVoltActv : 54|2@1+ (1,0) [0|0] "" Vector__XXX
 SG_ ECW_LoVolt : 56|2@1+ (1,0) [0|0] "" Vector__XXX
 SG_ ECW_LoVoltActv : 58|2@1+ (1,0) [0|0] "" Vector__XXX
 SG_ ECW_Overload : 60|2@1+ (1,0) [0|0] "" Vector__XXX
 SG_ ECW_OverloadActv : 62|2@1+ (1,0) [0|0] "" Vector__XXX
 SG_ ECW_CommErr : 64|2@1+ (1,0) [0|0] "" Vector__XXX
 SG_ ECW_Err_Type : 66|3@1+ (1,0) [0|0] "" Vector__XXX
 SG_ Wiper_NonParkWarning : 69|2@1+ (1,0) [0|0] "" Vector__XXX
 SG_ BCM_SolSnsrRt : 72|8@1+ (4.72441,0) [0|0] "W/m2" Vector__XXX
 SG_ BCM_SolSnsrLft : 80|8@1+ (4.72441,0) [0|0] "W/m2" Vector__XXX
 SG_ Mirror_MirFldOpt : 88|2@1+ (1,0) [0|0] "" Vector__XXX
 SG_ Mirror_FldUnfldCmd : 90|2@1+ (1,0) [0|0] "" Vector__XXX
 SG_ Mirror_FldCtrlSta : 92|2@1+ (1,0) [0|0] ""  BLTN_CAM_FD
 SG_ Mirror_UnFldCtrlSta : 94|2@1+ (1,0) [0|0] ""  BLTN_CAM_FD
 SG_ Mirror_PosMnlCmd : 96|3@1+ (1,0) [0|0] "" Vector__XXX
 SG_ Mirror_SelSwIndCmd : 99|3@1+ (1,0) [0|0] "" Vector__XXX

BO_ 861 LBM_FD_03_300ms: 32 CGW_CCU
 SG_ LBM_FD_Crc3Val : 0|16@1+ (1,0) [0|0] "" Vector__XXX
 SG_ MainLBM_CellVtgDeviationSta : 112|16@1+ (1,0) [0|0] "" Vector__XXX
 SG_ MainLBM_12VAvgCurrAtReset : 128|12@1+ (10,-40940) [0|0] "mA" Vector__XXX
 SG_ MainLBM_VehSpdLimContReq : 140|3@1+ (1,0) [0|0] "" Vector__XXX
 SG_ LBM_FD_AlvCnt3Val : 16|8@1+ (1,0) [0|0] "" Vector__XXX
 SG_ MainLBM_OptType : 24|8@1+ (1,0) [0|0] ""  BLTN_CAM_FD
 SG_ MainLBM_RlyOnSta : 32|2@1+ (1,0) [0|0] ""  BLTN_CAM_FD
 SG_ MainLBM_RlyOutVoltVal : 34|8@1+ (0.1,0) [0|0] "V"  BLTN_CAM_FD
 SG_ MainLBM_RlyOnSwReq : 42|2@1+ (1,0) [0|0] ""  BLTN_CAM_FD
 SG_ MainLBM_BmsFailWarn : 44|2@1+ (1,0) [0|0] ""  BLTN_CAM_FD
 SG_ MainLBM_FaultSta : 46|10@1+ (1,0) [0|0] ""  BLTN_CAM_FD
 SG_ MainLBM_ResetOpSta : 56|2@1+ (1,0) [0|0] "" Vector__XXX
 SG_ MainLBM_CellOverVtgSta : 64|16@1+ (1,0) [0|0] "" Vector__XXX
 SG_ MainLBM_CellLowVtgSta : 80|16@1+ (1,0) [0|0] "" Vector__XXX
 SG_ MainLBM_CellOverTempSta : 96|16@1+ (1,0) [0|0] "" Vector__XXX

BO_ 980 BDC_FD_05_200ms: 32 CGW_CCU
 SG_ BDC_FD_Crc5Val : 0|16@1+ (1,0) [0|0] ""  GW_PSU_DRV_FD
 SG_ AutoLt_HorRes_STD : 107|2@1+ (1,0) [0|0] ""  ATS_FD
 SG_ AutoLt_VerVal_STD : 109|11@1+ (1,0) [0|0] ""  ATS_FD
 SG_ AutoLt_VerRes_STD : 120|2@1+ (1,0) [0|0] ""  ATS_FD
 SG_ MoodLamp_SlvColor_X : 128|8@1+ (1,0) [0|0] "" Vector__XXX
 SG_ MoodLamp_SlvColor_Y : 136|8@1+ (1,0) [0|0] "" Vector__XXX
 SG_ MoodLamp_SlvBrgtnsVal : 144|8@1+ (1,0) [0|0] "" Vector__XXX
 SG_ MoodLamp_SlvFadeInTimetVal : 152|8@1+ (1,0) [0|0] "" Vector__XXX
 SG_ BDC_FD_AlvCnt5Val : 16|8@1+ (1,0) [0|0] ""  GW_PSU_DRV_FD
 SG_ MoodLamp_SlvFadeOutTimetVal : 160|8@1+ (1,0) [0|0] "" Vector__XXX
 SG_ Lamp_LftTrnLmpCmdSta : 168|2@1+ (1,0) [0|0] "" Vector__XXX
 SG_ Lamp_RtTrnLmpCmdSta : 170|2@1+ (1,0) [0|0] "" Vector__XXX
 SG_ Lamp_LftTrnLmpCmd : 172|2@1+ (1,0) [0|0] ""  BLTN_CAM_FD
 SG_ Lamp_RtTrnLmpCmd : 174|2@1+ (1,0) [0|0] ""  BLTN_CAM_FD
 SG_ Lamp_TrnLmpMode : 176|3@1+ (1,0) [0|0] "" Vector__XXX
 SG_ Lamp_HzrdSwIND : 182|2@1+ (1,0) [0|0] "" Vector__XXX
 SG_ Lamp_HdLmpEscortShortCmd : 184|2@1+ (1,0) [0|0] "" Vector__XXX
 SG_ Lamp_LightPopUpMsgType : 186|2@1+ (1,0) [0|0] "" Vector__XXX
 SG_ Lamp_LightPopUpReq : 188|2@1+ (1,0) [0|0] "" Vector__XXX
 SG_ Lamp_HdLmpLoOffPopUpReq : 190|2@1+ (1,0) [0|0] "" Vector__XXX
 SG_ MoodLamp_SpeechRecogPosSta : 192|3@1+ (1,0) [0|0] "" Vector__XXX
 SG_ MoodLamp_BttmSlvColor_X : 195|8@1+ (1,0) [0|0] "" Vector__XXX
 SG_ MoodLamp_BttmSlvColor_Y : 203|8@1+ (1,0) [0|0] "" Vector__XXX
 SG_ MoodLamp_BttmSlvBrgtnsVal : 211|8@1+ (1,0) [0|0] "" Vector__XXX
 SG_ MoodLamp_BttmSlvFadeInTimetVal : 219|8@1+ (1,0) [0|0] "" Vector__XXX
 SG_ MoodLamp_BttmSlvFadeOutTimetVal : 227|8@1+ (1,0) [0|0] "" Vector__XXX
 SG_ Lamp_FrontGroundLightOnReq : 235|2@1+ (1,0) [0|0] "" Vector__XXX
 SG_ Lamp_SideGroundLightOnReq : 237|2@1+ (1,0) [0|0] "" Vector__XXX
 SG_ Lamp_RearGroundLightOnReq : 239|2@1+ (1,0) [0|0] "" Vector__XXX
 SG_ Lamp_HiPrioHzrdReq : 24|3@1+ (1,0) [0|0] "" Vector__XXX
 SG_ Lamp_DecoLmpOnReq : 243|2@1+ (1,0) [0|0] "" Vector__XXX
 SG_ Lamp_SideGndLmpCmd : 245|2@1+ (1,0) [0|0] "" Vector__XXX
 SG_ Lamp_SideGndCptLmpCmd : 247|2@1+ (1,0) [0|0] "" Vector__XXX
 SG_ Lamp_HzrdLampStabySW : 251|2@1+ (1,0) [0|0] "" Vector__XXX
 SG_ Lamp_LoPrioHzrdReq : 27|3@1+ (1,0) [0|0] "" Vector__XXX
 SG_ Lamp_ExtrnlTailLmpOnReq : 30|2@1+ (1,0) [0|0] ""  BLTN_CAM_FD
 SG_ Lamp_HdLmpLoOnReq : 32|2@1+ (1,0) [0|0] "" Vector__XXX
 SG_ Lamp_HdLmpHiOnReq : 34|2@1+ (1,0) [0|0] "" Vector__XXX
 SG_ Lamp_DrlOnReq : 36|2@1+ (1,0) [0|0] "" Vector__XXX
 SG_ Lamp_BckUpLmpCmd : 38|2@1+ (1,0) [0|0] ""  DCM_FD
 SG_ Lamp_FrFogLmpOnReq : 40|2@1+ (1,0) [0|0] "" Vector__XXX
 SG_ Lamp_RrFogLmpOnReq : 42|2@1+ (1,0) [0|0] "" Vector__XXX
 SG_ Lamp_StcBendingLmpLftOnReq : 44|2@1+ (1,0) [0|0] "" Vector__XXX
 SG_ Lamp_StcBendingLmpRtOnReq : 46|2@1+ (1,0) [0|0] "" Vector__XXX
 SG_ Lamp_CornerLmpLftOnReq : 48|2@1+ (1,0) [0|0] "" Vector__XXX
 SG_ Lamp_CornerLmpRtOnReq : 50|2@1+ (1,0) [0|0] "" Vector__XXX
 SG_ Lamp_HbaCtrlModTyp : 52|2@1+ (1,0) [0|0] "" Vector__XXX
 SG_ Lamp_IFSCtrlModTyp : 54|2@1+ (1,0) [0|0] "" Vector__XXX
 SG_ Lamp_HdLmpWlcmCmd : 56|2@1+ (1,0) [0|0] "" Vector__XXX
 SG_ Lamp_PuddleLmpOnReq : 58|2@1+ (1,0) [0|0] "" Vector__XXX
 SG_ Lamp_ExtLampRSPAMode : 60|2@1+ (1,0) [0|0] "" Vector__XXX
 SG_ Lamp_IntTailLmpOnReq : 62|2@1+ (1,0) [0|0] ""  ATS_FD,FCS_FD,GW_PSU_3RD_FD,GW_PSU_AST_FD,GW_PSU_DRV_FD,GW_PSU_RL_FD,GW_PSU_RR_FD,RWPC_FD,SHVU_3RD_FD,SHVU_FRNT_FD,SHVU_REAR_FD,SHVU_RL_FD,SHVU_RR_FD,WPC2_FD,WPC_FD
 SG_ Lamp_AvTailLmpSta : 64|2@1+ (1,0) [0|0] ""  ATS_FD,GW_PSU_AST_FD
 SG_ Lamp_AutoLtSnsrNightSta : 66|2@1+ (1,0) [0|0] ""  ATS_FD,GW_PSU_AST_FD,PSB_FD
 SG_ Lamp_VendorInfo : 68|3@1+ (1,0) [0|0] ""  ATS_FD
 SG_ Lamp_AutoLtSnsrHorVal : 72|10@1+ (1,0) [0|0] ""  ATS_FD
 SG_ MoodLamp_AIVoiceOptSta : 82|2@1+ (1,0) [0|0] "" Vector__XXX
 SG_ MoodLamp_DualColorOptSta : 84|2@1+ (1,0) [0|0] ""  ATS_FD
 SG_ MoodLamp_MdLmpFadeSta : 86|2@1+ (1,0) [0|0] "" Vector__XXX
 SG_ MoodLamp_NumRecommendColor : 88|4@1+ (1,0) [0|0] ""  ATS_FD
 SG_ AutoLt_HorVal_STD : 96|11@1+ (1,0) [0|0] ""  ATS_FD

CM_ BO_ 101 "[P] Periodic";
CM_ SG_ 101 IEB_Crc1Val "IEB_CyclicRedundancyCheck1Value";
CM_ SG_ 101 IEB_StrkDpthPcVal "IEB_StrokeDepthPcValue ##2G##ESC - EBS2 - CR_Brk_StkDep_Pc";
CM_ SG_ 101 IEB_EstDpthPcVal "IEB_EstimatedPedalDepthValue ##2G##ESC - EBS2 - CR_Brk_Est_StkDep_Pc";
CM_ SG_ 101 IEB_AbsNGearReq "IEB_AbsNGearRequest ##2G##ESC - TCS11 - CF_Brk_AbsNReq";
CM_ SG_ 101 IEB_EstBrkPdlValVldSta "IEB_EstimatedBrakePedalValueValidityStatus ##2G##ESC - EBS2 - CF_Brk_Est_StkValid";
CM_ SG_ 101 IEB_RegenTqLimitNmVal_Rear "IEB_RegenTorqueLimitValue Rear";
CM_ SG_ 101 IEB_DrvWhlSlipFlg_Frnt "Slip status of driving wheel ##2G##ESC ? EBS2 ? CF_Brk_DrvWhlSlipFlg";
CM_ SG_ 101 IEB_IndDriftMode "Signal for feedback from AVNT drift mode ON/OFF command";
CM_ SG_ 101 IEB_RmcReqFrnt "IEB_RMC Request Front";
CM_ SG_ 101 IEB_RmcReqRear "IEB_RMC Request Rear";
CM_ SG_ 101 IEB_TCS_Req "IEB_TCS_Request";
CM_ SG_ 101 IEB_RSC_Req "IEB_RSC_Request";
CM_ SG_ 101 TCS_TqFlag_Frnt "TCS_TorqueFlag_Front";
CM_ SG_ 101 TCS_TqFlag_Rear "TCS_TorqueFlag_Rear";
CM_ SG_ 101 RSC_TqFlag_Frnt "RSC_TorqueFlag_Front";
CM_ SG_ 101 RSC_TqFlag_Rear "RSC_TorqueFlag_Rear";
CM_ SG_ 101 IEB_AlvCnt1Val "IEB_AliveCounter1Value";
CM_ SG_ 101 TCS_TqIntrvntnVal_Frnt "TCS_TorqueInterventionValue_Front";
CM_ SG_ 101 TCS_TqIntrvntnVal_Rear "TCS_TorqueInterventionValue_Rear";
CM_ SG_ 101 RSC_TqIntrvntnVal_Frnt "RSC_TorqueInterventionValue_Front";
CM_ SG_ 101 RSC_TqIntrvntnVal_Rear "RSC_TorqueInterventionValue_Rear";
CM_ SG_ 101 TCS_MtrTrgtRpm_Flag_Frnt "TCS_MotorTargetRPM_Flag_Front";
CM_ SG_ 101 TCS_MtrTrgtRpm_Flag_Rear "TCS_MotorTargetRPM_Flag_Rear";
CM_ SG_ 101 IEB_DriftElsdModSta "ELSD mode command from DMIC by AVNT custom mode select";
CM_ SG_ 101 IEB_DriftEcsModSta "ECS mode command from DMIC by AVNT custom mode select";
CM_ SG_ 101 IEB_DriftMdpsModSta "MDPS mode command from DMIC by AVNT custom mode select";
CM_ SG_ 101 TCS_MtrTrgtRpm_Frnt "TCS_MotorTargetRPM_Front";
CM_ SG_ 101 TCS_MtrTrgtRpm_Rear "TCS_MotorTargetRPM_Rear";
CM_ SG_ 101 IEB_DriftModeSta "Display";
CM_ SG_ 101 IEB_DriftModeActSta "ON/OFF status, Symbol";
CM_ SG_ 101 MCU_AntiJerk_Inhbtsta "MCU_AntiJerk_Inhbtsta is a signal to inform the MCU of anti-jerk control prohibition in order to prevent side effects caused by intervention in the IEB when ABS control and MCU anti-jerk control overlap.";
CM_ SG_ 101 IEB_Motor_ProtectModSta "It is a signal to notify when the internal motor protection mode of the electric integrated booster is activated.";
CM_ SG_ 101 IEB_EstBrkSacFrcNmVal "Estimated brake force value for stop assist control";
CM_ SG_ 101 IEB_SrvLmpDis "IEB_ServiceLampDisplay ##2G##ESC - AHB1 - CF_Ahb_SLmp";
CM_ SG_ 101 IEB_IndDriftEscModSta_TCS "Signal for feed back of TCS mode change from DMIC by AVNT custom mode select";
CM_ SG_ 101 IEB_IndDriftEscModSta_VDC "Signal for feed back of ESC/VDC mode command from DMIC by AVNT custom mode select";
CM_ SG_ 101 IEB_DfctvSta "IEB_DefectiveStatus ##2G##ESC - AHB1 - CF_Ahb_Def";
CM_ SG_ 101 IEB_ActvSta "IEB_ActiveStatus ##2G##ESC - AHB1 - CF_Ahb_Act";
CM_ SG_ 101 IEB_DiagSta "IEB_DiagnosticStatus ##2G##ESC - AHB1 - CF_Ahb_Diag";
CM_ SG_ 101 IEB_WrngLmpDis "IEB_WarningLampDisplay ##2G##ESC - AHB1 - CF_Ahb_WLmp";
CM_ SG_ 101 IEB_MILReq "MIL Requeset";
CM_ SG_ 101 IEB_DriftModeStaDis "This signal is for a pop-up display on restriction status of drift mode activation";
CM_ SG_ 101 RSC_Sta "RSC Ready Status";
CM_ SG_ 101 IEB_StrkDpthmmVal "IEB_StrokeDepthmmValue ##2G##ESC - AHB1 - CR_Ahb_StDep_mm";
CM_ SG_ 101 IEB_BrkActvSta "IEB_BrakeActiveStatus ##2G##ESC - AHB1 - CF_Esc_BrakeAct";
CM_ SG_ 101 IEB_PdlTrvlSnsrFailSta "IEB_PedalTravelSensorFailStatus ##2G##ESC - AHB1 - CF_Ahb_SnsFail";
CM_ SG_ 101 IEB_PdlCalibSta "IEB_PedalCalibrationStatus ##2G##ESC - AHB1 - CF_Ahb_PedalCalStat";
CM_ SG_ 101 IEB_BzrSta "IEB_BuzzerStatus ##2G##ESC - AHB1 - CF_Ahb_Bzzr";
CM_ SG_ 101 IEB_Sta "IEB_Status ##2G##ESC - EBS1 - CF_Brk_EBSStat";
CM_ SG_ 101 IEB_SnsrFailSta "IEB_SensorFailStatus ##2G##ESC - EBS1 - CF_Brk_SnsFail";
CM_ SG_ 101 IEB_RbsWrngLmpSta "IEB_RbsWarningLamp ##2G##ESC - EBS1 - CF_Brk_RBSWLamp";
CM_ SG_ 101 IEB_VacSysDfctvSta "IEB_VacuumSystemDefectiveStatus ##2G##ESC - EBS1 - CF_Brk_VacuumSysDef";
CM_ SG_ 101 IEB_RegenTqLimitNmVal_Frnt "IEB_RegenTorqueLimitValue ##2G##ESC - EBS1 - CR_Brk_RegenTqLimit_Nm";
CM_ SG_ 101 IEB_EstTtlBrkFrcNmVal "IEB_EstimatedTotalBrakeForceValue ##2G##ESC - EBS1 - CR_Brk_EstTot_Nm";
CM_ BO_ 1071 "[PE] Periodic and On Event";
CM_ SG_ 1071 HU_AVM_Crc3Val "HU_AVM_CyclicRedundancyCheck3Value";
CM_ SG_ 1071 HU_SVM_ccp_pan "This value is a number of CCP rotation movement steps during specific period (Ps)";
CM_ SG_ 1071 HU_AVM_AlvCnt3Val "HU_AVM_AliveCounter3Value";
CM_ SG_ 1071 HU_SVM_ccp_pan_valid "This signal determines the validity of CCP rotation movement";
CM_ SG_ 1071 SVM_CaptureModeCMD "SVM Wake Up & Capture Mode On Signal";
CM_ BO_ 704 "[P] Periodic";
CM_ SG_ 704 VCU_Crc6Val "VCU_CyclicRedundancyCheck6Value";
CM_ SG_ 704 VCU_BstWarnMsg "VCU_Boost Warning Message";
CM_ SG_ 704 VCU_BstAvailSta "VCU Boost Available Status";
CM_ SG_ 704 VCU_BstAplySta "VCU Boost Apply Status";
CM_ SG_ 704 VCU_MxPwrMdSta "Max Power Mode State";
CM_ SG_ 704 VCU_MxPwrMdSegVal "Max Power Mode Segement Value";
CM_ SG_ 704 VCU_MxPwrMdOSD "Max Power Mode Related SS OSD Pop-up request";
CM_ SG_ 704 VCU_PwrDnByHoodOpenSta "Power Down Status By Hood Open";
CM_ SG_ 704 VCU_FlatTowModeConIndSta "FlatTowMode Condition State";
CM_ SG_ 704 VCU_VgsVirAGIUpGear "AGI)Available Gear Indicator) Gear capable of upshifting";
CM_ SG_ 704 VCU_VgsVirAGIDnGear "AGI)Available Gear Indicator) Gear capable of downshifting";
CM_ SG_ 704 VCU_NCstmBrkOvrSta "The Brake override system could be deactivated by a driver(for High performance vehicle USM)";
CM_ SG_ 704 VCU_NCondDragSta "N-Conditioning Drag Mode State";
CM_ SG_ 704 VCU_NCondDragSegVal "NConditioning Drag Mode Segement Value";
CM_ SG_ 704 VCU_NCondTrackSta "N Conditioning Track Mode State";
CM_ SG_ 704 VCU_NCondTrackTimeVal "N Conditioning Track Mode Estimated Time Value";
CM_ SG_ 704 VCU_NCondOSD "N Conditioning Related SS OSD Pop-up request";
CM_ SG_ 704 VCU_ExpUnitEnrgCnsmptnVal "Expected energy consumption per km";
CM_ SG_ 704 VCU_AlvCnt6Val "VCU_AliveCounter6Value";
CM_ SG_ 704 VCU_FlatTowModeChgPwrUsmSta "Charging Power for FlatTow";
CM_ SG_ 704 VCU_NCstmHighPefMdWarnMsg "High Performance mode Warning Message";
CM_ SG_ 704 VCU_NCstmNtdUsmSta "N Torque Distribition mode activation State(for High Performance vehicle USM)";
CM_ SG_ 704 VCU_EstRoadSlopeValue "Estmation Road Slope value for MCU";
CM_ SG_ 704 VCU_DteV2LVal "This signal is the V2L DTE when V2L SOC value is limited";
CM_ SG_ 704 VCU_TrgFuelEcoVal_PerkWh "Target Fuel Economy Value for Cluster Display (EV)";
CM_ SG_ 704 VCU_FlatTowModeUsmSta "FlatTowMode Usm State (acknowledge)";
CM_ SG_ 704 VCU_FlatTowModeEquip "FlatTow Equipment State";
CM_ SG_ 704 VCU_MaintenanceSrvMd "VCU to BMS M/Rly OFF request status for Maintanance mode";
CM_ SG_ 704 VCU_DteQcChrgStsVal "This signal is the DTE for Quick charging state";
CM_ SG_ 704 VCU_CnvrtPermPwrVal "48V Convert Permission Power";
CM_ SG_ 704 VCU_CnvrtOpPermSta "48V Convert Operating Permission";
CM_ SG_ 704 VCU_ARSPosition "Active Rear Spoiler Position Information";
CM_ SG_ 704 VCU_AccelBoostOnOffSta "Accel Boost on off status";
CM_ SG_ 704 VCU_DteGuideVal "This signal is Guide DTE";
CM_ SG_ 704 VCU_Required_ADASMapMsg "VCU_Required_ADASMapMessage";
CM_ SG_ 704 VCU_HvBatAutoDchOpSta "VCU HighVOltage DischargeOperating Status";
CM_ SG_ 704 VCU_UtilModeWarnAddMsgSta "Rest Mode warning message including request controller information";
CM_ SG_ 704 VCU_SwVer "VCU_SWVersion";
CM_ SG_ 704 VCU_PwrAutoOffInfo "VCU_PowerAutoOffInformation";
CM_ SG_ 704 VCU_PwrAutoOffTimerSta "VCU_PowerAutoOffTimerStatus";
CM_ SG_ 704 VCU_FlatTowModeTargetSocUsmSta "Charging Target SOC for FlatTowMode";
CM_ SG_ 704 VCU_AutoShutOffTimerMin "VCU_AutoShutOffTimerMinute";
CM_ SG_ 704 VCU_AutoShutOffTimerSec "VCU_AutoShutOffTimerSecond";
CM_ SG_ 704 VCU_PwrAutoOffTimerReset "VCU_PowerAutoOffTimerReset";
CM_ SG_ 704 VCU_AutoShutOffReq "VCU_AutoShutOffRequest";
CM_ SG_ 704 VCU_DrvInfoPageOptSta "AVN Driving information page option state";
CM_ SG_ 704 VCU_TireSizeWrnMsgSta "VCU_TireSizeWarningMessageStatus";
CM_ SG_ 704 VCU_FrntTqDispPcVal "VCU_FrontTorqueDisplayPercentValue";
CM_ SG_ 704 VCU_RearTqDispPcVal "VCU_RearTorqueDisplayPercentValue";
CM_ SG_ 704 VCU_BstOpSta "VCU_Boost Operating Status";
CM_ SG_ 704 VCU_BstTimerVal "VCU_Boost Timer Value";
CM_ BO_ 979 "[PE] Periodic and On Event";
CM_ SG_ 979 BDC_FD_Crc4Val "BDC_FD_CyclicRedundancyCheck4Value";
CM_ SG_ 979 CPD_NotiReq_Reactivate "CPD_Notification Request_Reactivate";
CM_ SG_ 979 CPD_CLU_IntDisplayRdyReq "Child Presence Detection CLU Internal Display Ready Request";
CM_ SG_ 979 CPD_CLU_IntDisplayOnReq "child presence detection CLU internal Display On Request";
CM_ SG_ 979 ROA_SnSrStat_1 "ROA Sensor State";
CM_ SG_ 979 Warn_ExtBuzzerOut "External Buzzer Command";
CM_ SG_ 979 SBR_AsstStBltWrngIndSta "SBR_AssistSeatBeltWarningIndicatorStatus ##2G##BCM - BCMmsg32 - C_AstSeatBeltInd";
CM_ SG_ 979 BDC_FD_AlvCnt4Val "BDC_FD_AliveCounter4Value";
CM_ SG_ 979 BAlarm_BglrAlrm_CurrentSta "Only for CAN FD (SV~)";
CM_ SG_ 979 BAlarm_BglrAlrm_Sta "Only for CAN FD (SV~)";
CM_ SG_ 979 BAlarm_PncAlrmSta "BAlarm_PanicAlarmStatus ##2G##BCM - BCMmsg17 - C_PanicState";
CM_ SG_ 979 SBR_StBltStpWrngBzrSta "SBR_SeatBeltStepWarningBuzzerStatus ##2G##BCM - BCMmsg32 - C_SeatBeltWngBuzStep";
CM_ SG_ 979 SBR_StBltWrngBzrSta "SBR_SeatBeltWarningBuzzerStatus ##2G##BCM - BCMmsg32 - C_SeatBeltWngBuz";
CM_ SG_ 979 BAlarm_BrglrHrnRlySta "BAlarm_BurglarHornRelayStatus ##2G##BCM - BCMmsg19 - C_BurglarHornRly";
CM_ SG_ 979 SBR_DrvStBltIndSta "SBR_DriverSeatBeltIndicatorStatus ##2G##BCM - BCMmsg32 - C_DrvSeatBeltInd";
CM_ SG_ 979 SBR_RrLftStBltWrngIndSta "SBR_RearLeftSeatBeltWarningIndicatorStatus ##2G##BCM - BCMmsg32 - C_RLSeatBeltInd";
CM_ SG_ 979 SBR_RrRtStBltWrngIndSta "SBR_RearRightSeatBeltWarningIndicatorStatus ##2G##BCM - BCMmsg32 - C_RRSeatBeltInd";
CM_ SG_ 979 SBR_RrCtrStBltIndSta "SBR_RearCenterSeatBeltIndicatorStatus ##2G##BCM - BCMmsg32 - C_RCSeatBeltInd";
CM_ SG_ 979 SBR_3rdLftStBltWrngIndSta "SBR_3rdLeftSeatBeltWarningIndicatorStatus ##2G##BCM - BCMmsg32 - C_3LSeatBeltInd";
CM_ SG_ 979 SBR_3rdRtStBltWrngIndSta "SBR_3rdRightSeatBeltWarningIndicatorStatus ##2G##BCM - BCMmsg32 - C_3RSeatBeltInd";
CM_ SG_ 979 SBR_3rdCtrStBltWrngIndSta "SBR_3rdCeterSeatBeltWarningIndicatorStatus ##2G##BCM - BCMmsg32 - C_3CSeatBeltInd";
CM_ SG_ 979 Warn_BzrWrngSta "Warn_BuzzerWarningStatus ##2G##BCM - BCMmsg18 - C_WngBuz";
CM_ SG_ 979 Warn_BCMWrngSta "Warn_BCMWarningStatus ##2G##BCM - BCMmsg19 - C_BCMWarning";
CM_ SG_ 979 ROA_RegionOpt "A Euro NCAP Option signal (BDC only)";
CM_ SG_ 979 Warn_RrStRmndOpt "Warn_RearSeatReminderOption ##2G##BCM - BCMmsg22 - C_RrSeatRemindOpt";
CM_ SG_ 979 Warn_RrStRmndAlrmOnReq "Warn_RearSeatReminderAlarmOnRequest ##2G##BCM - BCMmsg22 - C_RrSeatRemindAlarm";
CM_ SG_ 979 Warn_RrStRmndSysSta "Warn_RearSeatReminderSystemStatus ##2G##BCM - BCMmsg22 - C_RrSeatRemindState";
CM_ SG_ 979 Warn_RrStRmndAlrmInfo "Warn_RearSeatReminderAlarmInformaion ##2G##BCM - BCMmsg22 - C_RrSeatRemindInfo";
CM_ SG_ 979 Warn_RoaErr "Warn_RoaError##2G##BCM - BCMmsg22 - C_RoaError";
CM_ SG_ 979 Warn_RrStRmndDelay "Warn_RStRmndDelay";
CM_ SG_ 979 Warn_RrStRmndSysAct "Warn_RrStRmndSysAct";
CM_ SG_ 979 WAL_FobSearching "IBU Walk Away Lock Fob Searching State for Radar ROA";
CM_ SG_ 979 Warn_RrStRmndSysOffIND "Warning_RearSeatRemindSystemOffIND";
CM_ SG_ 979 Warn_VehNotPWrngSta "Vehicle Not P Warning";
CM_ SG_ 979 Warn_RrStRmndAlrmInfo_1 "Warn_RearSeatReminderAlarmInformaion";
CM_ SG_ 979 CPD_WrngSta "CPD Warning State";
CM_ SG_ 979 CPD_HU_IntDisplayRdyReq "child presence detection internal display ready request";
CM_ SG_ 979 CPD_HU_IntDisplayOnReq "Child Presence Detection Internal Display On Request";
CM_ BO_ 1059 "[PE] Periodic and On Event";
CM_ SG_ 1059 HU_GW_Crc4Val "HU_GW_CyclicRedundancyCheck4Value";
CM_ SG_ 1059 HU_ResetOpSta "This signal indicates whether the reset operation has been completed or not";
CM_ SG_ 1059 CRS_BabyOnSeatstates "The status of baby left in the car";
CM_ SG_ 1059 OMUOSMirCtrl_Vr "This signal is for the OutSide Mirror Control (Fold or Unfold)";
CM_ SG_ 1059 HU_GW_AlvCnt4Val "HU_GW_AliveCounter4Value";
CM_ SG_ 1059 HU_IG3_Request "IG3 wake up and sleep request for EV/PHEV";
CM_ SG_ 1059 HU_DigitalKeyGroupingSupport "Digital Key Grouping Support";
CM_ SG_ 1059 HU_Background "HU Backgound image info";
CM_ SG_ 1059 HU_BackgroundFadeInOut "HU Background Fade in/out info - (HEX * Factor) %";
CM_ BO_ 983 "[PE] Periodic and On Event";
CM_ SG_ 983 BDC_FD_Crc8Val "BDC_FD_CyclicRedundancyCheck8Value";
CM_ SG_ 983 Mirror_MnlFldModSta "Mirror Manual Fold State";
CM_ SG_ 983 Mirror_SelSwSta "Outside Mirror Select Button Status";
CM_ SG_ 983 Mirror_LHPosMnlReq "Left Outside Mirror Positioning Request";
CM_ SG_ 983 Mirror_RHPosMnlReq "Right Outside Mirror Positioning Request";
CM_ SG_ 983 Mirror_LHPosMnlCmd "Left Outside Mirror Positioning Command";
CM_ SG_ 983 Mirror_RHPosMnlCmd "Right Outside Mirror Positioning Command";
CM_ SG_ 983 Wiper_FrtWiperLowCmd "Front Wiper Low Output";
CM_ SG_ 983 Wiper_FrtWiperHighCmd "Front Wiper High Output";
CM_ SG_ 983 Wiper_RrWiperCmd "Rear Wiper Output";
CM_ SG_ 983 Wiper_PowerEnableCmd "Wiper Power Enable Output";
CM_ SG_ 983 Wiper_FrtWasherCmd "Front Washer Output";
CM_ SG_ 983 Wiper_RrWasherCmd "Rear Washer Output";
CM_ SG_ 983 Wiper_HeadLampWasherCmd "Head Lamp Washer Output";
CM_ SG_ 983 BDC_FD_AlvCnt8Val "BDC_FD_AliveCounter8Value";
CM_ SG_ 983 Mirror_AutoRevModSetSta "Mirror_AutoModSetSta";
CM_ SG_ 983 Wiper_AutoWashModeSta "Auto Wash Mode Wiper State";
CM_ SG_ 983 Wiper_PrkngPosSta "Wiper_ParkingPositionStatus ##2G##BCM - BCMmsg22 - C_WiperParkPosition";
CM_ SG_ 983 Wiper_RainSnsrOptionTyp "Wiper_RainSensorOptionType ##2G##BCM - BCMmsg24 - C_RainSnsOption";
CM_ SG_ 983 Wiper_RainSnsrSta "Wiper_RainSensorStatus ##2G##BCM - BCMmsg24 - C_RainSnsState";
CM_ SG_ 983 BCM_SolSnsrRt "BCM_SolarSensorRightOutputVoltageValue ##2G##BCM - BCMmsg24 - C_PhotosensorRH";
CM_ SG_ 983 BCM_SolSnsrLft "BCM_SolarSensorLeftOutputVoltageValue ##2G##BCM - BCMmsg24 - C_PhotosensorLH";
CM_ SG_ 983 Mirror_MirFldOpt "Outside Mirror Electric Fold Option Signal";
CM_ SG_ 983 Mirror_FldUnfldCmd "Mirror Folding Unfolding Command";
CM_ SG_ 983 Mirror_FldCtrlSta "Mirror Fold and Folding Control State";
CM_ SG_ 983 Mirror_UnFldCtrlSta "Mirror Unfold and Unfolding Control State";
CM_ SG_ 983 Mirror_PosMnlCmd "Mirror Positioning Command";
CM_ SG_ 983 Mirror_SelSwIndCmd "Mirror Select Switch Indicator Command";
CM_ BO_ 861 "[P] Periodic";
CM_ SG_ 861 LBM_FD_Crc3Val "LBM_FD_CyclicRedundancyCheck3Value";
CM_ SG_ 861 MainLBM_CellVtgDeviationSta "Main Lithium Battery Cell Voltage Deviation Status";
CM_ SG_ 861 MainLBM_12VAvgCurrAtReset "Average 12V Current before Reset";
CM_ SG_ 861 MainLBM_VehSpdLimContReq "Vehicle Speed Limit Control Request";
CM_ SG_ 861 LBM_FD_AlvCnt3Val "LBM_FD_AliveCounter3Value";
CM_ SG_ 861 MainLBM_OptType "Main Lithium Battery Option Information";
CM_ SG_ 861 MainLBM_RlyOnSta "Main Lithium Battery Latch Relay On Status";
CM_ SG_ 861 MainLBM_RlyOutVoltVal "Main Lithium Battery Relay Output Voltage (Voltage of the Latter Part)";
CM_ SG_ 861 MainLBM_RlyOnSwReq "12V relay ON switch ON status";
CM_ SG_ 861 MainLBM_BmsFailWarn "Battery Fault Warning(Severe Fault/Fault1/Fault2) to driver via SMS";
CM_ SG_ 861 MainLBM_FaultSta "Main Lithium Battery Pack Fault Status Alarm";
CM_ SG_ 861 MainLBM_ResetOpSta "This signal indicates whether the reset operation has been completed or not";
CM_ SG_ 861 MainLBM_CellOverVtgSta "Main Lithium Battery Cell Over Voltage Status";
CM_ SG_ 861 MainLBM_CellLowVtgSta "Main Lithium Battery Cell Low Voltage Status";
CM_ SG_ 861 MainLBM_CellOverTempSta "Main Lithium Battery Cell Over Temperature Status";
CM_ BO_ 980 "[PE] Periodic and On Event";
CM_ SG_ 980 BDC_FD_Crc5Val "BDC_FD_CyclicRedundancyCheck5Value";
CM_ SG_ 980 BDC_FD_AlvCnt5Val "BDC_FD_AliveCounter5Value";
CM_ SG_ 980 Lamp_LftTrnLmpCmdSta "Lamp_LeftTurnLampCmdState";
CM_ SG_ 980 Lamp_RtTrnLmpCmdSta "Lamp_RightTurnLampCmdState";
CM_ SG_ 980 Lamp_LftTrnLmpCmd "Lamp_LeftTrunLampCommand";
CM_ SG_ 980 Lamp_RtTrnLmpCmd "Lamp_RightTurnLampCommand";
CM_ SG_ 980 Lamp_TrnLmpMode "Lamp_TurnLampMode";
CM_ SG_ 980 Lamp_HzrdSwIND "Lamp_HazardSwitchIndicator";
CM_ SG_ 980 Lamp_HiPrioHzrdReq "Lamp_HighPriorityHazardRequest ##2G##BCM - BCMmsg19 - C_HazardFromBCMHigh";
CM_ SG_ 980 Lamp_LoPrioHzrdReq "Lamp_LowPriorityHazardStatus ##2G##BCM - BCMmsg19 - C_HazardfromBCMLow";
CM_ SG_ 980 Lamp_ExtrnlTailLmpOnReq "Lamp_ExternalTailLampOnRequest ##2G##BCM - BCMmsg19 - C_ExtTailOn";
CM_ SG_ 980 Lamp_HdLmpLoOnReq "Lamp_HeadLampLowOnRequest ##2G##BCM - BCMmsg19 - C_HLpLowOn";
CM_ SG_ 980 Lamp_HdLmpHiOnReq "Lamp_HeadLampHighOnRequest ##2G##BCM - BCMmsg19 - C_HLpHighOn";
CM_ SG_ 980 Lamp_FrFogLmpOnReq "Lamp_FrontFogLampOnRequest ##2G##BCM - BCMmsg19 - C_FrtFogOn";
CM_ SG_ 980 Lamp_RrFogLmpOnReq "Lamp_RearFogLampOnRequest ##2G##BCM - BCMmsg19 - C_RearFogOn";
CM_ SG_ 980 Lamp_StcBendingLmpLftOnReq "Lamp_StaticBendingLampLeftOnRequest ##2G##BCM - BCMmsg19 - C_StaticBendLhOn";
CM_ SG_ 980 Lamp_StcBendingLmpRtOnReq "Lamp_StaticBendingLampRightOnRequest ##2G##BCM - BCMmsg19 - C_StaticBendRhOn";
CM_ SG_ 980 Lamp_CornerLmpLftOnReq "Lamp_CorneringLampLeftOnRequest ##2G##BCM - BCMmsg19 - C_CorneringLpLhOn";
CM_ SG_ 980 Lamp_CornerLmpRtOnReq "Lamp_CorneringLampRightOnRequest ##2G##BCM - BCMmsg19 - C_CorneringLpRhOn";
CM_ SG_ 980 Lamp_HbaCtrlModTyp "Lamp_HbaControlModeType ##2G##BCM - BCMmsg22 - C_HBAControlMode";
CM_ SG_ 980 Lamp_IFSCtrlModTyp "Lamp_IFSControlModeType ##2G##BCM - BCMmsg22 - C_IFSControlMode";
CM_ SG_ 980 Lamp_HdLmpWlcmCmd "Lamp_HeadLampWelcomeOnCommand ##2G##BCM - BCMmsg19 - C_HLpWelcomeCmd";
CM_ SG_ 980 Lamp_PuddleLmpOnReq "Lamp_PuddleLampOnRequest ##2G##BCM - BCMmsg19 - C_PuddleLpOn";
CM_ SG_ 980 Lamp_IntTailLmpOnReq "Lamp_InternalTailLampOnRequest ##2G##BCM - BCMmsg19 - C_IntTailOn";
CM_ SG_ 980 Lamp_AvTailLmpSta "Lamp_AvTailLampStatus ##2G##BCM - BCMmsg18 - C_AvTail";
CM_ SG_ 980 Lamp_AutoLtSnsrNightSta "Lamp_AutoLightSensorNightStatus ##2G##BCM - BCMmsg24 - C_AutolightValue";
CM_ SG_ 980 Lamp_AutoLtSnsrHorVal "Lamp_AutoLightSensorHorValue ##2G##BCM - BCMmsg24 - C_AutolightSensorHorState";
BA_DEF_ BO_  "GenMsgEVName" STRING ;
BA_DEF_ BO_  "NmAsrMessage" ENUM  "No","Yes";
BA_DEF_ BO_  "DiagState" ENUM  "No","Yes";
BA_DEF_ BO_  "DiagRequest" ENUM  "No","Yes";
BA_DEF_ BO_  "TpMessage" ENUM  "No","Yes";
BA_DEF_ BO_  "UsrMsgIDSforwardDeviation" INT 0 100;
BA_DEF_ BO_  "UsrMsgIDSbackwardDeviation" INT 50 1000;
BA_DEF_ BO_  "GenMsgCycleTime" INT 0 2000;
BA_DEF_ BO_  "GenMsgStartDelayTime" INT 0 2000;
BA_DEF_ BO_  "GenMsgSendType" ENUM  "Cyclic","NoMsgSendType";
BA_DEF_ BO_  "GenMsgCycleTimeFast" INT 0 500;
BA_DEF_ BO_  "GenMsgDelayTime" INT 0 20;
BA_DEF_ BO_  "GenMsgILSupport" ENUM  "No","Yes";
BA_DEF_ BO_  "GenMsgNrOfRepetition" INT 0 3;
BA_DEF_ BO_  "VFrameFormat" ENUM  "StandardCAN","ExtendedCAN","reserved","reserved","reserved","reserved","reserved","reserved","reserved","reserved","reserved","reserved","reserved","reserved","StandardCAN_FD","ExtendedCAN_FD";
BA_DEF_ SG_  "UserSigValidity" ENUM  "B+","ACC","IG","IG1","IG2","IG3","IG1 or IG2","IG1 or IG3","Undef";
BA_DEF_ SG_  "TimeoutValue" STRING ;
BA_DEF_ SG_  "UsrSigPurpose" ENUM  "Undef","FN","DIAG","DIAG(Req)","DIAG(Res)","DIAG(Func)","DEV","CCP","NM","TP";
BA_DEF_ SG_  "GenSigStartValue" INT 0 1215752192;
BA_DEF_ SG_  "NetworkRequest" ENUM  "Yes","No";
BA_DEF_ SG_  "NetworkRequestHoldingTime" INT 0 65535;
BA_DEF_ SG_  "Description" STRING ;
BA_DEF_ SG_  "Version" STRING ;
BA_DEF_ SG_  "GenSigEnvVarType" ENUM  "Int","Float","Undef";
BA_DEF_ SG_  "GenSigSendType" ENUM  "Cyclic","OnWrite","OnWriteWithRepetition","OnChange","OnChangeWithRepetition","IfActive","IfActiveWithRepetition","NoSigSendType","OnChangeAndIfActive","OnChangeAndIfActiveWithRepetition";
BA_DEF_ SG_  "GwSigLatencyTime" INT 0 65536;
BA_DEF_ SG_  "GwSigMissingSourceType" ENUM  "Undef","OldValue","DefaultValue","InitialValue";
BA_DEF_ SG_  "NWM-WakeupAllowed" ENUM  "<n.a.>";
BA_DEF_ SG_  "RoutingFactor" INT 1 1215752192;
BA_DEF_ SG_  "SystemSignalLongSymbol" STRING ;
BA_DEF_REL_ BU_SG_REL_  "GenSigTimeoutTime" INT 0 7000;
BA_DEF_DEF_  "GenMsgEVName" "@Signame";
BA_DEF_DEF_  "NmAsrMessage" "No";
BA_DEF_DEF_  "DiagState" "No";
BA_DEF_DEF_  "DiagRequest" "No";
BA_DEF_DEF_  "TpMessage" "No";
BA_DEF_DEF_  "UsrMsgIDSforwardDeviation" 10;
BA_DEF_DEF_  "UsrMsgIDSbackwardDeviation" 100;
BA_DEF_DEF_  "GenMsgCycleTime" 200;
BA_DEF_DEF_  "GenMsgStartDelayTime" 0;
BA_DEF_DEF_  "GenMsgSendType" "NoMsgSendType";
BA_DEF_DEF_  "GenMsgCycleTimeFast" 40;
BA_DEF_DEF_  "GenMsgDelayTime" 20;
BA_DEF_DEF_  "GenMsgILSupport" "Yes";
BA_DEF_DEF_  "GenMsgNrOfRepetition" 3;
BA_DEF_DEF_  "VFrameFormat" "StandardCAN";
BA_DEF_DEF_  "UserSigValidity" "IG";
BA_DEF_DEF_  "TimeoutValue" "";
BA_DEF_DEF_  "UsrSigPurpose" "FN";
BA_DEF_DEF_  "GenSigStartValue" 0;
BA_DEF_DEF_  "NetworkRequest" "No";
BA_DEF_DEF_  "NetworkRequestHoldingTime" 0;
BA_DEF_DEF_  "Description" "";
BA_DEF_DEF_  "Version" "";
BA_DEF_DEF_  "GenSigEnvVarType" "Undef";
BA_DEF_DEF_  "GenSigSendType" "NoSigSendType";
BA_DEF_DEF_  "GwSigLatencyTime" 40;
BA_DEF_DEF_  "GwSigMissingSourceType" "Undef";
BA_DEF_DEF_  "NWM-WakeupAllowed" "<n.a.>";
BA_DEF_DEF_  "RoutingFactor" 1;
BA_DEF_DEF_REL_ "GenSigTimeoutTime" 500;
BA_DEF_DEF_  "SystemSignalLongSymbol" "";
BA_ "GenMsgNrOfRepetition" BO_ 101 0;
BA_ "GenMsgCycleTimeFast" BO_ 101 0;
BA_ "GenMsgCycleTime" BO_ 101 50;
BA_ "GenMsgSendType" BO_ 101 0;
BA_ "VFrameFormat" BO_ 101 14;
BA_ "GenMsgStartDelayTime" BO_ 1071 70;
BA_ "GenMsgCycleTime" BO_ 1071 600;
BA_ "GenMsgSendType" BO_ 1071 0;
BA_ "VFrameFormat" BO_ 1071 14;
BA_ "GenMsgNrOfRepetition" BO_ 704 0;
BA_ "GenMsgCycleTimeFast" BO_ 704 0;
BA_ "GenMsgSendType" BO_ 704 0;
BA_ "VFrameFormat" BO_ 704 14;
BA_ "GenMsgSendType" BO_ 979 0;
BA_ "VFrameFormat" BO_ 979 14;
BA_ "GenMsgStartDelayTime" BO_ 1059 20;
BA_ "GenMsgCycleTime" BO_ 1059 1000;
BA_ "GenMsgSendType" BO_ 1059 0;
BA_ "VFrameFormat" BO_ 1059 14;
BA_ "GenMsgStartDelayTime" BO_ 983 20;
BA_ "GenMsgSendType" BO_ 983 0;
BA_ "VFrameFormat" BO_ 983 14;
BA_ "GenMsgNrOfRepetition" BO_ 861 0;
BA_ "GenMsgCycleTimeFast" BO_ 861 0;
BA_ "GenMsgCycleTime" BO_ 861 300;
BA_ "GenMsgSendType" BO_ 861 0;
BA_ "VFrameFormat" BO_ 861 14;
BA_ "GenMsgStartDelayTime" BO_ 980 10;
BA_ "GenMsgSendType" BO_ 980 0;
BA_ "VFrameFormat" BO_ 980 14;
BA_ "Version" SG_ 101 IEB_Crc1Val "21.09.03";
BA_ "RoutingFactor" SG_ 101 IEB_Crc1Val 5;
BA_ "UserSigValidity" SG_ 101 IEB_Crc1Val 3;
BA_ "GenSigStartValue" SG_ 101 IEB_Crc1Val 65535;
BA_ "Description" SG_ 101 IEB_Crc1Val "The data area for CRC calculation is based on the data length (DLC) of the message DB.

The CRC shall be calculated over the entire data block (excluding the CRC bytes) including the user data, alive counter and Data ID



- CRC Polynomial (0x1021) , Ini";
BA_ "Version" SG_ 101 IEB_StrkDpthPcVal "19.05.02";
BA_ "RoutingFactor" SG_ 101 IEB_StrkDpthPcVal 5;
BA_ "UserSigValidity" SG_ 101 IEB_StrkDpthPcVal 3;
BA_ "Description" SG_ 101 IEB_StrkDpthPcVal "Brake Pedal Stroke Depth";
BA_ "Version" SG_ 101 IEB_EstDpthPcVal "19.05.02";
BA_ "RoutingFactor" SG_ 101 IEB_EstDpthPcVal 5;
BA_ "UserSigValidity" SG_ 101 IEB_EstDpthPcVal 3;
BA_ "Description" SG_ 101 IEB_EstDpthPcVal "Estimated Brake Pedal Depth for SCC";
BA_ "Version" SG_ 101 IEB_AbsNGearReq "19.05.02";
BA_ "RoutingFactor" SG_ 101 IEB_AbsNGearReq 5;
BA_ "UserSigValidity" SG_ 101 IEB_AbsNGearReq 3;
BA_ "Description" SG_ 101 IEB_AbsNGearReq "indigates N gear position request while ABS activation";
BA_ "Version" SG_ 101 IEB_EstBrkPdlValVldSta "19.05.02";
BA_ "RoutingFactor" SG_ 101 IEB_EstBrkPdlValVldSta 5;
BA_ "UserSigValidity" SG_ 101 IEB_EstBrkPdlValVldSta 3;
BA_ "GenSigStartValue" SG_ 101 IEB_EstBrkPdlValVldSta 1;
BA_ "Description" SG_ 101 IEB_EstBrkPdlValVldSta "Estimated Brake pedal value Validity";
BA_ "Version" SG_ 101 IEB_FRAmode_Req "22.10.20";
BA_ "RoutingFactor" SG_ 101 IEB_FRAmode_Req 5;
BA_ "UserSigValidity" SG_ 101 IEB_FRAmode_Req 3;
BA_ "Description" SG_ 101 IEB_FRAmode_Req "This signal requests braking load reduction logic when braking the ABS based on an electric vehicle";
BA_ "Version" SG_ 101 IEB_RegenTqLimitNmVal_Rear "19.05.03";
BA_ "RoutingFactor" SG_ 101 IEB_RegenTqLimitNmVal_Rear 5;
BA_ "UserSigValidity" SG_ 101 IEB_RegenTqLimitNmVal_Rear 3;
BA_ "Description" SG_ 101 IEB_RegenTqLimitNmVal_Rear "Regen Brake Torque limit at rear wheel";
BA_ "Version" SG_ 101 IEB_DrvWhlSlipFlg_Frnt "20.10.02";
BA_ "RoutingFactor" SG_ 101 IEB_DrvWhlSlipFlg_Frnt 5;
BA_ "UserSigValidity" SG_ 101 IEB_DrvWhlSlipFlg_Frnt 3;
BA_ "Description" SG_ 101 IEB_DrvWhlSlipFlg_Frnt "This signal is to indicate the slip status of the driving wheels.";
BA_ "Version" SG_ 101 IEB_IndDriftMode "22.02.04";
BA_ "RoutingFactor" SG_ 101 IEB_IndDriftMode 5;
BA_ "UserSigValidity" SG_ 101 IEB_IndDriftMode 3;
BA_ "Description" SG_ 101 IEB_IndDriftMode "Signal for feedback from AVNT drift mode ON/OFF command";
BA_ "Version" SG_ 101 IEB_RmcReqFrnt "25.04.01";
BA_ "RoutingFactor" SG_ 101 IEB_RmcReqFrnt 5;
BA_ "UserSigValidity" SG_ 101 IEB_RmcReqFrnt 3;
BA_ "Description" SG_ 101 IEB_RmcReqFrnt "This signal indicates RMC status at front wheel.";
BA_ "Version" SG_ 101 IEB_RmcReqRear "25.04.01";
BA_ "RoutingFactor" SG_ 101 IEB_RmcReqRear 5;
BA_ "UserSigValidity" SG_ 101 IEB_RmcReqRear 3;
BA_ "Description" SG_ 101 IEB_RmcReqRear "This signal indicates RMC status at rear wheel.";
BA_ "Version" SG_ 101 IEB_TCS_Req "20.04.05";
BA_ "RoutingFactor" SG_ 101 IEB_TCS_Req 5;
BA_ "UserSigValidity" SG_ 101 IEB_TCS_Req 3;
BA_ "Description" SG_ 101 IEB_TCS_Req "이 신호는 IEB_01_10ms 메시지의 TCS 토크 신호에 대한 Validity를 의미한다.



0x1 : TCS_TqIntrvntnVal_Frnt, TCS_TqIntrvntnVal_Rear 신호에 의한 TCS 제어

0x2 : TCS_MtrTrgtRpm_Frnt, TCS_MtrTrgtRpm_Rear 신호에 의한 TCS 제어";
BA_ "Version" SG_ 101 IEB_RSC_Req "22.01.02";
BA_ "RoutingFactor" SG_ 101 IEB_RSC_Req 5;
BA_ "UserSigValidity" SG_ 101 IEB_RSC_Req 3;
BA_ "Description" SG_ 101 IEB_RSC_Req "Validity of RSC torque signal from IEB_01_10ms";
BA_ "Version" SG_ 101 TCS_TqFlag_Frnt "19.05.03";
BA_ "RoutingFactor" SG_ 101 TCS_TqFlag_Frnt 5;
BA_ "UserSigValidity" SG_ 101 TCS_TqFlag_Frnt 3;
BA_ "Description" SG_ 101 TCS_TqFlag_Frnt "이 신호는 IEB_01_10ms 메시지의 TCS 전륜 토크 신호에 대한 부호를 의미한다.";
BA_ "Version" SG_ 101 TCS_TqFlag_Rear "19.05.03";
BA_ "RoutingFactor" SG_ 101 TCS_TqFlag_Rear 5;
BA_ "UserSigValidity" SG_ 101 TCS_TqFlag_Rear 3;
BA_ "Description" SG_ 101 TCS_TqFlag_Rear "이 신호는 IEB_01_10ms 메시지의 TCS 후륜 토크 신호에 대한 부호를 의미한다.";
BA_ "Version" SG_ 101 RSC_TqFlag_Frnt "19.05.03";
BA_ "RoutingFactor" SG_ 101 RSC_TqFlag_Frnt 5;
BA_ "UserSigValidity" SG_ 101 RSC_TqFlag_Frnt 3;
BA_ "Description" SG_ 101 RSC_TqFlag_Frnt "이 신호는 IEB_01_10ms 메시지의 RSC 전륜 토크 신호에 대한 부호를 의미한다.";
BA_ "Version" SG_ 101 RSC_TqFlag_Rear "19.05.03";
BA_ "RoutingFactor" SG_ 101 RSC_TqFlag_Rear 5;
BA_ "UserSigValidity" SG_ 101 RSC_TqFlag_Rear 3;
BA_ "Description" SG_ 101 RSC_TqFlag_Rear "이 신호는 IEB_01_10ms 메시지의 RSC 후륜 토크 신호에 대한 부호를 의미한다.";
BA_ "Version" SG_ 101 IEB_AlvCnt1Val "21.09.03";
BA_ "RoutingFactor" SG_ 101 IEB_AlvCnt1Val 5;
BA_ "UserSigValidity" SG_ 101 IEB_AlvCnt1Val 3;
BA_ "Description" SG_ 101 IEB_AlvCnt1Val "For the first transmission request for a data element the counter shall be initialized with 0 and shall be incremented by 1 for every subsequent send request. 

When the counter reaches the maximum value(0xFF), then it shall restart with 0 for the next s";
BA_ "Version" SG_ 101 TCS_TqIntrvntnVal_Frnt "19.05.03";
BA_ "RoutingFactor" SG_ 101 TCS_TqIntrvntnVal_Frnt 5;
BA_ "UserSigValidity" SG_ 101 TCS_TqIntrvntnVal_Frnt 3;
BA_ "Description" SG_ 101 TCS_TqIntrvntnVal_Frnt "TCS 제어를 위한 전륜 구동토크의 요구값을 의미.

부호는 TCS_TqFlag_Frnt 신호를 참조.";
BA_ "Version" SG_ 101 TCS_TqIntrvntnVal_Rear "19.05.03";
BA_ "RoutingFactor" SG_ 101 TCS_TqIntrvntnVal_Rear 5;
BA_ "UserSigValidity" SG_ 101 TCS_TqIntrvntnVal_Rear 3;
BA_ "Description" SG_ 101 TCS_TqIntrvntnVal_Rear "TCS 제어를 위한 후륜 구동토크의 요구값을 의미.

부호는 TCS_TqFlag_Rear 신호를 참조.";
BA_ "Version" SG_ 101 RSC_TqIntrvntnVal_Frnt "19.05.03";
BA_ "RoutingFactor" SG_ 101 RSC_TqIntrvntnVal_Frnt 5;
BA_ "UserSigValidity" SG_ 101 RSC_TqIntrvntnVal_Frnt 3;
BA_ "Description" SG_ 101 RSC_TqIntrvntnVal_Frnt "RSC 제어를 위한 전륜 구동토크의 요구값을 의미.

부호는 RSC_TqFlag_Frnt 신호를 참조.";
BA_ "Version" SG_ 101 RSC_TqIntrvntnVal_Rear "19.05.03";
BA_ "RoutingFactor" SG_ 101 RSC_TqIntrvntnVal_Rear 5;
BA_ "UserSigValidity" SG_ 101 RSC_TqIntrvntnVal_Rear 3;
BA_ "Description" SG_ 101 RSC_TqIntrvntnVal_Rear "RSC 제어를 위한 후륜 구동토크의 요구값을 의미.

부호는 RSC_TqFlag_Rear 신호를 참조.";
BA_ "Version" SG_ 101 TCS_MtrTrgtRpm_Flag_Frnt "20.04.05";
BA_ "RoutingFactor" SG_ 101 TCS_MtrTrgtRpm_Flag_Frnt 5;
BA_ "UserSigValidity" SG_ 101 TCS_MtrTrgtRpm_Flag_Frnt 3;
BA_ "Description" SG_ 101 TCS_MtrTrgtRpm_Flag_Frnt "이 신호는 IEB_01_10ms 메시지의 TCS 작동시 전륜 모터의 타겟 RPM 신호(TCS_MtrTrgtRpm_Frnt)에 대한 부호를 의미한다.";
BA_ "Version" SG_ 101 TCS_MtrTrgtRpm_Flag_Rear "20.04.05";
BA_ "RoutingFactor" SG_ 101 TCS_MtrTrgtRpm_Flag_Rear 5;
BA_ "UserSigValidity" SG_ 101 TCS_MtrTrgtRpm_Flag_Rear 3;
BA_ "Description" SG_ 101 TCS_MtrTrgtRpm_Flag_Rear "이 신호는 IEB_01_10ms 메시지의 TCS 작동시 후륜 모터의 타겟 RPM 신호(TCS_MtrTrgtRpm_Rear)에 대한 부호를 의미한다.";
BA_ "Version" SG_ 101 IEB_DriftElsdModSta "24.05.01";
BA_ "RoutingFactor" SG_ 101 IEB_DriftElsdModSta 5;
BA_ "UserSigValidity" SG_ 101 IEB_DriftElsdModSta 3;
BA_ "Description" SG_ 101 IEB_DriftElsdModSta "ELSD mode command from DMIC by AVNT custom mode select";
BA_ "Version" SG_ 101 IEB_DriftEcsModSta "22.07.06";
BA_ "RoutingFactor" SG_ 101 IEB_DriftEcsModSta 5;
BA_ "UserSigValidity" SG_ 101 IEB_DriftEcsModSta 3;
BA_ "Description" SG_ 101 IEB_DriftEcsModSta "ECS mode command from DMIC by AVNT custom mode select";
BA_ "Version" SG_ 101 IEB_DriftMdpsModSta "22.07.06";
BA_ "RoutingFactor" SG_ 101 IEB_DriftMdpsModSta 5;
BA_ "UserSigValidity" SG_ 101 IEB_DriftMdpsModSta 3;
BA_ "Description" SG_ 101 IEB_DriftMdpsModSta "MDPS mode command from DMIC by AVNT custom mode select";
BA_ "Version" SG_ 101 TCS_MtrTrgtRpm_Frnt "20.04.05";
BA_ "RoutingFactor" SG_ 101 TCS_MtrTrgtRpm_Frnt 5;
BA_ "UserSigValidity" SG_ 101 TCS_MtrTrgtRpm_Frnt 3;
BA_ "Description" SG_ 101 TCS_MtrTrgtRpm_Frnt "TCS 제어를 위한 전륜 모터의 RPM 요구값을 의미.

부호는 TCS_MtrTrgtRpm_Flag_Frnt 신호를 참조.";
BA_ "Version" SG_ 101 TCS_MtrTrgtRpm_Rear "20.04.05";
BA_ "RoutingFactor" SG_ 101 TCS_MtrTrgtRpm_Rear 5;
BA_ "UserSigValidity" SG_ 101 TCS_MtrTrgtRpm_Rear 3;
BA_ "Description" SG_ 101 TCS_MtrTrgtRpm_Rear "TCS 제어를 위한 후륜 모터의 RPM 요구값을 의미.

부호는 TCS_MtrTrgtRpm_Flag_Rear 신호를 참조.";
BA_ "Version" SG_ 101 IEB_DriftModeSta "20.12.02";
BA_ "RoutingFactor" SG_ 101 IEB_DriftModeSta 5;
BA_ "UserSigValidity" SG_ 101 IEB_DriftModeSta 3;
BA_ "Description" SG_ 101 IEB_DriftModeSta "This signal is for a pop-up display on drift mode.";
BA_ "Version" SG_ 101 IEB_DriftModeActSta "20.12.02";
BA_ "RoutingFactor" SG_ 101 IEB_DriftModeActSta 5;
BA_ "UserSigValidity" SG_ 101 IEB_DriftModeActSta 3;
BA_ "Description" SG_ 101 IEB_DriftModeActSta "This signal is for drift mode ON/OFF status";
BA_ "Version" SG_ 101 MCU_AntiJerk_Inhbtsta "22.11.03";
BA_ "RoutingFactor" SG_ 101 MCU_AntiJerk_Inhbtsta 5;
BA_ "UserSigValidity" SG_ 101 MCU_AntiJerk_Inhbtsta 3;
BA_ "Description" SG_ 101 MCU_AntiJerk_Inhbtsta "MCU_AntiJerk_Inhbtsta is a signal to inform the MCU of anti-jerk control prohibition in order to prevent side effects caused by intervention in the IEB when ABS control and MCU anti-jerk control overlap.";
BA_ "Version" SG_ 101 IEB_Motor_ProtectModSta "22.08.03";
BA_ "RoutingFactor" SG_ 101 IEB_Motor_ProtectModSta 5;
BA_ "UserSigValidity" SG_ 101 IEB_Motor_ProtectModSta 3;
BA_ "Description" SG_ 101 IEB_Motor_ProtectModSta "It is a signal to notify when the internal motor protection mode of the electric integrated booster is activated.

When the corresponding signal becomes a flag (0x1), the braking pressure is limited to a maximum of 60bar in the stop state.

It is not aff";
BA_ "Version" SG_ 101 IEB_EstBrkSacFrcNmVal "21.11.00";
BA_ "RoutingFactor" SG_ 101 IEB_EstBrkSacFrcNmVal 5;
BA_ "UserSigValidity" SG_ 101 IEB_EstBrkSacFrcNmVal 3;
BA_ "Description" SG_ 101 IEB_EstBrkSacFrcNmVal "Estimated brake force value for stop assist control";
BA_ "Version" SG_ 101 IEB_SrvLmpDis "19.05.02";
BA_ "RoutingFactor" SG_ 101 IEB_SrvLmpDis 5;
BA_ "UserSigValidity" SG_ 101 IEB_SrvLmpDis 3;
BA_ "Description" SG_ 101 IEB_SrvLmpDis "The signal indicates the status of the “AHB Service lamp”";
BA_ "Version" SG_ 101 IEB_IndDriftEscModSta_TCS "22.07.06";
BA_ "RoutingFactor" SG_ 101 IEB_IndDriftEscModSta_TCS 5;
BA_ "UserSigValidity" SG_ 101 IEB_IndDriftEscModSta_TCS 3;
BA_ "Description" SG_ 101 IEB_IndDriftEscModSta_TCS "Signal for feed back of TCS mode change from DMIC by AVNT custom mode select";
BA_ "Version" SG_ 101 IEB_IndDriftEscModSta_VDC "24.04.06";
BA_ "RoutingFactor" SG_ 101 IEB_IndDriftEscModSta_VDC 5;
BA_ "UserSigValidity" SG_ 101 IEB_IndDriftEscModSta_VDC 3;
BA_ "Description" SG_ 101 IEB_IndDriftEscModSta_VDC "Signal for feed back of ESC/VDC mode command from DMIC by AVNT custom mode select";
BA_ "Version" SG_ 101 IEB_DfctvSta "19.05.02";
BA_ "RoutingFactor" SG_ 101 IEB_DfctvSta 5;
BA_ "UserSigValidity" SG_ 101 IEB_DfctvSta 3;
BA_ "Description" SG_ 101 IEB_DfctvSta "Information regarding the AHB 'defective' indication.";
BA_ "Version" SG_ 101 IEB_ActvSta "19.05.02";
BA_ "RoutingFactor" SG_ 101 IEB_ActvSta 5;
BA_ "UserSigValidity" SG_ 101 IEB_ActvSta 3;
BA_ "Description" SG_ 101 IEB_ActvSta "Information regarding AHB “Control Active” signal";
BA_ "Version" SG_ 101 IEB_DiagSta "19.05.02";
BA_ "RoutingFactor" SG_ 101 IEB_DiagSta 5;
BA_ "UserSigValidity" SG_ 101 IEB_DiagSta 3;
BA_ "Description" SG_ 101 IEB_DiagSta "Information regarding the AHB “diagnostic mode” indication.";
BA_ "Version" SG_ 101 IEB_WrngLmpDis "19.05.02";
BA_ "RoutingFactor" SG_ 101 IEB_WrngLmpDis 5;
BA_ "UserSigValidity" SG_ 101 IEB_WrngLmpDis 3;
BA_ "Description" SG_ 101 IEB_WrngLmpDis "The signal indicates the status of the “AHB Warning lamp”";
BA_ "Version" SG_ 101 IEB_MILReq "19.05.02";
BA_ "RoutingFactor" SG_ 101 IEB_MILReq 5;
BA_ "UserSigValidity" SG_ 101 IEB_MILReq 3;
BA_ "Description" SG_ 101 IEB_MILReq "IEB sends this signal to turn on the Malfunction Indicator Lamp (MIL).";
BA_ "Version" SG_ 101 IEB_DriftModeStaDis "22.11.03";
BA_ "RoutingFactor" SG_ 101 IEB_DriftModeStaDis 5;
BA_ "UserSigValidity" SG_ 101 IEB_DriftModeStaDis 3;
BA_ "Description" SG_ 101 IEB_DriftModeStaDis "This signal is for a pop-up display on restriction status of drift mode activation";
BA_ "Version" SG_ 101 RSC_Sta "23.04.06";
BA_ "RoutingFactor" SG_ 101 RSC_Sta 5;
BA_ "UserSigValidity" SG_ 101 RSC_Sta 3;
BA_ "Description" SG_ 101 RSC_Sta "RSC Ready Status";
BA_ "Version" SG_ 101 IEB_StrkDpthmmVal "19.05.02";
BA_ "RoutingFactor" SG_ 101 IEB_StrkDpthmmVal 5;
BA_ "UserSigValidity" SG_ 101 IEB_StrkDpthmmVal 3;
BA_ "Description" SG_ 101 IEB_StrkDpthmmVal "The signal indicates the depth of brake pedal";
BA_ "Version" SG_ 101 IEB_BrkActvSta "19.05.05";
BA_ "RoutingFactor" SG_ 101 IEB_BrkActvSta 5;
BA_ "UserSigValidity" SG_ 101 IEB_BrkActvSta 3;
BA_ "Description" SG_ 101 IEB_BrkActvSta "This signal indicates that a brake switch is activated or not. When the brake switch is activated(pressed) its value is 02H otherwise its value is 01H.

If the ECU does not support this signal the value is 00H.



이 신호는 EV, FCEV 에서만 사용될 수 있음";
BA_ "Version" SG_ 101 IEB_PdlTrvlSnsrFailSta "19.05.02";
BA_ "RoutingFactor" SG_ 101 IEB_PdlTrvlSnsrFailSta 5;
BA_ "UserSigValidity" SG_ 101 IEB_PdlTrvlSnsrFailSta 3;
BA_ "Description" SG_ 101 IEB_PdlTrvlSnsrFailSta "Information regarding the pedal travel sensor fail status";
BA_ "Version" SG_ 101 IEB_PdlCalibSta "19.05.02";
BA_ "RoutingFactor" SG_ 101 IEB_PdlCalibSta 5;
BA_ "UserSigValidity" SG_ 101 IEB_PdlCalibSta 3;
BA_ "Description" SG_ 101 IEB_PdlCalibSta "Information regarding the pedal travel sensor’s calibration status";
BA_ "Version" SG_ 101 IEB_BzrSta "19.05.02";
BA_ "RoutingFactor" SG_ 101 IEB_BzrSta 5;
BA_ "UserSigValidity" SG_ 101 IEB_BzrSta 3;
BA_ "Description" SG_ 101 IEB_BzrSta "The signal indicates the status of the “Buzzer”";
BA_ "Version" SG_ 101 IEB_Sta "19.06.01";
BA_ "RoutingFactor" SG_ 101 IEB_Sta 5;
BA_ "UserSigValidity" SG_ 101 IEB_Sta 3;
BA_ "Description" SG_ 101 IEB_Sta "EBS Ready Status

※ 전/후륜에 대한 구분이 없는 경우에는 0x0 (Not Ready) / 0x1(Ready) 만 사용한다.

     : 전륜 구동 회생제동 차량의 경우, 0x0 는 Front not Ready / 0x1은 Front only Ready를 의미함.";
BA_ "Version" SG_ 101 IEB_SnsrFailSta "19.05.02";
BA_ "RoutingFactor" SG_ 101 IEB_SnsrFailSta 5;
BA_ "UserSigValidity" SG_ 101 IEB_SnsrFailSta 3;
BA_ "Version" SG_ 101 IEB_RbsWrngLmpSta "19.05.02";
BA_ "RoutingFactor" SG_ 101 IEB_RbsWrngLmpSta 5;
BA_ "UserSigValidity" SG_ 101 IEB_RbsWrngLmpSta 3;
BA_ "Description" SG_ 101 IEB_RbsWrngLmpSta "This signal indicates RBS warning lamp status.";
BA_ "Version" SG_ 101 IEB_VacSysDfctvSta "19.05.02";
BA_ "RoutingFactor" SG_ 101 IEB_VacSysDfctvSta 5;
BA_ "UserSigValidity" SG_ 101 IEB_VacSysDfctvSta 3;
BA_ "Description" SG_ 101 IEB_VacSysDfctvSta "This signal indicates Vacuum pump “defective”.";
BA_ "Version" SG_ 101 IEB_RegenTqLimitNmVal_Frnt "19.05.03";
BA_ "RoutingFactor" SG_ 101 IEB_RegenTqLimitNmVal_Frnt 5;
BA_ "UserSigValidity" SG_ 101 IEB_RegenTqLimitNmVal_Frnt 3;
BA_ "Description" SG_ 101 IEB_RegenTqLimitNmVal_Frnt "Regen Brake Torque limit at front wheel";
BA_ "Version" SG_ 101 IEB_EstTtlBrkFrcNmVal "19.05.02";
BA_ "RoutingFactor" SG_ 101 IEB_EstTtlBrkFrcNmVal 5;
BA_ "UserSigValidity" SG_ 101 IEB_EstTtlBrkFrcNmVal 3;
BA_ "Description" SG_ 101 IEB_EstTtlBrkFrcNmVal "Estimated Total Brake Force";
BA_ "Version" SG_ 1071 HU_AVM_Crc3Val "22.10.20";
BA_ "UserSigValidity" SG_ 1071 HU_AVM_Crc3Val 3;
BA_ "GenSigStartValue" SG_ 1071 HU_AVM_Crc3Val 65535;
BA_ "GenSigSendType" SG_ 1071 HU_AVM_Crc3Val 4;
BA_ "Description" SG_ 1071 HU_AVM_Crc3Val "The data area for CRC calculation is based on the data length (DLC) of the message DB.

The CRC shall be calculated over the entire data block (excluding the CRC bytes) including the user data, alive counter and Data ID



- CRC Polynomial (0x1021) , Ini";
BA_ "Version" SG_ 1071 HU_SVM_ccp_pan "22.07.05";
BA_ "UserSigValidity" SG_ 1071 HU_SVM_ccp_pan 3;
BA_ "GenSigSendType" SG_ 1071 HU_SVM_ccp_pan 4;
BA_ "Description" SG_ 1071 HU_SVM_ccp_pan "This value is a number of CCP rotation movement steps during specific period (Ps),

Range : -7~+8 (Positive: CW, Negative: CCW)";
BA_ "Version" SG_ 1071 HU_AVM_AlvCnt3Val "22.10.20";
BA_ "UserSigValidity" SG_ 1071 HU_AVM_AlvCnt3Val 3;
BA_ "GenSigSendType" SG_ 1071 HU_AVM_AlvCnt3Val 4;
BA_ "Description" SG_ 1071 HU_AVM_AlvCnt3Val "For the first transmission request for a data element the counter shall be initialized with 0 and shall be incremented by 1 for every subsequent send request. 

When the counter reaches the maximum value(0xFF), then it shall restart with 0 for the next s";
BA_ "Version" SG_ 1071 HU_SVMTopViewDispSta "22.07.05";
BA_ "UserSigValidity" SG_ 1071 HU_SVMTopViewDispSta 3;
BA_ "GenSigSendType" SG_ 1071 HU_SVMTopViewDispSta 4;
BA_ "Description" SG_ 1071 HU_SVMTopViewDispSta "SVM Top View displaying status on AVNT";
BA_ "Version" SG_ 1071 HU_SVM_ccp_pan_valid "22.07.05";
BA_ "UserSigValidity" SG_ 1071 HU_SVM_ccp_pan_valid 3;
BA_ "GenSigSendType" SG_ 1071 HU_SVM_ccp_pan_valid 4;
BA_ "Description" SG_ 1071 HU_SVM_ccp_pan_valid "This signal determines the validity of CCP rotation movement";
BA_ "Version" SG_ 1071 SVM_CaptureModeCMD "22.07.05";
BA_ "NetworkRequest" SG_ 1071 SVM_CaptureModeCMD 0;
BA_ "UserSigValidity" SG_ 1071 SVM_CaptureModeCMD 0;
BA_ "GenSigStartValue" SG_ 1071 SVM_CaptureModeCMD 3;
BA_ "GenSigSendType" SG_ 1071 SVM_CaptureModeCMD 4;
BA_ "Description" SG_ 1071 SVM_CaptureModeCMD "SVM Wake Up & Capture Mode On Signal";
BA_ "Version" SG_ 704 VCU_Crc6Val "19.07.01";
BA_ "UserSigValidity" SG_ 704 VCU_Crc6Val 3;
BA_ "GenSigStartValue" SG_ 704 VCU_Crc6Val 65535;
BA_ "Description" SG_ 704 VCU_Crc6Val "The data area for CRC calculation is based on the data length (DLC) of the message DB.

The CRC shall be calculated over the entire data block (excluding the CRC bytes) including the user data, alive counter and Data ID

 

- CRC Polynomial (0x1021) , In";
BA_ "Version" SG_ 704 VCU_BstWarnMsg "22.10.19";
BA_ "UserSigValidity" SG_ 704 VCU_BstWarnMsg 7;
BA_ "TimeoutValue" SG_ 704 VCU_BstWarnMsg "0x0";
BA_ "Description" SG_ 704 VCU_BstWarnMsg "Boost function's warning message";
BA_ "Version" SG_ 704 VCU_BstAvailSta "20.09.00";
BA_ "UserSigValidity" SG_ 704 VCU_BstAvailSta 7;
BA_ "Description" SG_ 704 VCU_BstAvailSta "Boost function's available status";
BA_ "Version" SG_ 704 VCU_BstAplySta "20.10.00";
BA_ "UserSigValidity" SG_ 704 VCU_BstAplySta 7;
BA_ "Description" SG_ 704 VCU_BstAplySta "Boost function's apply status";
BA_ "Version" SG_ 704 VCU_MxPwrMdSta "21.12.05";
BA_ "UserSigValidity" SG_ 704 VCU_MxPwrMdSta 7;
BA_ "Description" SG_ 704 VCU_MxPwrMdSta "Max Power Mode State";
BA_ "Version" SG_ 704 VCU_MxPwrMdSegVal "21.12.05";
BA_ "UserSigValidity" SG_ 704 VCU_MxPwrMdSegVal 7;
BA_ "Description" SG_ 704 VCU_MxPwrMdSegVal "Max Power Mode Segement Value";
BA_ "Version" SG_ 704 VCU_MxPwrMdOSD "22.01.00";
BA_ "UserSigValidity" SG_ 704 VCU_MxPwrMdOSD 7;
BA_ "Description" SG_ 704 VCU_MxPwrMdOSD "Max Power Mode Related SS OSD Pop-up request";
BA_ "Version" SG_ 704 VCU_PwrDnByHoodOpenSta "22.01.06";
BA_ "UserSigValidity" SG_ 704 VCU_PwrDnByHoodOpenSta 7;
BA_ "Description" SG_ 704 VCU_PwrDnByHoodOpenSta "Power Down Status By Hood Open";
BA_ "Version" SG_ 704 VCU_FlatTowModeConIndSta "23.07.05";
BA_ "UserSigValidity" SG_ 704 VCU_FlatTowModeConIndSta 3;
BA_ "Description" SG_ 704 VCU_FlatTowModeConIndSta "FlatTowMode Condition State";
BA_ "Version" SG_ 704 VCU_VgsVirAGIUpGear "22.10.19";
BA_ "UserSigValidity" SG_ 704 VCU_VgsVirAGIUpGear 7;
BA_ "Description" SG_ 704 VCU_VgsVirAGIUpGear "AGI)Available Gear Indicator) Gear capable of upshifting";
BA_ "Version" SG_ 704 VCU_VgsVirAGIDnGear "22.10.19";
BA_ "UserSigValidity" SG_ 704 VCU_VgsVirAGIDnGear 7;
BA_ "Description" SG_ 704 VCU_VgsVirAGIDnGear "AGI)Available Gear Indicator) Gear capable of downshifting";
BA_ "Version" SG_ 704 VCU_NCstmBrkOvrSta "22.08.00";
BA_ "UserSigValidity" SG_ 704 VCU_NCstmBrkOvrSta 7;
BA_ "Description" SG_ 704 VCU_NCstmBrkOvrSta "The Brake override system could be deactivated by a driver";
BA_ "Version" SG_ 704 VCU_NCondDragSta "22.07.06";
BA_ "UserSigValidity" SG_ 704 VCU_NCondDragSta 7;
BA_ "Description" SG_ 704 VCU_NCondDragSta "N-Conditioning/Drag Mode State";
BA_ "Version" SG_ 704 VCU_NCondDragSegVal "22.07.06";
BA_ "UserSigValidity" SG_ 704 VCU_NCondDragSegVal 7;
BA_ "Description" SG_ 704 VCU_NCondDragSegVal "NConditioning Drag Mode Segement Value";
BA_ "Version" SG_ 704 VCU_NCondTrackSta "22.07.06";
BA_ "UserSigValidity" SG_ 704 VCU_NCondTrackSta 7;
BA_ "Description" SG_ 704 VCU_NCondTrackSta "N Conditioning Track Mode State";
BA_ "Version" SG_ 704 VCU_NCondTrackTimeVal "22.07.06";
BA_ "UserSigValidity" SG_ 704 VCU_NCondTrackTimeVal 7;
BA_ "Description" SG_ 704 VCU_NCondTrackTimeVal "N Conditioning Track Mode Estimated Time Value";
BA_ "Version" SG_ 704 VCU_NCondOSD "22.07.06";
BA_ "UserSigValidity" SG_ 704 VCU_NCondOSD 7;
BA_ "Description" SG_ 704 VCU_NCondOSD "N Conditioning Related SS OSD Pop-up request";
BA_ "Version" SG_ 704 VCU_ExpUnitEnrgCnsmptnVal "23.02.09";
BA_ "UserSigValidity" SG_ 704 VCU_ExpUnitEnrgCnsmptnVal 7;
BA_ "Description" SG_ 704 VCU_ExpUnitEnrgCnsmptnVal "Expected energy consumption per km.

The resolution is 10.



- 0xFF:Error indicator

- 0x0~0xFE:0~2540";
BA_ "Version" SG_ 704 VCU_AlvCnt6Val "19.07.01";
BA_ "UserSigValidity" SG_ 704 VCU_AlvCnt6Val 3;
BA_ "Description" SG_ 704 VCU_AlvCnt6Val "For the first transmission request for a data element the counter shall be initialized with 0 and shall be incremented by 1 for every subsequent send request. 

When the counter reaches the maximum value(0xFF), then it shall restart with 0 for the next s";
BA_ "Version" SG_ 704 VCU_FlatTowModeChgPwrUsmSta "23.07.05";
BA_ "UserSigValidity" SG_ 704 VCU_FlatTowModeChgPwrUsmSta 3;
BA_ "Description" SG_ 704 VCU_FlatTowModeChgPwrUsmSta "Charging Power for FlatTow";
BA_ "Version" SG_ 704 VCU_NCstmHighPefMdWarnMsg "23.02.02";
BA_ "UserSigValidity" SG_ 704 VCU_NCstmHighPefMdWarnMsg 7;
BA_ "Description" SG_ 704 VCU_NCstmHighPefMdWarnMsg "High Performance mode Warning Message";
BA_ "Version" SG_ 704 VCU_NCstmNtdUsmSta "23.02.02";
BA_ "UserSigValidity" SG_ 704 VCU_NCstmNtdUsmSta 7;
BA_ "Description" SG_ 704 VCU_NCstmNtdUsmSta "N Torque Distribition mode activation State(for High Performance vehicle USM)";
BA_ "Version" SG_ 704 VCU_EstRoadSlopeValue "22.12.04";
BA_ "UserSigValidity" SG_ 704 VCU_EstRoadSlopeValue 3;
BA_ "Description" SG_ 704 VCU_EstRoadSlopeValue "0x0~0xFE:Slope, 0xFF:Error";
BA_ "Version" SG_ 704 VCU_DteV2LVal "23.01.01";
BA_ "UserSigValidity" SG_ 704 VCU_DteV2LVal 7;
BA_ "Description" SG_ 704 VCU_DteV2LVal "This signal is the V2L DTE when V2L SOC value is limited";
BA_ "Version" SG_ 704 VCU_TrgFuelEcoVal_PerkWh "23.01.01";
BA_ "UserSigValidity" SG_ 704 VCU_TrgFuelEcoVal_PerkWh 7;
BA_ "Description" SG_ 704 VCU_TrgFuelEcoVal_PerkWh "This signal is the target fuel economy value (Unit : km/kWh or mile/kWh).

This signal is approximate and may not match the authorized value.

This signal is used only for cluster display



- 0x00~0x7C : 0~124 (for km/h) / 0x00~0x84 : 0~132 (for mph)

-";
BA_ "Version" SG_ 704 VCU_FlatTowModeUsmSta "23.07.05";
BA_ "UserSigValidity" SG_ 704 VCU_FlatTowModeUsmSta 3;
BA_ "Description" SG_ 704 VCU_FlatTowModeUsmSta "FlatTowMode Usm State (acknowledge)";
BA_ "Version" SG_ 704 VCU_FlatTowModeEquip "23.07.05";
BA_ "UserSigValidity" SG_ 704 VCU_FlatTowModeEquip 3;
BA_ "Description" SG_ 704 VCU_FlatTowModeEquip "FlatTow Equipment State";
BA_ "Version" SG_ 704 VCU_MaintenanceSrvMd "23.07.06";
BA_ "UserSigValidity" SG_ 704 VCU_MaintenanceSrvMd 7;
BA_ "Description" SG_ 704 VCU_MaintenanceSrvMd "VCU to BMS M/Rly OFF request status for Maintanance mode";
BA_ "Version" SG_ 704 VCU_DteQcChrgStsVal "23.10.03";
BA_ "UserSigValidity" SG_ 704 VCU_DteQcChrgStsVal 7;
BA_ "Description" SG_ 704 VCU_DteQcChrgStsVal "This signal is the DTE for Quick charging state

- Physical value min. : 0 (0x0)

- Physical value max. : 2047 (0x7FF)";
BA_ "Version" SG_ 704 VCU_CnvrtPermPwrVal "23.10.05";
BA_ "UserSigValidity" SG_ 704 VCU_CnvrtPermPwrVal 7;
BA_ "Description" SG_ 704 VCU_CnvrtPermPwrVal "48V Convert Permission Power";
BA_ "Version" SG_ 704 VCU_CnvrtOpPermSta "23.10.05";
BA_ "UserSigValidity" SG_ 704 VCU_CnvrtOpPermSta 7;
BA_ "Description" SG_ 704 VCU_CnvrtOpPermSta "48V Convert Operating Permission";
BA_ "Version" SG_ 704 VCU_ARSPosition "23.11.02";
BA_ "UserSigValidity" SG_ 704 VCU_ARSPosition 3;
BA_ "TimeoutValue" SG_ 704 VCU_ARSPosition "0x7";
BA_ "Description" SG_ 704 VCU_ARSPosition "Active Rear Spoiler Position Information";
BA_ "Version" SG_ 704 VCU_AccelBoostOnOffSta "23.11.04";
BA_ "UserSigValidity" SG_ 704 VCU_AccelBoostOnOffSta 6;
BA_ "Description" SG_ 704 VCU_AccelBoostOnOffSta "Accel Boost on off";
BA_ "Version" SG_ 704 VCU_DteGuideVal "24.06.00";
BA_ "UserSigValidity" SG_ 704 VCU_DteGuideVal 7;
BA_ "Description" SG_ 704 VCU_DteGuideVal "This signal is Guide DTE

- Physical value min. : 0 (0x0)

- Physical value max. : 2047 (0x7FF)";
BA_ "Version" SG_ 704 VCU_Required_ADASMapMsg "19.07.01";
BA_ "UserSigValidity" SG_ 704 VCU_Required_ADASMapMsg 7;
BA_ "Description" SG_ 704 VCU_Required_ADASMapMsg "Map based ADAS messages information used in VCU";
BA_ "Version" SG_ 704 VCU_HvBatAutoDchOpSta "23.12.00";
BA_ "UserSigValidity" SG_ 704 VCU_HvBatAutoDchOpSta 7;
BA_ "Description" SG_ 704 VCU_HvBatAutoDchOpSta "High Voltage Battery Auto Discharge's operating status (ENG_HVBAD Gen2)";
BA_ "Version" SG_ 704 VCU_UtilModeWarnAddMsgSta "24.04.03";
BA_ "UserSigValidity" SG_ 704 VCU_UtilModeWarnAddMsgSta 7;
BA_ "Description" SG_ 704 VCU_UtilModeWarnAddMsgSta "Rest Mode warning message including request controller information";
BA_ "Version" SG_ 704 VCU_TowModSta "24.04.03";
BA_ "UserSigValidity" SG_ 704 VCU_TowModSta 3;
BA_ "Description" SG_ 704 VCU_TowModSta "Tow Mode On State";
BA_ "Version" SG_ 704 VCU_TowLvlSta "24.04.03";
BA_ "UserSigValidity" SG_ 704 VCU_TowLvlSta 3;
BA_ "Description" SG_ 704 VCU_TowLvlSta "Calculated Towing Level";
BA_ "Version" SG_ 704 VCU_SwVer "19.07.01";
BA_ "UserSigValidity" SG_ 704 VCU_SwVer 7;
BA_ "Description" SG_ 704 VCU_SwVer "VCU SW Version X.XX (Bit0~3 : Development Step, Bit3~7 : Month)";
BA_ "Version" SG_ 704 VCU_PwrAutoOffInfo "19.12.08";
BA_ "UserSigValidity" SG_ 704 VCU_PwrAutoOffInfo 7;
BA_ "Description" SG_ 704 VCU_PwrAutoOffInfo "Auto Power Off Activation bit";
BA_ "Version" SG_ 704 VCU_PwrAutoOffTimerSta "19.12.08";
BA_ "UserSigValidity" SG_ 704 VCU_PwrAutoOffTimerSta 7;
BA_ "Description" SG_ 704 VCU_PwrAutoOffTimerSta "Auto Power Off Timer Setting Value";
BA_ "Version" SG_ 704 VCU_FlatTowModeTargetSocUsmSta "23.07.05";
BA_ "UserSigValidity" SG_ 704 VCU_FlatTowModeTargetSocUsmSta 3;
BA_ "Description" SG_ 704 VCU_FlatTowModeTargetSocUsmSta "Charging Target SOC for FlatTowMode";
BA_ "Version" SG_ 704 VCU_AutoShutOffTimerMin "19.12.08";
BA_ "UserSigValidity" SG_ 704 VCU_AutoShutOffTimerMin 7;
BA_ "Description" SG_ 704 VCU_AutoShutOffTimerMin "0x0:Default(Timer Stop)/

0x1~0xFA:250min ~ 1min/

0xFB~0xFE:Reserved/

0xFF:Invalid";
BA_ "Version" SG_ 704 VCU_AutoShutOffTimerSec "19.12.08";
BA_ "UserSigValidity" SG_ 704 VCU_AutoShutOffTimerSec 7;
BA_ "Description" SG_ 704 VCU_AutoShutOffTimerSec "0x0:Default(Timer Stop)/

0x1~0x3C:60sec ~ 1sec/

0x3D~0x3E:Reserved/

0x3F:Invalid";
BA_ "Version" SG_ 704 VCU_PwrAutoOffTimerReset "19.12.08";
BA_ "UserSigValidity" SG_ 704 VCU_PwrAutoOffTimerReset 7;
BA_ "Description" SG_ 704 VCU_PwrAutoOffTimerReset "Auto Power Off Timer Reset bit";
BA_ "Version" SG_ 704 VCU_AutoShutOffReq "19.12.08";
BA_ "UserSigValidity" SG_ 704 VCU_AutoShutOffReq 7;
BA_ "Description" SG_ 704 VCU_AutoShutOffReq "0x0~0xE:IG ON/

0xF:IG OFF";
BA_ "Version" SG_ 704 VCU_DrvInfoPageOptSta "23.02.09";
BA_ "UserSigValidity" SG_ 704 VCU_DrvInfoPageOptSta 7;
BA_ "Description" SG_ 704 VCU_DrvInfoPageOptSta "AVN Driving information page option state";
BA_ "Version" SG_ 704 VCU_TireSizeWrnMsgSta "20.02.01";
BA_ "UserSigValidity" SG_ 704 VCU_TireSizeWrnMsgSta 7;
BA_ "Description" SG_ 704 VCU_TireSizeWrnMsgSta "Tire Size Warning Message Popup";
BA_ "Version" SG_ 704 VCU_FrntTqDispPcVal "20.02.01";
BA_ "UserSigValidity" SG_ 704 VCU_FrntTqDispPcVal 7;
BA_ "TimeoutValue" SG_ 704 VCU_FrntTqDispPcVal "0x0";
BA_ "Description" SG_ 704 VCU_FrntTqDispPcVal "Front Torque Display Percent Value";
BA_ "Version" SG_ 704 VCU_RearTqDispPcVal "20.02.01";
BA_ "UserSigValidity" SG_ 704 VCU_RearTqDispPcVal 7;
BA_ "TimeoutValue" SG_ 704 VCU_RearTqDispPcVal "0x0";
BA_ "Description" SG_ 704 VCU_RearTqDispPcVal "Rear Torque Display Percent Value";
BA_ "Version" SG_ 704 VCU_BstOpSta "20.08.05";
BA_ "UserSigValidity" SG_ 704 VCU_BstOpSta 7;
BA_ "Description" SG_ 704 VCU_BstOpSta "Boost function's operating status";
BA_ "Version" SG_ 704 VCU_BstTimerVal "20.08.05";
BA_ "UserSigValidity" SG_ 704 VCU_BstTimerVal 7;
BA_ "Description" SG_ 704 VCU_BstTimerVal "Boost function's timer value";
BA_ "Version" SG_ 979 BDC_FD_Crc4Val "22.11.04";
BA_ "UserSigValidity" SG_ 979 BDC_FD_Crc4Val 0;
BA_ "GenSigStartValue" SG_ 979 BDC_FD_Crc4Val 65535;
BA_ "GenSigSendType" SG_ 979 BDC_FD_Crc4Val 4;
BA_ "Description" SG_ 979 BDC_FD_Crc4Val "The data area for CRC calculation is based on the data length (DLC) of the message DB.

The CRC shall be calculated over the entire data block (excluding the CRC bytes) including the user data, alive counter and Data ID



- CRC Polynomial (0x1021) , Ini";
BA_ "Version" SG_ 979 CPD_NotiReq_Reactivate "25.07.04";
BA_ "NetworkRequestHoldingTime" SG_ 979 CPD_NotiReq_Reactivate 5000;
BA_ "NetworkRequest" SG_ 979 CPD_NotiReq_Reactivate 0;
BA_ "UserSigValidity" SG_ 979 CPD_NotiReq_Reactivate 0;
BA_ "GenSigSendType" SG_ 979 CPD_NotiReq_Reactivate 4;
BA_ "Description" SG_ 979 CPD_NotiReq_Reactivate "CPD_Notification Request_Reactivate";
BA_ "Version" SG_ 979 CPD_CLU_IntDisplayRdyReq "25.07.04";
BA_ "NetworkRequestHoldingTime" SG_ 979 CPD_CLU_IntDisplayRdyReq 5000;
BA_ "NetworkRequest" SG_ 979 CPD_CLU_IntDisplayRdyReq 0;
BA_ "UserSigValidity" SG_ 979 CPD_CLU_IntDisplayRdyReq 0;
BA_ "GenSigSendType" SG_ 979 CPD_CLU_IntDisplayRdyReq 4;
BA_ "Description" SG_ 979 CPD_CLU_IntDisplayRdyReq "Child Presence Detection CLU Internal Display Ready Request";
BA_ "Version" SG_ 979 CPD_CLU_IntDisplayOnReq "25.11.00";
BA_ "NetworkRequestHoldingTime" SG_ 979 CPD_CLU_IntDisplayOnReq 5000;
BA_ "NetworkRequest" SG_ 979 CPD_CLU_IntDisplayOnReq 0;
BA_ "UserSigValidity" SG_ 979 CPD_CLU_IntDisplayOnReq 0;
BA_ "GenSigSendType" SG_ 979 CPD_CLU_IntDisplayOnReq 4;
BA_ "Description" SG_ 979 CPD_CLU_IntDisplayOnReq "Child Presence Detection CLU internal Display On Request";
BA_ "Version" SG_ 979 ROA_SnSrStat_1 "25.07.05";
BA_ "NetworkRequestHoldingTime" SG_ 979 ROA_SnSrStat_1 5000;
BA_ "NetworkRequest" SG_ 979 ROA_SnSrStat_1 0;
BA_ "UserSigValidity" SG_ 979 ROA_SnSrStat_1 0;
BA_ "GenSigSendType" SG_ 979 ROA_SnSrStat_1 4;
BA_ "Description" SG_ 979 ROA_SnSrStat_1 "ROA Sensor State (L CAN -> B CAN)";
BA_ "Version" SG_ 979 Warn_ExtBuzzerOut "25.07.05";
BA_ "NetworkRequestHoldingTime" SG_ 979 Warn_ExtBuzzerOut 5000;
BA_ "NetworkRequest" SG_ 979 Warn_ExtBuzzerOut 0;
BA_ "UserSigValidity" SG_ 979 Warn_ExtBuzzerOut 0;
BA_ "GenSigSendType" SG_ 979 Warn_ExtBuzzerOut 4;
BA_ "Description" SG_ 979 Warn_ExtBuzzerOut "External Buzzer Command";
BA_ "Version" SG_ 979 SBR_AsstStBltWrngIndSta "17.12.00";
BA_ "NetworkRequestHoldingTime" SG_ 979 SBR_AsstStBltWrngIndSta 5000;
BA_ "NetworkRequest" SG_ 979 SBR_AsstStBltWrngIndSta 0;
BA_ "UserSigValidity" SG_ 979 SBR_AsstStBltWrngIndSta 0;
BA_ "GenSigSendType" SG_ 979 SBR_AsstStBltWrngIndSta 4;
BA_ "Version" SG_ 979 SBR_DrvStBltWrngIndSta "25.11.00";
BA_ "NetworkRequestHoldingTime" SG_ 979 SBR_DrvStBltWrngIndSta 5000;
BA_ "NetworkRequest" SG_ 979 SBR_DrvStBltWrngIndSta 0;
BA_ "UserSigValidity" SG_ 979 SBR_DrvStBltWrngIndSta 0;
BA_ "GenSigSendType" SG_ 979 SBR_DrvStBltWrngIndSta 4;
BA_ "Version" SG_ 979 SeatOccuPres_Drv "25.11.00";
BA_ "NetworkRequestHoldingTime" SG_ 979 SeatOccuPres_Drv 5000;
BA_ "NetworkRequest" SG_ 979 SeatOccuPres_Drv 0;
BA_ "UserSigValidity" SG_ 979 SeatOccuPres_Drv 0;
BA_ "GenSigSendType" SG_ 979 SeatOccuPres_Drv 4;
BA_ "Description" SG_ 979 SeatOccuPres_Drv "This signal indicates the presence of an occupant in the driver seat based on the seatbelt buckle status and the seat mat switch state.";
BA_ "Version" SG_ 979 SeatOccuPres_Asst "25.11.00";
BA_ "NetworkRequestHoldingTime" SG_ 979 SeatOccuPres_Asst 5000;
BA_ "NetworkRequest" SG_ 979 SeatOccuPres_Asst 0;
BA_ "UserSigValidity" SG_ 979 SeatOccuPres_Asst 0;
BA_ "GenSigSendType" SG_ 979 SeatOccuPres_Asst 4;
BA_ "Description" SG_ 979 SeatOccuPres_Asst "This signal indicates the presence of an occupant in the front passenger seat based on the seatbelt buckle status and the seat mat switch state.";
BA_ "Version" SG_ 979 SeatOccuPres_1stCtr "25.11.00";
BA_ "NetworkRequestHoldingTime" SG_ 979 SeatOccuPres_1stCtr 5000;
BA_ "NetworkRequest" SG_ 979 SeatOccuPres_1stCtr 0;
BA_ "UserSigValidity" SG_ 979 SeatOccuPres_1stCtr 0;
BA_ "GenSigSendType" SG_ 979 SeatOccuPres_1stCtr 4;
BA_ "Description" SG_ 979 SeatOccuPres_1stCtr "This signal indicates the presence of an occupant in the front center seat based on the seatbelt buckle status and the seat mat switch state.";
BA_ "Version" SG_ 979 SeatOccuPres_2ndLft "25.11.00";
BA_ "NetworkRequestHoldingTime" SG_ 979 SeatOccuPres_2ndLft 5000;
BA_ "NetworkRequest" SG_ 979 SeatOccuPres_2ndLft 0;
BA_ "UserSigValidity" SG_ 979 SeatOccuPres_2ndLft 0;
BA_ "GenSigSendType" SG_ 979 SeatOccuPres_2ndLft 4;
BA_ "Description" SG_ 979 SeatOccuPres_2ndLft "This signal indicates the presence of an occupant in the second-row left seat based on the seatbelt buckle status and the seat mat switch state.";
BA_ "Version" SG_ 979 SeatOccuPres_2ndRt "25.11.00";
BA_ "NetworkRequestHoldingTime" SG_ 979 SeatOccuPres_2ndRt 5000;
BA_ "NetworkRequest" SG_ 979 SeatOccuPres_2ndRt 0;
BA_ "UserSigValidity" SG_ 979 SeatOccuPres_2ndRt 0;
BA_ "GenSigSendType" SG_ 979 SeatOccuPres_2ndRt 4;
BA_ "Description" SG_ 979 SeatOccuPres_2ndRt "This signal indicates the presence of an occupant in the second-row right seat based on the seatbelt buckle status and the seat mat switch state.";
BA_ "Version" SG_ 979 SeatOccuPres_2ndCtr "25.11.00";
BA_ "NetworkRequestHoldingTime" SG_ 979 SeatOccuPres_2ndCtr 5000;
BA_ "NetworkRequest" SG_ 979 SeatOccuPres_2ndCtr 0;
BA_ "UserSigValidity" SG_ 979 SeatOccuPres_2ndCtr 0;
BA_ "GenSigSendType" SG_ 979 SeatOccuPres_2ndCtr 4;
BA_ "Description" SG_ 979 SeatOccuPres_2ndCtr "This signal indicates the presence of an occupant in the second-row center seat based on the seatbelt buckle status and the seat mat switch state.";
BA_ "Version" SG_ 979 SeatOccuPres_3rdLft "25.11.00";
BA_ "NetworkRequestHoldingTime" SG_ 979 SeatOccuPres_3rdLft 5000;
BA_ "NetworkRequest" SG_ 979 SeatOccuPres_3rdLft 0;
BA_ "UserSigValidity" SG_ 979 SeatOccuPres_3rdLft 0;
BA_ "GenSigSendType" SG_ 979 SeatOccuPres_3rdLft 4;
BA_ "Description" SG_ 979 SeatOccuPres_3rdLft "This signal indicates the presence of an occupant in the third-row left seat based on the seatbelt buckle status and the seat mat switch state.";
BA_ "Version" SG_ 979 SeatOccuPres_3rdRt "25.11.00";
BA_ "NetworkRequestHoldingTime" SG_ 979 SeatOccuPres_3rdRt 5000;
BA_ "NetworkRequest" SG_ 979 SeatOccuPres_3rdRt 0;
BA_ "UserSigValidity" SG_ 979 SeatOccuPres_3rdRt 0;
BA_ "GenSigSendType" SG_ 979 SeatOccuPres_3rdRt 4;
BA_ "Description" SG_ 979 SeatOccuPres_3rdRt "This signal indicates the presence of an occupant in the third-row right seat based on the seatbelt buckle status and the seat mat switch state.";
BA_ "Version" SG_ 979 SeatOccuPres_3rdCtr "25.11.00";
BA_ "NetworkRequestHoldingTime" SG_ 979 SeatOccuPres_3rdCtr 5000;
BA_ "NetworkRequest" SG_ 979 SeatOccuPres_3rdCtr 0;
BA_ "UserSigValidity" SG_ 979 SeatOccuPres_3rdCtr 0;
BA_ "GenSigSendType" SG_ 979 SeatOccuPres_3rdCtr 4;
BA_ "Description" SG_ 979 SeatOccuPres_3rdCtr "This signal indicates the presence of an occupant in the third-row center seat based on the seatbelt buckle status and the seat mat switch state.";
BA_ "Version" SG_ 979 SeatOccuPres_4thLft "25.11.00";
BA_ "NetworkRequestHoldingTime" SG_ 979 SeatOccuPres_4thLft 5000;
BA_ "NetworkRequest" SG_ 979 SeatOccuPres_4thLft 0;
BA_ "UserSigValidity" SG_ 979 SeatOccuPres_4thLft 0;
BA_ "GenSigSendType" SG_ 979 SeatOccuPres_4thLft 4;
BA_ "Description" SG_ 979 SeatOccuPres_4thLft "This signal indicates the presence of an occupant in the fourth-row left seat based on the seatbelt buckle status and the seat mat switch state.";
BA_ "Version" SG_ 979 SeatOccuPres_4thRt "25.11.00";
BA_ "NetworkRequestHoldingTime" SG_ 979 SeatOccuPres_4thRt 5000;
BA_ "NetworkRequest" SG_ 979 SeatOccuPres_4thRt 0;
BA_ "UserSigValidity" SG_ 979 SeatOccuPres_4thRt 0;
BA_ "GenSigSendType" SG_ 979 SeatOccuPres_4thRt 4;
BA_ "Description" SG_ 979 SeatOccuPres_4thRt "This signal indicates the presence of an occupant in the fourth-row right seat based on the seatbelt buckle status and the seat mat switch state.";
BA_ "Version" SG_ 979 SeatOccuPres_4thCtr "25.11.00";
BA_ "NetworkRequestHoldingTime" SG_ 979 SeatOccuPres_4thCtr 5000;
BA_ "NetworkRequest" SG_ 979 SeatOccuPres_4thCtr 0;
BA_ "UserSigValidity" SG_ 979 SeatOccuPres_4thCtr 0;
BA_ "GenSigSendType" SG_ 979 SeatOccuPres_4thCtr 4;
BA_ "Description" SG_ 979 SeatOccuPres_4thCtr "This signal indicates the presence of an occupant in the fourth-row center seat based on the seatbelt buckle status and the seat mat switch state.";
BA_ "Version" SG_ 979 CPD_VersionOpt "25.11.00";
BA_ "NetworkRequestHoldingTime" SG_ 979 CPD_VersionOpt 5000;
BA_ "NetworkRequest" SG_ 979 CPD_VersionOpt 0;
BA_ "UserSigValidity" SG_ 979 CPD_VersionOpt 0;
BA_ "GenSigSendType" SG_ 979 CPD_VersionOpt 4;
BA_ "Description" SG_ 979 CPD_VersionOpt "CPD S/W version separator";
BA_ "Version" SG_ 979 BDC_FD_AlvCnt4Val "22.11.04";
BA_ "UserSigValidity" SG_ 979 BDC_FD_AlvCnt4Val 0;
BA_ "GenSigSendType" SG_ 979 BDC_FD_AlvCnt4Val 4;
BA_ "Description" SG_ 979 BDC_FD_AlvCnt4Val "For the first transmission request for a data element the counter shall be initialized with 0 and shall be incremented by 1 for every subsequent send request. 

When the counter reaches the maximum value(0xFF), then it shall restart with 0 for the next s";
BA_ "Version" SG_ 979 BAlarm_BglrAlrm_CurrentSta "22.11.02";
BA_ "NetworkRequestHoldingTime" SG_ 979 BAlarm_BglrAlrm_CurrentSta 5000;
BA_ "NetworkRequest" SG_ 979 BAlarm_BglrAlrm_CurrentSta 0;
BA_ "UserSigValidity" SG_ 979 BAlarm_BglrAlrm_CurrentSta 0;
BA_ "GenSigSendType" SG_ 979 BAlarm_BglrAlrm_CurrentSta 4;
BA_ "Version" SG_ 979 BAlarm_BglrAlrm_Sta "22.11.02";
BA_ "NetworkRequestHoldingTime" SG_ 979 BAlarm_BglrAlrm_Sta 5000;
BA_ "NetworkRequest" SG_ 979 BAlarm_BglrAlrm_Sta 0;
BA_ "UserSigValidity" SG_ 979 BAlarm_BglrAlrm_Sta 0;
BA_ "GenSigSendType" SG_ 979 BAlarm_BglrAlrm_Sta 4;
BA_ "Version" SG_ 979 BAlarm_PncAlrmSta "21.09.05";
BA_ "NetworkRequestHoldingTime" SG_ 979 BAlarm_PncAlrmSta 5000;
BA_ "NetworkRequest" SG_ 979 BAlarm_PncAlrmSta 0;
BA_ "UserSigValidity" SG_ 979 BAlarm_PncAlrmSta 0;
BA_ "GenSigSendType" SG_ 979 BAlarm_PncAlrmSta 4;
BA_ "Description" SG_ 979 BAlarm_PncAlrmSta "-For TeleCranking Panic Function

-This signal send to IBOX";
BA_ "Version" SG_ 979 SBR_StBltStpWrngBzrSta "18.07.03";
BA_ "NetworkRequestHoldingTime" SG_ 979 SBR_StBltStpWrngBzrSta 5000;
BA_ "NetworkRequest" SG_ 979 SBR_StBltStpWrngBzrSta 0;
BA_ "UserSigValidity" SG_ 979 SBR_StBltStpWrngBzrSta 0;
BA_ "GenSigSendType" SG_ 979 SBR_StBltStpWrngBzrSta 4;
BA_ "Description" SG_ 979 SBR_StBltStpWrngBzrSta "This signal is used for control the Seatbelt Step Warning Buzzer function with 3 bits.

It provides pre-warning, 1st warning, 2nd warning and 3rd warning.";
BA_ "Version" SG_ 979 SBR_StBltWrngBzrSta "17.12.00";
BA_ "NetworkRequestHoldingTime" SG_ 979 SBR_StBltWrngBzrSta 5000;
BA_ "NetworkRequest" SG_ 979 SBR_StBltWrngBzrSta 0;
BA_ "UserSigValidity" SG_ 979 SBR_StBltWrngBzrSta 0;
BA_ "GenSigSendType" SG_ 979 SBR_StBltWrngBzrSta 4;
BA_ "Description" SG_ 979 SBR_StBltWrngBzrSta "-Seat belt Warning (Reminder) buzzer";
BA_ "Version" SG_ 979 BAlarm_BrglrHrnRlySta "17.12.00";
BA_ "NetworkRequestHoldingTime" SG_ 979 BAlarm_BrglrHrnRlySta 5000;
BA_ "NetworkRequest" SG_ 979 BAlarm_BrglrHrnRlySta 0;
BA_ "UserSigValidity" SG_ 979 BAlarm_BrglrHrnRlySta 0;
BA_ "GenSigSendType" SG_ 979 BAlarm_BrglrHrnRlySta 4;
BA_ "Version" SG_ 979 SBR_DrvStBltIndSta "17.12.00";
BA_ "NetworkRequestHoldingTime" SG_ 979 SBR_DrvStBltIndSta 5000;
BA_ "NetworkRequest" SG_ 979 SBR_DrvStBltIndSta 0;
BA_ "UserSigValidity" SG_ 979 SBR_DrvStBltIndSta 0;
BA_ "GenSigSendType" SG_ 979 SBR_DrvStBltIndSta 4;
BA_ "Version" SG_ 979 SBR_RrLftStBltWrngIndSta "18.06.01";
BA_ "NetworkRequestHoldingTime" SG_ 979 SBR_RrLftStBltWrngIndSta 5000;
BA_ "NetworkRequest" SG_ 979 SBR_RrLftStBltWrngIndSta 0;
BA_ "UserSigValidity" SG_ 979 SBR_RrLftStBltWrngIndSta 0;
BA_ "GenSigSendType" SG_ 979 SBR_RrLftStBltWrngIndSta 4;
BA_ "Version" SG_ 979 SBR_RrRtStBltWrngIndSta "18.06.01";
BA_ "NetworkRequestHoldingTime" SG_ 979 SBR_RrRtStBltWrngIndSta 5000;
BA_ "NetworkRequest" SG_ 979 SBR_RrRtStBltWrngIndSta 0;
BA_ "UserSigValidity" SG_ 979 SBR_RrRtStBltWrngIndSta 0;
BA_ "GenSigSendType" SG_ 979 SBR_RrRtStBltWrngIndSta 4;
BA_ "Version" SG_ 979 SBR_RrCtrStBltIndSta "20.01.01";
BA_ "NetworkRequestHoldingTime" SG_ 979 SBR_RrCtrStBltIndSta 5000;
BA_ "NetworkRequest" SG_ 979 SBR_RrCtrStBltIndSta 0;
BA_ "UserSigValidity" SG_ 979 SBR_RrCtrStBltIndSta 0;
BA_ "GenSigSendType" SG_ 979 SBR_RrCtrStBltIndSta 4;
BA_ "Version" SG_ 979 SBR_3rdLftStBltWrngIndSta "18.06.01";
BA_ "NetworkRequestHoldingTime" SG_ 979 SBR_3rdLftStBltWrngIndSta 5000;
BA_ "NetworkRequest" SG_ 979 SBR_3rdLftStBltWrngIndSta 0;
BA_ "UserSigValidity" SG_ 979 SBR_3rdLftStBltWrngIndSta 0;
BA_ "GenSigSendType" SG_ 979 SBR_3rdLftStBltWrngIndSta 4;
BA_ "Description" SG_ 979 SBR_3rdLftStBltWrngIndSta "This signal is used for control the 3th Row Left Seatbelt indicator function.";
BA_ "Version" SG_ 979 SBR_3rdRtStBltWrngIndSta "18.06.01";
BA_ "NetworkRequestHoldingTime" SG_ 979 SBR_3rdRtStBltWrngIndSta 5000;
BA_ "NetworkRequest" SG_ 979 SBR_3rdRtStBltWrngIndSta 0;
BA_ "UserSigValidity" SG_ 979 SBR_3rdRtStBltWrngIndSta 0;
BA_ "GenSigSendType" SG_ 979 SBR_3rdRtStBltWrngIndSta 4;
BA_ "Description" SG_ 979 SBR_3rdRtStBltWrngIndSta "This signal is used for control the 3th Row Right Seatbelt indicator function.";
BA_ "Version" SG_ 979 SBR_3rdCtrStBltWrngIndSta "20.01.01";
BA_ "NetworkRequestHoldingTime" SG_ 979 SBR_3rdCtrStBltWrngIndSta 5000;
BA_ "NetworkRequest" SG_ 979 SBR_3rdCtrStBltWrngIndSta 0;
BA_ "UserSigValidity" SG_ 979 SBR_3rdCtrStBltWrngIndSta 0;
BA_ "GenSigSendType" SG_ 979 SBR_3rdCtrStBltWrngIndSta 4;
BA_ "Description" SG_ 979 SBR_3rdCtrStBltWrngIndSta "This signal is used for control the 3th Row Center Seatbelt indicator function.";
BA_ "Version" SG_ 979 Warn_BzrWrngSta "17.12.00";
BA_ "NetworkRequestHoldingTime" SG_ 979 Warn_BzrWrngSta 5000;
BA_ "NetworkRequest" SG_ 979 Warn_BzrWrngSta 0;
BA_ "UserSigValidity" SG_ 979 Warn_BzrWrngSta 0;
BA_ "GenSigSendType" SG_ 979 Warn_BzrWrngSta 4;
BA_ "Description" SG_ 979 Warn_BzrWrngSta "-(Old)C_WngBuzzer";
BA_ "Version" SG_ 979 Warn_BCMWrngSta "25.07.02";
BA_ "NetworkRequestHoldingTime" SG_ 979 Warn_BCMWrngSta 5000;
BA_ "NetworkRequest" SG_ 979 Warn_BCMWrngSta 0;
BA_ "UserSigValidity" SG_ 979 Warn_BCMWrngSta 0;
BA_ "GenSigSendType" SG_ 979 Warn_BCMWrngSta 4;
BA_ "Description" SG_ 979 Warn_BCMWrngSta "Warning command og BCM";
BA_ "Version" SG_ 979 ROA_RrBlwAutoOffReq "21.04.00";
BA_ "NetworkRequestHoldingTime" SG_ 979 ROA_RrBlwAutoOffReq 5000;
BA_ "NetworkRequest" SG_ 979 ROA_RrBlwAutoOffReq 0;
BA_ "UserSigValidity" SG_ 979 ROA_RrBlwAutoOffReq 0;
BA_ "GenSigSendType" SG_ 979 ROA_RrBlwAutoOffReq 4;
BA_ "Description" SG_ 979 ROA_RrBlwAutoOffReq "This signal is used for a request to Rear Blow Off (Auto Cut)";
BA_ "Version" SG_ 979 ROA_RegionOpt "21.11.07";
BA_ "NetworkRequestHoldingTime" SG_ 979 ROA_RegionOpt 5000;
BA_ "NetworkRequest" SG_ 979 ROA_RegionOpt 0;
BA_ "UserSigValidity" SG_ 979 ROA_RegionOpt 0;
BA_ "GenSigSendType" SG_ 979 ROA_RegionOpt 4;
BA_ "Description" SG_ 979 ROA_RegionOpt "A Euro NCAP Option signal (BDC only)";
BA_ "Version" SG_ 979 Warn_RrStRmndOpt "21.04.00";
BA_ "NetworkRequestHoldingTime" SG_ 979 Warn_RrStRmndOpt 5000;
BA_ "NetworkRequest" SG_ 979 Warn_RrStRmndOpt 0;
BA_ "UserSigValidity" SG_ 979 Warn_RrStRmndOpt 0;
BA_ "GenSigSendType" SG_ 979 Warn_RrStRmndOpt 4;
BA_ "Description" SG_ 979 Warn_RrStRmndOpt "Rear Seat Reminder System Appled Option

(BDC Only Use 0x0 and 0x2 in Signal Value Table)";
BA_ "Version" SG_ 979 Warn_RrStRmndAlrmOnReq "17.12.00";
BA_ "NetworkRequestHoldingTime" SG_ 979 Warn_RrStRmndAlrmOnReq 5000;
BA_ "NetworkRequest" SG_ 979 Warn_RrStRmndAlrmOnReq 0;
BA_ "UserSigValidity" SG_ 979 Warn_RrStRmndAlrmOnReq 0;
BA_ "GenSigSendType" SG_ 979 Warn_RrStRmndAlrmOnReq 4;
BA_ "Description" SG_ 979 Warn_RrStRmndAlrmOnReq "Rear Seat Reminder Alarm State";
BA_ "Version" SG_ 979 Warn_RrStRmndSysSta "17.12.00";
BA_ "NetworkRequestHoldingTime" SG_ 979 Warn_RrStRmndSysSta 5000;
BA_ "NetworkRequest" SG_ 979 Warn_RrStRmndSysSta 0;
BA_ "UserSigValidity" SG_ 979 Warn_RrStRmndSysSta 0;
BA_ "GenSigSendType" SG_ 979 Warn_RrStRmndSysSta 4;
BA_ "Description" SG_ 979 Warn_RrStRmndSysSta "Rear Seat Reminder Alarm System Enable(On)/Disable(Off) state";
BA_ "Version" SG_ 979 Warn_RrStRmndAlrmInfo "24.03.06";
BA_ "NetworkRequestHoldingTime" SG_ 979 Warn_RrStRmndAlrmInfo 5000;
BA_ "NetworkRequest" SG_ 979 Warn_RrStRmndAlrmInfo 0;
BA_ "UserSigValidity" SG_ 979 Warn_RrStRmndAlrmInfo 0;
BA_ "GenSigSendType" SG_ 979 Warn_RrStRmndAlrmInfo 4;
BA_ "Description" SG_ 979 Warn_RrStRmndAlrmInfo "Rear Seat Reminder Warning request signal";
BA_ "Version" SG_ 979 Warn_RoaErr "18.07.01";
BA_ "NetworkRequestHoldingTime" SG_ 979 Warn_RoaErr 5000;
BA_ "NetworkRequest" SG_ 979 Warn_RoaErr 0;
BA_ "UserSigValidity" SG_ 979 Warn_RoaErr 0;
BA_ "GenSigSendType" SG_ 979 Warn_RoaErr 4;
BA_ "Description" SG_ 979 Warn_RoaErr "ROA SENSOR Error(Malfunction)  signal";
BA_ "Version" SG_ 979 Warn_RrStRmndDelay "25.07.04";
BA_ "NetworkRequestHoldingTime" SG_ 979 Warn_RrStRmndDelay 5000;
BA_ "NetworkRequest" SG_ 979 Warn_RrStRmndDelay 0;
BA_ "UserSigValidity" SG_ 979 Warn_RrStRmndDelay 0;
BA_ "TimeoutValue" SG_ 979 Warn_RrStRmndDelay "0x0";
BA_ "GenSigSendType" SG_ 979 Warn_RrStRmndDelay 4;
BA_ "Version" SG_ 979 Warn_RrStRmndSysAct "22.03.04";
BA_ "NetworkRequestHoldingTime" SG_ 979 Warn_RrStRmndSysAct 5000;
BA_ "NetworkRequest" SG_ 979 Warn_RrStRmndSysAct 0;
BA_ "UserSigValidity" SG_ 979 Warn_RrStRmndSysAct 0;
BA_ "TimeoutValue" SG_ 979 Warn_RrStRmndSysAct "0x0";
BA_ "GenSigSendType" SG_ 979 Warn_RrStRmndSysAct 4;
BA_ "Version" SG_ 979 WAL_FobSearching "19.06.00";
BA_ "NetworkRequestHoldingTime" SG_ 979 WAL_FobSearching 5000;
BA_ "NetworkRequest" SG_ 979 WAL_FobSearching 0;
BA_ "UserSigValidity" SG_ 979 WAL_FobSearching 0;
BA_ "GenSigSendType" SG_ 979 WAL_FobSearching 4;
BA_ "Description" SG_ 979 WAL_FobSearching "IBU Walk Away Lock Fob Searching State for Radar ROA

(LIN_IBU_WAL_FobSearching for UIP ROA)";
BA_ "Version" SG_ 979 Warn_RrStRmndSysOffIND "22.08.01";
BA_ "NetworkRequestHoldingTime" SG_ 979 Warn_RrStRmndSysOffIND 5000;
BA_ "NetworkRequest" SG_ 979 Warn_RrStRmndSysOffIND 0;
BA_ "UserSigValidity" SG_ 979 Warn_RrStRmndSysOffIND 0;
BA_ "TimeoutValue" SG_ 979 Warn_RrStRmndSysOffIND "0x0";
BA_ "GenSigSendType" SG_ 979 Warn_RrStRmndSysOffIND 4;
BA_ "Version" SG_ 979 Warn_VehNotPWrngSta "23.05.01";
BA_ "NetworkRequestHoldingTime" SG_ 979 Warn_VehNotPWrngSta 5000;
BA_ "NetworkRequest" SG_ 979 Warn_VehNotPWrngSta 0;
BA_ "UserSigValidity" SG_ 979 Warn_VehNotPWrngSta 0;
BA_ "GenSigSendType" SG_ 979 Warn_VehNotPWrngSta 4;
BA_ "Description" SG_ 979 Warn_VehNotPWrngSta "Vehicle Not P Warning";
BA_ "Version" SG_ 979 Warn_RrStRmndAlrmInfo_1 "25.07.04";
BA_ "NetworkRequestHoldingTime" SG_ 979 Warn_RrStRmndAlrmInfo_1 5000;
BA_ "NetworkRequest" SG_ 979 Warn_RrStRmndAlrmInfo_1 0;
BA_ "UserSigValidity" SG_ 979 Warn_RrStRmndAlrmInfo_1 0;
BA_ "GenSigSendType" SG_ 979 Warn_RrStRmndAlrmInfo_1 4;
BA_ "Description" SG_ 979 Warn_RrStRmndAlrmInfo_1 "Rear Seat Reminder Warning request signal";
BA_ "Version" SG_ 979 CPD_WrngSta "25.01.01";
BA_ "NetworkRequestHoldingTime" SG_ 979 CPD_WrngSta 5000;
BA_ "NetworkRequest" SG_ 979 CPD_WrngSta 0;
BA_ "UserSigValidity" SG_ 979 CPD_WrngSta 0;
BA_ "GenSigSendType" SG_ 979 CPD_WrngSta 4;
BA_ "Description" SG_ 979 CPD_WrngSta "CPD Warning State";
BA_ "Version" SG_ 979 CPD_HU_IntDisplayRdyReq "25.07.04";
BA_ "NetworkRequestHoldingTime" SG_ 979 CPD_HU_IntDisplayRdyReq 5000;
BA_ "NetworkRequest" SG_ 979 CPD_HU_IntDisplayRdyReq 0;
BA_ "UserSigValidity" SG_ 979 CPD_HU_IntDisplayRdyReq 0;
BA_ "GenSigSendType" SG_ 979 CPD_HU_IntDisplayRdyReq 4;
BA_ "Description" SG_ 979 CPD_HU_IntDisplayRdyReq "child presence detection internal display ready request";
BA_ "Version" SG_ 979 CPD_HU_IntDisplayOnReq "25.11.00";
BA_ "NetworkRequestHoldingTime" SG_ 979 CPD_HU_IntDisplayOnReq 5000;
BA_ "NetworkRequest" SG_ 979 CPD_HU_IntDisplayOnReq 0;
BA_ "UserSigValidity" SG_ 979 CPD_HU_IntDisplayOnReq 0;
BA_ "GenSigSendType" SG_ 979 CPD_HU_IntDisplayOnReq 4;
BA_ "Description" SG_ 979 CPD_HU_IntDisplayOnReq "Child Presence Detection H/U Internal Display On Request";
BA_ "Version" SG_ 1059 HU_GW_Crc4Val "22.10.20";
BA_ "UserSigValidity" SG_ 1059 HU_GW_Crc4Val 3;
BA_ "GenSigStartValue" SG_ 1059 HU_GW_Crc4Val 65535;
BA_ "GenSigSendType" SG_ 1059 HU_GW_Crc4Val 4;
BA_ "Description" SG_ 1059 HU_GW_Crc4Val "The data area for CRC calculation is based on the data length (DLC) of the message DB.

The CRC shall be calculated over the entire data block (excluding the CRC bytes) including the user data, alive counter and Data ID



- CRC Polynomial (0x1021) , Ini";
BA_ "Version" SG_ 1059 CF_AVN_AutoWashModeSta "22.07.05";
BA_ "UserSigValidity" SG_ 1059 CF_AVN_AutoWashModeSta 3;
BA_ "GenSigSendType" SG_ 1059 CF_AVN_AutoWashModeSta 4;
BA_ "Description" SG_ 1059 CF_AVN_AutoWashModeSta "Washer Mode status signal";
BA_ "Version" SG_ 1059 HU_ResetOpSta "24.05.01";
BA_ "UserSigValidity" SG_ 1059 HU_ResetOpSta 0;
BA_ "GenSigSendType" SG_ 1059 HU_ResetOpSta 4;
BA_ "Description" SG_ 1059 HU_ResetOpSta "This signal indicates whether the reset operation has been completed or not";
BA_ "Version" SG_ 1059 CRS_BabyOnSeatstates "25.01.01";
BA_ "UserSigValidity" SG_ 1059 CRS_BabyOnSeatstates 0;
BA_ "GenSigSendType" SG_ 1059 CRS_BabyOnSeatstates 4;
BA_ "Description" SG_ 1059 CRS_BabyOnSeatstates "The status of baby left in the car";
BA_ "Version" SG_ 1059 OMUOSMirCtrl_Vr "22.07.05";
BA_ "UserSigValidity" SG_ 1059 OMUOSMirCtrl_Vr 3;
BA_ "GenSigStartValue" SG_ 1059 OMUOSMirCtrl_Vr 3;
BA_ "GenSigSendType" SG_ 1059 OMUOSMirCtrl_Vr 4;
BA_ "Version" SG_ 1059 CF_AVN_ValetModeSta "25.04.01";
BA_ "UserSigValidity" SG_ 1059 CF_AVN_ValetModeSta 0;
BA_ "GenSigSendType" SG_ 1059 CF_AVN_ValetModeSta 4;
BA_ "Description" SG_ 1059 CF_AVN_ValetModeSta "Valet Mode 2.0 on/off set signal";
BA_ "Version" SG_ 1059 CF_AVN_DTOPEnableNValueSet "25.06.01";
BA_ "UserSigValidity" SG_ 1059 CF_AVN_DTOPEnableNValueSet 0;
BA_ "GenSigSendType" SG_ 1059 CF_AVN_DTOPEnableNValueSet 4;
BA_ "Description" SG_ 1059 CF_AVN_DTOPEnableNValueSet "HU_OptionInfo(Bit13:1 Support) Signal sent when master profile creation is completed for a region (DTOP capable signal)";
BA_ "Version" SG_ 1059 HU_GW_AlvCnt4Val "22.10.20";
BA_ "UserSigValidity" SG_ 1059 HU_GW_AlvCnt4Val 3;
BA_ "GenSigSendType" SG_ 1059 HU_GW_AlvCnt4Val 4;
BA_ "Description" SG_ 1059 HU_GW_AlvCnt4Val "For the first transmission request for a data element the counter shall be initialized with 0 and shall be incremented by 1 for every subsequent send request. 

When the counter reaches the maximum value(0xFF), then it shall restart with 0 for the next s";
BA_ "Version" SG_ 1059 HU_Customer_Action_Ind "24.04.09";
BA_ "UserSigValidity" SG_ 1059 HU_Customer_Action_Ind 0;
BA_ "GenSigSendType" SG_ 1059 HU_Customer_Action_Ind 4;
BA_ "Description" SG_ 1059 HU_Customer_Action_Ind "Send indication signal to BCD when a customer uses the service.";
BA_ "Version" SG_ 1059 HU_IG3_Request "22.07.05";
BA_ "UserSigValidity" SG_ 1059 HU_IG3_Request 0;
BA_ "GenSigStartValue" SG_ 1059 HU_IG3_Request 3;
BA_ "GenSigSendType" SG_ 1059 HU_IG3_Request 4;
BA_ "Description" SG_ 1059 HU_IG3_Request "IG3 wake up and sleep Request signal for EV/PHEV/HEV



Please apply this signal after checking ICU on your vehicle.";
BA_ "Version" SG_ 1059 HU_DigitalKeyGroupingSupport "23.05.01";
BA_ "UserSigValidity" SG_ 1059 HU_DigitalKeyGroupingSupport 1;
BA_ "GenSigSendType" SG_ 1059 HU_DigitalKeyGroupingSupport 4;
BA_ "Description" SG_ 1059 HU_DigitalKeyGroupingSupport "This signal indicates whether the H/U can support the grouping specification for digital key.";
BA_ "Version" SG_ 1059 HU_Background "22.11.03";
BA_ "UserSigValidity" SG_ 1059 HU_Background 1;
BA_ "GenSigStartValue" SG_ 1059 HU_Background 7;
BA_ "GenSigSendType" SG_ 1059 HU_Background 4;
BA_ "Description" SG_ 1059 HU_Background "HU Backgound image info";
BA_ "Version" SG_ 1059 HU_BackgroundFadeInOut "22.07.05";
BA_ "UserSigValidity" SG_ 1059 HU_BackgroundFadeInOut 1;
BA_ "GenSigStartValue" SG_ 1059 HU_BackgroundFadeInOut 1023;
BA_ "GenSigSendType" SG_ 1059 HU_BackgroundFadeInOut 4;
BA_ "Description" SG_ 1059 HU_BackgroundFadeInOut "HU Background Fade in/out info

(HEX * Factor) %";
BA_ "Version" SG_ 983 BDC_FD_Crc8Val "22.11.04";
BA_ "UserSigValidity" SG_ 983 BDC_FD_Crc8Val 0;
BA_ "GenSigStartValue" SG_ 983 BDC_FD_Crc8Val 65535;
BA_ "GenSigSendType" SG_ 983 BDC_FD_Crc8Val 4;
BA_ "Description" SG_ 983 BDC_FD_Crc8Val "The data area for CRC calculation is based on the data length (DLC) of the message DB.

The CRC shall be calculated over the entire data block (excluding the CRC bytes) including the user data, alive counter and Data ID



- CRC Polynomial (0x1021) , Ini";
BA_ "Version" SG_ 983 Mirror_MnlFldModSta "23.01.03";
BA_ "NetworkRequestHoldingTime" SG_ 983 Mirror_MnlFldModSta 5000;
BA_ "NetworkRequest" SG_ 983 Mirror_MnlFldModSta 0;
BA_ "UserSigValidity" SG_ 983 Mirror_MnlFldModSta 0;
BA_ "GenSigSendType" SG_ 983 Mirror_MnlFldModSta 4;
BA_ "Description" SG_ 983 Mirror_MnlFldModSta "Mirror Manual Fold State

0x0:None = AutoFold Mode or Unfold Mode

0x1: ManualFold = ManualFold Mode";
BA_ "Version" SG_ 983 Mirror_SelSwSta "20.12.00";
BA_ "NetworkRequestHoldingTime" SG_ 983 Mirror_SelSwSta 5000;
BA_ "NetworkRequest" SG_ 983 Mirror_SelSwSta 0;
BA_ "UserSigValidity" SG_ 983 Mirror_SelSwSta 0;
BA_ "GenSigSendType" SG_ 983 Mirror_SelSwSta 4;
BA_ "Description" SG_ 983 Mirror_SelSwSta "Outside Mirror Select Button Status";
BA_ "Version" SG_ 983 Mirror_LHPosMnlReq "22.01.05";
BA_ "NetworkRequestHoldingTime" SG_ 983 Mirror_LHPosMnlReq 5000;
BA_ "NetworkRequest" SG_ 983 Mirror_LHPosMnlReq 0;
BA_ "UserSigValidity" SG_ 983 Mirror_LHPosMnlReq 0;
BA_ "GenSigSendType" SG_ 983 Mirror_LHPosMnlReq 4;
BA_ "Description" SG_ 983 Mirror_LHPosMnlReq "Left Outside Mirror Positioning Request";
BA_ "Version" SG_ 983 Mirror_AutoWashModeSta_TypeC "23.04.00";
BA_ "NetworkRequestHoldingTime" SG_ 983 Mirror_AutoWashModeSta_TypeC 5000;
BA_ "NetworkRequest" SG_ 983 Mirror_AutoWashModeSta_TypeC 0;
BA_ "UserSigValidity" SG_ 983 Mirror_AutoWashModeSta_TypeC 0;
BA_ "GenSigSendType" SG_ 983 Mirror_AutoWashModeSta_TypeC 4;
BA_ "Version" SG_ 983 Mirror_RHPosMnlReq "22.01.05";
BA_ "NetworkRequestHoldingTime" SG_ 983 Mirror_RHPosMnlReq 5000;
BA_ "NetworkRequest" SG_ 983 Mirror_RHPosMnlReq 0;
BA_ "UserSigValidity" SG_ 983 Mirror_RHPosMnlReq 0;
BA_ "GenSigSendType" SG_ 983 Mirror_RHPosMnlReq 4;
BA_ "Description" SG_ 983 Mirror_RHPosMnlReq "Right Outside Mirror Positioning Request";
BA_ "Version" SG_ 983 Mirror_LHPosMnlCmd "22.11.03";
BA_ "NetworkRequestHoldingTime" SG_ 983 Mirror_LHPosMnlCmd 5000;
BA_ "NetworkRequest" SG_ 983 Mirror_LHPosMnlCmd 0;
BA_ "UserSigValidity" SG_ 983 Mirror_LHPosMnlCmd 0;
BA_ "GenSigSendType" SG_ 983 Mirror_LHPosMnlCmd 4;
BA_ "Description" SG_ 983 Mirror_LHPosMnlCmd "Left Outside Mirror Positioning Command";
BA_ "Version" SG_ 983 Mirror_RHPosMnlCmd "22.11.03";
BA_ "NetworkRequestHoldingTime" SG_ 983 Mirror_RHPosMnlCmd 5000;
BA_ "NetworkRequest" SG_ 983 Mirror_RHPosMnlCmd 0;
BA_ "UserSigValidity" SG_ 983 Mirror_RHPosMnlCmd 0;
BA_ "GenSigSendType" SG_ 983 Mirror_RHPosMnlCmd 4;
BA_ "Description" SG_ 983 Mirror_RHPosMnlCmd "Right Outside Mirror Positioning Command";
BA_ "Version" SG_ 983 Wiper_FrWiperLowAct "22.11.03";
BA_ "NetworkRequestHoldingTime" SG_ 983 Wiper_FrWiperLowAct 5000;
BA_ "NetworkRequest" SG_ 983 Wiper_FrWiperLowAct 0;
BA_ "UserSigValidity" SG_ 983 Wiper_FrWiperLowAct 0;
BA_ "GenSigSendType" SG_ 983 Wiper_FrWiperLowAct 4;
BA_ "Description" SG_ 983 Wiper_FrWiperLowAct "Wiper Low Speed Output";
BA_ "Version" SG_ 983 Wiper_FrWiperHighAct "22.11.03";
BA_ "NetworkRequestHoldingTime" SG_ 983 Wiper_FrWiperHighAct 5000;
BA_ "NetworkRequest" SG_ 983 Wiper_FrWiperHighAct 0;
BA_ "UserSigValidity" SG_ 983 Wiper_FrWiperHighAct 0;
BA_ "GenSigSendType" SG_ 983 Wiper_FrWiperHighAct 4;
BA_ "Description" SG_ 983 Wiper_FrWiperHighAct "Wiper High Speed Output";
BA_ "Version" SG_ 983 Wiper_FrtWiperLowCmd "23.02.02";
BA_ "NetworkRequestHoldingTime" SG_ 983 Wiper_FrtWiperLowCmd 5000;
BA_ "NetworkRequest" SG_ 983 Wiper_FrtWiperLowCmd 0;
BA_ "UserSigValidity" SG_ 983 Wiper_FrtWiperLowCmd 0;
BA_ "GenSigSendType" SG_ 983 Wiper_FrtWiperLowCmd 4;
BA_ "Version" SG_ 983 Wiper_FrtWiperHighCmd "23.02.02";
BA_ "NetworkRequestHoldingTime" SG_ 983 Wiper_FrtWiperHighCmd 5000;
BA_ "NetworkRequest" SG_ 983 Wiper_FrtWiperHighCmd 0;
BA_ "UserSigValidity" SG_ 983 Wiper_FrtWiperHighCmd 0;
BA_ "GenSigSendType" SG_ 983 Wiper_FrtWiperHighCmd 4;
BA_ "Version" SG_ 983 Wiper_RrWiperCmd "23.02.02";
BA_ "NetworkRequestHoldingTime" SG_ 983 Wiper_RrWiperCmd 5000;
BA_ "NetworkRequest" SG_ 983 Wiper_RrWiperCmd 0;
BA_ "UserSigValidity" SG_ 983 Wiper_RrWiperCmd 0;
BA_ "GenSigSendType" SG_ 983 Wiper_RrWiperCmd 4;
BA_ "Version" SG_ 983 Wiper_PowerEnableCmd "23.02.02";
BA_ "NetworkRequestHoldingTime" SG_ 983 Wiper_PowerEnableCmd 5000;
BA_ "NetworkRequest" SG_ 983 Wiper_PowerEnableCmd 0;
BA_ "UserSigValidity" SG_ 983 Wiper_PowerEnableCmd 0;
BA_ "GenSigSendType" SG_ 983 Wiper_PowerEnableCmd 4;
BA_ "Version" SG_ 983 Wiper_FrtWasherCmd "23.02.02";
BA_ "NetworkRequestHoldingTime" SG_ 983 Wiper_FrtWasherCmd 5000;
BA_ "NetworkRequest" SG_ 983 Wiper_FrtWasherCmd 0;
BA_ "UserSigValidity" SG_ 983 Wiper_FrtWasherCmd 0;
BA_ "GenSigSendType" SG_ 983 Wiper_FrtWasherCmd 4;
BA_ "Version" SG_ 983 Wiper_RrWasherCmd "23.02.02";
BA_ "NetworkRequestHoldingTime" SG_ 983 Wiper_RrWasherCmd 5000;
BA_ "NetworkRequest" SG_ 983 Wiper_RrWasherCmd 0;
BA_ "UserSigValidity" SG_ 983 Wiper_RrWasherCmd 0;
BA_ "GenSigSendType" SG_ 983 Wiper_RrWasherCmd 4;
BA_ "Version" SG_ 983 Wiper_HeadLampWasherCmd "23.02.02";
BA_ "NetworkRequestHoldingTime" SG_ 983 Wiper_HeadLampWasherCmd 5000;
BA_ "NetworkRequest" SG_ 983 Wiper_HeadLampWasherCmd 0;
BA_ "UserSigValidity" SG_ 983 Wiper_HeadLampWasherCmd 0;
BA_ "GenSigSendType" SG_ 983 Wiper_HeadLampWasherCmd 4;
BA_ "Version" SG_ 983 Wiper_AutoWashModeSta_TypeC "23.03.01";
BA_ "NetworkRequestHoldingTime" SG_ 983 Wiper_AutoWashModeSta_TypeC 5000;
BA_ "NetworkRequest" SG_ 983 Wiper_AutoWashModeSta_TypeC 0;
BA_ "UserSigValidity" SG_ 983 Wiper_AutoWashModeSta_TypeC 0;
BA_ "GenSigSendType" SG_ 983 Wiper_AutoWashModeSta_TypeC 4;
BA_ "Description" SG_ 983 Wiper_AutoWashModeSta_TypeC "Auto Wash Mode Wiper State";
BA_ "Version" SG_ 983 Mirror_LHPosMnlPlyCmd "23.02.13";
BA_ "NetworkRequestHoldingTime" SG_ 983 Mirror_LHPosMnlPlyCmd 5000;
BA_ "NetworkRequest" SG_ 983 Mirror_LHPosMnlPlyCmd 0;
BA_ "UserSigValidity" SG_ 983 Mirror_LHPosMnlPlyCmd 0;
BA_ "GenSigSendType" SG_ 983 Mirror_LHPosMnlPlyCmd 4;
BA_ "Version" SG_ 983 Mirror_RHPosMnlPlyCmd "23.02.13";
BA_ "NetworkRequestHoldingTime" SG_ 983 Mirror_RHPosMnlPlyCmd 5000;
BA_ "NetworkRequest" SG_ 983 Mirror_RHPosMnlPlyCmd 0;
BA_ "UserSigValidity" SG_ 983 Mirror_RHPosMnlPlyCmd 0;
BA_ "GenSigSendType" SG_ 983 Mirror_RHPosMnlPlyCmd 4;
BA_ "Version" SG_ 983 BDC_FD_AlvCnt8Val "22.11.04";
BA_ "UserSigValidity" SG_ 983 BDC_FD_AlvCnt8Val 0;
BA_ "GenSigSendType" SG_ 983 BDC_FD_AlvCnt8Val 4;
BA_ "Description" SG_ 983 BDC_FD_AlvCnt8Val "For the first transmission request for a data element the counter shall be initialized with 0 and shall be incremented by 1 for every subsequent send request. 

When the counter reaches the maximum value(0xFF), then it shall restart with 0 for the next s";
BA_ "Version" SG_ 983 Mirror_LHPosAutoPlyCmd "23.02.13";
BA_ "NetworkRequestHoldingTime" SG_ 983 Mirror_LHPosAutoPlyCmd 5000;
BA_ "NetworkRequest" SG_ 983 Mirror_LHPosAutoPlyCmd 0;
BA_ "UserSigValidity" SG_ 983 Mirror_LHPosAutoPlyCmd 0;
BA_ "GenSigSendType" SG_ 983 Mirror_LHPosAutoPlyCmd 4;
BA_ "Version" SG_ 983 Mirror_RHPosAutoPlyCmd "23.02.13";
BA_ "NetworkRequestHoldingTime" SG_ 983 Mirror_RHPosAutoPlyCmd 5000;
BA_ "NetworkRequest" SG_ 983 Mirror_RHPosAutoPlyCmd 0;
BA_ "UserSigValidity" SG_ 983 Mirror_RHPosAutoPlyCmd 0;
BA_ "GenSigSendType" SG_ 983 Mirror_RHPosAutoPlyCmd 4;
BA_ "Version" SG_ 983 Mirror_IMSMemoryCmd "23.02.13";
BA_ "NetworkRequestHoldingTime" SG_ 983 Mirror_IMSMemoryCmd 5000;
BA_ "NetworkRequest" SG_ 983 Mirror_IMSMemoryCmd 0;
BA_ "UserSigValidity" SG_ 983 Mirror_IMSMemoryCmd 0;
BA_ "GenSigSendType" SG_ 983 Mirror_IMSMemoryCmd 4;
BA_ "Version" SG_ 983 ECW_Overload2 "24.09.00";
BA_ "NetworkRequestHoldingTime" SG_ 983 ECW_Overload2 5000;
BA_ "NetworkRequest" SG_ 983 ECW_Overload2 0;
BA_ "UserSigValidity" SG_ 983 ECW_Overload2 0;
BA_ "GenSigSendType" SG_ 983 ECW_Overload2 4;
BA_ "Description" SG_ 983 ECW_Overload2 "ECW LIN to CAN Signal

 - SWI Option, OVERLOAD_ECW (2bit)";
BA_ "Version" SG_ 983 Mirror_AutoRevModSetSta "24.10.02";
BA_ "NetworkRequestHoldingTime" SG_ 983 Mirror_AutoRevModSetSta 5000;
BA_ "NetworkRequest" SG_ 983 Mirror_AutoRevModSetSta 0;
BA_ "UserSigValidity" SG_ 983 Mirror_AutoRevModSetSta 0;
BA_ "GenSigSendType" SG_ 983 Mirror_AutoRevModSetSta 4;
BA_ "Description" SG_ 983 Mirror_AutoRevModSetSta "Mirror_AutoRevModSetSta";
BA_ "Version" SG_ 983 IRS_Err_Type "25.04.01";
BA_ "NetworkRequestHoldingTime" SG_ 983 IRS_Err_Type 5000;
BA_ "NetworkRequest" SG_ 983 IRS_Err_Type 0;
BA_ "UserSigValidity" SG_ 983 IRS_Err_Type 0;
BA_ "GenSigSendType" SG_ 983 IRS_Err_Type 4;
BA_ "Description" SG_ 983 IRS_Err_Type "IRS Error Type";
BA_ "Version" SG_ 983 Wiper_RainAmount "23.02.01";
BA_ "NetworkRequestHoldingTime" SG_ 983 Wiper_RainAmount 5000;
BA_ "NetworkRequest" SG_ 983 Wiper_RainAmount 0;
BA_ "UserSigValidity" SG_ 983 Wiper_RainAmount 0;
BA_ "GenSigStartValue" SG_ 983 Wiper_RainAmount 255;
BA_ "GenSigSendType" SG_ 983 Wiper_RainAmount 4;
BA_ "Description" SG_ 983 Wiper_RainAmount "Amount of rain on windshield (LIN to CAN Signal)

- LIN Signal Name : VAL_RAIN_AMOUNT

- 0~150 : PH=0.1*HEX(mm/Hr)

- 151~254 : Reserved

- 255 (1111 1111) : Invalid 



RainSnsrPartNum CU000's Factor is 0.5

- 0~150 : PH=0.5*HEX(%)

- 151~254 : Reserved";
BA_ "Version" SG_ 983 Wiper_AutoWashModeSta "21.12.00";
BA_ "NetworkRequestHoldingTime" SG_ 983 Wiper_AutoWashModeSta 5000;
BA_ "NetworkRequest" SG_ 983 Wiper_AutoWashModeSta 0;
BA_ "UserSigValidity" SG_ 983 Wiper_AutoWashModeSta 0;
BA_ "GenSigSendType" SG_ 983 Wiper_AutoWashModeSta 4;
BA_ "Description" SG_ 983 Wiper_AutoWashModeSta "Auto Wash Mode Wiper State";
BA_ "Version" SG_ 983 Wiper_PrkngPosSta "17.12.00";
BA_ "NetworkRequestHoldingTime" SG_ 983 Wiper_PrkngPosSta 5000;
BA_ "NetworkRequest" SG_ 983 Wiper_PrkngPosSta 0;
BA_ "UserSigValidity" SG_ 983 Wiper_PrkngPosSta 0;
BA_ "GenSigSendType" SG_ 983 Wiper_PrkngPosSta 4;
BA_ "Version" SG_ 983 Wiper_RainSnsrOptionTyp "17.12.00";
BA_ "NetworkRequestHoldingTime" SG_ 983 Wiper_RainSnsrOptionTyp 5000;
BA_ "NetworkRequest" SG_ 983 Wiper_RainSnsrOptionTyp 0;
BA_ "UserSigValidity" SG_ 983 Wiper_RainSnsrOptionTyp 0;
BA_ "GenSigSendType" SG_ 983 Wiper_RainSnsrOptionTyp 4;
BA_ "Description" SG_ 983 Wiper_RainSnsrOptionTyp "Rain Sensor Option Information";
BA_ "Version" SG_ 983 Wiper_HtWshNzzlCmd "20.08.07";
BA_ "NetworkRequestHoldingTime" SG_ 983 Wiper_HtWshNzzlCmd 5000;
BA_ "NetworkRequest" SG_ 983 Wiper_HtWshNzzlCmd 0;
BA_ "UserSigValidity" SG_ 983 Wiper_HtWshNzzlCmd 0;
BA_ "GenSigSendType" SG_ 983 Wiper_HtWshNzzlCmd 4;
BA_ "Description" SG_ 983 Wiper_HtWshNzzlCmd "Heated Washer Nozzle Command";
BA_ "Version" SG_ 983 Wiper_RainSnsrSta "20.08.00";
BA_ "NetworkRequestHoldingTime" SG_ 983 Wiper_RainSnsrSta 5000;
BA_ "NetworkRequest" SG_ 983 Wiper_RainSnsrSta 0;
BA_ "UserSigValidity" SG_ 983 Wiper_RainSnsrSta 0;
BA_ "GenSigSendType" SG_ 983 Wiper_RainSnsrSta 4;
BA_ "Description" SG_ 983 Wiper_RainSnsrSta "This signal represents the status of Rain Sensor signal state. 

- '20. 8/3 : Changed value table (0x5, 0x6 : Fault2/3 → Reserved)";
BA_ "Version" SG_ 983 Wiper_RainSnsrPartNum "25.06.00";
BA_ "NetworkRequestHoldingTime" SG_ 983 Wiper_RainSnsrPartNum 5000;
BA_ "NetworkRequest" SG_ 983 Wiper_RainSnsrPartNum 0;
BA_ "UserSigValidity" SG_ 983 Wiper_RainSnsrPartNum 0;
BA_ "GenSigSendType" SG_ 983 Wiper_RainSnsrPartNum 4;
BA_ "Description" SG_ 983 Wiper_RainSnsrPartNum "Rain Sensor PartNumber (LIN to CAN Signal)

- LIN Signal Name : INFO_PARTNUMBER

▶HELLA

 0x00(0000):NI000 / 0x01(0001):EV000 / 0x02(0010):XA000 / 0x03(0011):DC000 / 0x04(0100):XB000 / 0x5(0101)~0x0E(1110):Reserved / 0x0F(1111):N9000

▶BCS(舊 TRW)

 0x";
BA_ "Version" SG_ 983 ECW_Fault "20.05.02";
BA_ "NetworkRequestHoldingTime" SG_ 983 ECW_Fault 5000;
BA_ "NetworkRequest" SG_ 983 ECW_Fault 0;
BA_ "UserSigValidity" SG_ 983 ECW_Fault 0;
BA_ "GenSigSendType" SG_ 983 ECW_Fault 4;
BA_ "Description" SG_ 983 ECW_Fault "ECW LIN to CAN Signal 

- LIN Signal Name : FAULT_ECW";
BA_ "Version" SG_ 983 ECW_FaultActv "20.05.02";
BA_ "NetworkRequestHoldingTime" SG_ 983 ECW_FaultActv 5000;
BA_ "NetworkRequest" SG_ 983 ECW_FaultActv 0;
BA_ "UserSigValidity" SG_ 983 ECW_FaultActv 0;
BA_ "GenSigStartValue" SG_ 983 ECW_FaultActv 1;
BA_ "GenSigSendType" SG_ 983 ECW_FaultActv 4;
BA_ "Description" SG_ 983 ECW_FaultActv "ECW LIN to CAN Signal

- LIN Signal Name : FAULT_ACTIVE";
BA_ "Version" SG_ 983 ECW_HiVolt "20.05.02";
BA_ "NetworkRequestHoldingTime" SG_ 983 ECW_HiVolt 5000;
BA_ "NetworkRequest" SG_ 983 ECW_HiVolt 0;
BA_ "UserSigValidity" SG_ 983 ECW_HiVolt 0;
BA_ "GenSigSendType" SG_ 983 ECW_HiVolt 4;
BA_ "Description" SG_ 983 ECW_HiVolt "ECW LIN to CAN Signal

- LIN Signal Name : HIGH_VOLT_ECW";
BA_ "Version" SG_ 983 ECW_HiVoltActv "20.05.02";
BA_ "NetworkRequestHoldingTime" SG_ 983 ECW_HiVoltActv 5000;
BA_ "NetworkRequest" SG_ 983 ECW_HiVoltActv 0;
BA_ "UserSigValidity" SG_ 983 ECW_HiVoltActv 0;
BA_ "GenSigStartValue" SG_ 983 ECW_HiVoltActv 1;
BA_ "GenSigSendType" SG_ 983 ECW_HiVoltActv 4;
BA_ "Description" SG_ 983 ECW_HiVoltActv "ECW LIN to CAN Signal

- LIN Signal Name : HIGH_VOLT_ACTIVE";
BA_ "Version" SG_ 983 ECW_LoVolt "20.05.02";
BA_ "NetworkRequestHoldingTime" SG_ 983 ECW_LoVolt 5000;
BA_ "NetworkRequest" SG_ 983 ECW_LoVolt 0;
BA_ "UserSigValidity" SG_ 983 ECW_LoVolt 0;
BA_ "GenSigSendType" SG_ 983 ECW_LoVolt 4;
BA_ "Description" SG_ 983 ECW_LoVolt "ECW LIN to CAN Signal

- LIN Signal Name : LOW_VOLT_ECW";
BA_ "Version" SG_ 983 ECW_LoVoltActv "20.05.02";
BA_ "NetworkRequestHoldingTime" SG_ 983 ECW_LoVoltActv 5000;
BA_ "NetworkRequest" SG_ 983 ECW_LoVoltActv 0;
BA_ "UserSigValidity" SG_ 983 ECW_LoVoltActv 0;
BA_ "GenSigStartValue" SG_ 983 ECW_LoVoltActv 1;
BA_ "GenSigSendType" SG_ 983 ECW_LoVoltActv 4;
BA_ "Description" SG_ 983 ECW_LoVoltActv "ECW LIN to CAN Signal

- LIN Signal Name : LOW_VOLT_ACTIVE";
BA_ "Version" SG_ 983 ECW_Overload "20.05.02";
BA_ "NetworkRequestHoldingTime" SG_ 983 ECW_Overload 5000;
BA_ "NetworkRequest" SG_ 983 ECW_Overload 0;
BA_ "UserSigValidity" SG_ 983 ECW_Overload 0;
BA_ "GenSigSendType" SG_ 983 ECW_Overload 4;
BA_ "Description" SG_ 983 ECW_Overload "ECW LIN to CAN Signal

- LIN Signal Name : OVERLOAD_ECW";
BA_ "Version" SG_ 983 ECW_OverloadActv "20.05.02";
BA_ "NetworkRequestHoldingTime" SG_ 983 ECW_OverloadActv 5000;
BA_ "NetworkRequest" SG_ 983 ECW_OverloadActv 0;
BA_ "UserSigValidity" SG_ 983 ECW_OverloadActv 0;
BA_ "GenSigStartValue" SG_ 983 ECW_OverloadActv 1;
BA_ "GenSigSendType" SG_ 983 ECW_OverloadActv 4;
BA_ "Description" SG_ 983 ECW_OverloadActv "ECW LIN to CAN Signal

- LIN Signal Name : OVERLOAD_ACTIVE";
BA_ "Version" SG_ 983 ECW_CommErr "20.05.02";
BA_ "NetworkRequestHoldingTime" SG_ 983 ECW_CommErr 5000;
BA_ "NetworkRequest" SG_ 983 ECW_CommErr 0;
BA_ "UserSigValidity" SG_ 983 ECW_CommErr 0;
BA_ "GenSigSendType" SG_ 983 ECW_CommErr 4;
BA_ "Description" SG_ 983 ECW_CommErr "ECW LIN to CAN Signal

- LIN Signal Name : ERR_COMM_ECW";
BA_ "Version" SG_ 983 ECW_Err_Type "25.04.01";
BA_ "NetworkRequestHoldingTime" SG_ 983 ECW_Err_Type 5000;
BA_ "NetworkRequest" SG_ 983 ECW_Err_Type 0;
BA_ "UserSigValidity" SG_ 983 ECW_Err_Type 0;
BA_ "GenSigSendType" SG_ 983 ECW_Err_Type 4;
BA_ "Version" SG_ 983 Wiper_NonParkWarning "25.06.00";
BA_ "NetworkRequestHoldingTime" SG_ 983 Wiper_NonParkWarning 5000;
BA_ "NetworkRequest" SG_ 983 Wiper_NonParkWarning 0;
BA_ "UserSigValidity" SG_ 983 Wiper_NonParkWarning 0;
BA_ "GenSigSendType" SG_ 983 Wiper_NonParkWarning 4;
BA_ "Version" SG_ 983 BCM_SolSnsrRt "24.05.01";
BA_ "NetworkRequestHoldingTime" SG_ 983 BCM_SolSnsrRt 5000;
BA_ "NetworkRequest" SG_ 983 BCM_SolSnsrRt 0;
BA_ "UserSigValidity" SG_ 983 BCM_SolSnsrRt 0;
BA_ "GenSigSendType" SG_ 983 BCM_SolSnsrRt 4;
BA_ "Description" SG_ 983 BCM_SolSnsrRt "This signal indicates solar sensor output W/m^2 - RH";
BA_ "Version" SG_ 983 BCM_SolSnsrLft "24.05.01";
BA_ "NetworkRequestHoldingTime" SG_ 983 BCM_SolSnsrLft 5000;
BA_ "NetworkRequest" SG_ 983 BCM_SolSnsrLft 0;
BA_ "UserSigValidity" SG_ 983 BCM_SolSnsrLft 0;
BA_ "GenSigSendType" SG_ 983 BCM_SolSnsrLft 4;
BA_ "Description" SG_ 983 BCM_SolSnsrLft "This signal indicates solar sensor output W/m^2 - LH";
BA_ "Version" SG_ 983 Mirror_MirFldOpt "21.04.00";
BA_ "NetworkRequestHoldingTime" SG_ 983 Mirror_MirFldOpt 5000;
BA_ "NetworkRequest" SG_ 983 Mirror_MirFldOpt 0;
BA_ "UserSigValidity" SG_ 983 Mirror_MirFldOpt 0;
BA_ "GenSigSendType" SG_ 983 Mirror_MirFldOpt 4;
BA_ "Description" SG_ 983 Mirror_MirFldOpt "Outside Mirror Electric Fold Option Signal";
BA_ "Version" SG_ 983 Mirror_FldUnfldCmd "21.03.00";
BA_ "NetworkRequestHoldingTime" SG_ 983 Mirror_FldUnfldCmd 5000;
BA_ "NetworkRequest" SG_ 983 Mirror_FldUnfldCmd 0;
BA_ "UserSigValidity" SG_ 983 Mirror_FldUnfldCmd 0;
BA_ "GenSigSendType" SG_ 983 Mirror_FldUnfldCmd 4;
BA_ "Description" SG_ 983 Mirror_FldUnfldCmd "Mirror Folding Unfolding Command";
BA_ "Version" SG_ 983 Mirror_FldCtrlSta "21.03.00";
BA_ "NetworkRequestHoldingTime" SG_ 983 Mirror_FldCtrlSta 5000;
BA_ "NetworkRequest" SG_ 983 Mirror_FldCtrlSta 0;
BA_ "UserSigValidity" SG_ 983 Mirror_FldCtrlSta 0;
BA_ "GenSigSendType" SG_ 983 Mirror_FldCtrlSta 4;
BA_ "Description" SG_ 983 Mirror_FldCtrlSta "Mirror Fold and Folding Control State";
BA_ "Version" SG_ 983 Mirror_UnFldCtrlSta "21.03.00";
BA_ "NetworkRequestHoldingTime" SG_ 983 Mirror_UnFldCtrlSta 5000;
BA_ "NetworkRequest" SG_ 983 Mirror_UnFldCtrlSta 0;
BA_ "UserSigValidity" SG_ 983 Mirror_UnFldCtrlSta 0;
BA_ "GenSigSendType" SG_ 983 Mirror_UnFldCtrlSta 4;
BA_ "Description" SG_ 983 Mirror_UnFldCtrlSta "Mirror Unfold and Unfolding Control State";
BA_ "Version" SG_ 983 Mirror_PosMnlCmd "21.10.04";
BA_ "NetworkRequestHoldingTime" SG_ 983 Mirror_PosMnlCmd 5000;
BA_ "NetworkRequest" SG_ 983 Mirror_PosMnlCmd 0;
BA_ "UserSigValidity" SG_ 983 Mirror_PosMnlCmd 0;
BA_ "GenSigSendType" SG_ 983 Mirror_PosMnlCmd 4;
BA_ "Description" SG_ 983 Mirror_PosMnlCmd "Mirror Positioning Command";
BA_ "Version" SG_ 983 Mirror_SelSwIndCmd "21.03.00";
BA_ "NetworkRequestHoldingTime" SG_ 983 Mirror_SelSwIndCmd 5000;
BA_ "NetworkRequest" SG_ 983 Mirror_SelSwIndCmd 0;
BA_ "UserSigValidity" SG_ 983 Mirror_SelSwIndCmd 0;
BA_ "GenSigSendType" SG_ 983 Mirror_SelSwIndCmd 4;
BA_ "Description" SG_ 983 Mirror_SelSwIndCmd "Mirror Select Switch Indicator Command";
BA_ "Version" SG_ 861 LBM_FD_Crc3Val "24.04.07";
BA_ "UserSigValidity" SG_ 861 LBM_FD_Crc3Val 3;
BA_ "GenSigStartValue" SG_ 861 LBM_FD_Crc3Val 65535;
BA_ "Description" SG_ 861 LBM_FD_Crc3Val "The data area for CRC calculation is based on the data length (DLC) of the message DB.

The CRC shall be calculated over the entire data block (excluding the CRC bytes) including the user data, alive counter and Data ID



- CRC Polynomial (0x1021) , Ini";
BA_ "Version" SG_ 861 MainLBM_CellVtgDeviationSta "25.01.00";
BA_ "UserSigValidity" SG_ 861 MainLBM_CellVtgDeviationSta 0;
BA_ "Description" SG_ 861 MainLBM_CellVtgDeviationSta "-Bit0 : Cell1 Voltage Deviation

-Bit1 : Cell2 Voltage Deviation

-Bit2 : Cell3 Voltage Deviation

-Bit3 : Cell4 Voltage Deviation

-Bit4 : Cell5 Voltage Deviation

-Bit5 : Cell6 Voltage Deviation

-Bit6 : Cell7 Voltage Deviation

-Bit7 : Cell8 Voltage D";
BA_ "Version" SG_ 861 MainLBM_12VAvgCurrAtReset "25.01.00";
BA_ "UserSigValidity" SG_ 861 MainLBM_12VAvgCurrAtReset 0;
BA_ "GenSigStartValue" SG_ 861 MainLBM_12VAvgCurrAtReset 4094;
BA_ "Description" SG_ 861 MainLBM_12VAvgCurrAtReset "Average 12V Current at reset

0x0~0xFFE : Valid Value

(-40,940mA~0mA)

0xFFF : Error ID";
BA_ "Version" SG_ 861 MainLBM_VehSpdLimContReq "25.06.01";
BA_ "UserSigValidity" SG_ 861 MainLBM_VehSpdLimContReq 0;
BA_ "Description" SG_ 861 MainLBM_VehSpdLimContReq "Vehicle Speed Deceleration Control Request to VPC when LBM has a critical problem";
BA_ "Version" SG_ 861 LBM_FD_AlvCnt3Val "24.04.07";
BA_ "UserSigValidity" SG_ 861 LBM_FD_AlvCnt3Val 3;
BA_ "Description" SG_ 861 LBM_FD_AlvCnt3Val "For the first transmission request for a data element the counter shall be initialized with 0 and shall be incremented by 1 for every subsequent send request. 

When the counter reaches the maximum value(0xFF), then it shall restart with 0 for the next s";
BA_ "Version" SG_ 861 MainLBM_OptType "24.04.07";
BA_ "UserSigValidity" SG_ 861 MainLBM_OptType 0;
BA_ "Description" SG_ 861 MainLBM_OptType "Main Lithium Battery Option Information";
BA_ "Version" SG_ 861 MainLBM_RlyOnSta "24.04.07";
BA_ "UserSigValidity" SG_ 861 MainLBM_RlyOnSta 0;
BA_ "GenSigStartValue" SG_ 861 MainLBM_RlyOnSta 1;
BA_ "Description" SG_ 861 MainLBM_RlyOnSta "12V Battery Latch Relay On Status(Ref. Command)";
BA_ "Version" SG_ 861 MainLBM_RlyOutVoltVal "24.04.07";
BA_ "UserSigValidity" SG_ 861 MainLBM_RlyOutVoltVal 0;
BA_ "Description" SG_ 861 MainLBM_RlyOutVoltVal "12V Battery Relay Output Voltage (Voltage of the Latter Part)

(All the analog value indicate valid values except for Error ID)";
BA_ "Version" SG_ 861 MainLBM_RlyOnSwReq "24.04.07";
BA_ "UserSigValidity" SG_ 861 MainLBM_RlyOnSwReq 0;
BA_ "Description" SG_ 861 MainLBM_RlyOnSwReq "12V relay ON switch ON status. BMS sets this Flag when 12V Relay Switch is ON.";
BA_ "Version" SG_ 861 MainLBM_BmsFailWarn "24.04.07";
BA_ "UserSigValidity" SG_ 861 MainLBM_BmsFailWarn 0;
BA_ "Description" SG_ 861 MainLBM_BmsFailWarn "If a 12V lithium battery fails, it is a signal that is sent according to the type of fault";
BA_ "Version" SG_ 861 MainLBM_FaultSta "25.07.04";
BA_ "UserSigValidity" SG_ 861 MainLBM_FaultSta 0;
BA_ "Description" SG_ 861 MainLBM_FaultSta "-bit0 : Permanent Failure?

-bit1 : Over Voltage Fault Failure?

-bit2 : Low Voltage Fault Failure/?

-bit3 : Over Current Fault Failure?

-bit4 : Over Temp Fault Failure?

-bit5 : Temp Sensor Fault Failure?

-bit6 : Current Sensor Fault Failure?

-bit7 ";
BA_ "Version" SG_ 861 MainLBM_ResetOpSta "24.05.04";
BA_ "UserSigValidity" SG_ 861 MainLBM_ResetOpSta 0;
BA_ "Description" SG_ 861 MainLBM_ResetOpSta "This signal indicates whether the reset operation has been completed or not";
BA_ "Version" SG_ 861 MainLBM_CellOverVtgSta "25.01.00";
BA_ "UserSigValidity" SG_ 861 MainLBM_CellOverVtgSta 0;
BA_ "Description" SG_ 861 MainLBM_CellOverVtgSta "-Bit0 : Cell1 Over Voltage Fault

-Bit1 : Cell2 Over Voltage Fault 

-Bit2 : Cell3 Over Voltage Fault

-Bit3 : Cell4 Over Voltage Fault

-Bit4 : Cell5 Over Voltage Fault

-Bit5 : Cell6 Over Voltage Fault

-Bit6 : Cell7 Over Voltage Fault

-Bit7 : Cell8 O";
BA_ "Version" SG_ 861 MainLBM_CellLowVtgSta "25.01.00";
BA_ "UserSigValidity" SG_ 861 MainLBM_CellLowVtgSta 0;
BA_ "Description" SG_ 861 MainLBM_CellLowVtgSta "-Bit0 : Cell1 Low Voltage Fault

-Bit1 : Cell2 Low Voltage Fault 

-Bit2 : Cell3 Low Voltage Fault

-Bit3 : Cell4 Low Voltage Fault

-Bit4 : Cell5 Low Voltage Fault

-Bit5 : Cell6 Low Voltage Fault

-Bit6 : Cell7 Low Voltage Fault

-Bit7 : Cell8 Low Volt";
BA_ "Version" SG_ 861 MainLBM_CellOverTempSta "25.01.00";
BA_ "UserSigValidity" SG_ 861 MainLBM_CellOverTempSta 0;
BA_ "Description" SG_ 861 MainLBM_CellOverTempSta "-Bit0 : Cell1 Over Temperature Fault

-Bit1 : Cell2 Over Temperature Fault 

-Bit2 : Cell3 Over Temperature Fault

-Bit3 : Cell4 Over Temperature Fault

-Bit4 : Cell5 Over Temperature Fault

-Bit5 : Cell6 Over Temperature Fault

-Bit6 : Cell7 Over Temper";
BA_ "Version" SG_ 980 BDC_FD_Crc5Val "22.11.04";
BA_ "UserSigValidity" SG_ 980 BDC_FD_Crc5Val 0;
BA_ "GenSigStartValue" SG_ 980 BDC_FD_Crc5Val 65535;
BA_ "GenSigSendType" SG_ 980 BDC_FD_Crc5Val 4;
BA_ "Description" SG_ 980 BDC_FD_Crc5Val "The data area for CRC calculation is based on the data length (DLC) of the message DB.

The CRC shall be calculated over the entire data block (excluding the CRC bytes) including the user data, alive counter and Data ID



- CRC Polynomial (0x1021) , Ini";
BA_ "Version" SG_ 980 AutoLt_HorRes_STD "23.01.01";
BA_ "NetworkRequestHoldingTime" SG_ 980 AutoLt_HorRes_STD 5000;
BA_ "NetworkRequest" SG_ 980 AutoLt_HorRes_STD 0;
BA_ "UserSigValidity" SG_ 980 AutoLt_HorRes_STD 0;
BA_ "GenSigSendType" SG_ 980 AutoLt_HorRes_STD 4;
BA_ "Description" SG_ 980 AutoLt_HorRes_STD "This signal is standard horizontal resolution of autolight sensor.



Horizontal brightness(lux)=AutoLt_HorRes_STD*AutoLt_HorVal_STD

※ AutoLt_HorVal_STD : Horizontal value signal

Brightness 0~1,000lux : Resolution is 1lux and value is 0(0h)~1,000(3E8h";
BA_ "Version" SG_ 980 AutoLt_VerVal_STD "23.01.01";
BA_ "NetworkRequestHoldingTime" SG_ 980 AutoLt_VerVal_STD 5000;
BA_ "NetworkRequest" SG_ 980 AutoLt_VerVal_STD 0;
BA_ "UserSigValidity" SG_ 980 AutoLt_VerVal_STD 0;
BA_ "GenSigSendType" SG_ 980 AutoLt_VerVal_STD 4;
BA_ "Description" SG_ 980 AutoLt_VerVal_STD "This signal is standard vertical value of autolight sensor.



Vertical brightness(lux)=AutoLt_VerRes_STD*AutoLt_VerVal_STD

※ AutoLt_VerRes_STD : Vertical resolution signal

Brightness 0~1,000lux : Resolution is 1lux and value is 0(0h)~1,000(3E8h)

Bri";
BA_ "Version" SG_ 980 AutoLt_VerRes_STD "23.01.01";
BA_ "NetworkRequestHoldingTime" SG_ 980 AutoLt_VerRes_STD 5000;
BA_ "NetworkRequest" SG_ 980 AutoLt_VerRes_STD 0;
BA_ "UserSigValidity" SG_ 980 AutoLt_VerRes_STD 0;
BA_ "GenSigSendType" SG_ 980 AutoLt_VerRes_STD 4;
BA_ "Description" SG_ 980 AutoLt_VerRes_STD "This signal is standard vertical resolution of autolight sensor.



Vertical brightness(lux)=AutoLt_VerRes_STD*AutoLt_VerVal_STD

※ AutoLt_VerVal_STD : Vertical value signal

Brightness 0~1,000lux : Resolution is 1lux and value is 0(0h)~1,000(3E8h)

Bri";
BA_ "Version" SG_ 980 MoodLamp_SlvColor_X "23.02.02";
BA_ "UserSigValidity" SG_ 980 MoodLamp_SlvColor_X 0;
BA_ "GenSigStartValue" SG_ 980 MoodLamp_SlvColor_X 47;
BA_ "GenSigSendType" SG_ 980 MoodLamp_SlvColor_X 4;
BA_ "Description" SG_ 980 MoodLamp_SlvColor_X "Color X Mood Lamp to slave";
BA_ "Version" SG_ 980 MoodLamp_SlvColor_Y "23.02.02";
BA_ "UserSigValidity" SG_ 980 MoodLamp_SlvColor_Y 0;
BA_ "GenSigStartValue" SG_ 980 MoodLamp_SlvColor_Y 51;
BA_ "GenSigSendType" SG_ 980 MoodLamp_SlvColor_Y 4;
BA_ "Description" SG_ 980 MoodLamp_SlvColor_Y "Color Y Mood lamp to slave";
BA_ "Version" SG_ 980 MoodLamp_SlvBrgtnsVal "23.02.02";
BA_ "UserSigValidity" SG_ 980 MoodLamp_SlvBrgtnsVal 0;
BA_ "GenSigStartValue" SG_ 980 MoodLamp_SlvBrgtnsVal 250;
BA_ "GenSigSendType" SG_ 980 MoodLamp_SlvBrgtnsVal 4;
BA_ "Description" SG_ 980 MoodLamp_SlvBrgtnsVal "Brightness mood lamp to slave";
BA_ "Version" SG_ 980 MoodLamp_SlvFadeInTimetVal "23.02.02";
BA_ "UserSigValidity" SG_ 980 MoodLamp_SlvFadeInTimetVal 0;
BA_ "GenSigStartValue" SG_ 980 MoodLamp_SlvFadeInTimetVal 10;
BA_ "GenSigSendType" SG_ 980 MoodLamp_SlvFadeInTimetVal 4;
BA_ "Description" SG_ 980 MoodLamp_SlvFadeInTimetVal "Fade In Time Mood Lamp to slave";
BA_ "Version" SG_ 980 BDC_FD_AlvCnt5Val "22.11.04";
BA_ "UserSigValidity" SG_ 980 BDC_FD_AlvCnt5Val 0;
BA_ "GenSigSendType" SG_ 980 BDC_FD_AlvCnt5Val 4;
BA_ "Description" SG_ 980 BDC_FD_AlvCnt5Val "For the first transmission request for a data element the counter shall be initialized with 0 and shall be incremented by 1 for every subsequent send request. 

When the counter reaches the maximum value(0xFF), then it shall restart with 0 for the next s";
BA_ "Version" SG_ 980 MoodLamp_SlvFadeOutTimetVal "23.02.02";
BA_ "UserSigValidity" SG_ 980 MoodLamp_SlvFadeOutTimetVal 0;
BA_ "GenSigStartValue" SG_ 980 MoodLamp_SlvFadeOutTimetVal 10;
BA_ "GenSigSendType" SG_ 980 MoodLamp_SlvFadeOutTimetVal 4;
BA_ "Description" SG_ 980 MoodLamp_SlvFadeOutTimetVal "Fade Out Time Mood Lamp to slave";
BA_ "Version" SG_ 980 Lamp_LftTrnLmpCmdSta "23.02.06";
BA_ "NetworkRequestHoldingTime" SG_ 980 Lamp_LftTrnLmpCmdSta 5000;
BA_ "NetworkRequest" SG_ 980 Lamp_LftTrnLmpCmdSta 0;
BA_ "UserSigValidity" SG_ 980 Lamp_LftTrnLmpCmdSta 0;
BA_ "GenSigSendType" SG_ 980 Lamp_LftTrnLmpCmdSta 4;
BA_ "Description" SG_ 980 Lamp_LftTrnLmpCmdSta "Left Turn Signal and Hazard Lamp Command State";
BA_ "Version" SG_ 980 Lamp_RtTrnLmpCmdSta "23.02.06";
BA_ "NetworkRequestHoldingTime" SG_ 980 Lamp_RtTrnLmpCmdSta 5000;
BA_ "NetworkRequest" SG_ 980 Lamp_RtTrnLmpCmdSta 0;
BA_ "UserSigValidity" SG_ 980 Lamp_RtTrnLmpCmdSta 0;
BA_ "GenSigSendType" SG_ 980 Lamp_RtTrnLmpCmdSta 4;
BA_ "Description" SG_ 980 Lamp_RtTrnLmpCmdSta "Right Turn Signal and Hazard Lamp Command State";
BA_ "Version" SG_ 980 Lamp_LftTrnLmpCmd "23.02.10";
BA_ "NetworkRequestHoldingTime" SG_ 980 Lamp_LftTrnLmpCmd 5000;
BA_ "NetworkRequest" SG_ 980 Lamp_LftTrnLmpCmd 0;
BA_ "UserSigValidity" SG_ 980 Lamp_LftTrnLmpCmd 0;
BA_ "GenSigSendType" SG_ 980 Lamp_LftTrnLmpCmd 4;
BA_ "Description" SG_ 980 Lamp_LftTrnLmpCmd "Left Turn Signal and Hazard Lamp Command State";
BA_ "Version" SG_ 980 Lamp_RtTrnLmpCmd "23.02.10";
BA_ "NetworkRequestHoldingTime" SG_ 980 Lamp_RtTrnLmpCmd 500;
BA_ "NetworkRequest" SG_ 980 Lamp_RtTrnLmpCmd 0;
BA_ "UserSigValidity" SG_ 980 Lamp_RtTrnLmpCmd 0;
BA_ "GenSigSendType" SG_ 980 Lamp_RtTrnLmpCmd 4;
BA_ "Description" SG_ 980 Lamp_RtTrnLmpCmd "Right Turn Signal and Hazard Lamp Command";
BA_ "Version" SG_ 980 Lamp_TrnLmpMode "23.04.06";
BA_ "NetworkRequestHoldingTime" SG_ 980 Lamp_TrnLmpMode 5000;
BA_ "NetworkRequest" SG_ 980 Lamp_TrnLmpMode 0;
BA_ "UserSigValidity" SG_ 980 Lamp_TrnLmpMode 0;
BA_ "GenSigSendType" SG_ 980 Lamp_TrnLmpMode 4;
BA_ "Description" SG_ 980 Lamp_TrnLmpMode "Turn Signal and Hazard Lamp Mode";
BA_ "Version" SG_ 980 Lamp_HzrdSwIND "23.02.10";
BA_ "NetworkRequestHoldingTime" SG_ 980 Lamp_HzrdSwIND 5000;
BA_ "NetworkRequest" SG_ 980 Lamp_HzrdSwIND 0;
BA_ "UserSigValidity" SG_ 980 Lamp_HzrdSwIND 0;
BA_ "GenSigSendType" SG_ 980 Lamp_HzrdSwIND 4;
BA_ "Description" SG_ 980 Lamp_HzrdSwIND "Hazard switch indicator command";
BA_ "Version" SG_ 980 Lamp_HdLmpEscortShortCmd "23.07.06";
BA_ "NetworkRequestHoldingTime" SG_ 980 Lamp_HdLmpEscortShortCmd 5000;
BA_ "NetworkRequest" SG_ 980 Lamp_HdLmpEscortShortCmd 0;
BA_ "UserSigValidity" SG_ 980 Lamp_HdLmpEscortShortCmd 0;
BA_ "GenSigSendType" SG_ 980 Lamp_HdLmpEscortShortCmd 4;
BA_ "Description" SG_ 980 Lamp_HdLmpEscortShortCmd "HeadLamp Escort(short) Cmd";
BA_ "Version" SG_ 980 Lamp_LightPopUpMsgType "23.10.00";
BA_ "NetworkRequestHoldingTime" SG_ 980 Lamp_LightPopUpMsgType 5000;
BA_ "NetworkRequest" SG_ 980 Lamp_LightPopUpMsgType 0;
BA_ "UserSigValidity" SG_ 980 Lamp_LightPopUpMsgType 0;
BA_ "GenSigSendType" SG_ 980 Lamp_LightPopUpMsgType 4;
BA_ "Description" SG_ 980 Lamp_LightPopUpMsgType "Only for CPAD type lightmode switch.

Type A : OFF-TAIL-AUTO-LOW

Type B : AUTO-LOW";
BA_ "Version" SG_ 980 Lamp_LightPopUpReq "25.10.00";
BA_ "NetworkRequestHoldingTime" SG_ 980 Lamp_LightPopUpReq 5000;
BA_ "NetworkRequest" SG_ 980 Lamp_LightPopUpReq 0;
BA_ "UserSigValidity" SG_ 980 Lamp_LightPopUpReq 0;
BA_ "GenSigSendType" SG_ 980 Lamp_LightPopUpReq 4;
BA_ "Description" SG_ 980 Lamp_LightPopUpReq "Only for CPAD Type Lightmode Switch

Current light switch state when the switch is pushed";
BA_ "Version" SG_ 980 Lamp_HdLmpLoOffPopUpReq "24.04.03";
BA_ "NetworkRequestHoldingTime" SG_ 980 Lamp_HdLmpLoOffPopUpReq 5000;
BA_ "NetworkRequest" SG_ 980 Lamp_HdLmpLoOffPopUpReq 0;
BA_ "UserSigValidity" SG_ 980 Lamp_HdLmpLoOffPopUpReq 0;
BA_ "GenSigSendType" SG_ 980 Lamp_HdLmpLoOffPopUpReq 4;
BA_ "Description" SG_ 980 Lamp_HdLmpLoOffPopUpReq "Head Lamp off pop up alarm request";
BA_ "Version" SG_ 980 MoodLamp_SpeechRecogPosSta "24.05.01";
BA_ "UserSigValidity" SG_ 980 MoodLamp_SpeechRecogPosSta 0;
BA_ "GenSigSendType" SG_ 980 MoodLamp_SpeechRecogPosSta 4;
BA_ "Description" SG_ 980 MoodLamp_SpeechRecogPosSta "MoodLamp AIVoice Speech Recognition Position Status";
BA_ "Version" SG_ 980 MoodLamp_BttmSlvColor_X "24.07.06";
BA_ "UserSigValidity" SG_ 980 MoodLamp_BttmSlvColor_X 0;
BA_ "GenSigStartValue" SG_ 980 MoodLamp_BttmSlvColor_X 47;
BA_ "GenSigSendType" SG_ 980 MoodLamp_BttmSlvColor_X 4;
BA_ "Description" SG_ 980 MoodLamp_BttmSlvColor_X "Color X Mood Lamp to slave (Bottom)";
BA_ "Version" SG_ 980 MoodLamp_BttmSlvColor_Y "24.07.06";
BA_ "UserSigValidity" SG_ 980 MoodLamp_BttmSlvColor_Y 0;
BA_ "GenSigStartValue" SG_ 980 MoodLamp_BttmSlvColor_Y 51;
BA_ "GenSigSendType" SG_ 980 MoodLamp_BttmSlvColor_Y 4;
BA_ "Description" SG_ 980 MoodLamp_BttmSlvColor_Y "Color Y Mood Lamp to slave (Bottom)";
BA_ "Version" SG_ 980 MoodLamp_BttmSlvBrgtnsVal "24.07.06";
BA_ "UserSigValidity" SG_ 980 MoodLamp_BttmSlvBrgtnsVal 0;
BA_ "GenSigStartValue" SG_ 980 MoodLamp_BttmSlvBrgtnsVal 250;
BA_ "GenSigSendType" SG_ 980 MoodLamp_BttmSlvBrgtnsVal 4;
BA_ "Description" SG_ 980 MoodLamp_BttmSlvBrgtnsVal "Brightness mood lamp to slave (Bottom)";
BA_ "Version" SG_ 980 MoodLamp_BttmSlvFadeInTimetVal "24.07.06";
BA_ "UserSigValidity" SG_ 980 MoodLamp_BttmSlvFadeInTimetVal 0;
BA_ "GenSigStartValue" SG_ 980 MoodLamp_BttmSlvFadeInTimetVal 10;
BA_ "GenSigSendType" SG_ 980 MoodLamp_BttmSlvFadeInTimetVal 4;
BA_ "Description" SG_ 980 MoodLamp_BttmSlvFadeInTimetVal "Fade In Time Mood Lamp to slave (Bottom)";
BA_ "Version" SG_ 980 MoodLamp_BttmSlvFadeOutTimetVal "24.07.06";
BA_ "UserSigValidity" SG_ 980 MoodLamp_BttmSlvFadeOutTimetVal 0;
BA_ "GenSigStartValue" SG_ 980 MoodLamp_BttmSlvFadeOutTimetVal 10;
BA_ "GenSigSendType" SG_ 980 MoodLamp_BttmSlvFadeOutTimetVal 4;
BA_ "Description" SG_ 980 MoodLamp_BttmSlvFadeOutTimetVal "Fade Out Time Mood Lamp to slave (Bottom)";
BA_ "Version" SG_ 980 Lamp_FrontGroundLightOnReq "24.07.05";
BA_ "NetworkRequestHoldingTime" SG_ 980 Lamp_FrontGroundLightOnReq 5000;
BA_ "NetworkRequest" SG_ 980 Lamp_FrontGroundLightOnReq 0;
BA_ "UserSigValidity" SG_ 980 Lamp_FrontGroundLightOnReq 0;
BA_ "GenSigSendType" SG_ 980 Lamp_FrontGroundLightOnReq 4;
BA_ "Description" SG_ 980 Lamp_FrontGroundLightOnReq "Signal for turning On/Off front exterior lamp for ground lighting";
BA_ "Version" SG_ 980 Lamp_SideGroundLightOnReq "24.07.05";
BA_ "NetworkRequestHoldingTime" SG_ 980 Lamp_SideGroundLightOnReq 5000;
BA_ "NetworkRequest" SG_ 980 Lamp_SideGroundLightOnReq 0;
BA_ "UserSigValidity" SG_ 980 Lamp_SideGroundLightOnReq 0;
BA_ "GenSigSendType" SG_ 980 Lamp_SideGroundLightOnReq 4;
BA_ "Description" SG_ 980 Lamp_SideGroundLightOnReq "Signal for turning On/Off side exterior lamp for ground lighting";
BA_ "Version" SG_ 980 Lamp_RearGroundLightOnReq "24.07.05";
BA_ "NetworkRequestHoldingTime" SG_ 980 Lamp_RearGroundLightOnReq 5000;
BA_ "NetworkRequest" SG_ 980 Lamp_RearGroundLightOnReq 0;
BA_ "UserSigValidity" SG_ 980 Lamp_RearGroundLightOnReq 0;
BA_ "GenSigSendType" SG_ 980 Lamp_RearGroundLightOnReq 4;
BA_ "Description" SG_ 980 Lamp_RearGroundLightOnReq "Signal for turning On/Off rear exterior lamp for ground lighting";
BA_ "Version" SG_ 980 Lamp_HiPrioHzrdReq "17.12.00";
BA_ "NetworkRequestHoldingTime" SG_ 980 Lamp_HiPrioHzrdReq 5000;
BA_ "NetworkRequest" SG_ 980 Lamp_HiPrioHzrdReq 0;
BA_ "UserSigValidity" SG_ 980 Lamp_HiPrioHzrdReq 0;
BA_ "GenSigStartValue" SG_ 980 Lamp_HiPrioHzrdReq 2;
BA_ "GenSigSendType" SG_ 980 Lamp_HiPrioHzrdReq 4;
BA_ "Description" SG_ 980 Lamp_HiPrioHzrdReq "-Higher priority than SJB hazard

-Diag/Arm/DisArm/Balarm/Panic/MTS

-Initial Value: 2";
BA_ "Version" SG_ 980 Lamp_DecoLmpOnReq "25.06.00";
BA_ "NetworkRequestHoldingTime" SG_ 980 Lamp_DecoLmpOnReq 5000;
BA_ "NetworkRequest" SG_ 980 Lamp_DecoLmpOnReq 0;
BA_ "UserSigValidity" SG_ 980 Lamp_DecoLmpOnReq 0;
BA_ "GenSigSendType" SG_ 980 Lamp_DecoLmpOnReq 4;
BA_ "Description" SG_ 980 Lamp_DecoLmpOnReq "Signal for turning On/Off deco lamp";
BA_ "Version" SG_ 980 Lamp_SideGndLmpCmd "24.10.01";
BA_ "NetworkRequestHoldingTime" SG_ 980 Lamp_SideGndLmpCmd 5000;
BA_ "NetworkRequest" SG_ 980 Lamp_SideGndLmpCmd 0;
BA_ "UserSigValidity" SG_ 980 Lamp_SideGndLmpCmd 0;
BA_ "GenSigSendType" SG_ 980 Lamp_SideGndLmpCmd 4;
BA_ "Description" SG_ 980 Lamp_SideGndLmpCmd "Side ground lamp for ground lighting";
BA_ "Version" SG_ 980 Lamp_SideGndCptLmpCmd "24.10.01";
BA_ "NetworkRequestHoldingTime" SG_ 980 Lamp_SideGndCptLmpCmd 5000;
BA_ "NetworkRequest" SG_ 980 Lamp_SideGndCptLmpCmd 0;
BA_ "UserSigValidity" SG_ 980 Lamp_SideGndCptLmpCmd 0;
BA_ "GenSigSendType" SG_ 980 Lamp_SideGndCptLmpCmd 4;
BA_ "Description" SG_ 980 Lamp_SideGndCptLmpCmd "Side ground carpet lamp signal for genesis brand";
BA_ "Version" SG_ 980 Lamp_HzrdLampStabySW "25.10.00";
BA_ "NetworkRequestHoldingTime" SG_ 980 Lamp_HzrdLampStabySW 5000;
BA_ "NetworkRequest" SG_ 980 Lamp_HzrdLampStabySW 0;
BA_ "UserSigValidity" SG_ 980 Lamp_HzrdLampStabySW 0;
BA_ "GenSigSendType" SG_ 980 Lamp_HzrdLampStabySW 4;
BA_ "Description" SG_ 980 Lamp_HzrdLampStabySW "Hazard lamp control state by hazard switch";
BA_ "Version" SG_ 980 Lamp_LoPrioHzrdReq "17.12.00";
BA_ "NetworkRequestHoldingTime" SG_ 980 Lamp_LoPrioHzrdReq 5000;
BA_ "NetworkRequest" SG_ 980 Lamp_LoPrioHzrdReq 0;
BA_ "UserSigValidity" SG_ 980 Lamp_LoPrioHzrdReq 0;
BA_ "GenSigStartValue" SG_ 980 Lamp_LoPrioHzrdReq 2;
BA_ "GenSigSendType" SG_ 980 Lamp_LoPrioHzrdReq 4;
BA_ "Description" SG_ 980 Lamp_LoPrioHzrdReq "-Lower priority than SJB hazard

-TrunkOpenClose/CrashUnlock/RemoteStart

-Initial Value: 2";
BA_ "Version" SG_ 980 Lamp_ExtrnlTailLmpOnReq "17.12.00";
BA_ "NetworkRequestHoldingTime" SG_ 980 Lamp_ExtrnlTailLmpOnReq 5000;
BA_ "NetworkRequest" SG_ 980 Lamp_ExtrnlTailLmpOnReq 0;
BA_ "UserSigValidity" SG_ 980 Lamp_ExtrnlTailLmpOnReq 0;
BA_ "GenSigSendType" SG_ 980 Lamp_ExtrnlTailLmpOnReq 4;
BA_ "Description" SG_ 980 Lamp_ExtrnlTailLmpOnReq "-(Old)C_EXTTailOn";
BA_ "Version" SG_ 980 Lamp_HdLmpLoOnReq "17.12.00";
BA_ "NetworkRequestHoldingTime" SG_ 980 Lamp_HdLmpLoOnReq 5000;
BA_ "NetworkRequest" SG_ 980 Lamp_HdLmpLoOnReq 0;
BA_ "UserSigValidity" SG_ 980 Lamp_HdLmpLoOnReq 0;
BA_ "GenSigSendType" SG_ 980 Lamp_HdLmpLoOnReq 4;
BA_ "Description" SG_ 980 Lamp_HdLmpLoOnReq "-(Old)C_HLampLowON";
BA_ "Version" SG_ 980 Lamp_HdLmpHiOnReq "17.12.00";
BA_ "NetworkRequestHoldingTime" SG_ 980 Lamp_HdLmpHiOnReq 5000;
BA_ "NetworkRequest" SG_ 980 Lamp_HdLmpHiOnReq 0;
BA_ "UserSigValidity" SG_ 980 Lamp_HdLmpHiOnReq 0;
BA_ "GenSigSendType" SG_ 980 Lamp_HdLmpHiOnReq 4;
BA_ "Description" SG_ 980 Lamp_HdLmpHiOnReq "-(Old)C_HLampHighON";
BA_ "Version" SG_ 980 Lamp_DrlOnReq "20.09.00";
BA_ "NetworkRequestHoldingTime" SG_ 980 Lamp_DrlOnReq 5000;
BA_ "NetworkRequest" SG_ 980 Lamp_DrlOnReq 0;
BA_ "UserSigValidity" SG_ 980 Lamp_DrlOnReq 0;
BA_ "GenSigSendType" SG_ 980 Lamp_DrlOnReq 4;
BA_ "Description" SG_ 980 Lamp_DrlOnReq "Lamp on command for DRL";
BA_ "Version" SG_ 980 Lamp_BckUpLmpCmd "20.08.02";
BA_ "NetworkRequestHoldingTime" SG_ 980 Lamp_BckUpLmpCmd 5000;
BA_ "NetworkRequest" SG_ 980 Lamp_BckUpLmpCmd 0;
BA_ "UserSigValidity" SG_ 980 Lamp_BckUpLmpCmd 0;
BA_ "GenSigSendType" SG_ 980 Lamp_BckUpLmpCmd 4;
BA_ "Description" SG_ 980 Lamp_BckUpLmpCmd "BackUp Lamp On/Off Command";
BA_ "Version" SG_ 980 Lamp_FrFogLmpOnReq "17.12.00";
BA_ "NetworkRequestHoldingTime" SG_ 980 Lamp_FrFogLmpOnReq 5000;
BA_ "NetworkRequest" SG_ 980 Lamp_FrFogLmpOnReq 0;
BA_ "UserSigValidity" SG_ 980 Lamp_FrFogLmpOnReq 0;
BA_ "GenSigSendType" SG_ 980 Lamp_FrFogLmpOnReq 4;
BA_ "Version" SG_ 980 Lamp_RrFogLmpOnReq "17.12.00";
BA_ "NetworkRequestHoldingTime" SG_ 980 Lamp_RrFogLmpOnReq 5000;
BA_ "NetworkRequest" SG_ 980 Lamp_RrFogLmpOnReq 0;
BA_ "UserSigValidity" SG_ 980 Lamp_RrFogLmpOnReq 0;
BA_ "GenSigSendType" SG_ 980 Lamp_RrFogLmpOnReq 4;
BA_ "Version" SG_ 980 Lamp_StcBendingLmpLftOnReq "20.08.02";
BA_ "NetworkRequestHoldingTime" SG_ 980 Lamp_StcBendingLmpLftOnReq 5000;
BA_ "NetworkRequest" SG_ 980 Lamp_StcBendingLmpLftOnReq 0;
BA_ "UserSigValidity" SG_ 980 Lamp_StcBendingLmpLftOnReq 0;
BA_ "GenSigSendType" SG_ 980 Lamp_StcBendingLmpLftOnReq 4;
BA_ "Description" SG_ 980 Lamp_StcBendingLmpLftOnReq "-(Old)C_StaticBend_LH_On";
BA_ "Version" SG_ 980 Lamp_StcBendingLmpRtOnReq "20.08.02";
BA_ "NetworkRequestHoldingTime" SG_ 980 Lamp_StcBendingLmpRtOnReq 5000;
BA_ "NetworkRequest" SG_ 980 Lamp_StcBendingLmpRtOnReq 0;
BA_ "UserSigValidity" SG_ 980 Lamp_StcBendingLmpRtOnReq 0;
BA_ "GenSigSendType" SG_ 980 Lamp_StcBendingLmpRtOnReq 4;
BA_ "Description" SG_ 980 Lamp_StcBendingLmpRtOnReq "-(Old)C_StaticBend_RH_On";
BA_ "Version" SG_ 980 Lamp_CornerLmpLftOnReq "20.08.02";
BA_ "NetworkRequestHoldingTime" SG_ 980 Lamp_CornerLmpLftOnReq 5000;
BA_ "NetworkRequest" SG_ 980 Lamp_CornerLmpLftOnReq 0;
BA_ "UserSigValidity" SG_ 980 Lamp_CornerLmpLftOnReq 0;
BA_ "GenSigSendType" SG_ 980 Lamp_CornerLmpLftOnReq 4;
BA_ "Description" SG_ 980 Lamp_CornerLmpLftOnReq "cornering lamp control signal";
BA_ "Version" SG_ 980 Lamp_CornerLmpRtOnReq "20.08.02";
BA_ "NetworkRequestHoldingTime" SG_ 980 Lamp_CornerLmpRtOnReq 5000;
BA_ "NetworkRequest" SG_ 980 Lamp_CornerLmpRtOnReq 0;
BA_ "UserSigValidity" SG_ 980 Lamp_CornerLmpRtOnReq 0;
BA_ "GenSigSendType" SG_ 980 Lamp_CornerLmpRtOnReq 4;
BA_ "Description" SG_ 980 Lamp_CornerLmpRtOnReq "cornering lamp control signal";
BA_ "Version" SG_ 980 Lamp_HbaCtrlModTyp "17.12.00";
BA_ "NetworkRequestHoldingTime" SG_ 980 Lamp_HbaCtrlModTyp 5000;
BA_ "NetworkRequest" SG_ 980 Lamp_HbaCtrlModTyp 0;
BA_ "UserSigValidity" SG_ 980 Lamp_HbaCtrlModTyp 0;
BA_ "GenSigSendType" SG_ 980 Lamp_HbaCtrlModTyp 4;
BA_ "Description" SG_ 980 Lamp_HbaCtrlModTyp "This signal headlamp high control by BCM or HBA";
BA_ "Version" SG_ 980 Lamp_IFSCtrlModTyp "17.12.00";
BA_ "NetworkRequestHoldingTime" SG_ 980 Lamp_IFSCtrlModTyp 5000;
BA_ "NetworkRequest" SG_ 980 Lamp_IFSCtrlModTyp 0;
BA_ "UserSigValidity" SG_ 980 Lamp_IFSCtrlModTyp 0;
BA_ "GenSigSendType" SG_ 980 Lamp_IFSCtrlModTyp 4;
BA_ "Description" SG_ 980 Lamp_IFSCtrlModTyp "This signal headlamp high control by BCM or IFS";
BA_ "Version" SG_ 980 Lamp_HdLmpWlcmCmd "23.07.06";
BA_ "NetworkRequestHoldingTime" SG_ 980 Lamp_HdLmpWlcmCmd 5000;
BA_ "NetworkRequest" SG_ 980 Lamp_HdLmpWlcmCmd 0;
BA_ "UserSigValidity" SG_ 980 Lamp_HdLmpWlcmCmd 0;
BA_ "GenSigSendType" SG_ 980 Lamp_HdLmpWlcmCmd 4;
BA_ "Description" SG_ 980 Lamp_HdLmpWlcmCmd "HeadLamp Welcome Cmd 

- receiver : ICU (CGW)";
BA_ "Version" SG_ 980 Lamp_PuddleLmpOnReq "17.12.00";
BA_ "NetworkRequestHoldingTime" SG_ 980 Lamp_PuddleLmpOnReq 5000;
BA_ "NetworkRequest" SG_ 980 Lamp_PuddleLmpOnReq 0;
BA_ "UserSigValidity" SG_ 980 Lamp_PuddleLmpOnReq 0;
BA_ "GenSigSendType" SG_ 980 Lamp_PuddleLmpOnReq 4;
BA_ "Description" SG_ 980 Lamp_PuddleLmpOnReq "Puddle Lamp command";
BA_ "Version" SG_ 980 Lamp_ExtLampRSPAMode "21.09.05";
BA_ "NetworkRequestHoldingTime" SG_ 980 Lamp_ExtLampRSPAMode 5000;
BA_ "NetworkRequest" SG_ 980 Lamp_ExtLampRSPAMode 0;
BA_ "UserSigValidity" SG_ 980 Lamp_ExtLampRSPAMode 0;
BA_ "GenSigSendType" SG_ 980 Lamp_ExtLampRSPAMode 4;
BA_ "Description" SG_ 980 Lamp_ExtLampRSPAMode "RSPA Mode for Box/Cargo Lamp";
BA_ "Version" SG_ 980 Lamp_IntTailLmpOnReq "17.12.00";
BA_ "NetworkRequestHoldingTime" SG_ 980 Lamp_IntTailLmpOnReq 5000;
BA_ "NetworkRequest" SG_ 980 Lamp_IntTailLmpOnReq 0;
BA_ "UserSigValidity" SG_ 980 Lamp_IntTailLmpOnReq 0;
BA_ "GenSigSendType" SG_ 980 Lamp_IntTailLmpOnReq 4;
BA_ "Description" SG_ 980 Lamp_IntTailLmpOnReq "-(Old)C_INTTailOn";
BA_ "Version" SG_ 980 Lamp_AvTailLmpSta "21.09.05";
BA_ "NetworkRequestHoldingTime" SG_ 980 Lamp_AvTailLmpSta 5000;
BA_ "NetworkRequest" SG_ 980 Lamp_AvTailLmpSta 0;
BA_ "UserSigValidity" SG_ 980 Lamp_AvTailLmpSta 0;
BA_ "GenSigStartValue" SG_ 980 Lamp_AvTailLmpSta 1;
BA_ "GenSigSendType" SG_ 980 Lamp_AvTailLmpSta 4;
BA_ "Description" SG_ 980 Lamp_AvTailLmpSta "-Send with at the same time with C_IntTailOn

-Initiail Value: 1";
BA_ "Version" SG_ 980 Lamp_AutoLtSnsrNightSta "20.04.06";
BA_ "NetworkRequestHoldingTime" SG_ 980 Lamp_AutoLtSnsrNightSta 5000;
BA_ "NetworkRequest" SG_ 980 Lamp_AutoLtSnsrNightSta 0;
BA_ "UserSigValidity" SG_ 980 Lamp_AutoLtSnsrNightSta 0;
BA_ "GenSigStartValue" SG_ 980 Lamp_AutoLtSnsrNightSta 1;
BA_ "GenSigSendType" SG_ 980 Lamp_AutoLtSnsrNightSta 4;
BA_ "Description" SG_ 980 Lamp_AutoLtSnsrNightSta "This signal indicates autolight sensor output";
BA_ "Version" SG_ 980 Lamp_VendorInfo "25.06.00";
BA_ "NetworkRequestHoldingTime" SG_ 980 Lamp_VendorInfo 5000;
BA_ "NetworkRequest" SG_ 980 Lamp_VendorInfo 0;
BA_ "UserSigValidity" SG_ 980 Lamp_VendorInfo 0;
BA_ "GenSigStartValue" SG_ 980 Lamp_VendorInfo 7;
BA_ "GenSigSendType" SG_ 980 Lamp_VendorInfo 4;
BA_ "Description" SG_ 980 Lamp_VendorInfo "Rain sensor Vendor info (LIN to CAN signal)

  - Not applied standard sensor : 0x1 or 0x2

  - Applied standard sensor : 0x3 or 0x4

  - Add New vendor (Baolong)";
BA_ "Version" SG_ 980 Lamp_AutoLtSnsrHorVal "21.12.00";
BA_ "NetworkRequestHoldingTime" SG_ 980 Lamp_AutoLtSnsrHorVal 5000;
BA_ "NetworkRequest" SG_ 980 Lamp_AutoLtSnsrHorVal 0;
BA_ "UserSigValidity" SG_ 980 Lamp_AutoLtSnsrHorVal 0;
BA_ "GenSigSendType" SG_ 980 Lamp_AutoLtSnsrHorVal 4;
BA_ "Description" SG_ 980 Lamp_AutoLtSnsrHorVal "This signal indicates autolight sensor output (for HUD)

<BCS>

0x0~0x3FE : Light Sensor Value

0x3FF : Invalid

<HELLA>

0x0~0xFE, 100~0x3FE : Light Sensor Value

0xFF, 0x3FF : Invalid";
BA_ "Version" SG_ 980 MoodLamp_AIVoiceOptSta "22.11.02";
BA_ "NetworkRequestHoldingTime" SG_ 980 MoodLamp_AIVoiceOptSta 5000;
BA_ "NetworkRequest" SG_ 980 MoodLamp_AIVoiceOptSta 0;
BA_ "UserSigValidity" SG_ 980 MoodLamp_AIVoiceOptSta 0;
BA_ "GenSigSendType" SG_ 980 MoodLamp_AIVoiceOptSta 4;
BA_ "Version" SG_ 980 MoodLamp_DualColorOptSta "22.11.02";
BA_ "NetworkRequestHoldingTime" SG_ 980 MoodLamp_DualColorOptSta 5000;
BA_ "NetworkRequest" SG_ 980 MoodLamp_DualColorOptSta 0;
BA_ "UserSigValidity" SG_ 980 MoodLamp_DualColorOptSta 0;
BA_ "GenSigSendType" SG_ 980 MoodLamp_DualColorOptSta 4;
BA_ "Version" SG_ 980 MoodLamp_MdLmpFadeSta "22.11.02";
BA_ "NetworkRequestHoldingTime" SG_ 980 MoodLamp_MdLmpFadeSta 5000;
BA_ "NetworkRequest" SG_ 980 MoodLamp_MdLmpFadeSta 0;
BA_ "UserSigValidity" SG_ 980 MoodLamp_MdLmpFadeSta 0;
BA_ "GenSigSendType" SG_ 980 MoodLamp_MdLmpFadeSta 4;
BA_ "Version" SG_ 980 MoodLamp_NumRecommendColor "22.11.02";
BA_ "NetworkRequestHoldingTime" SG_ 980 MoodLamp_NumRecommendColor 5000;
BA_ "NetworkRequest" SG_ 980 MoodLamp_NumRecommendColor 0;
BA_ "UserSigValidity" SG_ 980 MoodLamp_NumRecommendColor 0;
BA_ "GenSigSendType" SG_ 980 MoodLamp_NumRecommendColor 4;
BA_ "Version" SG_ 980 AutoLt_HorVal_STD "22.12.04";
BA_ "NetworkRequestHoldingTime" SG_ 980 AutoLt_HorVal_STD 5000;
BA_ "NetworkRequest" SG_ 980 AutoLt_HorVal_STD 0;
BA_ "UserSigValidity" SG_ 980 AutoLt_HorVal_STD 0;
BA_ "GenSigSendType" SG_ 980 AutoLt_HorVal_STD 4;
BA_ "Description" SG_ 980 AutoLt_HorVal_STD "This signal is standard horizontal value of autolight sensor



Horizontal brightness(lux)=AutoLt_HorRes_STD*AutoLt_HorVal_STD

※ AutoLt_HorRes_STD : Horizontal resolution signal

Brightness 0~1,000lux : Resolution is 1lux and value is 0(0h)~1,000(3E8h)";
BA_REL_ "GenSigTimeoutTime" BU_SG_REL_ BLTN_CAM_FD SG_ 1071 SVM_CaptureModeCMD 5000;
BA_REL_ "GenSigTimeoutTime" BU_SG_REL_ GW_PSU_DRV_FD SG_ 704 VCU_Crc6Val 1500;
BA_REL_ "GenSigTimeoutTime" BU_SG_REL_ GW_PSU_DRV_FD SG_ 704 VCU_BstWarnMsg 1500;
BA_REL_ "GenSigTimeoutTime" BU_SG_REL_ GW_SAU_DRV_FD SG_ 704 VCU_BstWarnMsg 1500;
BA_REL_ "GenSigTimeoutTime" BU_SG_REL_ PSB_FD SG_ 704 VCU_BstWarnMsg 1500;
BA_REL_ "GenSigTimeoutTime" BU_SG_REL_ BLTN_CAM_FD SG_ 704 VCU_BstAvailSta 1500;
BA_REL_ "GenSigTimeoutTime" BU_SG_REL_ GW_SAU_DRV_FD SG_ 704 VCU_BstAvailSta 1500;
BA_REL_ "GenSigTimeoutTime" BU_SG_REL_ BLTN_CAM_FD SG_ 704 VCU_BstAplySta 1500;
BA_REL_ "GenSigTimeoutTime" BU_SG_REL_ GW_SAU_DRV_FD SG_ 704 VCU_BstAplySta 1500;
BA_REL_ "GenSigTimeoutTime" BU_SG_REL_ BLTN_CAM_FD SG_ 704 VCU_NCondDragSta 1500;
BA_REL_ "GenSigTimeoutTime" BU_SG_REL_ BLTN_CAM_FD SG_ 704 VCU_NCondDragSegVal 1500;
BA_REL_ "GenSigTimeoutTime" BU_SG_REL_ BLTN_CAM_FD SG_ 704 VCU_NCondTrackSta 1500;
BA_REL_ "GenSigTimeoutTime" BU_SG_REL_ BLTN_CAM_FD SG_ 704 VCU_NCondTrackTimeVal 1500;
BA_REL_ "GenSigTimeoutTime" BU_SG_REL_ BLTN_CAM_FD SG_ 704 VCU_NCondOSD 1500;
BA_REL_ "GenSigTimeoutTime" BU_SG_REL_ GW_PSU_DRV_FD SG_ 704 VCU_AlvCnt6Val 1500;
BA_REL_ "GenSigTimeoutTime" BU_SG_REL_ ATS_FD SG_ 704 VCU_UtilModeWarnAddMsgSta 1500;
BA_REL_ "GenSigTimeoutTime" BU_SG_REL_ BLTN_CAM_FD SG_ 704 VCU_FrntTqDispPcVal 1500;
BA_REL_ "GenSigTimeoutTime" BU_SG_REL_ BLTN_CAM_FD SG_ 704 VCU_RearTqDispPcVal 1500;
BA_REL_ "GenSigTimeoutTime" BU_SG_REL_ BLTN_CAM_FD SG_ 704 VCU_BstOpSta 1500;
BA_REL_ "GenSigTimeoutTime" BU_SG_REL_ GW_SAU_DRV_FD SG_ 704 VCU_BstOpSta 1500;
BA_REL_ "GenSigTimeoutTime" BU_SG_REL_ PSB_FD SG_ 704 VCU_BstOpSta 1500;
BA_REL_ "GenSigTimeoutTime" BU_SG_REL_ GW_SAU_DRV_FD SG_ 704 VCU_BstTimerVal 1500;
BA_REL_ "GenSigTimeoutTime" BU_SG_REL_ PSB_FD SG_ 704 VCU_BstTimerVal 1500;
BA_REL_ "GenSigTimeoutTime" BU_SG_REL_ PSB_FD SG_ 979 SBR_AsstStBltWrngIndSta 1500;
BA_REL_ "GenSigTimeoutTime" BU_SG_REL_ PSB_FD SG_ 979 SBR_DrvStBltWrngIndSta 1500;
BA_REL_ "GenSigTimeoutTime" BU_SG_REL_ BLTN_CAM_FD SG_ 979 BAlarm_BglrAlrm_CurrentSta 1500;
BA_REL_ "GenSigTimeoutTime" BU_SG_REL_ DCM_FD SG_ 979 BAlarm_BglrAlrm_Sta 1500;
BA_REL_ "GenSigTimeoutTime" BU_SG_REL_ PSB_FD SG_ 979 SBR_DrvStBltIndSta 1500;
BA_REL_ "GenSigTimeoutTime" BU_SG_REL_ PSB_FD SG_ 979 SBR_RrLftStBltWrngIndSta 1500;
BA_REL_ "GenSigTimeoutTime" BU_SG_REL_ PSB_FD SG_ 979 SBR_RrRtStBltWrngIndSta 1500;
BA_REL_ "GenSigTimeoutTime" BU_SG_REL_ PSB_FD SG_ 979 SBR_RrCtrStBltIndSta 1500;
BA_REL_ "GenSigTimeoutTime" BU_SG_REL_ PSB_FD SG_ 979 SBR_3rdLftStBltWrngIndSta 1500;
BA_REL_ "GenSigTimeoutTime" BU_SG_REL_ PSB_FD SG_ 979 SBR_3rdRtStBltWrngIndSta 1500;
BA_REL_ "GenSigTimeoutTime" BU_SG_REL_ PSB_FD SG_ 979 SBR_3rdCtrStBltWrngIndSta 1500;
BA_REL_ "GenSigTimeoutTime" BU_SG_REL_ BLTN_CAM_FD SG_ 1059 CF_AVN_ValetModeSta 5000;
BA_REL_ "GenSigTimeoutTime" BU_SG_REL_ FCS_FD SG_ 1059 CF_AVN_ValetModeSta 5000;
BA_REL_ "GenSigTimeoutTime" BU_SG_REL_ GW_PSU_3RD_FD SG_ 1059 CF_AVN_ValetModeSta 5000;
BA_REL_ "GenSigTimeoutTime" BU_SG_REL_ GW_PSU_AST_FD SG_ 1059 CF_AVN_ValetModeSta 5000;
BA_REL_ "GenSigTimeoutTime" BU_SG_REL_ GW_PSU_DRV_FD SG_ 1059 CF_AVN_ValetModeSta 5000;
BA_REL_ "GenSigTimeoutTime" BU_SG_REL_ GW_PSU_RL_FD SG_ 1059 CF_AVN_ValetModeSta 5000;
BA_REL_ "GenSigTimeoutTime" BU_SG_REL_ GW_PSU_RR_FD SG_ 1059 CF_AVN_ValetModeSta 5000;
BA_REL_ "GenSigTimeoutTime" BU_SG_REL_ GW_SAU_DRV_FD SG_ 1059 CF_AVN_ValetModeSta 5000;
BA_REL_ "GenSigTimeoutTime" BU_SG_REL_ SCM_FD SG_ 1059 CF_AVN_ValetModeSta 5000;
BA_REL_ "GenSigTimeoutTime" BU_SG_REL_ SHVU_3RD_FD SG_ 1059 CF_AVN_ValetModeSta 5000;
BA_REL_ "GenSigTimeoutTime" BU_SG_REL_ SHVU_FRNT_FD SG_ 1059 CF_AVN_ValetModeSta 5000;
BA_REL_ "GenSigTimeoutTime" BU_SG_REL_ SHVU_REAR_FD SG_ 1059 CF_AVN_ValetModeSta 5000;
BA_REL_ "GenSigTimeoutTime" BU_SG_REL_ ATS_FD SG_ 1059 HU_Background 5000;
BA_REL_ "GenSigTimeoutTime" BU_SG_REL_ BLTN_CAM_FD SG_ 1059 HU_Background 5000;
BA_REL_ "GenSigTimeoutTime" BU_SG_REL_ ATS_FD SG_ 1059 HU_BackgroundFadeInOut 5000;
BA_REL_ "GenSigTimeoutTime" BU_SG_REL_ BLTN_CAM_FD SG_ 1059 HU_BackgroundFadeInOut 5000;
BA_REL_ "GenSigTimeoutTime" BU_SG_REL_ BLTN_CAM_FD SG_ 983 Wiper_PrkngPosSta 1500;
BA_REL_ "GenSigTimeoutTime" BU_SG_REL_ BLTN_CAM_FD SG_ 983 Wiper_RainSnsrSta 1500;
BA_REL_ "GenSigTimeoutTime" BU_SG_REL_ BLTN_CAM_FD SG_ 983 Mirror_FldCtrlSta 1500;
BA_REL_ "GenSigTimeoutTime" BU_SG_REL_ BLTN_CAM_FD SG_ 983 Mirror_UnFldCtrlSta 1500;
BA_REL_ "GenSigTimeoutTime" BU_SG_REL_ BLTN_CAM_FD SG_ 861 MainLBM_OptType 1500;
BA_REL_ "GenSigTimeoutTime" BU_SG_REL_ BLTN_CAM_FD SG_ 861 MainLBM_RlyOnSta 1500;
BA_REL_ "GenSigTimeoutTime" BU_SG_REL_ BLTN_CAM_FD SG_ 861 MainLBM_RlyOutVoltVal 1500;
BA_REL_ "GenSigTimeoutTime" BU_SG_REL_ BLTN_CAM_FD SG_ 861 MainLBM_RlyOnSwReq 1500;
BA_REL_ "GenSigTimeoutTime" BU_SG_REL_ BLTN_CAM_FD SG_ 861 MainLBM_BmsFailWarn 1500;
BA_REL_ "GenSigTimeoutTime" BU_SG_REL_ BLTN_CAM_FD SG_ 861 MainLBM_FaultSta 1500;
BA_REL_ "GenSigTimeoutTime" BU_SG_REL_ GW_PSU_DRV_FD SG_ 980 BDC_FD_Crc5Val 1500;
BA_REL_ "GenSigTimeoutTime" BU_SG_REL_ ATS_FD SG_ 980 AutoLt_HorRes_STD 1500;
BA_REL_ "GenSigTimeoutTime" BU_SG_REL_ ATS_FD SG_ 980 AutoLt_VerVal_STD 1500;
BA_REL_ "GenSigTimeoutTime" BU_SG_REL_ ATS_FD SG_ 980 AutoLt_VerRes_STD 1500;
BA_REL_ "GenSigTimeoutTime" BU_SG_REL_ GW_PSU_DRV_FD SG_ 980 BDC_FD_AlvCnt5Val 1500;
BA_REL_ "GenSigTimeoutTime" BU_SG_REL_ BLTN_CAM_FD SG_ 980 Lamp_LftTrnLmpCmd 1500;
BA_REL_ "GenSigTimeoutTime" BU_SG_REL_ BLTN_CAM_FD SG_ 980 Lamp_RtTrnLmpCmd 1500;
BA_REL_ "GenSigTimeoutTime" BU_SG_REL_ BLTN_CAM_FD SG_ 980 Lamp_ExtrnlTailLmpOnReq 1500;
BA_REL_ "GenSigTimeoutTime" BU_SG_REL_ DCM_FD SG_ 980 Lamp_BckUpLmpCmd 1500;
BA_REL_ "GenSigTimeoutTime" BU_SG_REL_ ATS_FD SG_ 980 Lamp_IntTailLmpOnReq 1500;
BA_REL_ "GenSigTimeoutTime" BU_SG_REL_ FCS_FD SG_ 980 Lamp_IntTailLmpOnReq 1500;
BA_REL_ "GenSigTimeoutTime" BU_SG_REL_ GW_PSU_3RD_FD SG_ 980 Lamp_IntTailLmpOnReq 1500;
BA_REL_ "GenSigTimeoutTime" BU_SG_REL_ GW_PSU_AST_FD SG_ 980 Lamp_IntTailLmpOnReq 1500;
BA_REL_ "GenSigTimeoutTime" BU_SG_REL_ GW_PSU_DRV_FD SG_ 980 Lamp_IntTailLmpOnReq 1500;
BA_REL_ "GenSigTimeoutTime" BU_SG_REL_ GW_PSU_RL_FD SG_ 980 Lamp_IntTailLmpOnReq 1500;
BA_REL_ "GenSigTimeoutTime" BU_SG_REL_ GW_PSU_RR_FD SG_ 980 Lamp_IntTailLmpOnReq 1500;
BA_REL_ "GenSigTimeoutTime" BU_SG_REL_ RWPC_FD SG_ 980 Lamp_IntTailLmpOnReq 1500;
BA_REL_ "GenSigTimeoutTime" BU_SG_REL_ SHVU_3RD_FD SG_ 980 Lamp_IntTailLmpOnReq 1500;
BA_REL_ "GenSigTimeoutTime" BU_SG_REL_ SHVU_FRNT_FD SG_ 980 Lamp_IntTailLmpOnReq 1500;
BA_REL_ "GenSigTimeoutTime" BU_SG_REL_ SHVU_REAR_FD SG_ 980 Lamp_IntTailLmpOnReq 1500;
BA_REL_ "GenSigTimeoutTime" BU_SG_REL_ SHVU_RL_FD SG_ 980 Lamp_IntTailLmpOnReq 1500;
BA_REL_ "GenSigTimeoutTime" BU_SG_REL_ SHVU_RR_FD SG_ 980 Lamp_IntTailLmpOnReq 1500;
BA_REL_ "GenSigTimeoutTime" BU_SG_REL_ WPC2_FD SG_ 980 Lamp_IntTailLmpOnReq 1500;
BA_REL_ "GenSigTimeoutTime" BU_SG_REL_ WPC_FD SG_ 980 Lamp_IntTailLmpOnReq 1500;
BA_REL_ "GenSigTimeoutTime" BU_SG_REL_ ATS_FD SG_ 980 Lamp_AvTailLmpSta 1500;
BA_REL_ "GenSigTimeoutTime" BU_SG_REL_ GW_PSU_AST_FD SG_ 980 Lamp_AvTailLmpSta 1500;
BA_REL_ "GenSigTimeoutTime" BU_SG_REL_ ATS_FD SG_ 980 Lamp_AutoLtSnsrNightSta 1500;
BA_REL_ "GenSigTimeoutTime" BU_SG_REL_ GW_PSU_AST_FD SG_ 980 Lamp_AutoLtSnsrNightSta 1500;
BA_REL_ "GenSigTimeoutTime" BU_SG_REL_ PSB_FD SG_ 980 Lamp_AutoLtSnsrNightSta 1500;
BA_REL_ "GenSigTimeoutTime" BU_SG_REL_ ATS_FD SG_ 980 Lamp_VendorInfo 1500;
BA_REL_ "GenSigTimeoutTime" BU_SG_REL_ ATS_FD SG_ 980 Lamp_AutoLtSnsrHorVal 1500;
BA_REL_ "GenSigTimeoutTime" BU_SG_REL_ ATS_FD SG_ 980 MoodLamp_DualColorOptSta 1500;
BA_REL_ "GenSigTimeoutTime" BU_SG_REL_ ATS_FD SG_ 980 MoodLamp_NumRecommendColor 1500;
BA_REL_ "GenSigTimeoutTime" BU_SG_REL_ ATS_FD SG_ 980 AutoLt_HorVal_STD 1500;
VAL_ 101 IEB_Crc1Val 0 "0x0~0xFFFF:CRCValue" 65535 "0x0~0xFFFF:CRCValue" ;
VAL_ 101 IEB_AbsNGearReq 0 "Inactive" 1 "N Gear position Request Active" 2 "Not used" 3 "Error Indicator" ;
VAL_ 101 IEB_EstBrkPdlValVldSta 0 "Invalid" 1 "Valid" 2 "Not used" 3 "Error Indicator" ;
VAL_ 101 IEB_FRAmode_Req 0 "No Request" 1 "Inhibit Transition To 4WD" 2 "Request FRA mode" 3 "Not used" ;
VAL_ 101 IEB_DrvWhlSlipFlg_Frnt 0 "No slip occurred at the driving wheels" 1 "Slip occurred at the driving wheels" ;
VAL_ 101 IEB_IndDriftMode 0 "Default" 1 "off" 2 "on" 3 "RESERVED" 4 "RESERVED" 5 "RESERVED" 6 "RESERVED" 7 "Invaild" ;
VAL_ 101 IEB_RmcReqFrnt 0 "RMC is not active" 1 "RMC is active" 2 "RESERVED" 3 "RESERVED" ;
VAL_ 101 IEB_RmcReqRear 0 "RMC is not active" 1 "RMC is active" 2 "RESERVED" 3 "RESERVED" ;
VAL_ 101 IEB_TCS_Req 0 "TCS control is not active" 1 "TCS control is active by requested TORQUE based" 2 "TCS control is active by requested RPM based" 3 "Not used" ;
VAL_ 101 IEB_RSC_Req 0 "RSC is not active" 1 "RSC is active" 2 "RESERVED" 3 "RESERVED" ;
VAL_ 101 TCS_TqFlag_Frnt 0 "Positive" 1 "Negative" ;
VAL_ 101 TCS_TqFlag_Rear 0 "Positive" 1 "Negative" ;
VAL_ 101 RSC_TqFlag_Frnt 0 "Positive" 1 "Negative" ;
VAL_ 101 RSC_TqFlag_Rear 0 "Positive" 1 "Negative" ;
VAL_ 101 IEB_AlvCnt1Val 0 "0x0~0xFF:AlvCntValue" 255 "0x0~0xFF:AlvCntValue" ;
VAL_ 101 TCS_MtrTrgtRpm_Flag_Frnt 0 "Positive" 1 "Negative" ;
VAL_ 101 TCS_MtrTrgtRpm_Flag_Rear 0 "Positive" 1 "Negative" ;
VAL_ 101 IEB_DriftElsdModSta 0 "Default" 1 "Drift Mode Base" 2 "Drift Mode" 3 "RESERVED" ;
VAL_ 101 IEB_DriftEcsModSta 0 "Default" 1 "N-Mode" 2 "Drift Mode" 3 "Reserved" ;
VAL_ 101 IEB_DriftMdpsModSta 0 "Default" 1 "N-Mode" 2 "Drift Mode" 3 "Reserved" ;
VAL_ 101 TCS_MtrTrgtRpm_Frnt 0 "0x000~0xFFE:Motor RPM Target" 4094 "0x000~0xFFE:Motor RPM Target" 4095 "Error Value" ;
VAL_ 101 TCS_MtrTrgtRpm_Rear 0 "0x000~0xFFE:Motor RPM Target" 4094 "0x000~0xFFE:Motor RPM Target" 4095 "Error Value" ;
VAL_ 101 IEB_DriftModeSta 0 "Default" 1 "Drift Mode Activate (ON)" 2 "Drift Mode Deactivate (OFF)" 3 "Defective" ;
VAL_ 101 IEB_DriftModeActSta 0 "Default" 1 "Drift Mode ON" 2 "Drift Mode OFF" 3 "Reserved" ;
VAL_ 101 MCU_AntiJerk_Inhbtsta 0 "Allow Anti Jerk Control" 1 "Inhibit Anti Jerk control" ;
VAL_ 101 IEB_Motor_ProtectModSta 0 "default" 1 "Protection mode operation" ;
VAL_ 101 IEB_EstBrkSacFrcNmVal 0 "0x0~0xFFFF:friction brake torque for stop assist control" 65535 "0x0~0xFFFF:friction brake torque for stop assist control" ;
VAL_ 101 IEB_SrvLmpDis 0 "AHB Service Lamp is Off" 1 "AHB Service Lamp is On" 2 "AHB Service Lamp is BLINKING(2HZ)" 3 "Error Indicator" ;
VAL_ 101 IEB_IndDriftEscModSta_TCS 0 "Default" 1 "Slip level_01" 2 "Slip level_02" 3 "Slip level_03" 4 "Slip level_04" 5 "Slip level_05" 6 "Slip level_06" 7 "Slip level_07" 8 "Slip level_08" 9 "Slip level_09" 10 "Slip level_10" 11 "Reserved" 12 "Reserved" 13 "Reserved" 14 "Reserved" 15 "Reserved" ;
VAL_ 101 IEB_IndDriftEscModSta_VDC 0 "Default" 1 "VDC level_01" 2 "VDC level_02" 3 "VDC level_03" 4 "VDC level_04" 5 "VDC level_05" 6 "VDC level_06" 7 "VDC level_07" 8 "VDC level_08" 9 "VDC level_09" 10 "VDC level_10" 11 "RESERVED" 12 "RESERVED" 13 "RESERVED" 14 "RESERVED" 15 "RESERVED" ;
VAL_ 101 IEB_DfctvSta 0 "AHB is normal mode" 1 "AHB is degraded mode" 2 "AHB is defective mode" 3 "Error Indicator" ;
VAL_ 101 IEB_ActvSta 0 "All Control Inactive" 1 "Charging Active" 2 "AHB Control Active" 3 "Chaging Active + AHB Control Active" ;
VAL_ 101 IEB_DiagSta 0 "AHB is not diagnostic mode" 1 "AHB is diagnostic mode" 2 "Not used" 3 "Error Indicator" ;
VAL_ 101 IEB_WrngLmpDis 0 "AHB Warning Lamp is Off" 1 "AHB Warning Lamp is On" 2 "Not used" 3 "Error Indicator" ;
VAL_ 101 IEB_MILReq 0 "No Request" 1 "MIL On Request" 2 "Reserved" 3 "Reserved" ;
VAL_ 101 IEB_DriftModeStaDis 0 "Default" 1 "Restriction state of Drift" 2 "RESERVED" 3 "RESERVED" 4 "RESERVED" 5 "RESERVED" 6 "RESERVED" 7 "RESERVED" ;
VAL_ 101 RSC_Sta 0 "RSC is ready" 1 "RSC is not ready" ;
VAL_ 101 IEB_BrkActvSta 0 "ECU does not support this function." 1 "Brake switch is not pressed (OFF)" 2 "Brake switch is pressed (ON)" 3 "Brake switch failure" ;
VAL_ 101 IEB_PdlTrvlSnsrFailSta 0 "Normal" 1 "Fail" 2 "Not used" 3 "Error Indicator" ;
VAL_ 101 IEB_PdlCalibSta 0 "Not complete" 1 "Complete" 2 "Not used" 3 "Error Indicator" ;
VAL_ 101 IEB_BzrSta 0 "Buzzer is Off" 1 "Buzzer is On" 2 "Not used" 3 "Error Indicator" ;
VAL_ 101 IEB_Sta 0 "Not Ready" 1 "Ready" 2 "Ready (Front only) & Not Ready(Rear)" 3 "Ready (Rear only) & Not Ready(Front)" ;
VAL_ 101 IEB_SnsrFailSta 0 "Normal" 1 "Fail" 2 "Not used" 3 "Error Indicator" ;
VAL_ 101 IEB_RbsWrngLmpSta 0 "RBS Warning Lamp OFF" 1 "RBS Warning Lamp ON" 2 "Not used" 3 "Error Indicator" ;
VAL_ 101 IEB_VacSysDfctvSta 0 "Vacuum pump NOT defective" 1 "Vacuum pump defective (failed)" 2 "Not used" 3 "Error Indicator" ;
VAL_ 1071 HU_AVM_Crc3Val 0 "0x0~0xFFFF:CRCValue" 65535 "0x0~0xFFFF:CRCValue" ;
VAL_ 1071 HU_AVM_AlvCnt3Val 0 "0x0~0xFF:AlvCntValue" 255 "0x0~0xFF:AlvCntValue" ;
VAL_ 1071 HU_SVMTopViewDispSta 0 "Default" 1 "Not Showing" 2 "Showing" 3 "Invalid" ;
VAL_ 1071 HU_SVM_ccp_pan_valid 0 "Invalid" 1 "Valid" ;
VAL_ 1071 SVM_CaptureModeCMD 0 "Default" 1 "Capture Mode OFF" 2 "Capture Mode ON" 3 "Invalid" ;
VAL_ 704 VCU_BstWarnMsg 0 "None(Default)" 1 "Failed by vehicle condition" 2 "Failed by low battery SOC" 3 "Failed by wait time" ;
VAL_ 704 VCU_BstAvailSta 0 "Not available" 1 "Available" 2 "Reserved" 3 "Reserved" ;
VAL_ 704 VCU_BstAplySta 0 "Not Applied" 1 "Applied" 2 "Reserved" 3 "Reserved" ;
VAL_ 704 VCU_MxPwrMdSta 0 "Not Supported" 1 "In Activate" 2 "Activate" 3 "Activate ON" ;
VAL_ 704 VCU_MxPwrMdSegVal 0 "0~100 %" 1 "0~100 %" 2 "0~100 %" 3 "0~100 %" 4 "0~100 %" 5 "0~100 %" 6 "0~100 %" 7 "0~100 %" 8 "0~100 %" 9 "0~100 %" 10 "0~100 %" 11 "0~100 %" 12 "0~100 %" 13 "0~100 %" 14 "0~100 %" 15 "0~100 %" 16 "0~100 %" 17 "0~100 %" 18 "0~100 %" 19 "0~100 %" 20 "0~100 %" 21 "RESERVED" 22 "RESERVED" 23 "RESERVED" 24 "RESERVED" 25 "RESERVED" 26 "RESERVED" 27 "RESERVED" 28 "RESERVED" 29 "RESERVED" 30 "RESERVED" 31 "Not Display" ;
VAL_ 704 VCU_MxPwrMdOSD 0 "None" 1 "Battery Heating Complete" 2 "Canceled by Low SOC" 3 "Canceled by Fault" 4 "RESERVED" 5 "RESERVED" 6 "RESERVED" 7 "Error" ;
VAL_ 704 VCU_PwrDnByHoodOpenSta 0 "OFF" 1 "ON" 2 "RESERVED" 3 "Error" ;
VAL_ 704 VCU_FlatTowModeConIndSta 0 "OFF" 1 "Ready" 2 "Activation" 3 "SOC High" 4 "Stop Condition" 5 "Gear Shift" 6 "Charging Complete" 7 "Charging Invalid Stop" 8 "Fault" ;
VAL_ 704 VCU_VgsVirAGIUpGear 0 "Default" 1 "1gear" 2 "2gear" 3 "3gear" 4 "4gear" 5 "5gear" 6 "6gear" 7 "7gear" 8 "8gear" 9 "RESERVED" 10 "RESERVED" 11 "RESERVED" 12 "RESERVED" 13 "RESERVED" 14 "RESERVED" 15 "RESERVED" ;
VAL_ 704 VCU_VgsVirAGIDnGear 0 "Default" 1 "1gear" 2 "2gear" 3 "3gear" 4 "4gear" 5 "5gear" 6 "6gear" 7 "7gear" 8 "8gear" 9 "RESERVED" 10 "RESERVED" 11 "RESERVED" 12 "RESERVED" 13 "RESERVED" 14 "RESERVED" 15 "RESERVED" ;
VAL_ 704 VCU_NCstmBrkOvrSta 0 "Default" 1 "Brake override system is activated" 2 "Brake override system is deactivated" 3 "Invalid" ;
VAL_ 704 VCU_NCondDragSta 0 "Not Supported" 1 "Drag Mode Inactivate" 2 "Drag Mode Activate Off" 3 "Drag Mode Activate ON" ;
VAL_ 704 VCU_NCondDragSegVal 0 "0~100 %" 1 "0~100 %" 2 "0~100 %" 3 "0~100 %" 4 "0~100 %" 5 "0~100 %" 6 "0~100 %" 7 "0~100 %" 8 "0~100 %" 9 "0~100 %" 10 "0~100 %" 11 "0~100 %" 12 "0~100 %" 13 "0~100 %" 14 "0~100 %" 15 "0~100 %" 16 "0~100 %" 17 "0~100 %" 18 "0~100 %" 19 "0~100 %" 20 "0~100 %" 21 "RESERVED" 22 "RESERVED" 23 "RESERVED" 24 "RESERVED" 25 "RESERVED" 26 "RESERVED" 27 "RESERVED" 28 "RESERVED" 29 "RESERVED" 30 "RESERVED" 31 "Not Display" ;
VAL_ 704 VCU_NCondTrackSta 0 "Not Supported" 1 "Track Mode Inactivate" 2 "Track Mode ActivateOff" 3 "Track Mode Activate ON" ;
VAL_ 704 VCU_NCondTrackTimeVal 0 "0~62min" 1 "0~62min" 2 "0~62min" 3 "0~62min" 4 "0~62min" 5 "0~62min" 6 "0~62min" 7 "0~62min" 8 "0~62min" 9 "0~62min" 10 "0~62min" 11 "0~62min" 12 "0~62min" 13 "0~62min" 14 "0~62min" 15 "0~62min" 16 "0~62min" 17 "0~62min" 18 "0~62min" 19 "0~62min" 20 "0~62min" 21 "0~62min" 22 "0~62min" 23 "0~62min" 24 "0~62min" 25 "0~62min" 26 "0~62min" 27 "0~62min" 28 "0~62min" 29 "0~62min" 30 "0~62min" 31 "0~62min" 32 "0~62min" 33 "0~62min" 34 "0~62min" 35 "0~62min" 36 "0~62min" 37 "0~62min" 38 "0~62min" 39 "0~62min" 40 "0~62min" 41 "0~62min" 42 "0~62min" 43 "0~62min" 44 "0~62min" 45 "0~62min" 46 "0~62min" 47 "0~62min" 48 "0~62min" 49 "0~62min" 50 "0~62min" 51 "0~62min" 52 "0~62min" 53 "0~62min" 54 "0~62min" 55 "0~62min" 56 "0~62min" 57 "0~62min" 58 "0~62min" 59 "0~62min" 60 "0~62min" 61 "0~62min" 62 "0~62min" 63 "Not Display" ;
VAL_ 704 VCU_NCondOSD 0 "None" 1 "Battery Heating Complete" 2 "Canceled by Low SOC" 3 "Canceled by Fault" 4 "N Conditioning Pop-up after EvRdy Off" 5 "RESERVED" 6 "RESERVED" 7 "Error" ;
VAL_ 704 VCU_ExpUnitEnrgCnsmptnVal 255 "Error indicator" ;
VAL_ 704 VCU_FlatTowModeChgPwrUsmSta 0 "OFF" 1 "Minimum" 2 "Medium" 3 "Maximum" 4 "Invalid" ;
VAL_ 704 VCU_NCstmHighPefMdWarnMsg 0 "Default" 1 "Failed by vehicle condition(Launch Control)" 2 "Failed by vehicle condition(Persistence mode)" 3 "Failed by vehicle condition(VGS)" 4 "RESERVED" 5 "Failed by vehicle condition (N Pedal)" 6 "Failed by vehicle condition (NTC)" 7 "RESERVED" 8 "RESERVED" 9 "RESERVED" 10 "RESERVED" 11 "RESERVED" 12 "RESERVED" 13 "RESERVED" 14 "RESERVED" 15 "RESERVED" ;
VAL_ 704 VCU_NCstmNtdUsmSta 0 "Default" 1 "NTD Off" 2 "NTD On" 3 "Invalid" ;
VAL_ 704 VCU_FlatTowModeUsmSta 0 "OFF (Not Equipment)" 1 "FlatTowMode OFF" 2 "Uncharged Towing (FlatTow without charging)" 3 "Towing Charging (FlatTow with charging)" 4 "Invalid" ;
VAL_ 704 VCU_FlatTowModeEquip 0 "Default" 1 "FlatTowMode not Equipment" 2 "FlatTowMode Equipment" 3 "Invalid" ;
VAL_ 704 VCU_MaintenanceSrvMd 0 "wait" 1 "M/Rly OFF Request" 2 "M/Rly OFF Complete" 3 "M/Rly OFF Prohibited" ;
VAL_ 704 VCU_CnvrtOpPermSta 0 "Not Permiited" 1 "Permitted" 2 "Not used" 3 "Error Indicator" ;
VAL_ 704 VCU_ARSPosition 0 "Closed" 1 "Open (Lv1)" 2 "Reserved (Lv2)" 3 "Reserved (Lv3)" 4 "Reserved (Lv4)" 5 "Reserved (Lv5)" 6 "Reserved (Lv6)" 7 "Invalid" ;
VAL_ 704 VCU_AccelBoostOnOffSta 0 "Accel Boost Fod not apply" 1 "Accel Boost Fod apply : boost off" 2 "Accel Boost Fod apply : boost off" 3 "-" ;
VAL_ 704 VCU_Required_ADASMapMsg 0 "0x0~0xFFFE:Required Map based ADAS Messages" 65534 "0x0~0xFFFE:Required Map based ADAS Messages" 65535 "Invalid" ;
VAL_ 704 VCU_HvBatAutoDchOpSta 0 "Default/NotReady" 1 "Ready" 2 "Progress" 3 "Complete" ;
VAL_ 704 VCU_UtilModeWarnAddMsgSta 0 "Default" 1 "Fail for AVN" 2 "Fail for CTS" 3 "Fail for BDC" 4 "RESERVED" 5 "RESERVED" 6 "RESERVED" 7 "RESERVED" ;
VAL_ 704 VCU_TowModSta 0 "None" 1 "Tow Mode On" 2 "RESERVED" 3 "RESERVED" ;
VAL_ 704 VCU_TowLvlSta 0 "Towing Level 0" 1 "Towing Level 1" 2 "Towing Level 2" 3 "Towing Level 3" 4 "RESERVED" 5 "RESERVED" 6 "RESERVED" 7 "RESERVED" ;
VAL_ 704 VCU_SwVer 0 "0x0~0xFE:VCU SW Version" 254 "0x0~0xFE:VCU SW Version" 255 "Invalid" ;
VAL_ 704 VCU_PwrAutoOffInfo 0 "Normal" 1 "AutoPowerOffActived" 2 "TimerActive" 3 "ErrorIndicator" ;
VAL_ 704 VCU_PwrAutoOffTimerSta 0 "Default" 1 "Timer1" 2 "Timer2" 3 "Timer3" 4 "Timer4" 5 "Disable" 6 "Invalid" 7 "ErrorIndicator" ;
VAL_ 704 VCU_FlatTowModeTargetSocUsmSta 0 "Off (Flat Tow Not Equipment)" 1 "40" 2 "50" 3 "60" 4 "70" 5 "80" 6 "90" 7 "Invalid" ;
VAL_ 704 VCU_PwrAutoOffTimerReset 0 "Normal" 1 "AutoPowerTimerResetActived" 2 "NotUsed" 3 "ErrorIndicator" ;
VAL_ 704 VCU_DrvInfoPageOptSta 0 "Off" 1 "On" 2 "RESERVED" 3 "Invalid" ;
VAL_ 704 VCU_TireSizeWrnMsgSta 0 "Not Display" 1 "Popup Req" 2 "Reserved" 3 "Reserved" ;
VAL_ 704 VCU_BstOpSta 0 "Off" 1 "Ready" 2 "Activated" 3 "Wait" 4 "Reserved" 5 "Reserved" 6 "Reserved" 7 "Reserved" ;
VAL_ 979 BDC_FD_Crc4Val 0 "0x0~0xFFFF:CRCValue" 65535 "0x0~0xFFFF:CRCValue" ;
VAL_ 979 CPD_NotiReq_Reactivate 0 "Default" 1 "Notification Request" 2 "RESERVED" 3 "Invalid" ;
VAL_ 979 CPD_CLU_IntDisplayRdyReq 0 "default" 1 "ready" 2 "reserved" 3 "invalid" ;
VAL_ 979 CPD_CLU_IntDisplayOnReq 0 "Default" 1 "Off" 2 "Ready" 3 "Warning" 4 "RESERVED" 5 "RESERVED" 6 "RESERVED" 7 "invalid" ;
VAL_ 979 ROA_SnSrStat_1 0 "Default" 1 "Ready" 2 "Run" 3 "Done" 4 "Delaying" 5 "Stop" 6 "RESERVED" 7 "Error Indicator" ;
VAL_ 979 Warn_ExtBuzzerOut 0 "Off" 1 "On" 2 "RESERVED" 3 "Error Indicator" ;
VAL_ 979 SBR_AsstStBltWrngIndSta 0 "Off" 1 "On" 2 "Not Used" 3 "Error Indicator" ;
VAL_ 979 SBR_DrvStBltWrngIndSta 0 "Off" 1 "On" 2 "RESERVED" 3 "Error Indicator" ;
VAL_ 979 SeatOccuPres_Drv 0 "Off" 1 "On" 2 "RESERVED" 3 "Error Indicator" ;
VAL_ 979 SeatOccuPres_Asst 0 "Off" 1 "On" 2 "RESERVED" 3 "Error Indicator" ;
VAL_ 979 SeatOccuPres_1stCtr 0 "Off" 1 "On" 2 "RESERVED" 3 "Error Indicator" ;
VAL_ 979 SeatOccuPres_2ndLft 0 "Off" 1 "On" 2 "RESERVED" 3 "Error Indicator" ;
VAL_ 979 SeatOccuPres_2ndRt 0 "Off" 1 "On" 2 "RESERVED" 3 "Error Indicator" ;
VAL_ 979 SeatOccuPres_2ndCtr 0 "Off" 1 "On" 2 "RESERVED" 3 "Error Indicator" ;
VAL_ 979 SeatOccuPres_3rdLft 0 "Off" 1 "On" 2 "RESERVED" 3 "Error Indicator" ;
VAL_ 979 SeatOccuPres_3rdRt 0 "Off" 1 "On" 2 "RESERVED" 3 "Error Indicator" ;
VAL_ 979 SeatOccuPres_3rdCtr 0 "Off" 1 "On" 2 "RESERVED" 3 "Error Indicator" ;
VAL_ 979 SeatOccuPres_4thLft 0 "Off" 1 "On" 2 "RESERVED" 3 "Error Indicator" ;
VAL_ 979 SeatOccuPres_4thRt 0 "Off" 1 "On" 2 "RESERVED" 3 "Error Indicator" ;
VAL_ 979 SeatOccuPres_4thCtr 0 "Off" 1 "On" 2 "RESERVED" 3 "Error Indicator" ;
VAL_ 979 CPD_VersionOpt 0 "Default" 1 "26yr" 2 "RESERVED" 3 "RESERVED" 4 "RESERVED" 5 "RESERVED" 6 "RESERVED" 7 "RESERVED" 8 "RESERVED" 9 "RESERVED" 10 "RESERVED" 11 "RESERVED" 12 "RESERVED" 13 "RESERVED" 14 "RESERVED" 15 "Invalid" ;
VAL_ 979 BDC_FD_AlvCnt4Val 0 "0x0~0xFF:AlvCntValue" 255 "0x0~0xFF:AlvCntValue" ;
VAL_ 979 BAlarm_BglrAlrm_CurrentSta 0 "Off" 1 "DisArm" 2 "Arm" 3 "PreArm" 4 "ArmWait" 5 "ArmHold" 6 "ReArm" 7 "AutoLockTimer (AutoLockTimer1)" 8 "RESERVED" 9 "Alarm" 10 "Default" 11 "TrunkTgTimer (AutoLockTimer3)" 12 "RESERVED" 13 "RESERVED" 14 "Not Used" 15 "Error Indicator" ;
VAL_ 979 BAlarm_BglrAlrm_Sta 0 "DIS-, PRE-, AUTOLOCKTIMER (AutoLockTimer1), TrunkTgTimer (AutoLockTimer3)" 1 "ARM, -WAIT, RE-, ALARM, -HD(Trunk)" 2 "Not Used" 3 "Error Indicator" ;
VAL_ 979 BAlarm_PncAlrmSta 0 "Off" 1 "On (Panic Alarm ON)" 2 "Not Used" 3 "Error Indicator" ;
VAL_ 979 SBR_StBltStpWrngBzrSta 0 "Warning Off" 1 "Buzzer Hold" 2 "1st Warning" 3 "2nd Warning" 4 "3rd Warning" 5 "Reserved" 6 "Pre Warning" 7 "Error Indicator" ;
VAL_ 979 SBR_StBltWrngBzrSta 0 "Warning Off" 1 "Buzzer Hold" 2 "Buzzer On" 3 "Reserved" 4 "Reserved" 5 "Reseved" 6 "Not Used" 7 "Error Indicator" ;
VAL_ 979 BAlarm_BrglrHrnRlySta 0 "Off" 1 "On" 2 "Not Used" 3 "Error Indicator" ;
VAL_ 979 SBR_DrvStBltIndSta 0 "Off" 1 "On" 2 "Not Used" 3 "Error Indicator" ;
VAL_ 979 SBR_RrLftStBltWrngIndSta 0 "Off" 1 "On" 2 "Belted" 3 "Error Indicator" ;
VAL_ 979 SBR_RrRtStBltWrngIndSta 0 "Off" 1 "On" 2 "Belted" 3 "Error Indicator" ;
VAL_ 979 SBR_RrCtrStBltIndSta 0 "Off" 1 "On" 2 "Belted" 3 "Error Indicator" ;
VAL_ 979 SBR_3rdLftStBltWrngIndSta 0 "Off" 1 "On" 2 "Belted" 3 "Error Indicator" ;
VAL_ 979 SBR_3rdRtStBltWrngIndSta 0 "Off" 1 "On" 2 "Belted" 3 "Error Indicator" ;
VAL_ 979 SBR_3rdCtrStBltWrngIndSta 0 "Off" 1 "On" 2 "Belted" 3 "Error Indicator" ;
VAL_ 979 Warn_BzrWrngSta 0 "Off" 1 "SeatBelt Warning" 2 "Key Operated Warning" 3 "Parking Brake Warning" 4 "Sun Roof Open Warning" 5 "Key Learning Sound(NoSMKOption" 6 "ICE Warning" 7 "Rear Fog Warning" 8 "Reserved" 9 "Reserved" 10 "Reserved" 11 "Reserved" 12 "Reserved" 13 "Reserved" 14 "Not Used" 15 "Error Indicator" ;
VAL_ 979 Warn_BCMWrngSta 0 "Off" 1 "Power off request warning" 2 "Shift P request Warning" 3 "Shift P Warning 2 (Pwr Off, Shift Enable)" 4 "Shift P Warning 2 (Pwr Off, Shift Disable)" 5 "Shift P Warning 2 (Pwr On, Shift Enable)" 6 "Shift P Warning 2 (Pwr On, Shift Disable)" 7 "MT Parking Brake Not Engage Warning" 8 "RESERVED" 9 "RESERVED" 10 "RESERVED" 11 "RESERVED" 12 "RESERVED" 13 "RESERVED" 14 "Not Used" 15 "Error Indicator" ;
VAL_ 979 ROA_RrBlwAutoOffReq 0 "default" 1 "Request of Rear Blow Off (auto Cut)" 2 "Not Used" 3 "Error Indciator" ;
VAL_ 979 ROA_RegionOpt 0 "Non Euro NCAP CPD" 1 "Euro NCAP CPD" 2 "Reserved" 3 "Error Indicator" ;
VAL_ 979 Warn_RrStRmndOpt 0 "Not apply RrSeatRemind" 1 "Apply RrSeatRemind" 2 "Apply Radar ROA sensor" 3 "Error Indicator" ;
VAL_ 979 Warn_RrStRmndAlrmOnReq 0 "Off" 1 "On(Alarm)" 2 "Not Used" 3 "Error Indicator" ;
VAL_ 979 Warn_RrStRmndSysSta 0 "Default" 1 "System ON" 2 "System OFF" 3 "Error Indicator" ;
VAL_ 979 Warn_RrStRmndAlrmInfo 0 "Off" 1 "Rear Seat Reminder" 2 "Rear Seat Reminder 1st Only" 3 "Delayed ROA" 4 "Pre-warning" 5 "Pre-warning 1st Only" 6 "Pre-warning Ncap" 7 "Error Indicator" ;
VAL_ 979 Warn_RoaErr 0 "Off" 1 "SensorError( Malfunction)" 2 "Reserved" 3 "Reserved" 4 "Reserved" 5 "Reseved" 6 "Not Used" 7 "Error Indicator" ;
VAL_ 979 Warn_RrStRmndDelay 0 "Off" 1 "Delayed ROA" 2 "Deactivated" 3 "Error Indicator" ;
VAL_ 979 Warn_RrStRmndSysAct 0 "Default" 1 "Deactivation" 2 "Off" 3 "Error Indicator" ;
VAL_ 979 WAL_FobSearching 0 "Not Fob Exist" 1 "Fob Exist" 2 "Reserved" 3 "Error Indicator" ;
VAL_ 979 Warn_RrStRmndSysOffIND 0 "Indicator Off" 1 "Indicator On" 2 "Not Used" 3 "Error Indicator" ;
VAL_ 979 Warn_VehNotPWrngSta 0 "Off" 1 "Not P Warning (Pwr Off, Shift Enable)" 2 "Not P Warning (Pwr Off, Shift Disable)" 3 "Not P Warning (Pwr On, Shift Enable)" 4 "Not P Warning (Pwr On, Shift Disable)" 5 "RESERVED" 6 "RESERVED" 7 "Error Indicator" ;
VAL_ 979 Warn_RrStRmndAlrmInfo_1 0 "Default" 1 "OFF" 2 "Pre-warning" 3 "Pre-warning 1st Only" 4 "Pre-warning Ncap" 5 "Pre-warning Ncap_Deactivation" 6 "RESERVED" 7 "Error Indicator" ;
VAL_ 979 CPD_WrngSta 0 "Off" 1 "On" 2 "Not Used" 3 "Error Indicator" ;
VAL_ 979 CPD_HU_IntDisplayRdyReq 0 "Default" 1 "Ready" 2 "RESERVED" 3 "Invalid" ;
VAL_ 979 CPD_HU_IntDisplayOnReq 0 "Default" 1 "Off" 2 "Ready" 3 "Warning" 4 "RESERVED" 5 "RESERVED" 6 "RESERVED" 7 "Invalid" ;
VAL_ 1059 HU_GW_Crc4Val 0 "0x0~0xFFFF:CRCValue" 65535 "0x0~0xFFFF:CRCValue" ;
VAL_ 1059 CF_AVN_AutoWashModeSta 0 "Default" 1 "Non Auto Wash Mode" 2 "Auto Wash Mode" 3 "RESERVED" 4 "RESERVED" 5 "RESERVED" 6 "RESERVED" 7 "Invalid" ;
VAL_ 1059 HU_ResetOpSta 0 "Normal" 1 "Reset Complete" 2 "Reset Fail" 3 "RESERVED" ;
VAL_ 1059 CRS_BabyOnSeatstates 0 "Default" 1 "Children not seating" 2 "Children seating" 3 "Invalid" ;
VAL_ 1059 OMUOSMirCtrl_Vr 0 "Off" 1 "Fold" 2 "Unfold" 3 "invalid" ;
VAL_ 1059 CF_AVN_ValetModeSta 0 "Default" 1 "Off" 2 "On" 3 "Invalid" ;
VAL_ 1059 CF_AVN_DTOPEnableNValueSet 0 "Default" 1 "Disable" 2 "Enable" 3 "Invalid" ;
VAL_ 1059 HU_GW_AlvCnt4Val 0 "0x0~0xFF:AlvCntValue" 255 "0x0~0xFF:AlvCntValue" ;
VAL_ 1059 HU_Customer_Action_Ind 0 "NoAction" 1 "Action" ;
VAL_ 1059 HU_IG3_Request 0 "Off" 1 "On" 2 "RESERVED" 3 "Invalid" ;
VAL_ 1059 HU_DigitalKeyGroupingSupport 0 "Default" 1 "Not supported" 2 "Support" 3 "RESERVED" ;
VAL_ 1059 HU_Background 0 "Default" 1 "Day" 2 "Night" 3 "RESERVED" 4 "RESERVED" 5 "RESERVED" 6 "RESERVED" 7 "Invalid" ;
VAL_ 1059 HU_BackgroundFadeInOut 0 "0x0~0x3E8:0.0~100.0%" 1000 "0x0~0x3E8:0.0~100.0%" 1001 "RESERVED" 1002 "RESERVED" 1003 "RESERVED" 1004 "RESERVED" 1005 "RESERVED" 1006 "RESERVED" 1007 "RESERVED" 1008 "RESERVED" 1009 "RESERVED" 1010 "RESERVED" 1011 "RESERVED" 1012 "RESERVED" 1013 "RESERVED" 1014 "RESERVED" 1015 "RESERVED" 1016 "RESERVED" 1017 "RESERVED" 1018 "RESERVED" 1019 "RESERVED" 1020 "RESERVED" 1021 "RESERVED" 1022 "Default" 1023 "Invalid" ;
VAL_ 983 BDC_FD_Crc8Val 0 "0x0~0xFFFF:CRCValue" 65535 "0x0~0xFFFF:CRCValue" ;
VAL_ 983 Mirror_MnlFldModSta 0 "None" 1 "ManualFold" 2 "RESERVED" 3 "Error Indicator" ;
VAL_ 983 Mirror_SelSwSta 0 "Off" 1 "Left" 2 "Neutral" 3 "Right" 4 "Not Used" 5 "Not Used" 6 "Not Used" 7 "Error Indicator" ;
VAL_ 983 Mirror_LHPosMnlReq 0 "Off" 1 "Up" 2 "Down" 3 "Left" 4 "Right" 5 "Not Used" 6 "Not Used" 7 "Error Indicator" ;
VAL_ 983 Mirror_AutoWashModeSta_TypeC 0 "Not Completed" 1 "Completed" 2 "RESERVED" 3 "Error Indicator" ;
VAL_ 983 Mirror_RHPosMnlReq 0 "Off" 1 "Up" 2 "Down" 3 "Left" 4 "Right" 5 "Not Used" 6 "Not Used" 7 "Error Indicator" ;
VAL_ 983 Mirror_LHPosMnlCmd 0 "Off" 1 "Up" 2 "Down" 3 "Left" 4 "Right" 5 "Not Used" 6 "Not Used" 7 "Error Indicator" ;
VAL_ 983 Mirror_RHPosMnlCmd 0 "Off" 1 "Up" 2 "Down" 3 "Left" 4 "Right" 5 "Not Used" 6 "Not Used" 7 "Error Indicator" ;
VAL_ 983 Wiper_FrWiperLowAct 0 "Off" 1 "On" 2 "Not Used" 3 "Error Indicator" ;
VAL_ 983 Wiper_FrWiperHighAct 0 "Off" 1 "On" 2 "Not Used" 3 "Error Indicator" ;
VAL_ 983 Wiper_FrtWiperLowCmd 0 "Off" 1 "On" 2 "Not Used" 3 "Error Indicator" ;
VAL_ 983 Wiper_FrtWiperHighCmd 0 "Off" 1 "On" 2 "Not Used" 3 "Error Indicator" ;
VAL_ 983 Wiper_RrWiperCmd 0 "Off" 1 "On" 2 "Not Used" 3 "Error Indicator" ;
VAL_ 983 Wiper_PowerEnableCmd 0 "Off" 1 "On" 2 "Not Used" 3 "Error Indicator" ;
VAL_ 983 Wiper_FrtWasherCmd 0 "Off" 1 "On" 2 "Not Used" 3 "Error Indicator" ;
VAL_ 983 Wiper_RrWasherCmd 0 "Off" 1 "On" 2 "Not Used" 3 "Error Indicator" ;
VAL_ 983 Wiper_HeadLampWasherCmd 0 "Off" 1 "On" 2 "Not Used" 3 "Error Indicator" ;
VAL_ 983 Wiper_AutoWashModeSta_TypeC 0 "Not Completed" 1 "Completed" 2 "RESERVED" 3 "Error Indicator" ;
VAL_ 983 Mirror_LHPosMnlPlyCmd 0 "Off" 1 "Up" 2 "Down" 3 "Left" 4 "Right" 5 "RESERVED" 6 "RESERVED" 7 "Error Indicator" ;
VAL_ 983 Mirror_RHPosMnlPlyCmd 0 "Off" 1 "Up" 2 "Down" 3 "Left" 4 "Right" 5 "RESERVED" 6 "RESERVED" 7 "Error Indicator" ;
VAL_ 983 BDC_FD_AlvCnt8Val 0 "0x0~0xFF:AlvCntValue" 255 "0x0~0xFF:AlvCntValue" ;
VAL_ 983 Mirror_LHPosAutoPlyCmd 0 "Off" 1 "IMS1" 2 "IMS2" 3 "IMS3" 4 "IMS Stop" 5 "SmartIMS" 6 "SmartIMS Stop" 7 "Personal Service(Profile)" 8 "Default Auto Reverse" 9 "IMS1 Auto Reverse" 10 "IMS2 Auto Reverse" 11 "IMS3 Auto Reverse" 12 "Self Return" 13 "RESERVED" 14 "RESERVED" 15 "Error Indicator" ;
VAL_ 983 Mirror_RHPosAutoPlyCmd 0 "Off" 1 "IMS1" 2 "IMS2" 3 "IMS3" 4 "IMS Stop" 5 "SmartIMS" 6 "SmartIMS Stop" 7 "Personal Service(Profile)" 8 "Default Auto Reverse" 9 "IMS1 Auto Reverse" 10 "IMS2 Auto Reverse" 11 "IMS3 Auto Reverse" 12 "Self Return" 13 "RESERVED" 14 "RESERVED" 15 "Error Indicator" ;
VAL_ 983 Mirror_IMSMemoryCmd 0 "Off" 1 "IMS1" 2 "IMS2" 3 "IMS3" 4 "RESERVED" 5 "RESERVED" 6 "RESERVED" 7 "Error Indicator" ;
VAL_ 983 ECW_Overload2 0 "Else" 1 "Detected Overload" 2 "Detected Block" 3 "Detected Overheat" 4 "RESERVED" 5 "RESERVED" 6 "Not Used" 7 "Error Indicator" ;
VAL_ 983 Mirror_AutoRevModSetSta 0 "Default" 1 "Off" 2 "On" 3 "Error Indicator" ;
VAL_ 983 IRS_Err_Type 0 "Invalid" 1 "LIN Error" 2 "Coding Error" 3 "Rain Sensor H/W Error" 4 "Light Sensor H/W Error" 5 "Solar Sensor H/W Error" 6 "Rain Sensor Calibration Error" 7 "Over Voltage Error" 8 "Over Temperature Error" 9 "RESERVED" 10 "RESERVED" 11 "RESERVED" 12 "RESERVED" 13 "RESERVED" 14 "Not Used" 15 "Error Indicator" ;
VAL_ 983 Wiper_RainAmount 0 "0x0~0x96:PH=0.1*HEX(mm/Hr)" 150 "0x0~0x96:PH=0.1*HEX(mm/Hr)" 151 "97~0xFE:RESERVED" 254 "97~0xFE:RESERVED" 255 "Invalid" ;
VAL_ 983 Wiper_AutoWashModeSta 0 "Auto Wash Mode Off" 1 "Auto Wash Mode On" 2 "Not Used" 3 "Error Indicator" ;
VAL_ 983 Wiper_PrkngPosSta 0 "else" 1 "Parking Position" 2 "Not Used" 3 "Error Indicator" ;
VAL_ 983 Wiper_RainSnsrOptionTyp 0 "Non Rain Sensor Option" 1 "Rain Sensor Option" 2 "Not Used" 3 "Error Indicator" ;
VAL_ 983 Wiper_HtWshNzzlCmd 0 "Off" 1 "On" 2 "Not Used" 3 "Error Indicator" ;
VAL_ 983 Wiper_RainSnsrSta 0 "OFF" 1 "Rain Detected" 2 "Low" 3 "High" 4 "Fault 1" 5 "RESERVED" 6 "RESERVED" 7 "RESERVED" 8 "RESERVED" 9 "RESERVED" 10 "RESERVED" 11 "RESERVED" 12 "RESERVED" 13 "RESERVED" 14 "Not Used" 15 "Error Indicator" ;
VAL_ 983 Wiper_RainSnsrPartNum 7 "N1000" 0 "T6000,NI000,JA000" 1 "EV000,DV000" 2 "CU000,XA000" 3 "CV000,DC000" 4 "KL000,XB000" 5 "DO000" 6 "CU500" 8 "RESERVED" 9 "RESERVED" 10 "RESERVED" 11 "RESERVED" 12 "RESERVED" 13 "RESERVED" 14 "RESERVED" 15 "L1000,N9000" ;
VAL_ 983 ECW_Fault 0 "Else" 1 "Detected" 2 "Not used" 3 "Error Indicator" ;
VAL_ 983 ECW_FaultActv 0 "Else" 1 "Valid" 2 "Not used" 3 "Error Indicator" ;
VAL_ 983 ECW_HiVolt 0 "Else" 1 "Detected" 2 "Not used" 3 "Error Indicator" ;
VAL_ 983 ECW_HiVoltActv 0 "Else" 1 "Valid" 2 "Not used" 3 "Error Indicator" ;
VAL_ 983 ECW_LoVolt 0 "Else" 1 "Detected" 2 "Not used" 3 "Error Indicator" ;
VAL_ 983 ECW_LoVoltActv 0 "Else" 1 "Valid" 2 "Not used" 3 "Error Indicator" ;
VAL_ 983 ECW_Overload 0 "Else" 1 "Detected" 2 "Not used" 3 "Error Indicator" ;
VAL_ 983 ECW_OverloadActv 0 "Else" 1 "Valid" 2 "Not used" 3 "Error Indicator" ;
VAL_ 983 ECW_CommErr 0 "No error" 1 "Error" 2 "Not used" 3 "Error Indicator" ;
VAL_ 983 ECW_Err_Type 0 "Invalid" 1 "LIN Error" 2 "Fault" 3 "High Voltage Error" 4 "Low Voltage Error" 5 "RESERVED" 6 "Not Used" 7 "Error Indicator" ;
VAL_ 983 Wiper_NonParkWarning 0 "Off" 1 "Warning1" 2 "Warning2" 3 "RESERVED" ;
VAL_ 983 BCM_SolSnsrRt 0 "0x00~0xFE:w/m2" 254 "0x00~0xFE:w/m2" 255 "Invalid" ;
VAL_ 983 BCM_SolSnsrLft 0 "0x00~0xFE:w/m2" 254 "0x00~0xFE:w/m2" 255 "Invalid" ;
VAL_ 983 Mirror_MirFldOpt 0 "Not Applied" 1 "Applied" 2 "Not Used" 3 "Error Indicator" ;
VAL_ 983 Mirror_FldUnfldCmd 0 "Off" 1 "Fold" 2 "Unfold" 3 "Error Indicator" ;
VAL_ 983 Mirror_FldCtrlSta 0 "Off" 1 "Fldng" 2 "Fld" 3 "Error Indicator" ;
VAL_ 983 Mirror_UnFldCtrlSta 0 "Off" 1 "UnFldng" 2 "UnFld" 3 "Error Indicator" ;
VAL_ 983 Mirror_PosMnlCmd 0 "Off" 1 "Up" 2 "Down" 3 "Left" 4 "Right" 5 "Not Used" 6 "Not Used" 7 "Error Indicator" ;
VAL_ 983 Mirror_SelSwIndCmd 0 "Off" 1 "Left" 2 "Neutral" 3 "Right" 4 "Not Used" 5 "Not Used" 6 "Not Used" 7 "Error Indicator" ;
VAL_ 861 LBM_FD_Crc3Val 0 "0x0~0xFFFF:CRCValue" 65535 "0x0~0xFFFF:CRCValue" ;
VAL_ 861 MainLBM_CellVtgDeviationSta 0 "0x0~0xFFFF:Valid Value" 65535 "0x0~0xFFFF:Valid Value" ;
VAL_ 861 MainLBM_12VAvgCurrAtReset 0 "0x0~0xFFE:-40,940~0" 4094 "0x0~0xFFE:-40,940~0" 4095 "Error Indicator" ;
VAL_ 861 MainLBM_VehSpdLimContReq 0 "Normal" 1 "Limphome Level1" 2 "Limphome Level2" 3 "Limphome Level3" 4 "Limphome Level4" 5 "Limphome Level5" 6 "RESERVED" 7 "Invalid" ;
VAL_ 861 LBM_FD_AlvCnt3Val 0 "0x0~0xFF:AlvCntValue" 255 "0x0~0xFF:AlvCntValue" ;
VAL_ 861 MainLBM_OptType 0 "NotApplied" 1 "M-LBMGen1(LTO)" 2 "M-LBMGen1(LFP)" 255 "Invalid" ;
VAL_ 861 MainLBM_RlyOnSta 0 "12V Latch Relay Off" 1 "12V Latch Relay On" 2 "Not used" 3 "Error indicator" ;
VAL_ 861 MainLBM_RlyOutVoltVal 0 "0x0~0xFE:Valid Value" 254 "0x0~0xFE:Valid Value" 255 "Error indicator" ;
VAL_ 861 MainLBM_RlyOnSwReq 0 "Normal" 1 "Request" 2 "Not used" 3 "Error indicator" ;
VAL_ 861 MainLBM_BmsFailWarn 0 "Normal(Default)" 1 "1st warning" 2 "2nd warning" 3 "SMS warning" ;
VAL_ 861 MainLBM_FaultSta 0 "0x0~0x3FF : Valid Value" 1023 "0x0~0x3FF : Valid Value" ;
VAL_ 861 MainLBM_ResetOpSta 0 "Normal" 1 "Reset Complete" 2 "Reset Fail" 3 "RESERVED" ;
VAL_ 861 MainLBM_CellOverVtgSta 0 "0x0~0xFFFF: Valid Value" 65535 "0x0~0xFFFF: Valid Value" ;
VAL_ 861 MainLBM_CellLowVtgSta 0 "0x0~0xFFFF:Valid Value" 65535 "0x0~0xFFFF:Valid Value" ;
VAL_ 980 BDC_FD_Crc5Val 0 "0x0~0xFFFF:CRCValue" 65535 "0x0~0xFFFF:CRCValue" ;
VAL_ 980 AutoLt_HorRes_STD 0 "1lux" 1 "20lux" 2 "Not Used" 3 "Error Indicator" ;
VAL_ 980 AutoLt_VerVal_STD 0 "0x0~0x7FE:Value" 2046 "0x0~0x7FE:Value" 2047 "Error Indicator" ;
VAL_ 980 AutoLt_VerRes_STD 0 "1lux" 1 "20lux" 2 "Not Used" 3 "Error Indicator" ;
VAL_ 980 MoodLamp_SlvColor_X 0 "0x00~0xFA:Color X : 0~250" 250 "0x00~0xFA:Color X : 0~250" 251 "Reserved : 251~254" 252 "Reserved : 251~254" 253 "Reserved : 251~254" 254 "Reserved : 251~254" 255 "Invalid : 255" ;
VAL_ 980 MoodLamp_SlvColor_Y 0 "0x00~0xFA:Color Y : 0~250" 250 "0x00~0xFA:Color Y : 0~250" 251 "Reserved : 251~254" 252 "Reserved : 251~254" 253 "Reserved : 251~254" 254 "Reserved : 251~254" 255 "Invalid : 255" ;
VAL_ 980 MoodLamp_SlvBrgtnsVal 0 "0x00~0xFA:Brightness 0~100%" 250 "0x00~0xFA:Brightness 0~100%" 251 "RESERVED" 252 "RESERVED" 253 "RESERVED" 254 "RESERVED" 255 "Invalid" ;
VAL_ 980 MoodLamp_SlvFadeInTimetVal 0 "0x00~0xFE:Fade in time 0~254" 254 "0x00~0xFE:Fade in time 0~254" 255 "Invalid" ;
VAL_ 980 BDC_FD_AlvCnt5Val 0 "0x0~0xFF:AlvCntValue" 255 "0x0~0xFF:AlvCntValue" ;
VAL_ 980 MoodLamp_SlvFadeOutTimetVal 0 "0x00~0xFE:Fade out time 0~254" 254 "0x00~0xFE:Fade out time 0~254" 255 "Invalid" ;
VAL_ 980 Lamp_LftTrnLmpCmdSta 0 "Off" 1 "On" 2 "Not Used" 3 "Error Indicator" ;
VAL_ 980 Lamp_RtTrnLmpCmdSta 0 "Off" 1 "On" 2 "Not Used" 3 "Error Indicator" ;
VAL_ 980 Lamp_LftTrnLmpCmd 0 "Inactive" 1 "BlinkingOff" 2 "BlinkingOn" 3 "Error Indicator" ;
VAL_ 980 Lamp_RtTrnLmpCmd 0 "Inactive" 1 "BlinkingOff" 2 "BlinkingOn" 3 "Error Indicator" ;
VAL_ 980 Lamp_TrnLmpMode 0 "Off" 1 "Hazard" 2 "LeftTurnNormal" 3 "RightTurnNormal" 4 "LeftTurnFault" 5 "RightTurnFault" 6 "RESERVED" 7 "Error Indicator" ;
VAL_ 980 Lamp_HzrdSwIND 0 "Inactive" 1 "IndOff" 2 "IndOn" 3 "Error Indicator" ;
VAL_ 980 Lamp_HdLmpEscortShortCmd 0 "Off" 1 "On" 2 "Not Used" 3 "Error Indicator" ;
VAL_ 980 Lamp_LightPopUpMsgType 0 "Default" 1 "A" 2 "B" 3 "Error Indicator" ;
VAL_ 980 Lamp_LightPopUpReq 0 "Off" 1 "On" 2 "RESERVED" 3 "Error Indicator" ;
VAL_ 980 Lamp_HdLmpLoOffPopUpReq 0 "Default" 1 "Off" 2 "On" 3 "Error Indicator" ;
VAL_ 980 MoodLamp_SpeechRecogPosSta 0 "Default" 1 "Front Left" 2 "Front Right" 3 "Rear Left" 4 "Rear Right" 5 "Third Left" 6 "Third Right" 7 "Invalid" ;
VAL_ 980 MoodLamp_BttmSlvColor_X 0 "0x00~0xFA:Color X : 0~250" 250 "0x00~0xFA:Color X : 0~250" 251 "Reserved : 251~254" 252 "Reserved : 251~254" 253 "Reserved : 251~254" 254 "Reserved : 251~254" 255 "Invalid : 255" ;
VAL_ 980 MoodLamp_BttmSlvColor_Y 0 "0x00~0xFA:Color Y : 0~250" 250 "0x00~0xFA:Color Y : 0~250" 251 "Reserved : 251~254" 252 "Reserved : 251~254" 253 "Reserved : 251~254" 254 "Reserved : 251~254" 255 "Invalid : 255" ;
VAL_ 980 MoodLamp_BttmSlvBrgtnsVal 0 "0x00~0xFA:Brightness 0~100%" 250 "0x00~0xFA:Brightness 0~100%" 251 "RESERVED" 252 "RESERVED" 253 "RESERVED" 254 "RESERVED" 255 "Invalid" ;
VAL_ 980 MoodLamp_BttmSlvFadeInTimetVal 0 "0x00~0xFE:Fade In time 0~254" 254 "0x00~0xFE:Fade In time 0~254" 255 "Invalid" ;
VAL_ 980 MoodLamp_BttmSlvFadeOutTimetVal 0 "0x00~0xFE:Fade out time 0~254" 254 "0x00~0xFE:Fade out time 0~254" 255 "Invalid" ;
VAL_ 980 Lamp_FrontGroundLightOnReq 0 "Off" 1 "On" 2 "NotUsed" 3 "ErrorIndicator" ;
VAL_ 980 Lamp_SideGroundLightOnReq 0 "Off" 1 "On" 2 "NotUsed" 3 "ErrorIndicator" ;
VAL_ 980 Lamp_RearGroundLightOnReq 0 "Off" 1 "On" 2 "NotUsed" 3 "ErrorIndicator" ;
VAL_ 980 Lamp_HiPrioHzrdReq 0 "Off" 1 "High On" 2 "High Inactive" 3 "Reserved" 4 "Reserved" 5 "Reseved" 6 "Not Used" 7 "Error Indicator" ;
VAL_ 980 Lamp_DecoLmpOnReq 0 "Off" 1 "On" 2 "NotUsed" 3 "ErrorIndicator" ;
VAL_ 980 Lamp_SideGndLmpCmd 0 "Off" 1 "On" 2 "NotUsed" 3 "ErrorIndicator" ;
VAL_ 980 Lamp_SideGndCptLmpCmd 0 "Off" 1 "On" 2 "NotUsed" 3 "ErrorIndicator" ;
VAL_ 980 Lamp_HzrdLampStabySW 0 "Off" 1 "On" 2 "RESERVED" 3 "Error Indicator" ;
VAL_ 980 Lamp_LoPrioHzrdReq 0 "Off" 1 "Low On" 2 "Low Inactive" 3 "Reserved" 4 "Reserved" 5 "Reseved" 6 "Not Used" 7 "Error Indicator" ;
VAL_ 980 Lamp_ExtrnlTailLmpOnReq 0 "Off" 1 "On" 2 "Not Used" 3 "Error Indicator" ;
VAL_ 980 Lamp_HdLmpLoOnReq 0 "Off" 1 "On" 2 "Not Used" 3 "Error Indicator" ;
VAL_ 980 Lamp_HdLmpHiOnReq 0 "Off" 1 "On" 2 "Not Used" 3 "Error Indicator" ;
VAL_ 980 Lamp_DrlOnReq 0 "Off" 1 "On" 2 "Not Used" 3 "Error Indicator" ;
VAL_ 980 Lamp_BckUpLmpCmd 0 "Off" 1 "On" 2 "Not Used" 3 "Error Indicator" ;
VAL_ 980 Lamp_FrFogLmpOnReq 0 "Off" 1 "On" 2 "Not Used" 3 "Error Indicator" ;
VAL_ 980 Lamp_RrFogLmpOnReq 0 "Off" 1 "On" 2 "Not Used" 3 "Error Indicator" ;
VAL_ 980 Lamp_StcBendingLmpLftOnReq 0 "Off" 1 "On" 2 "Direct Off" 3 "Error Indicator" ;
VAL_ 980 Lamp_StcBendingLmpRtOnReq 0 "Off" 1 "On" 2 "Direct Off" 3 "Error Indicator" ;
VAL_ 980 Lamp_CornerLmpLftOnReq 0 "Off" 1 "On" 2 "Direct Off" 3 "Error Indicator" ;
VAL_ 980 Lamp_CornerLmpRtOnReq 0 "Off" 1 "On" 2 "Direct Off" 3 "Error Indicator" ;
VAL_ 980 Lamp_HbaCtrlModTyp 0 "H/Lamp High control Mode by BCM" 1 "H/Lamp High control Mode by HBA" 2 "Not Used" 3 "Error Indicator" ;
VAL_ 980 Lamp_IFSCtrlModTyp 0 "H/Lamp High control Mode by BCM" 1 "H/Lamp High control Mode by IFS" 2 "Not Used" 3 "Error Indicator" ;
VAL_ 980 Lamp_HdLmpWlcmCmd 0 "Off" 1 "On" 2 "Not Used" 3 "Error Indicator" ;
VAL_ 980 Lamp_PuddleLmpOnReq 0 "Off" 1 "On" 2 "Not Used" 3 "Error Indicator" ;
VAL_ 980 Lamp_ExtLampRSPAMode 0 "Off" 1 "On" 2 "Not Used" 3 "Error Indicator" ;
VAL_ 980 Lamp_IntTailLmpOnReq 0 "Off" 1 "On" 2 "Not Used" 3 "Error Indicator" ;
VAL_ 980 Lamp_AvTailLmpSta 0 "Off" 1 "On" 2 "Not Used" 3 "Error Indicator" ;
VAL_ 980 Lamp_AutoLtSnsrNightSta 0 "Off" 1 "Night" 2 "Not Used" 3 "Error Indicator" ;
VAL_ 980 Lamp_VendorInfo 7 "Error Indicator" 0 "Not Used" 1 "TRW(BCS)" 2 "HELLA" 3 "TRW(BCS) STD" 4 "HELLA STD" 5 "BAOLONG" 6 "Not Used" ;
VAL_ 980 Lamp_AutoLtSnsrHorVal 0 "0x0~0x3FE:Light Sensor Value" 1022 "0x0~0x3FE:Light Sensor Value" 1023 "Invalid" ;
VAL_ 980 MoodLamp_AIVoiceOptSta 0 "Default" 1 "No" 2 "Yes" 3 "Invalid" ;
VAL_ 980 MoodLamp_DualColorOptSta 0 "Default" 1 "Single(USM)" 2 "Dual(USM)" 3 "Invalid" ;
VAL_ 980 MoodLamp_MdLmpFadeSta 0 "Default" 1 "Off" 2 "On" 3 "Invalid" ;
VAL_ 980 MoodLamp_NumRecommendColor 0 "Default" 1 "Number of recommended color (1~14)" 2 "Number of recommended color (1~14)" 3 "Number of recommended color (1~14)" 4 "Number of recommended color (1~14)" 5 "Number of recommended color (1~14)" 6 "Number of recommended color (1~14)" 7 "Number of recommended color (1~14)" 8 "Number of recommended color (1~14)" 9 "Number of recommended color (1~14)" 10 "Number of recommended color (1~14)" 11 "Number of recommended color (1~14)" 12 "Number of recommended color (1~14)" 13 "Number of recommended color (1~14)" 14 "Number of recommended color (1~14)" 15 "Invalid" ;
VAL_ 980 AutoLt_HorVal_STD 0 "0x0~0x7FE:Value" 2046 "0x0~0x7FE:Value" 2047 "Error Indicator" ;
