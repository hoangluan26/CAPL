VERSION ""

NS_ :

BS_:

BU_: ARS_FD WPC_FD WPC2_FD SCM_FD SHVU_FRNT_FD GW_SAU_DRV_FD GW_PSU_AST_FD GW_PSU_3RD_FD RCS_FD GW_PSU_RL_FD RCM_FD SHVU_3RD_FD SHVU_RR_FD PSB_FD ATS_FD GW_PSU_RR_FD SHVU_RL_FD RWPC_FD CGW_CCU OHCL_FD SHVU_REAR_FD BLTN_CAM_FD SGU_FD GW_PSU_DRV_FD FCS_FD

BO_ 1216 HU_MON_01_2000ms: 16 CGW_CCU
 SG_ HU_MON_Crc1Val : 0|16@1+ (1,0) [0|0] "" Vector__XXX
 SG_ HU_NaviHandshakingSupport : 118|2@1+ (1,0) [0|0] "" Vector__XXX
 SG_ HU_AMP_EQVariant : 120|5@1+ (1,0) [0|0] "" Vector__XXX
 SG_ HU_AdasSupport : 125|3@1+ (1,0) [0|0] "" Vector__XXX
 SG_ HU_MON_AlvCnt1Val : 16|8@1+ (1,0) [0|0] "" Vector__XXX
 SG_ HU_Type : 64|8@1+ (1,0) [0|0] ""  BLTN_CAM_FD
 SG_ HU_Navi_RspADASMapMsg : 72|16@1+ (1,0) [0|0] "" Vector__XXX
 SG_ HU_DistributeInfo : 88|8@1+ (1,0) [0|0] ""  BLTN_CAM_FD
 SG_ HU_OptionInfo : 96|16@1+ (1,0) [0|0] ""  BLTN_CAM_FD,RCM_FD,WPC2_FD

BO_ 955 BLTN_CAM_FD_HU_01_200ms: 16 BLTN_CAM_FD
 SG_ BLTN_CAM_FD_HU_Crc1Val : 0|16@1+ (1,0) [0|0] "" Vector__XXX
 SG_ BLTN_CAM_DEV_Count : 100|8@1+ (1,0) [0|0] ""  CGW_CCU
 SG_ BLTN_CAM_FD_HU_AlvCnt1Val : 16|8@1+ (1,0) [0|0] "" Vector__XXX
 SG_ BLTN_CAM_PMD_Count : 24|8@1+ (1,0) [0|0] ""  CGW_CCU
 SG_ BLTN_CAM_HU_UI_Mode : 64|4@1+ (1,0) [0|0] ""  CGW_CCU
 SG_ BLTN_CAM_Display : 68|4@1+ (1,0) [0|0] ""  CGW_CCU
 SG_ BLTN_CAM_WiFi_State : 72|4@1+ (1,0) [0|0] ""  CGW_CCU
 SG_ BLTN_CAM_SD_Format_Op_State : 76|2@1+ (1,0) [0|0] ""  CGW_CCU
 SG_ BLTN_CAM_PEV_Recorded : 78|2@1+ (1,0) [0|0] ""  CGW_CCU
 SG_ BLTN_CAM_PEV_Count : 80|8@1+ (1,0) [0|0] ""  CGW_CCU
 SG_ BLTN_CAM_Ind_Req : 88|5@1+ (1,0) [0|0] ""  CGW_CCU
 SG_ BLTN_CAM_LVDS_Mode_State : 93|2@1+ (1,0) [0|0] ""  CGW_CCU
 SG_ BLTN_CAM_PrkOp_Termiate_Info : 95|3@1+ (1,0) [0|0] ""  CGW_CCU
 SG_ BLTN_CAM_DEV_Recorded : 98|2@1+ (1,0) [0|0] ""  CGW_CCU

BO_ 613 EMS_08_100ms: 32 CGW_CCU
 SG_ EMS_Crc8Val : 0|16@1+ (1,0) [0|0] "" Vector__XXX
 SG_ HEV_EstClntTempVal : 128|8@1+ (0.75,-48) [0|0] "℃" Vector__XXX
 SG_ HEV_AptVal : 136|8@1+ (2,0) [0|0] "PSI" Vector__XXX
 SG_ HEV_EstAmbtAirTempVal : 144|8@1+ (0.75,-48) [0|0] "℃" Vector__XXX
 SG_ HEV_RbmSta : 152|7@1+ (1,0) [0|0] "" Vector__XXX
 SG_ HEV_WarmUpReq_For_DATC : 159|1@1+ (1,0) [0|0] "" Vector__XXX
 SG_ EMS_AlvCnt8Val : 16|8@1+ (1,0) [0|0] "" Vector__XXX
 SG_ HEV_RbmInhbtSta : 160|2@1+ (1,0) [0|0] "" Vector__XXX
 SG_ HEV_EhrsTempSta : 162|2@1+ (1,0) [0|0] "" Vector__XXX
 SG_ HEV_Aaf_WrnLamp : 164|2@1+ (1,0) [0|0] "" Vector__XXX
 SG_ HEV_OPSFail : 166|2@1+ (1,0) [0|0] "" Vector__XXX
 SG_ HEV_EngDsplceTyp : 168|8@1+ (0.1,0) [0|0] "liter" Vector__XXX
 SG_ HEV_EngTyp2 : 176|4@1+ (1,0) [0|0] "" Vector__XXX
 SG_ HEV_EngTyp1 : 180|4@1+ (1,0) [0|0] "" Vector__XXX
 SG_ HEV_S_F : 184|2@1+ (1,0) [0|0] "" Vector__XXX
 SG_ HEV_S_F_GEN : 186|3@1+ (1,0) [0|0] "" Vector__XXX
 SG_ HEV_RbmSta_2nd : 192|7@1+ (1,0) [0|0] "" Vector__XXX
 SG_ HEV_RECTrigSta : 200|1@1+ (1,0) [0|0] "" Vector__XXX
 SG_ HEV_PendingTrigSta : 201|1@1+ (1,0) [0|0] "" Vector__XXX
 SG_ HEV_OilLifeRatio : 202|7@1+ (1,0) [0|0] "%" Vector__XXX
 SG_ HEV_OilLifeEna : 209|2@1+ (1,0) [0|0] "" Vector__XXX
 SG_ HEV_OilLifeWarn : 211|3@1+ (1,0) [0|0] "" Vector__XXX
 SG_ HEV_ExtSoakTimeVal : 214|6@1+ (5,0) [0|0] "" Vector__XXX
 SG_ HEV_EngClntTempVal : 24|8@1+ (0.75,-48) [0|0] "℃" Vector__XXX
 SG_ HEV_EngOilTempVal : 32|8@1+ (1,-40) [0|0] "℃" Vector__XXX
 SG_ HEV_VbOffActSta : 40|2@1+ (1,0) [0|0] "" Vector__XXX
 SG_ HEV_AirCompOffReq : 42|2@1+ (1,0) [0|0] "" Vector__XXX
 SG_ HEV_MilConfgVal : 44|3@1+ (1,0) [0|0] "" Vector__XXX
 SG_ HEV_CF_EMS_LOCKUP : 47|1@1+ (1,0) [0|0] "" Vector__XXX
 SG_ HEV_OilLvlSta : 48|2@1+ (1,0) [0|0] "" Vector__XXX
 SG_ HEV_ImmoLmpReq : 50|2@1+ (1,0) [0|0] "" Vector__XXX
 SG_ HEV_MilReq : 52|2@1+ (1,0) [0|0] "" Vector__XXX
 SG_ HEV_WiperSwSta : 54|2@1+ (1,0) [0|0] "" Vector__XXX
 SG_ HEV_FanOpSta : 56|2@1+ (1,0) [0|0] "" Vector__XXX
 SG_ HEV_FanSta : 58|2@1+ (1,0) [0|0] "" Vector__XXX
 SG_ HEV_BrkLtSwSta : 62|2@1+ (1,0) [0|0] ""  BLTN_CAM_FD
 SG_ HEV_IgnCycCntVal : 64|16@1+ (1,0) [0|0] "" Vector__XXX
 SG_ HEV_SoakTimeVal : 80|8@1+ (1,0) [0|0] "Min" Vector__XXX
 SG_ HEV_SoakTimeErrSta : 88|2@1+ (1,0) [0|0] "" Vector__XXX
 SG_ HEV_SoakTimeOvrSta : 90|2@1+ (1,0) [0|0] "" Vector__XXX
 SG_ HEV_FuelRunOutSta : 92|2@1+ (1,0) [0|0] "" Vector__XXX
 SG_ HEV_FuelRunOutDetSta : 94|2@1+ (1,0) [0|0] "" Vector__XXX
 SG_ HEV_FuelCnsmptSumVal : 96|32@1+ (0.0001280018,0) [0|0] "ml" Vector__XXX

BO_ 829 SBCM_RR_FD_01_200ms: 24 CGW_CCU
 SG_ SBCM_RR_FD_Crc1Val : 0|16@1+ (1,0) [0|0] "" Vector__XXX
 SG_ USM_RRGhostDoorSta : 100|2@1+ (1,0) [0|0] "" Vector__XXX
 SG_ DoorLock_PDSLkSwSta_RR : 104|2@1+ (1,0) [0|0] "" Vector__XXX
 SG_ PDS_TypeOption_RR : 106|2@1+ (1,0) [0|0] "" Vector__XXX
 SG_ RR_CrashMRActAlarm : 138|2@1+ (1,0) [0|0] "" Vector__XXX
 SG_ PwrDRBuzzerOut_RR : 140|2@1+ (1,0) [0|0] "" Vector__XXX
 SG_ PwrDRClosingRRDrSta : 144|3@1+ (1,0) [0|0] ""  ATS_FD
 SG_ AFH_RR_FldUnfldSta : 150|2@1+ (1,0) [0|0] "" Vector__XXX
 SG_ SBCM_RR_FD_AlvCnt1Val : 16|8@1+ (1,0) [0|0] "" Vector__XXX
 SG_ DoorLock_RrRtLkOutSta_SBCM : 166|2@1+ (1,0) [0|0] "" Vector__XXX
 SG_ RrRt_DrLkRetryFail_SBCM : 171|2@1+ (1,0) [0|0] "" Vector__XXX
 SG_ RR_DetectObj_warn : 24|2@1+ (1,0) [0|0] ""  ATS_FD
 SG_ RRRrDrCurtainPosition : 26|2@1+ (1,0) [0|0] ""  ATS_FD
 SG_ RRRrDrCurtainDownInitState : 28|2@1+ (1,0) [0|0] "" Vector__XXX
 SG_ PwrDrSta_RrRt : 30|2@1+ (1,0) [0|0] "" Vector__XXX
 SG_ PwrDRBuzzerOut_RR_New : 32|3@1+ (1,0) [0|0] "" Vector__XXX
 SG_ SBCM_RR_SlidePosition : 40|8@1+ (1,0) [0|0] "%" Vector__XXX
 SG_ SBCM_RR_DoorAngle : 48|7@1+ (1,0) [0|0] "˚" Vector__XXX
 SG_ RRDoorPushAlarm : 72|2@1+ (1,0) [0|0] "" Vector__XXX
 SG_ RR_CrashUnlockCmd : 74|1@1+ (1,0) [0|0] ""  BLTN_CAM_FD
 SG_ Warn_RrRtDrSwSta_SBCM : 80|2@1+ (1,0) [0|0] ""  ATS_FD,BLTN_CAM_FD,GW_PSU_AST_FD,GW_PSU_RR_FD,RWPC_FD,WPC2_FD,WPC_FD
 SG_ DoorLock_RrRtDrUnLkSta_SBCM : 82|2@1+ (1,0) [0|0] ""  ATS_FD
 SG_ RR_SEAActivated : 84|2@1+ (1,0) [0|0] "" Vector__XXX
 SG_ RR_SEAWarn : 86|2@1+ (1,0) [0|0] "" Vector__XXX
 SG_ RR_SEWWarn : 88|2@1+ (1,0) [0|0] "" Vector__XXX
 SG_ RR_ReleaseWarn : 90|2@1+ (1,0) [0|0] "" Vector__XXX
 SG_ RR_SWFailAlarm : 92|2@1+ (1,0) [0|0] "" Vector__XXX
 SG_ RR_ChildLock_ActnFlSta : 94|2@1+ (1,0) [0|0] "" Vector__XXX
 SG_ RR_MRActivationAlarm : 96|2@1+ (1,0) [0|0] "" Vector__XXX
 SG_ RR_ChildLock_Status : 98|2@1+ (1,0) [0|0] "" Vector__XXX

BO_ 1026 BDC_FD_SMK_03_200ms: 32 CGW_CCU
 SG_ BDC_FD_SMK_Crc3Val : 0|16@1+ (1,0) [0|0] "" Vector__XXX
 SG_ SMK_TrmnlCtrlStaBDCEV : 104|5@1+ (1,0) [0|0] ""  BLTN_CAM_FD
 SG_ SMK_PwrOnModeSta : 109|2@1+ (1,0) [0|0] "" Vector__XXX
 SG_ SMK_StndbyMdTmrMin : 112|6@1+ (1,0) [0|0] "" Vector__XXX
 SG_ SMK_PwrTransitionReq : 118|2@1+ (1,0) [0|0] "" Vector__XXX
 SG_ SMK_StndbyMdTmrSec : 120|6@1+ (1,0) [0|0] "" Vector__XXX
 SG_ SMK_VhclSlpSta : 126|2@1+ (1,0) [0|0] "" Vector__XXX
 SG_ USM_SmrtSldngModSta : 128|3@1+ (1,0) [0|0] "" Vector__XXX
 SG_ SMK_EVPwrOffReq : 131|2@1+ (1,0) [0|0] "" Vector__XXX
 SG_ SMK_MaintenanceSrvMdReq : 133|2@1+ (1,0) [0|0] "" Vector__XXX
 SG_ Warn_DisWrngSta3 : 135|5@1+ (1,0) [0|0] "" Vector__XXX
 SG_ BDC_FD_SMK_AlvCnt3Val : 16|8@1+ (1,0) [0|0] "" Vector__XXX
 SG_ ESCL_EsclMngrSta : 24|4@1+ (1,0) [0|0] "" Vector__XXX
 SG_ ESCL_EsclPwrSupSta : 28|2@1+ (1,0) [0|0] "" Vector__XXX
 SG_ Fob_FoundExtrnlIntArea : 30|2@1+ (1,0) [0|0] "" Vector__XXX
 SG_ ESCL_EsclEnaSta : 32|2@1+ (1,0) [0|0] "" Vector__XXX
 SG_ ESCL_EsclUnitSta : 34|3@1+ (1,0) [0|0] "" Vector__XXX
 SG_ ESCL_EsclBoltSta : 37|3@1+ (1,0) [0|0] "" Vector__XXX
 SG_ ESCL_EsclLoBattSta : 40|3@1+ (1,0) [0|0] "" Vector__XXX
 SG_ ESCL_EsclUnLkSwSta : 43|3@1+ (1,0) [0|0] "" Vector__XXX
 SG_ Fob_FoundRrLftArea : 46|2@1+ (1,0) [0|0] "" Vector__XXX
 SG_ Fob_FoundRrRtArea : 48|2@1+ (1,0) [0|0] "" Vector__XXX
 SG_ Warn_StrtStpBtnWrngSta : 50|2@1+ (1,0) [0|0] "" Vector__XXX
 SG_ Warn_DeActvWrngSta : 52|2@1+ (1,0) [0|0] "" Vector__XXX
 SG_ Warn_GearPosPWrngReq : 54|2@1+ (1,0) [0|0] "" Vector__XXX
 SG_ Warn_ExtrnlBuzWrngSta : 56|4@1+ (1,0) [0|0] "" Vector__XXX
 SG_ Warn_IdOutWrngSta : 60|2@1+ (1,0) [0|0] "" Vector__XXX
 SG_ Warn_KeyBattLoWrngSta : 62|2@1+ (1,0) [0|0] "" Vector__XXX
 SG_ Warn_KeyOutLmpOnReq : 64|2@1+ (1,0) [0|0] "" Vector__XXX
 SG_ Warn_NotGearPosPWrngSta : 66|2@1+ (1,0) [0|0] "" Vector__XXX
 SG_ Warn_EsclFlWrngSta : 68|2@1+ (1,0) [0|0] "" Vector__XXX
 SG_ Warn_EsclNotLkWrngSta : 70|2@1+ (1,0) [0|0] "" Vector__XXX
 SG_ Warn_EsclNotUnLkWrngSta : 72|2@1+ (1,0) [0|0] "" Vector__XXX
 SG_ Warn_ImmoLmpOnReq : 74|2@1+ (1,0) [0|0] "" Vector__XXX
 SG_ Warn_DisWrngSta2 : 76|4@1+ (1,0) [0|0] "" Vector__XXX
 SG_ Warn_DisWrngSta : 80|5@1+ (1,0) [0|0] "" Vector__XXX
 SG_ SMK_OTACrankInhState : 85|3@1+ (1,0) [0|0] "" Vector__XXX
 SG_ SMK_TgltAwaySrchResult : 88|2@1+ (1,0) [0|0] "" Vector__XXX
 SG_ SMKFOBID_CHNAVNT : 90|3@1+ (1,0) [0|0] "" Vector__XXX
 SG_ SMK_TrmnlCtrlGrpStaBDC : 93|3@1+ (1,0) [0|0] ""  BLTN_CAM_FD
 SG_ SMK_TrmnlCtrlGrpStaBDCEV : 96|3@1+ (1,0) [0|0] ""  BLTN_CAM_FD
 SG_ SMK_TrmnlCtrlStaBDC : 99|5@1+ (1,0) [0|0] "" Vector__XXX

BO_ 830 SBCM_RL_FD_01_200ms: 24 CGW_CCU
 SG_ SBCM_RL_FD_Crc1Val : 0|16@1+ (1,0) [0|0] "" Vector__XXX
 SG_ USM_RLGhostDoorSta : 100|2@1+ (1,0) [0|0] "" Vector__XXX
 SG_ DoorLock_PDSLkSwSta_RL : 104|2@1+ (1,0) [0|0] "" Vector__XXX
 SG_ PDS_TypeOption_RL : 106|2@1+ (1,0) [0|0] "" Vector__XXX
 SG_ RL_CrashMRActAlarm : 138|2@1+ (1,0) [0|0] "" Vector__XXX
 SG_ PwrDRBuzzerOut_RL : 140|2@1+ (1,0) [0|0] "" Vector__XXX
 SG_ PwrDRClosingRLDrSta : 144|3@1+ (1,0) [0|0] ""  ATS_FD
 SG_ AFH_RL_FldUnfldSta : 150|2@1+ (1,0) [0|0] "" Vector__XXX
 SG_ SBCM_RL_FD_AlvCnt1Val : 16|8@1+ (1,0) [0|0] "" Vector__XXX
 SG_ DoorLock_RrLtLkOutSta_SBCM : 166|2@1+ (1,0) [0|0] "" Vector__XXX
 SG_ RrLt_DrLkRetryFail_SBCM : 171|2@1+ (1,0) [0|0] "" Vector__XXX
 SG_ RL_DetectObj_warn : 24|2@1+ (1,0) [0|0] ""  ATS_FD
 SG_ RLRrDrCurtainPosition : 26|2@1+ (1,0) [0|0] ""  ATS_FD
 SG_ RDC_TypeOption : 28|2@1+ (1,0) [0|0] ""  ATS_FD
 SG_ RLRrDrCurtainDownInitState : 30|2@1+ (1,0) [0|0] "" Vector__XXX
 SG_ PwrDRBuzzerOut_RL_New : 32|3@1+ (1,0) [0|0] "" Vector__XXX
 SG_ PwrDrSta_RrLt : 38|2@1+ (1,0) [0|0] "" Vector__XXX
 SG_ SBCM_RL_SlidePosition : 40|8@1+ (1,0) [0|0] "%" Vector__XXX
 SG_ SBCM_RL_DoorAngle : 48|7@1+ (1,0) [0|0] "˚" Vector__XXX
 SG_ RLDoorPushAlarm : 72|2@1+ (1,0) [0|0] "" Vector__XXX
 SG_ RL_CrashUnlockCmd : 74|1@1+ (1,0) [0|0] ""  BLTN_CAM_FD
 SG_ Warn_RrLftDrSwSta_SBCM : 80|2@1+ (1,0) [0|0] ""  ATS_FD,BLTN_CAM_FD,GW_PSU_AST_FD,RWPC_FD,WPC2_FD,WPC_FD
 SG_ DoorLock_RrLftDrUnLkSta_SBCM : 82|2@1+ (1,0) [0|0] ""  ATS_FD
 SG_ RL_SEAActivated : 84|2@1+ (1,0) [0|0] "" Vector__XXX
 SG_ RL_SEAWarn : 86|2@1+ (1,0) [0|0] "" Vector__XXX
 SG_ RL_SEWWarn : 88|2@1+ (1,0) [0|0] "" Vector__XXX
 SG_ RL_ReleaseWarn : 90|2@1+ (1,0) [0|0] "" Vector__XXX
 SG_ RL_SWFailAlarm : 92|2@1+ (1,0) [0|0] "" Vector__XXX
 SG_ RL_ChildLock_ActnFlSta : 94|2@1+ (1,0) [0|0] "" Vector__XXX
 SG_ RL_MRActivationAlarm : 96|2@1+ (1,0) [0|0] "" Vector__XXX
 SG_ RL_ChildLock_Status : 98|2@1+ (1,0) [0|0] "" Vector__XXX

BO_ 193 BLTN_CAM_FD_01_00ms: 16 BLTN_CAM_FD
 SG_ BLTN_CAM_FD_Crc1Val : 0|16@1+ (1,0) [0|0] "" Vector__XXX
 SG_ BLTN_CAM_FD_AlvCnt1Val : 16|8@1+ (1,0) [0|0] "" Vector__XXX
 SG_ BLTN_CAM_UI_Mode_Tmt_Req : 64|2@1+ (1,0) [0|0] ""  CGW_CCU
 SG_ BLTN_CAM_PopUp_Req : 66|4@1+ (1,0) [0|0] ""  CGW_CCU
 SG_ BLTN_CAM_File_List_Renew : 70|2@1+ (1,0) [0|0] ""  CGW_CCU
 SG_ BLTN_CAM_Wifi_Pwd_Chg_State : 72|2@1+ (1,0) [0|0] ""  CGW_CCU
 SG_ BLTN_CAM_Dis_Touch_BeepSound : 74|2@1+ (1,0) [0|0] ""  CGW_CCU

BO_ 194 BMS_FD_01_00ms: 16 CGW_CCU
 SG_ BMS_FD_Crc1Val : 0|16@1+ (1,0) [0|0] "" Vector__XXX
 SG_ BMS_FD_AlvCnt1Val : 16|8@1+ (1,0) [0|0] "" Vector__XXX
 SG_ xEV_BatEvtAlarm_HS : 64|3@1+ (1,0) [0|0] "" Vector__XXX
 SG_ xEV_BMS_WakeUpReqfor12V : 67|2@1+ (1,0) [0|0] "" Vector__XXX
 SG_ xEV_AuxBattChrgReq_HS : 69|2@1+ (1,0) [0|0] ""  BLTN_CAM_FD
 SG_ xEV_12VBatAlarmReq_HS : 72|2@1+ (1,0) [0|0] ""  BLTN_CAM_FD

BO_ 1048 GNSS_06_1000ms: 32 CGW_CCU
 SG_ GNSS_Crc6Val : 0|16@1+ (1,0) [0|0] "" Vector__XXX
 SG_ HU_MM_Altitude : 128|32@1- (0.01,0) [0|0] "m"  BLTN_CAM_FD
 SG_ GNSS_AlvCnt6Val : 16|8@1+ (1,0) [0|0] "" Vector__XXX
 SG_ HU_MM_Heading : 160|32@1+ (1,0) [0|0] "˚"  BLTN_CAM_FD
 SG_ GNSS_MM_type : 192|4@1+ (1,0) [0|0] ""  BLTN_CAM_FD
 SG_ HU_MM_Latitude : 64|32@1- (1E-006,0) [0|0] "˚"  BLTN_CAM_FD
 SG_ HU_MM_Longitude : 96|32@1- (1E-006,0) [0|0] "˚"  BLTN_CAM_FD

BO_ 256 EMS_02_10ms: 32 CGW_CCU
 SG_ EMS_Crc2Val : 0|16@1+ (1,0) [0|0] "" Vector__XXX
 SG_ ACC_CrsMainSwLmpSta : 104|2@1+ (1,0) [0|0] "" Vector__XXX
 SG_ ACC_CrsSetSwLmpSta : 106|2@1+ (1,0) [0|0] "" Vector__XXX
 SG_ ENG_LV_FUP_ENA_THD : 109|1@1+ (1,0) [0|0] "" Vector__XXX
 SG_ ENG_SoakTimeErrSta : 110|2@1+ (1,0) [0|0] "" Vector__XXX
 SG_ ENG_SoakTimeVal : 112|8@1+ (1,0) [0|0] "Min" Vector__XXX
 SG_ ENG_SprkTimeVal : 120|8@1+ (0.375,-35.625) [0|0] "˚" Vector__XXX
 SG_ ENG_MinIndTqVal : 128|12@1- (1,0) [0|0] "Nm" Vector__XXX
 SG_ ENG_TrgtTqVal : 144|12@1- (1,0) [0|0] "Nm" Vector__XXX
 SG_ EMS_AlvCnt2Val : 16|8@1+ (1,0) [0|0] "" Vector__XXX
 SG_ ENG_MaxIndTqVal : 160|12@1- (1,0) [0|0] "Nm" Vector__XXX
 SG_ ENG_AppAccelPdlSta : 176|2@1+ (1,0) [0|0] "" Vector__XXX
 SG_ ENG_BrkCtrlReq : 178|2@1+ (1,0) [0|0] "" Vector__XXX
 SG_ ACC_DnShftCtrlReq : 180|4@1+ (1,0) [0|0] "" Vector__XXX
 SG_ ENG_DclBrkCntrlReq : 192|12@1+ (0.001,-4.094) [0|0] "m/s^2" Vector__XXX
 SG_ ENG_BstPrsrVal : 204|12@1+ (1.322,0) [0|0] "hPa" Vector__XXX
 SG_ ENG_EngOilTempVal : 216|8@1+ (0.75,-40) [0|0] "℃" Vector__XXX
 SG_ ENG_AmbtTempModelVal : 224|8@1+ (0.5,-41) [0|0] "℃" Vector__XXX
 SG_ ENG_DpfWrngSta : 232|2@1+ (1,0) [0|0] "" Vector__XXX
 SG_ ENG_BattWrngLmpSta : 234|2@1+ (1,0) [0|0] "" Vector__XXX
 SG_ ENG_OilPrsrWrngLmpSta : 236|2@1+ (1,0) [0|0] "" Vector__XXX
 SG_ ENG_IsgInhbtLmpSta : 238|2@1+ (1,0) [0|0] ""  FCS_FD
 SG_ ENG_BrkSwSta : 32|2@1+ (1,0) [0|0] ""  BLTN_CAM_FD
 SG_ ENG_ObdFrzFrmSta : 34|6@1+ (1,0) [0|0] "" Vector__XXX
 SG_ ENG_EngClntTempVal : 40|8@1+ (0.75,-48) [0|0] "℃" Vector__XXX
 SG_ ENG_MafCrctVal : 48|8@1+ (0.00781,0) [0|0] "" Vector__XXX
 SG_ ENG_BattDscnctSta : 56|2@1+ (1,0) [0|0] "" Vector__XXX
 SG_ OBD_MilConfgVal : 58|3@1+ (1,0) [0|0] "" Vector__XXX
 SG_ ENG_EngSta : 61|3@1+ (1,0) [0|0] ""  BLTN_CAM_FD,GW_PSU_3RD_FD,GW_PSU_AST_FD,GW_PSU_DRV_FD,GW_PSU_RL_FD,GW_PSU_RR_FD,GW_SAU_DRV_FD,PSB_FD,RCM_FD,RWPC_FD,SCM_FD,SHVU_3RD_FD,SHVU_FRNT_FD,SHVU_REAR_FD,SHVU_RL_FD,SHVU_RR_FD,WPC2_FD,WPC_FD
 SG_ ENG_Ack4EngStpSta : 64|2@1+ (1,0) [0|0] "" Vector__XXX
 SG_ ENG_OverDrvOffReq : 66|2@1+ (1,0) [0|0] "" Vector__XXX
 SG_ ENG_AccActSta : 68|2@1+ (1,0) [0|0] "" Vector__XXX
 SG_ ENG_CltchOpSta : 70|2@1+ (1,0) [0|0] "" Vector__XXX
 SG_ EMS_BrkReq_Slope : 72|1@1+ (1,0) [0|0] "" Vector__XXX
 SG_ ENG_AccDrvAlertDisp : 74|2@1+ (1,0) [0|0] "" Vector__XXX
 SG_ DSL_GlowCtrlReq : 76|2@1+ (1,0) [0|0] "" Vector__XXX
 SG_ ENG_GlowLmpSta : 78|2@1+ (1,0) [0|0] "" Vector__XXX
 SG_ ENG_ThrPosVal : 80|8@1+ (0.4694836,-15.0234742) [0|0] "%" Vector__XXX
 SG_ ENG_AccelPdlVal : 88|10@1+ (0.09784,0) [0|0] "%"  BLTN_CAM_FD

BO_ 1051 HU_CLOCK_01_1000ms: 16 CGW_CCU
 SG_ HU_CLOCK_Crc1Val : 0|16@1+ (1,0) [0|0] "" Vector__XXX
 SG_ HU_DisplayYear1 : 102|2@1+ (1,0) [0|0] ""  ATS_FD,BLTN_CAM_FD
 SG_ HU_DisplayYear2 : 104|8@1+ (1,0) [0|0] ""  ATS_FD,BLTN_CAM_FD
 SG_ HU_DisplayDay : 112|8@1+ (1,0) [0|0] ""  ATS_FD,BLTN_CAM_FD
 SG_ HU_AM_PM_INFO : 120|2@1+ (1,0) [0|0] ""  ATS_FD,BLTN_CAM_FD
 SG_ HU_ComRefresh : 124|2@1+ (1,0) [0|0] ""  ATS_FD,BLTN_CAM_FD
 SG_ HU_ClockInfo : 126|2@1+ (1,0) [0|0] ""  ATS_FD,BLTN_CAM_FD
 SG_ HU_CLOCK_AlvCnt1Val : 16|8@1+ (1,0) [0|0] "" Vector__XXX
 SG_ HU_TimeSetting : 64|2@1+ (1,0) [0|0] ""  ATS_FD,BLTN_CAM_FD
 SG_ HU_Status : 66|4@1+ (1,0) [0|0] ""  ATS_FD,BLTN_CAM_FD
 SG_ HU_TimeFormat : 70|2@1+ (1,0) [0|0] ""  ATS_FD,BLTN_CAM_FD
 SG_ HU_DisplayHour : 72|8@1+ (1,0) [0|0] ""  ATS_FD,BLTN_CAM_FD
 SG_ HU_DisplayMinute : 80|8@1+ (1,0) [0|0] ""  ATS_FD,BLTN_CAM_FD
 SG_ HU_DisplaySecond : 88|8@1+ (1,0) [0|0] ""  ATS_FD,BLTN_CAM_FD
 SG_ HU_DisplayMonth : 98|4@1+ (1,0) [0|0] ""  ATS_FD,BLTN_CAM_FD

BO_ 1052 HU_CLU_02_1000ms: 16 CGW_CCU
 SG_ HU_CLU_Crc2Val : 0|16@1+ (1,0) [0|0] "" Vector__XXX
 SG_ HU_EVSupport : 104|2@1+ (1,0) [0|0] "" Vector__XXX
 SG_ HU_DayNightState : 108|2@1+ (1,0) [0|0] "" Vector__XXX
 SG_ HU_AutoBrightState_New : 118|10@1+ (1,0) [0|0] "" Vector__XXX
 SG_ HU_CLU_AlvCnt2Val : 16|8@1+ (1,0) [0|0] "" Vector__XXX
 SG_ HU_LanguageInfo : 64|8@1+ (1,0) [0|0] ""  ATS_FD,BLTN_CAM_FD
 SG_ HU_VolumeStatus : 72|6@1+ (1,0) [0|0] "" Vector__XXX
 SG_ HU_MuteStatus : 78|2@1+ (1,0) [0|0] "" Vector__XXX
 SG_ HU_WelcomeReady : 80|2@1+ (1,0) [0|0] "" Vector__XXX
 SG_ HU_UsmSupport : 82|2@1+ (1,0) [0|0] "" Vector__XXX
 SG_ HU_NaviStatus : 84|2@1+ (1,0) [0|0] "" Vector__XXX
 SG_ HU_NaviDisp : 86|2@1+ (1,0) [0|0] "" Vector__XXX
 SG_ HU_BVM_Display_Message : 88|3@1+ (1,0) [0|0] "" Vector__XXX
 SG_ HU_NaviCamSettingStatus : 96|8@1+ (1,0) [0|0] "" Vector__XXX

CM_ BO_ 1216 "[PE] Periodic and On Event";
CM_ SG_ 1216 HU_MON_Crc1Val "HU_MON_CyclicRedundancyCheck1Value";
CM_ SG_ 1216 HU_NaviHandshakingSupport "This is a signal to send whether handshaking logic is applied related to Navigation's 'Map based ADAS' specification";
CM_ SG_ 1216 HU_AMP_EQVariant "Set EQ Variant for various vehicle cases.
During the AMP initializing process, This signal should be sent before AMP unmute.
This signal is only needed for models that have variant EQ for vehicle types. (Hatchback, Wagon, Hybrid etc..)
Models that doesn’t have variant EQ for vehicle types shouldn’t have this signal.";
CM_ SG_ 1216 HU_AdasSupport "Information about ADAS support
-Classify between General Map and Precise Map Transmission Function
-AVN System Transmission Signal";
CM_ SG_ 1216 HU_MON_AlvCnt1Val "HU_MON_AliveCounter1Value";
CM_ SG_ 1216 HU_Type "Information for H/U Platform type
- Integrated AVN 1.0 use different value depends on development company (Mobis:0x68/LG:0x70)
- Integrated AVN 1.0 Mobis is developed based on Display Audio
- Integrated AVN 1.0 LG is developed based on Compact AVN

Information for China OPIO Platform
- 0xFC: China OPIO w/o CLU interface (most of phase1)
- 0xFD: China OPIO w/CLU interface (parts of phase1, phase2)

Information for Audio Platform Type
- 0x43 : Audio 4.0 Value";
CM_ SG_ 1216 HU_Navi_RspADASMapMsg "HU_ResponseADASMapMessage";
CM_ SG_ 1216 HU_DistributeInfo "Region :Europe/North America/
Vehicle Type : RHD/LHD
Positionning information";
CM_ SG_ 1216 HU_OptionInfo "Information of H/U functions";
CM_ BO_ 955 "[PE] Periodic and On Event";
CM_ SG_ 955 BLTN_CAM_FD_HU_Crc1Val "BLTN_CAM_FD_HU_CyclicRedundancyCheck1Value";
CM_ SG_ 955 BLTN_CAM_DEV_Count "This Signal is count of drive event record.";
CM_ SG_ 955 BLTN_CAM_FD_HU_AlvCnt1Val "BLTN_CAM_FD_HU_AliveCounter1Value";
CM_ SG_ 955 BLTN_CAM_PMD_Count "This Signal is count of park motion detetion.";
CM_ SG_ 955 BLTN_CAM_HU_UI_Mode "Display control of Built-in Cam UI mode. This Signal for Ethernet Type Built-in Cam.";
CM_ SG_ 955 BLTN_CAM_Display "Display control of Built-in Cam UI mode. This Signal for CAN Type Built-in Cam.(with Standard 5th Wide AVNT)";
CM_ SG_ 955 BLTN_CAM_WiFi_State "BLTN_CAM WiFi Stattus";
CM_ SG_ 955 BLTN_CAM_SD_Format_Op_State "BLTN_CAM SD card format operation status.";
CM_ SG_ 955 BLTN_CAM_PEV_Recorded "This Signal is sent just after the park event recorded.";
CM_ SG_ 955 BLTN_CAM_PEV_Count "This Signal is count of park event record.";
CM_ SG_ 955 BLTN_CAM_Ind_Req "This Signal is for HU Display Built-in Cam Indicator.";
CM_ SG_ 955 BLTN_CAM_LVDS_Mode_State "This Signal is for LVDS output status";
CM_ SG_ 955 BLTN_CAM_PrkOp_Termiate_Info "0x0:Default/0x01: Park operation terminated earlier than user set because of Bat. SoC/0x2 : Park operation terminated earlier than user set because of SD Card Problem /0x3 : Park operation terminated earlier than user set because of Built-in Cam internal Error /0x04~0x6:Reserved/0x07 : Park operation terminate on time which user se";
CM_ SG_ 955 BLTN_CAM_DEV_Recorded "This Signal is sent just after the drive event recorded.";
CM_ BO_ 613 "[P] Periodic";
CM_ SG_ 613 EMS_Crc8Val "EMS_CyclicRedundancyCheck8Value";
CM_ SG_ 613 HEV_EstClntTempVal "HEV_EstimatedCoolantTemperatureValue";
CM_ SG_ 613 HEV_AptVal "HEV_AptValue";
CM_ SG_ 613 HEV_EstAmbtAirTempVal "HEV_EstimatedAmbientAirTemperatureValue";
CM_ SG_ 613 HEV_RbmSta "HEV_RateBasedMonitoringStatus";
CM_ SG_ 613 HEV_WarmUpReq_For_DATC "HEV_WarmUpRequest";
CM_ SG_ 613 EMS_AlvCnt8Val "EMS_AliveCounter8Value";
CM_ SG_ 613 HEV_RbmInhbtSta "HEV_RbmInhibitionStatus";
CM_ SG_ 613 HEV_EhrsTempSta "HEV_EhrsTemperatureStatus";
CM_ SG_ 613 HEV_Aaf_WrnLamp "Air Flap Warning Lamp/Message Request Signal indicates whether Warning Lamp/Message should be displayed in the display screen in order to warn AAF System failure to customer.";
CM_ SG_ 613 HEV_OPSFail "Oil Pressure Warning Lamp Status";
CM_ SG_ 613 HEV_EngDsplceTyp "HEV_EngineDisplacementType ##2G##EMS - EMS12 - ENG_VOL";
CM_ SG_ 613 HEV_EngTyp2 "HEV_EngineType2 ##2G##EMS - EMS23 - ENG_TYPE";
CM_ SG_ 613 HEV_EngTyp1 "HEV_EngineType1 ##2G##EMS - EMS12 - ENG_CHR";
CM_ SG_ 613 HEV_S_F "AMS/ISG system type indicator";
CM_ SG_ 613 HEV_S_F_GEN "system generation type indicator";
CM_ SG_ 613 HEV_RbmSta_2nd "HEV_RateBasedMonitoringStatus";
CM_ SG_ 613 HEV_RECTrigSta "VCRM trigger bit by REC";
CM_ SG_ 613 HEV_PendingTrigSta "VCRM trigger bit by pending DTC";
CM_ SG_ 613 HEV_OilLifeRatio "Remaining engine oil life with % unit";
CM_ SG_ 613 HEV_OilLifeEna "Enabling information if engine oil life monitoring from EMS is applied or not";
CM_ SG_ 613 HEV_OilLifeWarn "Request to activate engine oil life warning";
CM_ SG_ 613 HEV_ExtSoakTimeVal "The additional Soak Time information extended from HEV_SoakTimeVal of EMS_08_100ms";
CM_ SG_ 613 HEV_EngClntTempVal "HEV_EngineCoolantTemperatureValue";
CM_ SG_ 613 HEV_EngOilTempVal "HEV_EngineOilTemperatureValue";
CM_ SG_ 613 HEV_VbOffActSta "HEV_VbOffActStatus";
CM_ SG_ 613 HEV_AirCompOffReq "HEV_AirCompressorOffRequest";
CM_ SG_ 613 HEV_MilConfgVal "HEV_MilConfigurationValue";
CM_ SG_ 613 HEV_CF_EMS_LOCKUP "Engine lock up mainentance request state";
CM_ SG_ 613 HEV_OilLvlSta "HEV_OilLevelStatus";
CM_ SG_ 613 HEV_ImmoLmpReq "HEV_ImmobilizerLampRequest";
CM_ SG_ 613 HEV_MilReq "HEV_MalfunctionIndicationLampRequest";
CM_ SG_ 613 HEV_WiperSwSta "HEV_WiperSwitchStatus";
CM_ SG_ 613 HEV_FanOpSta "HEV_CoolingFanOperatingStatus";
CM_ SG_ 613 HEV_FanSta "HEV_CoolingFanStatus";
CM_ SG_ 613 HEV_BrkLtSwSta "HEV_BrakeLightSwitchStatus";
CM_ SG_ 613 HEV_IgnCycCntVal "HEV_IgnitionCycleCounterValue";
CM_ SG_ 613 HEV_SoakTimeVal "HEV_SoakTimeValue";
CM_ SG_ 613 HEV_SoakTimeErrSta "HEV_SoakTimeErrorStatus";
CM_ SG_ 613 HEV_SoakTimeOvrSta "HEV_SoakTimeOverStatus";
CM_ SG_ 613 HEV_FuelRunOutSta "HEV_FuelRunOutStatus";
CM_ SG_ 613 HEV_FuelRunOutDetSta "HEV_FuelRunOutDetectStatus";
CM_ SG_ 613 HEV_FuelCnsmptSumVal "HEV_FuelConsumptionSumValue";
CM_ BO_ 829 "[PE] Periodic and On Event";
CM_ SG_ 829 SBCM_RR_FD_Crc1Val "SBCM_RR_FD_CyclicRedundancyCheck1Value";
CM_ SG_ 829 SBCM_RR_FD_AlvCnt1Val "SBCM_RR_FD_AliveCounter1Value";
CM_ SG_ 829 RR_CrashUnlockCmd "Rear Right Crash Unlock Command";
CM_ SG_ 829 Warn_RrRtDrSwSta_SBCM "Warn_RearRightDoorSwitchStatus ##2G## -  - C_RRDrSw,CF_Gway_RRDrSw,Warn_RrRtDrSwSta";
CM_ SG_ 829 DoorLock_RrRtDrUnLkSta_SBCM "DoorLock_RearRightDoorUnLockStatus ##2G## -  - C_RRUnlockState,DoorLock_RrRtDrUnLkSta";
CM_ SG_ 829 RR_SEAActivated "Rear Right SEA Activated";
CM_ SG_ 829 RR_SEAWarn "Rear Righr SEA Warning";
CM_ BO_ 1026 "[PE] Periodic and On Event";
CM_ SG_ 1026 BDC_FD_SMK_Crc3Val "BDC_FD_SMK_CyclicRedundancyCheck3Value";
CM_ SG_ 1026 SMK_TrmnlCtrlStaBDCEV "SMK_TerminalControlStatus";
CM_ SG_ 1026 SMK_PwrTransitionReq "SMK Power Transition Request";
CM_ SG_ 1026 SMK_VhclSlpSta "This Signal is used to calculate slope of the vehicle and to determine whether vehicle is in inclined condition or vehicle is in flat(inclination within the limits) condition for remote start operation (2nd CAN - C_VehicleSlopeState)";
CM_ SG_ 1026 SMK_EVPwrOffReq "EV Power Off Request";
CM_ SG_ 1026 SMK_MaintenanceSrvMdReq "Maintenance Service mode request from BDC to VCU";
CM_ SG_ 1026 Warn_DisWrngSta3 "SMK Warnng Display signal";
CM_ SG_ 1026 BDC_FD_SMK_AlvCnt3Val "BDC_FD_SMK_AliveCounter3Value";
CM_ SG_ 1026 ESCL_EsclMngrSta "ESCL_EsclManagerStatus ##2G##SMK - SMKmsg19 - C_EsclManagerState";
CM_ SG_ 1026 ESCL_EsclPwrSupSta "ESCL_EsclPowerSupplyStatus ##2G##SMK - SMKmsg19 - C_EsclPowerSupplystatus";
CM_ SG_ 1026 ESCL_EsclEnaSta "ESCL_EsclEnableStatus ##2G##SMK - SMKmsg19 - C_EsclEnableStatus";
CM_ SG_ 1026 ESCL_EsclUnitSta "ESCL_EsclUnitStatus ##2G##SMK - SMKmsg19 - C_EsclUnitStatus";
CM_ SG_ 1026 ESCL_EsclBoltSta "ESCL_EsclBoltStatus ##2G##SMK - SMKmsg19 - C_EsclBoltStatus";
CM_ SG_ 1026 ESCL_EsclLoBattSta "ESCL_EsclLowBatteryStatus ##2G##SMK - SMKmsg19 - C_EsclLowBat";
CM_ SG_ 1026 ESCL_EsclUnLkSwSta "ESCL_UnLockSwitchStatus ##2G##SMK - SMKmsg19 - C_EsclUnlock";
CM_ SG_ 1026 Warn_StrtStpBtnWrngSta "Warn_StartStopButtonWarningStatus ##2G##SMK - SMKmsg17 - C_SSBWarn";
CM_ SG_ 1026 Warn_DeActvWrngSta "Warn_DeActivationWarningStatus ##2G##SMK - SMKmsg17 - C_DeactivationWarn";
CM_ SG_ 1026 Warn_GearPosPWrngReq "Warn_GearPositionPWarningRequest ##2G##SMK - SMKmsg17 - C_ShiftPWarn";
CM_ SG_ 1026 Warn_ExtrnlBuzWrngSta "Warn_ExternalBuzzelWarningStatus ##2G##SMK - SMKmsg17 - C_SMKExtBuzWarn";
CM_ SG_ 1026 Warn_IdOutWrngSta "Warn_IdOutWarningStatus ##2G##SMK - SMKmsg17 - C_IDoutWarn";
CM_ SG_ 1026 Warn_KeyBattLoWrngSta "Warn_KeyBatteryLowWarningStatus ##2G##SMK - SMKmsg17 - C_KeyBATDischargeWarn";
CM_ SG_ 1026 Warn_KeyOutLmpOnReq "Warn_KeyOutLampOnRequest ##2G##SMK - SMKmsg17 - C_KeyoutLp";
CM_ SG_ 1026 Warn_NotGearPosPWrngSta "Warn_NotGearPositionPWarningStatus ##2G##SMK - SMKmsg17 - C_VehicleNotPWarn";
CM_ SG_ 1026 Warn_EsclFlWrngSta "Warn_EsclFailWarningStatus ##2G##SMK - SMKmsg17 - C_ESCLFailWarn";
CM_ SG_ 1026 Warn_EsclNotLkWrngSta "Warn_EsclNotLockWarningStatus ##2G##SMK - SMKmsg17 - C_ESCLNotLockedWarn";
CM_ SG_ 1026 Warn_EsclNotUnLkWrngSta "Warn_EsclNotUnLockWarningStatus ##2G##SMK - SMKmsg17 - C_ESCLNotUnlockWarn";
CM_ SG_ 1026 Warn_ImmoLmpOnReq "Warn_ImmobilizerLampOnRequest ##2G##SMK - SMKmsg17 - C_ImmoLp";
CM_ SG_ 1026 Warn_DisWrngSta2 "Request to SMK Display warning on CLU ##2G ## SMK - SMKmsg17 - C_SMKDispWarn2";
CM_ SG_ 1026 Warn_DisWrngSta "Warn_DisplayWarningStatus ##2G##SMK - SMKmsg17 - C_SMKDispWarn";
CM_ SG_ 1026 SMKFOBID_CHNAVNT "SMK FOB ID information for china AVNT personalization function##2G##SMK-SMKmsg17-C_SMKFobID_CHNAVNT";
CM_ SG_ 1026 SMK_TrmnlCtrlGrpStaBDC "SMK_TerminalControlStatus";
CM_ SG_ 1026 SMK_TrmnlCtrlGrpStaBDCEV "SMK_TerminalControlStatus";
CM_ SG_ 1026 SMK_TrmnlCtrlStaBDC "SMK_TerminalControlStatus";
CM_ BO_ 830 "[PE] Periodic and On Event";
CM_ SG_ 830 SBCM_RL_FD_Crc1Val "SBCM_RL_FD_CyclicRedundancyCheck1Value";
CM_ SG_ 830 SBCM_RL_FD_AlvCnt1Val "SBCM_RL_FD_AliveCounter1Value";
CM_ SG_ 830 RL_CrashUnlockCmd "Rear Lefr Crash Unlock Command";
CM_ SG_ 830 Warn_RrLftDrSwSta_SBCM "Warn_RearLeftDoorSwitchStatus ##2G## -  - C_RLDrSw,CF_Gway_RLDrSw,Warn_RrLftDrSwSta";
CM_ SG_ 830 DoorLock_RrLftDrUnLkSta_SBCM "DoorLock_RearLeftDoorUnLockStatus ##2G## -  - C_RLUnlockState,DoorLock_RrLftDrUnLkSta";
CM_ SG_ 830 RL_SEAActivated "RearLeftSEAActivated";
CM_ SG_ 830 RL_SEAWarn "Rear Left SEA Warning";
CM_ BO_ 193 "[EC] On Event and On Change";
CM_ SG_ 193 BLTN_CAM_FD_Crc1Val "BLTN_CAM_FD_CyclicRedundancyCheck1Value";
CM_ SG_ 193 BLTN_CAM_FD_AlvCnt1Val "BLTN_CAM_FD_AliveCounter1Value";
CM_ SG_ 193 BLTN_CAM_UI_Mode_Tmt_Req "Built-in Cam UI Mode terminate request.";
CM_ SG_ 193 BLTN_CAM_PopUp_Req "Built-in Cam Operating and SD Card related Popup Request on HU Display.";
CM_ SG_ 193 BLTN_CAM_File_List_Renew "The Storage information is renewed inform to HU.";
CM_ SG_ 193 BLTN_CAM_Wifi_Pwd_Chg_State "The Response, when HU change Wifi Passowrd via SOME/IP";
CM_ SG_ 193 BLTN_CAM_Dis_Touch_BeepSound "Display Touch Beep Sound of valid space touch.";
CM_ BO_ 194 "[EW] On Event and On Write";
CM_ SG_ 194 BMS_FD_Crc1Val "BMS_FD_CyclicRedundancyCheck1Value";
CM_ SG_ 194 BMS_FD_AlvCnt1Val "BMS_FD_AliveCounter1Value";
CM_ SG_ 194 xEV_BMS_WakeUpReqfor12V "BMS-PDC/ICU Wake Up, PLBM Discharge Reqest Signal for12V Li-thium Battery";
CM_ SG_ 194 xEV_AuxBattChrgReq_HS "(12V Lithium Battery) Aux. Battery Charge Request Flag (HS-CAN)";
CM_ SG_ 194 xEV_12VBatAlarmReq_HS "BMS-PDC/ICU 3rd Cut-off, Alarm Request for12V Li-thium Battery";
CM_ BO_ 1048 "[P] Periodic";
CM_ SG_ 1048 GNSS_Crc6Val "GNSS_CyclicRedundancyCheck6Value";
CM_ SG_ 1048 HU_MM_Altitude "Mapmatching Altitude";
CM_ SG_ 1048 GNSS_AlvCnt6Val "GNSS_AliveCounter6Value";
CM_ SG_ 1048 HU_MM_Heading "Map matching heading";
CM_ SG_ 1048 GNSS_MM_type "Map matching type info.";
CM_ SG_ 1048 HU_MM_Latitude "Map matching Latitude";
CM_ SG_ 1048 HU_MM_Longitude "Mapmatching Longitude";
CM_ BO_ 256 "[P] Periodic";
CM_ SG_ 256 EMS_Crc2Val "EMS_CyclicRedundancyCheck2Value";
CM_ SG_ 256 ACC_CrsMainSwLmpSta "ACC_CruiseMainSwLampStatus ##2G##EMS - EMS16 - CRUISE_LAMP_M";
CM_ SG_ 256 ACC_CrsSetSwLmpSta "ACC_CruiseSetSwLampStatus ##2G##EMS - EMS16 - CRUISE_LAMP_S";
CM_ SG_ 256 ENG_LV_FUP_ENA_THD "Fuel prsssure state ##2G##EMS - LPI11 - LV_FUP_ENA_THD";
CM_ SG_ 256 ENG_SoakTimeErrSta "ENG_SoakTimeErrorStatus ##2G##EMS - EMS16 - SOAK_TIME_ERROR";
CM_ SG_ 256 ENG_SoakTimeVal "ENG_SoakTimeValue ##2G##EMS - EMS16 - SOAK_TIME";
CM_ SG_ 256 ENG_SprkTimeVal "ENG_SparkTimeValue ##2G##EMS - EMS16 - SPK_TIME_CUR";
CM_ SG_ 256 ENG_MinIndTqVal "ENG_MinimumIndicatedTorqueValue ##2G##EMS - EMS16 - TQI_MIN";
CM_ SG_ 256 ENG_TrgtTqVal "ENG_TargetTorqueValue ##2G##EMS - EMS16 - TQI_TARGET";
CM_ SG_ 256 EMS_AlvCnt2Val "EMS_AliveCounter2Value";
CM_ SG_ 256 ENG_MaxIndTqVal "ENG_MaximumIndicatedTorqueValue ##2G##EMS - EMS16 - TQI_MAX";
CM_ SG_ 256 ENG_AppAccelPdlSta "ENG_AppliedAcceleratorPedalStatus ##2G##EMS - EMS16 - CF_Ems_AclAct";
CM_ SG_ 256 ENG_BrkCtrlReq "ENG_BrakeControlRequest ##2G##EMS - EMS19 - CF_Ems_BrkReq";
CM_ SG_ 256 ACC_DnShftCtrlReq "ACC_DownShiftControlRequest ##2G##EMS - EMS19 - CF_Ems_DnShftReq";
CM_ SG_ 256 ENG_DclBrkCntrlReq "ENG_DecelerationBrakeControlRequest ##2G##EMS - EMS19 - CF_Ems_DecelReq";
CM_ SG_ 256 ENG_BstPrsrVal "ENG_BoostPressureValue ##2G##EMS - EMS19 - CR_Ems_BstPre";
CM_ SG_ 256 ENG_EngOilTempVal "ENG_EngineOilTemperatureValue ##2G##EMS - EMS19 - CR_Ems_EngOilTemp";
CM_ SG_ 256 ENG_AmbtTempModelVal "ENG_AmbientTemperatureModelValue ##2G##EMS - EMS19 - CF_Ems_ModeledAmbTemp";
CM_ SG_ 256 ENG_DpfWrngSta "ENG_DpfWarningStatus ##2G##EMS - EMS19 - DPF_LAMP_STAT";
CM_ SG_ 256 ENG_BattWrngLmpSta "ENG_BatteryWarningLampStatus ##2G##EMS - EMS19 - BAT_LAMP_STAT";
CM_ SG_ 256 ENG_OilPrsrWrngLmpSta "ENG_OilPressureWarningLampStatus ##2G##EMS - EMS19 - CF_Ems_OPSFail";
CM_ SG_ 256 ENG_IsgInhbtLmpSta "ENG_IsgInhibitLampStatus ##2G##EMS - EMS19 - ISG_INHIBIT_LAMP_STAT";
CM_ SG_ 256 ENG_BrkSwSta "ENG_BrakeSwitchStatus ##2G##EMS - EMS12 - BRAKE_ACT";
CM_ SG_ 256 ENG_ObdFrzFrmSta "ENG_ObdFreezeFrameStatus ##2G##EMS - EMS12 - OBD_FRF_ACK";
CM_ SG_ 256 ENG_EngClntTempVal "ENG_EngineCoolantTemperatureValue ##2G##EMS - EMS12 - TEMP_ENG";
CM_ SG_ 256 ENG_MafCrctVal "ENG_MassAirFlowCorrectionValue ##2G##EMS - EMS12 - MAF_FAC_ALTI_MMV";
CM_ SG_ 256 ENG_BattDscnctSta "ENG_BatteryDisconnectStatus ##2G##EMS - EMS12 - VB_OFF_ACT";
CM_ SG_ 256 OBD_MilConfgVal "OBD_MalfunctionIndicationLampConfigurationValue ##2G##EMS - EMS12 - CONF_MIL_FMY";
CM_ SG_ 256 ENG_EngSta "ENG_EngineStatus ##2G##EMS - EMS16 - ENG_STAT";
CM_ SG_ 256 ENG_Ack4EngStpSta "ENG_AcknowledgeForEngineStopStatus ##2G##EMS - EMS12 - ACK_ES";
CM_ SG_ 256 ENG_OverDrvOffReq "ENG_OverDriveOffRequest ##2G##EMS - EMS12 - OD_OFF_REQ";
CM_ SG_ 256 ENG_AccActSta "ENG_AutoCruiseControlActiveStatus ##2G##EMS - EMS12 - ACC_ACT";
CM_ SG_ 256 ENG_CltchOpSta "ENG_ClutchStatus ##2G##EMS - EMS12 - CLU_ACK";
CM_ SG_ 256 EMS_BrkReq_Slope "Brake request at slope for anti-stall";
CM_ SG_ 256 ENG_AccDrvAlertDisp "The status of No Auto cruise Engaged or Auto cruise Disengaged.";
CM_ SG_ 256 DSL_GlowCtrlReq "DSL_GlowControlRequest ##2G##EMS - EMS12 - GP_CTL";
CM_ SG_ 256 ENG_GlowLmpSta "ENG_GlowLampStatus ##2G##EMS - EMS16 - GLOW_STAT";
CM_ SG_ 256 ENG_ThrPosVal "ENG_ThrottlePositionValue ##2G##EMS - EMS12 - TPS";
CM_ SG_ 256 ENG_AccelPdlVal "ENG_AcceleratorPedalValue ##2G##EMS - EMS12 - PV_AV_CAN";
CM_ BO_ 1051 "[PE] Periodic and On Event";
CM_ SG_ 1051 HU_CLOCK_Crc1Val "HU_CLOCK_CyclicRedundancyCheck1Value";
CM_ SG_ 1051 HU_DisplayYear1 "Information for Year (XXOO)
XX : HU_DisplayYear1
OO: HU_DisplayYear2";
CM_ SG_ 1051 HU_DisplayYear2 "Information for Year (XXOO)
XX : HU_DisplayYear1
OO: HU_DisplayYear2";
CM_ SG_ 1051 HU_DisplayDay "Information for Day";
CM_ SG_ 1051 HU_AM_PM_INFO "Information for AM/PM";
CM_ SG_ 1051 HU_CLOCK_AlvCnt1Val "HU_CLOCK_AliveCounter1Value";
CM_ SG_ 1051 HU_TimeSetting "Information for current time setting";
CM_ SG_ 1051 HU_Status "Information for H/U status
Transmitted on H/U status changing";
CM_ SG_ 1051 HU_TimeFormat "Information for time format
Digital CLOCK only";
CM_ SG_ 1051 HU_DisplayHour "Information for time display in Hour unit";
CM_ SG_ 1051 HU_DisplayMinute "Information for time display in Minute unit";
CM_ SG_ 1051 HU_DisplaySecond "Information for time display in Second unit";
CM_ SG_ 1051 HU_DisplayMonth "Information for Month";
CM_ BO_ 1052 "[PE] Periodic and On Event";
CM_ SG_ 1052 HU_CLU_Crc2Val "HU_CLU_CyclicRedundancyCheck2Value";
CM_ SG_ 1052 HU_EVSupport "Notification whether EV function support or not.";
CM_ SG_ 1052 HU_AutoBrightState_New "HU Display Brightness State(When automatically adjusted)";
CM_ SG_ 1052 HU_CLU_AlvCnt2Val "HU_CLU_AliveCounter2Value";
CM_ SG_ 1052 HU_LanguageInfo "Information for System Language (for Display Font)";
CM_ SG_ 1052 HU_VolumeStatus "Information for AVN Volume";
CM_ SG_ 1052 HU_MuteStatus "Information for System Mute Display";
CM_ SG_ 1052 HU_WelcomeReady "H/U playback ready signal to play welcome/goodbye animation video.";
CM_ SG_ 1052 HU_UsmSupport "Information whether HU can support USM or not";
CM_ SG_ 1052 HU_NaviStatus "Information for Navigation Status (Booting, Normal Operation, No SD card)
-AVN NAVI Transmission Signal";
CM_ SG_ 1052 HU_NaviDisp "Information for Navi Display status on Front Monitor";
CM_ SG_ 1052 HU_BVM_Display_Message "BVM Operation Message";
CM_ SG_ 1052 HU_NaviCamSettingStatus "Information for Navi Camera alert setting status

+ Bit-coded field (On 1, Off 0)
   - bit 0 : Fixed Camera
   - bit 1 : Signal/Speed Violation Camera
   - bit 2 : Movable Camera
   - bit 3 : User Registration Fixed Camera
   - bit 4 : User Registration Signal/Speed Violation Camera
   - bit 5~6 : RESERVED
-AVN NAVI Transmission Signal";
BA_DEF_ BO_  "CANFD_BRS" ENUM  "0","1";
BA_DEF_ BO_  "GenMsgEVName" STRING ;
BA_DEF_ BO_  "NmAsrMessage" ENUM  "No","Yes";
BA_DEF_ BO_  "DiagState" ENUM  "No","Yes";
BA_DEF_ BO_  "DiagResponse" ENUM  "No","Yes";
BA_DEF_ BO_  "DiagRequest" ENUM  "No","Yes";
BA_DEF_ BO_  "TpMessage" ENUM  "No","Yes";
BA_DEF_ BO_  "UsrMsgIDSforwardDeviation" INT 0 100;
BA_DEF_ BO_  "UsrMsgIDSbackwardDeviation" INT 50 1000;
BA_DEF_ BO_  "GenMsgCycleTime" INT 0 2000;
BA_DEF_ BO_  "GenMsgStartDelayTime" INT 0 2000;
BA_DEF_ BO_  "GenMsgSendType" ENUM  "Cyclic","NoMsgSendType";
BA_DEF_ BO_  "GenMsgCycleTimeFast" INT 0 500;
BA_DEF_ BO_  "GenMsgDelayTime" INT 0 20;
BA_DEF_ BO_  "GenMsgILSupport" ENUM  "No","Yes";
BA_DEF_ BO_  "GenMsgNrOfRepetition" INT 0 3;
BA_DEF_ BO_  "VFrameFormat" ENUM  "StandardCAN","ExtendedCAN","reserved","reserved","reserved","reserved","reserved","reserved","reserved","reserved","reserved","reserved","reserved","reserved","StandardCAN_FD","ExtendedCAN_FD";
BA_DEF_ SG_  "UserSigValidity" ENUM  "B+","ACC","IG","IG1","IG2","IG3","IG1 or IG2","IG1 or IG3","Undef";
BA_DEF_ SG_  "TimeoutValue" STRING ;
BA_DEF_ SG_  "UsrSigPurpose" ENUM  "Undef","FN","DIAG","DIAG(Req)","DIAG(Res)","DIAG(Func)","DEV","CCP","NM","TP";
BA_DEF_ SG_  "GenSigStartValue" INT 0 1215752192;
BA_DEF_ SG_  "NetworkRequest" ENUM  "Yes","No";
BA_DEF_ SG_  "NetworkRequestHoldingTime" INT 0 65535;
BA_DEF_ SG_  "Description" STRING ;
BA_DEF_ SG_  "Version" STRING ;
BA_DEF_ SG_  "GenSigEnvVarType" ENUM  "Int","Float","Undef";
BA_DEF_ SG_  "GenSigSendType" ENUM  "Cyclic","OnWrite","OnWriteWithRepetition","OnChange","OnChangeWithRepetition","IfActive","IfActiveWithRepetition","NoSigSendType","OnChangeAndIfActive","OnChangeAndIfActiveWithRepetition";
BA_DEF_ SG_  "GwSigLatencyTime" INT 0 65536;
BA_DEF_ SG_  "GwSigMissingSourceType" ENUM  "Undef","OldValue","DefaultValue","InitialValue";
BA_DEF_ SG_  "NWM-WakeupAllowed" ENUM  "<n.a.>";
BA_DEF_ SG_  "RoutingFactor" INT 1 1215752192;
BA_DEF_ SG_  "SystemSignalLongSymbol" STRING ;
BA_DEF_REL_ BU_SG_REL_  "GenSigTimeoutTime" INT 0 7000;
BA_DEF_DEF_  "CANFD_BRS" "1";
BA_DEF_DEF_  "GenMsgEVName" "@Signame";
BA_DEF_DEF_  "NmAsrMessage" "No";
BA_DEF_DEF_  "DiagState" "No";
BA_DEF_DEF_  "DiagResponse" "No";
BA_DEF_DEF_  "DiagRequest" "No";
BA_DEF_DEF_  "TpMessage" "No";
BA_DEF_DEF_  "UsrMsgIDSforwardDeviation" 10;
BA_DEF_DEF_  "UsrMsgIDSbackwardDeviation" 100;
BA_DEF_DEF_  "GenMsgCycleTime" 200;
BA_DEF_DEF_  "GenMsgStartDelayTime" 0;
BA_DEF_DEF_  "GenMsgSendType" "NoMsgSendType";
BA_DEF_DEF_  "GenMsgCycleTimeFast" 40;
BA_DEF_DEF_  "GenMsgDelayTime" 20;
BA_DEF_DEF_  "GenMsgILSupport" "Yes";
BA_DEF_DEF_  "GenMsgNrOfRepetition" 3;
BA_DEF_DEF_  "VFrameFormat" "StandardCAN";
BA_DEF_DEF_  "UserSigValidity" "IG";
BA_DEF_DEF_  "TimeoutValue" "";
BA_DEF_DEF_  "UsrSigPurpose" "FN";
BA_DEF_DEF_  "GenSigStartValue" 0;
BA_DEF_DEF_  "NetworkRequest" "No";
BA_DEF_DEF_  "NetworkRequestHoldingTime" 0;
BA_DEF_DEF_  "Description" "";
BA_DEF_DEF_  "Version" "";
BA_DEF_DEF_  "GenSigEnvVarType" "Undef";
BA_DEF_DEF_  "GenSigSendType" "NoSigSendType";
BA_DEF_DEF_  "GwSigLatencyTime" 40;
BA_DEF_DEF_  "GwSigMissingSourceType" "Undef";
BA_DEF_DEF_  "NWM-WakeupAllowed" "<n.a.>";
BA_DEF_DEF_  "RoutingFactor" 1;
BA_DEF_DEF_REL_ "GenSigTimeoutTime" 500;
BA_DEF_DEF_  "SystemSignalLongSymbol" "";
BA_ "GenMsgSendType" BO_ 1216 0;
BA_ "GenMsgCycleTime" BO_ 1216 2000;
BA_ "GenMsgStartDelayTime" BO_ 1216 70;
BA_ "VFrameFormat" BO_ 1216 14;
BA_ "GenMsgSendType" BO_ 955 0;
BA_ "VFrameFormat" BO_ 955 14;
BA_ "GenMsgSendType" BO_ 613 0;
BA_ "GenMsgCycleTimeFast" BO_ 613 0;
BA_ "GenMsgNrOfRepetition" BO_ 613 0;
BA_ "VFrameFormat" BO_ 613 14;
BA_ "GenMsgSendType" BO_ 829 0;
BA_ "VFrameFormat" BO_ 829 14;
BA_ "GenMsgSendType" BO_ 1026 0;
BA_ "GenMsgStartDelayTime" BO_ 1026 30;
BA_ "VFrameFormat" BO_ 1026 14;
BA_ "GenMsgSendType" BO_ 830 0;
BA_ "VFrameFormat" BO_ 830 14;
BA_ "GenMsgCycleTime" BO_ 193 0;
BA_ "VFrameFormat" BO_ 193 14;
BA_ "GenMsgCycleTime" BO_ 194 0;
BA_ "GenMsgNrOfRepetition" BO_ 194 0;
BA_ "GenMsgDelayTime" BO_ 194 10;
BA_ "VFrameFormat" BO_ 194 14;
BA_ "GenMsgSendType" BO_ 1048 0;
BA_ "GenMsgCycleTime" BO_ 1048 1000;
BA_ "GenMsgCycleTimeFast" BO_ 1048 0;
BA_ "GenMsgNrOfRepetition" BO_ 1048 0;
BA_ "VFrameFormat" BO_ 1048 14;
BA_ "GenMsgSendType" BO_ 256 0;
BA_ "GenMsgCycleTime" BO_ 256 50;
BA_ "GenMsgCycleTimeFast" BO_ 256 0;
BA_ "GenMsgNrOfRepetition" BO_ 256 0;
BA_ "VFrameFormat" BO_ 256 14;
BA_ "GenMsgSendType" BO_ 1051 0;
BA_ "GenMsgCycleTime" BO_ 1051 1000;
BA_ "GenMsgStartDelayTime" BO_ 1051 10;
BA_ "VFrameFormat" BO_ 1051 14;
BA_ "GenMsgSendType" BO_ 1052 0;
BA_ "GenMsgCycleTime" BO_ 1052 1000;
BA_ "GenMsgStartDelayTime" BO_ 1052 10;
BA_ "VFrameFormat" BO_ 1052 14;
BA_ "Description" SG_ 1216 HU_MON_Crc1Val "The data area for CRC calculation is based on the data length (DLC) of the message DB.

The CRC shall be calculated over the entire data block (excluding the CRC bytes) including the user data, alive counter and Data ID



- CRC Polynomial (0x1021) , Ini";
BA_ "GenSigSendType" SG_ 1216 HU_MON_Crc1Val 4;
BA_ "GenSigStartValue" SG_ 1216 HU_MON_Crc1Val 65535;
BA_ "UserSigValidity" SG_ 1216 HU_MON_Crc1Val 3;
BA_ "Version" SG_ 1216 HU_MON_Crc1Val "22.10.20";
BA_ "Description" SG_ 1216 HU_NaviHandshakingSupport "This is a signal to send whether handshaking logic is applied related to Navigation's 'Map based ADAS' specification";
BA_ "GenSigSendType" SG_ 1216 HU_NaviHandshakingSupport 4;
BA_ "UserSigValidity" SG_ 1216 HU_NaviHandshakingSupport 1;
BA_ "Version" SG_ 1216 HU_NaviHandshakingSupport "20.05.02";
BA_ "GenSigSendType" SG_ 1216 HU_AMP_EQVariant 4;
BA_ "GenSigStartValue" SG_ 1216 HU_AMP_EQVariant 31;
BA_ "UserSigValidity" SG_ 1216 HU_AMP_EQVariant 1;
BA_ "Version" SG_ 1216 HU_AMP_EQVariant "20.08.06";
BA_ "Description" SG_ 1216 HU_AdasSupport "0x0 : Not Support

0x1 : ADAS Support (General Map) - Send map information based on General Map

0x2 : ADAS Support (Map based ADAS v1) - Send map information based on Map based ADAS v1 or v1.5

0x3 : ADAS Support (Map based ADAS v2) - Send map informati";
BA_ "GenSigSendType" SG_ 1216 HU_AdasSupport 4;
BA_ "GenSigStartValue" SG_ 1216 HU_AdasSupport 7;
BA_ "UserSigValidity" SG_ 1216 HU_AdasSupport 1;
BA_ "NetworkRequest" SG_ 1216 HU_AdasSupport 0;
BA_ "NetworkRequestHoldingTime" SG_ 1216 HU_AdasSupport 5000;
BA_ "Version" SG_ 1216 HU_AdasSupport "20.05.02";
BA_ "Description" SG_ 1216 HU_MON_AlvCnt1Val "For the first transmission request for a data element the counter shall be initialized with 0 and shall be incremented by 1 for every subsequent send request. 

When the counter reaches the maximum value(0xFF), then it shall restart with 0 for the next s";
BA_ "GenSigSendType" SG_ 1216 HU_MON_AlvCnt1Val 4;
BA_ "UserSigValidity" SG_ 1216 HU_MON_AlvCnt1Val 3;
BA_ "Version" SG_ 1216 HU_MON_AlvCnt1Val "22.10.20";
BA_ "GenSigSendType" SG_ 1216 HU_Type 4;
BA_ "GenSigStartValue" SG_ 1216 HU_Type 255;
BA_ "UserSigValidity" SG_ 1216 HU_Type 1;
BA_ "NetworkRequest" SG_ 1216 HU_Type 0;
BA_ "NetworkRequestHoldingTime" SG_ 1216 HU_Type 7000;
BA_ "Version" SG_ 1216 HU_Type "23.12.00";
BA_ "Description" SG_ 1216 HU_Navi_RspADASMapMsg "This signal indicates an ADAS map message response from H_U to ECU 

which is stored the  required Map based ADAS messages for each ECU



Each bit indicates the request messages as follows.

(1: Sending message / 0 : Doens't sending message)

- Bit 0 : ";
BA_ "GenSigSendType" SG_ 1216 HU_Navi_RspADASMapMsg 4;
BA_ "UserSigValidity" SG_ 1216 HU_Navi_RspADASMapMsg 3;
BA_ "Version" SG_ 1216 HU_Navi_RspADASMapMsg "21.11.04";
BA_ "GenSigSendType" SG_ 1216 HU_DistributeInfo 4;
BA_ "GenSigStartValue" SG_ 1216 HU_DistributeInfo 255;
BA_ "UserSigValidity" SG_ 1216 HU_DistributeInfo 1;
BA_ "NetworkRequest" SG_ 1216 HU_DistributeInfo 0;
BA_ "NetworkRequestHoldingTime" SG_ 1216 HU_DistributeInfo 7000;
BA_ "Version" SG_ 1216 HU_DistributeInfo "20.09.00";
BA_ "Description" SG_ 1216 HU_OptionInfo "Bit0 : Navi (0: Not Support / 1: Support)

Bit1 : USM (0: Not Support / 1: Support)

Bit2 : TMS (0: Not Support / 1: Support)

Bit3 : Multi Profile (0: Not Support(No Profile or Single Profile)  / 1: Support)

Bit4 : Camera Guideline (0: Displayed by Cam";
BA_ "GenSigSendType" SG_ 1216 HU_OptionInfo 4;
BA_ "GenSigStartValue" SG_ 1216 HU_OptionInfo 32768;
BA_ "UserSigValidity" SG_ 1216 HU_OptionInfo 0;
BA_ "Version" SG_ 1216 HU_OptionInfo "21.09.05";
BA_ "Description" SG_ 955 BLTN_CAM_FD_HU_Crc1Val "The data area for CRC calculation is based on the data length (DLC) of the message DB.

The CRC shall be calculated over the entire data block (excluding the CRC bytes) including the user data, alive counter and Data ID



- CRC Polynomial (0x1021) , Ini";
BA_ "GenSigSendType" SG_ 955 BLTN_CAM_FD_HU_Crc1Val 4;
BA_ "GenSigStartValue" SG_ 955 BLTN_CAM_FD_HU_Crc1Val 65535;
BA_ "UserSigValidity" SG_ 955 BLTN_CAM_FD_HU_Crc1Val 3;
BA_ "Version" SG_ 955 BLTN_CAM_FD_HU_Crc1Val "22.11.04";
BA_ "Description" SG_ 955 BLTN_CAM_DEV_Count "This Signal is count of drive event record.";
BA_ "GenSigSendType" SG_ 955 BLTN_CAM_DEV_Count 4;
BA_ "UserSigValidity" SG_ 955 BLTN_CAM_DEV_Count 1;
BA_ "NetworkRequest" SG_ 955 BLTN_CAM_DEV_Count 0;
BA_ "NetworkRequestHoldingTime" SG_ 955 BLTN_CAM_DEV_Count 1000;
BA_ "Version" SG_ 955 BLTN_CAM_DEV_Count "23.04.02";
BA_ "Description" SG_ 955 BLTN_CAM_FD_HU_AlvCnt1Val "For the first transmission request for a data element the counter shall be initialized with 0 and shall be incremented by 1 for every subsequent send request. 

When the counter reaches the maximum value(0xFF), then it shall restart with 0 for the next s";
BA_ "GenSigSendType" SG_ 955 BLTN_CAM_FD_HU_AlvCnt1Val 4;
BA_ "UserSigValidity" SG_ 955 BLTN_CAM_FD_HU_AlvCnt1Val 3;
BA_ "Version" SG_ 955 BLTN_CAM_FD_HU_AlvCnt1Val "22.11.04";
BA_ "Description" SG_ 955 BLTN_CAM_PMD_Count "This Signal is count of park motion detetion.";
BA_ "GenSigSendType" SG_ 955 BLTN_CAM_PMD_Count 4;
BA_ "UserSigValidity" SG_ 955 BLTN_CAM_PMD_Count 0;
BA_ "Version" SG_ 955 BLTN_CAM_PMD_Count "24.02.00";
BA_ "Description" SG_ 955 BLTN_CAM_HU_UI_Mode "Display control of Built-in Cam UI mode. This Signal for Ethernet Type Built-in Cam.";
BA_ "GenSigSendType" SG_ 955 BLTN_CAM_HU_UI_Mode 4;
BA_ "UserSigValidity" SG_ 955 BLTN_CAM_HU_UI_Mode 0;
BA_ "Version" SG_ 955 BLTN_CAM_HU_UI_Mode "22.05.02";
BA_ "Description" SG_ 955 BLTN_CAM_Display "Display control of Built-in Cam UI mode. This Signal for CAN Type Built-in Cam.(with Standard 5th Wide AVNT)";
BA_ "GenSigSendType" SG_ 955 BLTN_CAM_Display 4;
BA_ "UserSigValidity" SG_ 955 BLTN_CAM_Display 1;
BA_ "Version" SG_ 955 BLTN_CAM_Display "21.07.04";
BA_ "Description" SG_ 955 BLTN_CAM_WiFi_State "BLTN_CAM WiFi Stattus";
BA_ "GenSigSendType" SG_ 955 BLTN_CAM_WiFi_State 4;
BA_ "UserSigValidity" SG_ 955 BLTN_CAM_WiFi_State 1;
BA_ "Version" SG_ 955 BLTN_CAM_WiFi_State "21.07.04";
BA_ "Description" SG_ 955 BLTN_CAM_SD_Format_Op_State "BLTN_CAM SD card format operation status.";
BA_ "GenSigSendType" SG_ 955 BLTN_CAM_SD_Format_Op_State 4;
BA_ "UserSigValidity" SG_ 955 BLTN_CAM_SD_Format_Op_State 1;
BA_ "Version" SG_ 955 BLTN_CAM_SD_Format_Op_State "21.07.04";
BA_ "Description" SG_ 955 BLTN_CAM_PEV_Recorded "This Signal is sent just after the park event recorded.";
BA_ "GenSigSendType" SG_ 955 BLTN_CAM_PEV_Recorded 4;
BA_ "UserSigValidity" SG_ 955 BLTN_CAM_PEV_Recorded 1;
BA_ "NetworkRequest" SG_ 955 BLTN_CAM_PEV_Recorded 0;
BA_ "NetworkRequestHoldingTime" SG_ 955 BLTN_CAM_PEV_Recorded 1000;
BA_ "Version" SG_ 955 BLTN_CAM_PEV_Recorded "21.12.00";
BA_ "Description" SG_ 955 BLTN_CAM_PEV_Count "This Signal is count of park event record.";
BA_ "GenSigSendType" SG_ 955 BLTN_CAM_PEV_Count 4;
BA_ "UserSigValidity" SG_ 955 BLTN_CAM_PEV_Count 1;
BA_ "NetworkRequest" SG_ 955 BLTN_CAM_PEV_Count 0;
BA_ "NetworkRequestHoldingTime" SG_ 955 BLTN_CAM_PEV_Count 1000;
BA_ "Version" SG_ 955 BLTN_CAM_PEV_Count "21.12.00";
BA_ "Description" SG_ 955 BLTN_CAM_Ind_Req "This Signal is for HU Display Built-in Cam Indicator.";
BA_ "GenSigSendType" SG_ 955 BLTN_CAM_Ind_Req 4;
BA_ "UserSigValidity" SG_ 955 BLTN_CAM_Ind_Req 1;
BA_ "Version" SG_ 955 BLTN_CAM_Ind_Req "22.11.00";
BA_ "Description" SG_ 955 BLTN_CAM_LVDS_Mode_State "This Signal is for LVDS output status";
BA_ "GenSigSendType" SG_ 955 BLTN_CAM_LVDS_Mode_State 4;
BA_ "UserSigValidity" SG_ 955 BLTN_CAM_LVDS_Mode_State 1;
BA_ "Version" SG_ 955 BLTN_CAM_LVDS_Mode_State "21.07.04";
BA_ "Description" SG_ 955 BLTN_CAM_PrkOp_Termiate_Info "The signal for CCS service related with Built-in Cam Park operation termination.";
BA_ "GenSigSendType" SG_ 955 BLTN_CAM_PrkOp_Termiate_Info 4;
BA_ "UserSigValidity" SG_ 955 BLTN_CAM_PrkOp_Termiate_Info 0;
BA_ "NetworkRequest" SG_ 955 BLTN_CAM_PrkOp_Termiate_Info 0;
BA_ "NetworkRequestHoldingTime" SG_ 955 BLTN_CAM_PrkOp_Termiate_Info 1000;
BA_ "Version" SG_ 955 BLTN_CAM_PrkOp_Termiate_Info "21.12.00";
BA_ "Description" SG_ 955 BLTN_CAM_DEV_Recorded "This Signal is sent just after the drive event recorded.";
BA_ "GenSigSendType" SG_ 955 BLTN_CAM_DEV_Recorded 4;
BA_ "UserSigValidity" SG_ 955 BLTN_CAM_DEV_Recorded 1;
BA_ "NetworkRequest" SG_ 955 BLTN_CAM_DEV_Recorded 0;
BA_ "NetworkRequestHoldingTime" SG_ 955 BLTN_CAM_DEV_Recorded 1000;
BA_ "Version" SG_ 955 BLTN_CAM_DEV_Recorded "23.04.02";
BA_ "Description" SG_ 613 EMS_Crc8Val "The data area for CRC calculation is based on the data length (DLC) of the message DB.

The CRC shall be calculated over the entire data block (excluding the CRC bytes) including the user data, alive counter and Data ID



- CRC Polynomial (0x1021) , Ini";
BA_ "GenSigStartValue" SG_ 613 EMS_Crc8Val 65535;
BA_ "UserSigValidity" SG_ 613 EMS_Crc8Val 3;
BA_ "RoutingFactor" SG_ 613 EMS_Crc8Val 2;
BA_ "Version" SG_ 613 EMS_Crc8Val "21.09.03";
BA_ "Description" SG_ 613 HEV_EstClntTempVal "Estimated Engine Coolant Temperature";
BA_ "UserSigValidity" SG_ 613 HEV_EstClntTempVal 3;
BA_ "RoutingFactor" SG_ 613 HEV_EstClntTempVal 2;
BA_ "Version" SG_ 613 HEV_EstClntTempVal "17.11.00";
BA_ "Description" SG_ 613 HEV_AptVal "APT Value";
BA_ "UserSigValidity" SG_ 613 HEV_AptVal 3;
BA_ "RoutingFactor" SG_ 613 HEV_AptVal 2;
BA_ "Version" SG_ 613 HEV_AptVal "17.11.00";
BA_ "Description" SG_ 613 HEV_EstAmbtAirTempVal "Estimated Ambient air temperature";
BA_ "GenSigStartValue" SG_ 613 HEV_EstAmbtAirTempVal 91;
BA_ "UserSigValidity" SG_ 613 HEV_EstAmbtAirTempVal 3;
BA_ "RoutingFactor" SG_ 613 HEV_EstAmbtAirTempVal 2;
BA_ "Version" SG_ 613 HEV_EstAmbtAirTempVal "17.11.00";
BA_ "Description" SG_ 613 HEV_RbmSta "Status of rate-based monitoring



Value Description



Bit0 : minimum trip length condition 

Bit1 : vehicle speed condition 

Bit2 : continuous idle condition 

Bit3 : ambient temperature condition 

Bit4 : maximum altitude condition 

Bit5 : fuel engi";
BA_ "UserSigValidity" SG_ 613 HEV_RbmSta 3;
BA_ "RoutingFactor" SG_ 613 HEV_RbmSta 2;
BA_ "Version" SG_ 613 HEV_RbmSta "19.11.11";
BA_ "Description" SG_ 613 HEV_WarmUpReq_For_DATC "Flag indicating an EMS request not to stop the engine.

 * This signal is for reference on the DATC.

 * This signal is same as HEV_WarmUpReq (@EMS_09_10ms).";
BA_ "UserSigValidity" SG_ 613 HEV_WarmUpReq_For_DATC 3;
BA_ "RoutingFactor" SG_ 613 HEV_WarmUpReq_For_DATC 2;
BA_ "Version" SG_ 613 HEV_WarmUpReq_For_DATC "19.09.04";
BA_ "Description" SG_ 613 EMS_AlvCnt8Val "For the first transmission request for a data element the counter shall be initialized with 0 and shall be incremented by 1 for every subsequent send request. 

When the counter reaches the maximum value(0xFF), then it shall restart with 0 for the next s";
BA_ "UserSigValidity" SG_ 613 EMS_AlvCnt8Val 3;
BA_ "RoutingFactor" SG_ 613 EMS_AlvCnt8Val 2;
BA_ "Version" SG_ 613 EMS_AlvCnt8Val "21.09.03";
BA_ "Description" SG_ 613 HEV_RbmInhbtSta "Inhibition of rate based monitoring";
BA_ "UserSigValidity" SG_ 613 HEV_RbmInhbtSta 3;
BA_ "RoutingFactor" SG_ 613 HEV_RbmInhbtSta 2;
BA_ "Version" SG_ 613 HEV_RbmInhbtSta "17.11.00";
BA_ "Description" SG_ 613 HEV_EhrsTempSta "The  signal is condition about EHRS' temperature";
BA_ "UserSigValidity" SG_ 613 HEV_EhrsTempSta 3;
BA_ "RoutingFactor" SG_ 613 HEV_EhrsTempSta 2;
BA_ "Version" SG_ 613 HEV_EhrsTempSta "17.11.00";
BA_ "Description" SG_ 613 HEV_Aaf_WrnLamp "Air Flap Warning Lamp/Message Request Signal indicates whether Warning Lamp/Message should be displayed in the display screen in order to warn AAF System failure to customer.";
BA_ "UserSigValidity" SG_ 613 HEV_Aaf_WrnLamp 3;
BA_ "RoutingFactor" SG_ 613 HEV_Aaf_WrnLamp 2;
BA_ "Version" SG_ 613 HEV_Aaf_WrnLamp "19.11.11";
BA_ "Description" SG_ 613 HEV_OPSFail "The signal indicates the status of the 'Oil Pressure Warning Lamp'";
BA_ "UserSigValidity" SG_ 613 HEV_OPSFail 3;
BA_ "RoutingFactor" SG_ 613 HEV_OPSFail 2;
BA_ "Version" SG_ 613 HEV_OPSFail "18.05.04";
BA_ "Description" SG_ 613 HEV_EngDsplceTyp "This signal indicates the engine displacement (volume).";
BA_ "UserSigValidity" SG_ 613 HEV_EngDsplceTyp 3;
BA_ "RoutingFactor" SG_ 613 HEV_EngDsplceTyp 2;
BA_ "Version" SG_ 613 HEV_EngDsplceTyp "19.07.01";
BA_ "UserSigValidity" SG_ 613 HEV_EngTyp2 3;
BA_ "RoutingFactor" SG_ 613 HEV_EngTyp2 2;
BA_ "Version" SG_ 613 HEV_EngTyp2 "19.07.01";
BA_ "UserSigValidity" SG_ 613 HEV_EngTyp1 3;
BA_ "RoutingFactor" SG_ 613 HEV_EngTyp1 2;
BA_ "Version" SG_ 613 HEV_EngTyp1 "19.07.01";
BA_ "Description" SG_ 613 HEV_S_F "AMS/ISG system type indicator";
BA_ "UserSigValidity" SG_ 613 HEV_S_F 3;
BA_ "RoutingFactor" SG_ 613 HEV_S_F 2;
BA_ "Version" SG_ 613 HEV_S_F "19.07.01";
BA_ "Description" SG_ 613 HEV_S_F_GEN "system generation type indicator";
BA_ "UserSigValidity" SG_ 613 HEV_S_F_GEN 3;
BA_ "RoutingFactor" SG_ 613 HEV_S_F_GEN 2;
BA_ "Version" SG_ 613 HEV_S_F_GEN "19.07.01";
BA_ "Description" SG_ 613 HEV_RbmSta_2nd "Status of rate-based monitoring



Value Description

Bit0 : cold start condition for PHEV

Bit1 : cold start inhibition condition for HEV/PHEV

Bit2 : reserved

Bit3 : reserved

Bit4 : reserved

Bit5 : reserved

Bit6 : reserved";
BA_ "UserSigValidity" SG_ 613 HEV_RbmSta_2nd 3;
BA_ "RoutingFactor" SG_ 613 HEV_RbmSta_2nd 2;
BA_ "Version" SG_ 613 HEV_RbmSta_2nd "19.10.00";
BA_ "Description" SG_ 613 HEV_RECTrigSta "Trigger signal(10 event) - when REC is occurred in the HEV ECU(Engine controller)";
BA_ "UserSigValidity" SG_ 613 HEV_RECTrigSta 3;
BA_ "RoutingFactor" SG_ 613 HEV_RECTrigSta 2;
BA_ "Version" SG_ 613 HEV_RECTrigSta "20.02.02";
BA_ "Description" SG_ 613 HEV_PendingTrigSta "Trigger signal(10 event) - when Pending DTC is occurred in the HEV ECU(Engine controller)";
BA_ "UserSigValidity" SG_ 613 HEV_PendingTrigSta 3;
BA_ "RoutingFactor" SG_ 613 HEV_PendingTrigSta 2;
BA_ "Version" SG_ 613 HEV_PendingTrigSta "20.02.02";
BA_ "Description" SG_ 613 HEV_OilLifeRatio "EMS calculates remaining engine oil life, and Cluster displays this information with % unit, in order to guide driver to change engine oil.";
BA_ "UserSigValidity" SG_ 613 HEV_OilLifeRatio 3;
BA_ "RoutingFactor" SG_ 613 HEV_OilLifeRatio 2;
BA_ "Version" SG_ 613 HEV_OilLifeRatio "20.12.04";
BA_ "Description" SG_ 613 HEV_OilLifeEna "Cluster displays engine oil life warning and life ratio signal if this enabling bit is true.";
BA_ "UserSigValidity" SG_ 613 HEV_OilLifeEna 3;
BA_ "RoutingFactor" SG_ 613 HEV_OilLifeEna 2;
BA_ "Version" SG_ 613 HEV_OilLifeEna "20.12.04";
BA_ "Description" SG_ 613 HEV_OilLifeWarn "This signal indicates status of engine oil life warning.";
BA_ "UserSigValidity" SG_ 613 HEV_OilLifeWarn 3;
BA_ "RoutingFactor" SG_ 613 HEV_OilLifeWarn 2;
BA_ "Version" SG_ 613 HEV_OilLifeWarn "20.12.04";
BA_ "Description" SG_ 613 HEV_ExtSoakTimeVal "The SoakTimeExt is the Additional soak time information, which start to increase from the moment that Soak Time is over 255 min.



Total Soak Time [min] = 1 * HEV_SoakTimeVal (EMS_08_100ms) [min] + 5 * HEV_ExtSoakTimeVal (EMS_08_100ms) [min]";
BA_ "UserSigValidity" SG_ 613 HEV_ExtSoakTimeVal 3;
BA_ "RoutingFactor" SG_ 613 HEV_ExtSoakTimeVal 2;
BA_ "Version" SG_ 613 HEV_ExtSoakTimeVal "21.06.08";
BA_ "Description" SG_ 613 HEV_EngClntTempVal "Engine coolant temperature";
BA_ "UserSigValidity" SG_ 613 HEV_EngClntTempVal 3;
BA_ "RoutingFactor" SG_ 613 HEV_EngClntTempVal 2;
BA_ "Version" SG_ 613 HEV_EngClntTempVal "17.11.00";
BA_ "Description" SG_ 613 HEV_EngOilTempVal "Engine Oil Temperature";
BA_ "UserSigValidity" SG_ 613 HEV_EngOilTempVal 3;
BA_ "RoutingFactor" SG_ 613 HEV_EngOilTempVal 2;
BA_ "Version" SG_ 613 HEV_EngOilTempVal "17.11.00";
BA_ "Description" SG_ 613 HEV_VbOffActSta "ECU adaptive values and failure memory erase after battery disconnection";
BA_ "UserSigValidity" SG_ 613 HEV_VbOffActSta 3;
BA_ "RoutingFactor" SG_ 613 HEV_VbOffActSta 2;
BA_ "Version" SG_ 613 HEV_VbOffActSta "17.11.00";
BA_ "Description" SG_ 613 HEV_AirCompOffReq "air conditioner compressor off request";
BA_ "UserSigValidity" SG_ 613 HEV_AirCompOffReq 3;
BA_ "RoutingFactor" SG_ 613 HEV_AirCompOffReq 2;
BA_ "Version" SG_ 613 HEV_AirCompOffReq "17.11.00";
BA_ "Description" SG_ 613 HEV_MilConfgVal "Configuration of MIL handing and failure memory management";
BA_ "UserSigValidity" SG_ 613 HEV_MilConfgVal 3;
BA_ "RoutingFactor" SG_ 613 HEV_MilConfgVal 2;
BA_ "Version" SG_ 613 HEV_MilConfgVal "17.11.00";
BA_ "Description" SG_ 613 HEV_CF_EMS_LOCKUP "Engine lock up maintenance request state

0x0 : Engine doesn't require lock up maintenance

0x1 : Engine require lock up mainentance";
BA_ "UserSigValidity" SG_ 613 HEV_CF_EMS_LOCKUP 3;
BA_ "RoutingFactor" SG_ 613 HEV_CF_EMS_LOCKUP 2;
BA_ "Version" SG_ 613 HEV_CF_EMS_LOCKUP "18.10.12";
BA_ "Description" SG_ 613 HEV_OilLvlSta "This signal indicates the replace time of engine oil.";
BA_ "UserSigValidity" SG_ 613 HEV_OilLvlSta 3;
BA_ "RoutingFactor" SG_ 613 HEV_OilLvlSta 2;
BA_ "Version" SG_ 613 HEV_OilLvlSta "20.12.04";
BA_ "Description" SG_ 613 HEV_ImmoLmpReq "Immobilizer Lamp";
BA_ "UserSigValidity" SG_ 613 HEV_ImmoLmpReq 3;
BA_ "RoutingFactor" SG_ 613 HEV_ImmoLmpReq 2;
BA_ "Version" SG_ 613 HEV_ImmoLmpReq "17.11.00";
BA_ "Description" SG_ 613 HEV_MilReq "This signal indicates the status of MIL physical output.";
BA_ "UserSigValidity" SG_ 613 HEV_MilReq 3;
BA_ "RoutingFactor" SG_ 613 HEV_MilReq 2;
BA_ "Version" SG_ 613 HEV_MilReq "17.11.00";
BA_ "Description" SG_ 613 HEV_WiperSwSta "This signal indicates the status of a wiper switch.";
BA_ "UserSigValidity" SG_ 613 HEV_WiperSwSta 3;
BA_ "RoutingFactor" SG_ 613 HEV_WiperSwSta 2;
BA_ "Version" SG_ 613 HEV_WiperSwSta "17.11.00";
BA_ "Description" SG_ 613 HEV_FanOpSta "This signal indicates whether the cooling/condenser fan is operating or not.";
BA_ "UserSigValidity" SG_ 613 HEV_FanOpSta 3;
BA_ "RoutingFactor" SG_ 613 HEV_FanOpSta 2;
BA_ "Version" SG_ 613 HEV_FanOpSta "17.11.00";
BA_ "Description" SG_ 613 HEV_FanSta "This signal indicates the operating state of the cooling/condenser fan.";
BA_ "UserSigValidity" SG_ 613 HEV_FanSta 3;
BA_ "RoutingFactor" SG_ 613 HEV_FanSta 2;
BA_ "Version" SG_ 613 HEV_FanSta "17.11.00";
BA_ "Description" SG_ 613 HEV_BrkLtSwSta "Brake light Switch";
BA_ "UserSigValidity" SG_ 613 HEV_BrkLtSwSta 3;
BA_ "RoutingFactor" SG_ 613 HEV_BrkLtSwSta 2;
BA_ "Version" SG_ 613 HEV_BrkLtSwSta "17.11.00";
BA_ "Description" SG_ 613 HEV_IgnCycCntVal "Number of driving cycle since first ECU power-up. The counter increases each time a driving cycle with engine running for a specified time duration is detected. This value is only initialized with 0 on saved RAM lost (or reprogramming).";
BA_ "UserSigValidity" SG_ 613 HEV_IgnCycCntVal 3;
BA_ "RoutingFactor" SG_ 613 HEV_IgnCycCntVal 2;
BA_ "Version" SG_ 613 HEV_IgnCycCntVal "17.11.00";
BA_ "Description" SG_ 613 HEV_SoakTimeVal "Engine soaking time";
BA_ "UserSigValidity" SG_ 613 HEV_SoakTimeVal 3;
BA_ "RoutingFactor" SG_ 613 HEV_SoakTimeVal 2;
BA_ "Version" SG_ 613 HEV_SoakTimeVal "17.11.00";
BA_ "Description" SG_ 613 HEV_SoakTimeErrSta "If the HEV_SoakTimeErrSta = 1 then the engine is in fuel cut off state, i.e. e. no injection is applied.";
BA_ "UserSigValidity" SG_ 613 HEV_SoakTimeErrSta 3;
BA_ "RoutingFactor" SG_ 613 HEV_SoakTimeErrSta 2;
BA_ "Version" SG_ 613 HEV_SoakTimeErrSta "19.11.11";
BA_ "UserSigValidity" SG_ 613 HEV_SoakTimeOvrSta 3;
BA_ "RoutingFactor" SG_ 613 HEV_SoakTimeOvrSta 2;
BA_ "Version" SG_ 613 HEV_SoakTimeOvrSta "18.12.01";
BA_ "UserSigValidity" SG_ 613 HEV_FuelRunOutSta 3;
BA_ "RoutingFactor" SG_ 613 HEV_FuelRunOutSta 2;
BA_ "Version" SG_ 613 HEV_FuelRunOutSta "17.11.00";
BA_ "UserSigValidity" SG_ 613 HEV_FuelRunOutDetSta 3;
BA_ "RoutingFactor" SG_ 613 HEV_FuelRunOutDetSta 2;
BA_ "Version" SG_ 613 HEV_FuelRunOutDetSta "17.11.00";
BA_ "Description" SG_ 613 HEV_FuelCnsmptSumVal "Fuel Comsumption summed";
BA_ "UserSigValidity" SG_ 613 HEV_FuelCnsmptSumVal 3;
BA_ "RoutingFactor" SG_ 613 HEV_FuelCnsmptSumVal 2;
BA_ "Version" SG_ 613 HEV_FuelCnsmptSumVal "17.11.00";
BA_ "Description" SG_ 829 SBCM_RR_FD_Crc1Val "The data area for CRC calculation is based on the data length (DLC) of the message DB.

The CRC shall be calculated over the entire data block (excluding the CRC bytes) including the user data, alive counter and Data ID



- CRC Polynomial (0x1021) , Ini";
BA_ "GenSigSendType" SG_ 829 SBCM_RR_FD_Crc1Val 4;
BA_ "GenSigStartValue" SG_ 829 SBCM_RR_FD_Crc1Val 65535;
BA_ "UserSigValidity" SG_ 829 SBCM_RR_FD_Crc1Val 3;
BA_ "Version" SG_ 829 SBCM_RR_FD_Crc1Val "22.10.20";
BA_ "GenSigSendType" SG_ 829 USM_RRGhostDoorSta 4;
BA_ "UserSigValidity" SG_ 829 USM_RRGhostDoorSta 0;
BA_ "NetworkRequest" SG_ 829 USM_RRGhostDoorSta 0;
BA_ "NetworkRequestHoldingTime" SG_ 829 USM_RRGhostDoorSta 5000;
BA_ "Version" SG_ 829 USM_RRGhostDoorSta "21.07.07";
BA_ "GenSigSendType" SG_ 829 DoorLock_PDSLkSwSta_RR 4;
BA_ "UserSigValidity" SG_ 829 DoorLock_PDSLkSwSta_RR 0;
BA_ "NetworkRequest" SG_ 829 DoorLock_PDSLkSwSta_RR 0;
BA_ "Version" SG_ 829 DoorLock_PDSLkSwSta_RR "21.09.05";
BA_ "GenSigSendType" SG_ 829 PDS_TypeOption_RR 4;
BA_ "UserSigValidity" SG_ 829 PDS_TypeOption_RR 0;
BA_ "NetworkRequest" SG_ 829 PDS_TypeOption_RR 0;
BA_ "Version" SG_ 829 PDS_TypeOption_RR "21.07.07";
BA_ "GenSigSendType" SG_ 829 RR_CrashMRActAlarm 4;
BA_ "UserSigValidity" SG_ 829 RR_CrashMRActAlarm 0;
BA_ "NetworkRequest" SG_ 829 RR_CrashMRActAlarm 0;
BA_ "NetworkRequestHoldingTime" SG_ 829 RR_CrashMRActAlarm 5000;
BA_ "Version" SG_ 829 RR_CrashMRActAlarm "21.07.07";
BA_ "GenSigSendType" SG_ 829 PwrDRBuzzerOut_RR 4;
BA_ "UserSigValidity" SG_ 829 PwrDRBuzzerOut_RR 0;
BA_ "NetworkRequest" SG_ 829 PwrDRBuzzerOut_RR 0;
BA_ "NetworkRequestHoldingTime" SG_ 829 PwrDRBuzzerOut_RR 5000;
BA_ "Version" SG_ 829 PwrDRBuzzerOut_RR "21.07.07";
BA_ "GenSigSendType" SG_ 829 PwrDRClosingRRDrSta 4;
BA_ "UserSigValidity" SG_ 829 PwrDRClosingRRDrSta 0;
BA_ "NetworkRequest" SG_ 829 PwrDRClosingRRDrSta 0;
BA_ "NetworkRequestHoldingTime" SG_ 829 PwrDRClosingRRDrSta 5000;
BA_ "Version" SG_ 829 PwrDRClosingRRDrSta "23.07.06";
BA_ "GenSigSendType" SG_ 829 AFH_RR_FldUnfldSta 4;
BA_ "UserSigValidity" SG_ 829 AFH_RR_FldUnfldSta 0;
BA_ "NetworkRequest" SG_ 829 AFH_RR_FldUnfldSta 0;
BA_ "NetworkRequestHoldingTime" SG_ 829 AFH_RR_FldUnfldSta 5000;
BA_ "Version" SG_ 829 AFH_RR_FldUnfldSta "23.01.01";
BA_ "Description" SG_ 829 SBCM_RR_FD_AlvCnt1Val "For the first transmission request for a data element the counter shall be initialized with 0 and shall be incremented by 1 for every subsequent send request. 

When the counter reaches the maximum value(0xFF), then it shall restart with 0 for the next s";
BA_ "GenSigSendType" SG_ 829 SBCM_RR_FD_AlvCnt1Val 4;
BA_ "UserSigValidity" SG_ 829 SBCM_RR_FD_AlvCnt1Val 3;
BA_ "Version" SG_ 829 SBCM_RR_FD_AlvCnt1Val "22.10.20";
BA_ "Description" SG_ 829 DoorLock_RrRtLkOutSta_SBCM "- Door Lock or Unlock Output State 

0x0 : Off (Door lock/unlock output Off state)

0x1 : On (Door lock/unlock output On state)";
BA_ "GenSigSendType" SG_ 829 DoorLock_RrRtLkOutSta_SBCM 4;
BA_ "UserSigValidity" SG_ 829 DoorLock_RrRtLkOutSta_SBCM 0;
BA_ "NetworkRequest" SG_ 829 DoorLock_RrRtLkOutSta_SBCM 0;
BA_ "NetworkRequestHoldingTime" SG_ 829 DoorLock_RrRtLkOutSta_SBCM 5000;
BA_ "Version" SG_ 829 DoorLock_RrRtLkOutSta_SBCM "23.02.09";
BA_ "GenSigSendType" SG_ 829 RrRt_DrLkRetryFail_SBCM 4;
BA_ "TimeoutValue" SG_ 829 RrRt_DrLkRetryFail_SBCM "0x0";
BA_ "UserSigValidity" SG_ 829 RrRt_DrLkRetryFail_SBCM 0;
BA_ "NetworkRequest" SG_ 829 RrRt_DrLkRetryFail_SBCM 0;
BA_ "NetworkRequestHoldingTime" SG_ 829 RrRt_DrLkRetryFail_SBCM 5000;
BA_ "Version" SG_ 829 RrRt_DrLkRetryFail_SBCM "23.03.00";
BA_ "GenSigSendType" SG_ 829 RR_DetectObj_warn 4;
BA_ "UserSigValidity" SG_ 829 RR_DetectObj_warn 0;
BA_ "NetworkRequest" SG_ 829 RR_DetectObj_warn 0;
BA_ "NetworkRequestHoldingTime" SG_ 829 RR_DetectObj_warn 5000;
BA_ "Version" SG_ 829 RR_DetectObj_warn "23.10.11";
BA_ "GenSigSendType" SG_ 829 RRRrDrCurtainPosition 4;
BA_ "UserSigValidity" SG_ 829 RRRrDrCurtainPosition 0;
BA_ "NetworkRequest" SG_ 829 RRRrDrCurtainPosition 0;
BA_ "NetworkRequestHoldingTime" SG_ 829 RRRrDrCurtainPosition 5000;
BA_ "Version" SG_ 829 RRRrDrCurtainPosition "23.08.00";
BA_ "GenSigSendType" SG_ 829 RRRrDrCurtainDownInitState 4;
BA_ "UserSigValidity" SG_ 829 RRRrDrCurtainDownInitState 0;
BA_ "NetworkRequest" SG_ 829 RRRrDrCurtainDownInitState 0;
BA_ "NetworkRequestHoldingTime" SG_ 829 RRRrDrCurtainDownInitState 5000;
BA_ "Version" SG_ 829 RRRrDrCurtainDownInitState "24.01.05";
BA_ "GenSigSendType" SG_ 829 PwrDrSta_RrRt 4;
BA_ "UserSigValidity" SG_ 829 PwrDrSta_RrRt 0;
BA_ "NetworkRequest" SG_ 829 PwrDrSta_RrRt 0;
BA_ "NetworkRequestHoldingTime" SG_ 829 PwrDrSta_RrRt 5000;
BA_ "Version" SG_ 829 PwrDrSta_RrRt "24.01.05";
BA_ "GenSigSendType" SG_ 829 PwrDRBuzzerOut_RR_New 4;
BA_ "UserSigValidity" SG_ 829 PwrDRBuzzerOut_RR_New 0;
BA_ "NetworkRequest" SG_ 829 PwrDRBuzzerOut_RR_New 0;
BA_ "NetworkRequestHoldingTime" SG_ 829 PwrDRBuzzerOut_RR_New 5000;
BA_ "Version" SG_ 829 PwrDRBuzzerOut_RR_New "24.01.05";
BA_ "Description" SG_ 829 SBCM_RR_SlidePosition "DHMC_RR_SlidePosition";
BA_ "GenSigSendType" SG_ 829 SBCM_RR_SlidePosition 4;
BA_ "GenSigStartValue" SG_ 829 SBCM_RR_SlidePosition 255;
BA_ "UserSigValidity" SG_ 829 SBCM_RR_SlidePosition 0;
BA_ "NetworkRequest" SG_ 829 SBCM_RR_SlidePosition 0;
BA_ "NetworkRequestHoldingTime" SG_ 829 SBCM_RR_SlidePosition 5000;
BA_ "Version" SG_ 829 SBCM_RR_SlidePosition "24.01.05";
BA_ "Description" SG_ 829 SBCM_RR_DoorAngle "PDSM_RR_DoorAngle";
BA_ "GenSigSendType" SG_ 829 SBCM_RR_DoorAngle 4;
BA_ "GenSigStartValue" SG_ 829 SBCM_RR_DoorAngle 100;
BA_ "UserSigValidity" SG_ 829 SBCM_RR_DoorAngle 0;
BA_ "NetworkRequest" SG_ 829 SBCM_RR_DoorAngle 0;
BA_ "NetworkRequestHoldingTime" SG_ 829 SBCM_RR_DoorAngle 5000;
BA_ "Version" SG_ 829 SBCM_RR_DoorAngle "24.01.05";
BA_ "GenSigSendType" SG_ 829 RRDoorPushAlarm 4;
BA_ "UserSigValidity" SG_ 829 RRDoorPushAlarm 0;
BA_ "NetworkRequest" SG_ 829 RRDoorPushAlarm 0;
BA_ "NetworkRequestHoldingTime" SG_ 829 RRDoorPushAlarm 5000;
BA_ "Version" SG_ 829 RRDoorPushAlarm "21.07.07";
BA_ "Description" SG_ 829 RR_CrashUnlockCmd "RearRightCrashUnlockCommand";
BA_ "GenSigSendType" SG_ 829 RR_CrashUnlockCmd 4;
BA_ "UserSigValidity" SG_ 829 RR_CrashUnlockCmd 0;
BA_ "NetworkRequest" SG_ 829 RR_CrashUnlockCmd 0;
BA_ "Version" SG_ 829 RR_CrashUnlockCmd "21.07.07";
BA_ "Description" SG_ 829 Warn_RrRtDrSwSta_SBCM "Warning Rear Right Door Switch Status";
BA_ "GenSigSendType" SG_ 829 Warn_RrRtDrSwSta_SBCM 4;
BA_ "UserSigValidity" SG_ 829 Warn_RrRtDrSwSta_SBCM 0;
BA_ "NetworkRequest" SG_ 829 Warn_RrRtDrSwSta_SBCM 0;
BA_ "Version" SG_ 829 Warn_RrRtDrSwSta_SBCM "21.09.05";
BA_ "Description" SG_ 829 DoorLock_RrRtDrUnLkSta_SBCM "Rear Right Door Unlock Status";
BA_ "GenSigSendType" SG_ 829 DoorLock_RrRtDrUnLkSta_SBCM 4;
BA_ "UserSigValidity" SG_ 829 DoorLock_RrRtDrUnLkSta_SBCM 0;
BA_ "NetworkRequest" SG_ 829 DoorLock_RrRtDrUnLkSta_SBCM 0;
BA_ "Version" SG_ 829 DoorLock_RrRtDrUnLkSta_SBCM "21.07.07";
BA_ "Description" SG_ 829 RR_SEAActivated "RearRightSEAActivated";
BA_ "GenSigSendType" SG_ 829 RR_SEAActivated 4;
BA_ "UserSigValidity" SG_ 829 RR_SEAActivated 0;
BA_ "NetworkRequest" SG_ 829 RR_SEAActivated 0;
BA_ "Version" SG_ 829 RR_SEAActivated "21.07.07";
BA_ "Description" SG_ 829 RR_SEAWarn "RearRighrSEAWarning";
BA_ "GenSigSendType" SG_ 829 RR_SEAWarn 4;
BA_ "UserSigValidity" SG_ 829 RR_SEAWarn 0;
BA_ "NetworkRequest" SG_ 829 RR_SEAWarn 0;
BA_ "Version" SG_ 829 RR_SEAWarn "21.07.07";
BA_ "GenSigSendType" SG_ 829 RR_SEWWarn 4;
BA_ "UserSigValidity" SG_ 829 RR_SEWWarn 0;
BA_ "NetworkRequest" SG_ 829 RR_SEWWarn 0;
BA_ "Version" SG_ 829 RR_SEWWarn "21.07.07";
BA_ "GenSigSendType" SG_ 829 RR_ReleaseWarn 4;
BA_ "UserSigValidity" SG_ 829 RR_ReleaseWarn 0;
BA_ "NetworkRequest" SG_ 829 RR_ReleaseWarn 0;
BA_ "NetworkRequestHoldingTime" SG_ 829 RR_ReleaseWarn 5000;
BA_ "Version" SG_ 829 RR_ReleaseWarn "21.09.05";
BA_ "GenSigSendType" SG_ 829 RR_SWFailAlarm 4;
BA_ "UserSigValidity" SG_ 829 RR_SWFailAlarm 0;
BA_ "NetworkRequest" SG_ 829 RR_SWFailAlarm 0;
BA_ "NetworkRequestHoldingTime" SG_ 829 RR_SWFailAlarm 5000;
BA_ "Version" SG_ 829 RR_SWFailAlarm "21.07.07";
BA_ "GenSigSendType" SG_ 829 RR_ChildLock_ActnFlSta 4;
BA_ "UserSigValidity" SG_ 829 RR_ChildLock_ActnFlSta 0;
BA_ "NetworkRequest" SG_ 829 RR_ChildLock_ActnFlSta 0;
BA_ "NetworkRequestHoldingTime" SG_ 829 RR_ChildLock_ActnFlSta 5000;
BA_ "Version" SG_ 829 RR_ChildLock_ActnFlSta "21.07.07";
BA_ "GenSigSendType" SG_ 829 RR_MRActivationAlarm 4;
BA_ "UserSigValidity" SG_ 829 RR_MRActivationAlarm 0;
BA_ "NetworkRequest" SG_ 829 RR_MRActivationAlarm 0;
BA_ "NetworkRequestHoldingTime" SG_ 829 RR_MRActivationAlarm 5000;
BA_ "Version" SG_ 829 RR_MRActivationAlarm "21.07.07";
BA_ "GenSigSendType" SG_ 829 RR_ChildLock_Status 4;
BA_ "UserSigValidity" SG_ 829 RR_ChildLock_Status 0;
BA_ "NetworkRequest" SG_ 829 RR_ChildLock_Status 0;
BA_ "NetworkRequestHoldingTime" SG_ 829 RR_ChildLock_Status 5000;
BA_ "Version" SG_ 829 RR_ChildLock_Status "21.07.07";
BA_ "Description" SG_ 1026 BDC_FD_SMK_Crc3Val "The data area for CRC calculation is based on the data length (DLC) of the message DB.

The CRC shall be calculated over the entire data block (excluding the CRC bytes) including the user data, alive counter and Data ID



- CRC Polynomial (0x1021) , Ini";
BA_ "GenSigSendType" SG_ 1026 BDC_FD_SMK_Crc3Val 4;
BA_ "GenSigStartValue" SG_ 1026 BDC_FD_SMK_Crc3Val 65535;
BA_ "UserSigValidity" SG_ 1026 BDC_FD_SMK_Crc3Val 0;
BA_ "Version" SG_ 1026 BDC_FD_SMK_Crc3Val "22.11.04";
BA_ "Description" SG_ 1026 SMK_TrmnlCtrlStaBDCEV "Mirror Value of TerminalControlState(BDC EV)";
BA_ "GenSigSendType" SG_ 1026 SMK_TrmnlCtrlStaBDCEV 4;
BA_ "UserSigValidity" SG_ 1026 SMK_TrmnlCtrlStaBDCEV 0;
BA_ "Version" SG_ 1026 SMK_TrmnlCtrlStaBDCEV "23.07.04";
BA_ "Description" SG_ 1026 SMK_PwrOnModeSta "Value of Power mode(BDC)";
BA_ "GenSigSendType" SG_ 1026 SMK_PwrOnModeSta 4;
BA_ "UserSigValidity" SG_ 1026 SMK_PwrOnModeSta 0;
BA_ "Version" SG_ 1026 SMK_PwrOnModeSta "23.07.04";
BA_ "Description" SG_ 1026 SMK_StndbyMdTmrMin "Information of Standby Mode timer";
BA_ "GenSigSendType" SG_ 1026 SMK_StndbyMdTmrMin 4;
BA_ "UserSigValidity" SG_ 1026 SMK_StndbyMdTmrMin 0;
BA_ "Version" SG_ 1026 SMK_StndbyMdTmrMin "22.05.02";
BA_ "Description" SG_ 1026 SMK_PwrTransitionReq "SMK Power Transition Request";
BA_ "GenSigSendType" SG_ 1026 SMK_PwrTransitionReq 4;
BA_ "UserSigValidity" SG_ 1026 SMK_PwrTransitionReq 0;
BA_ "Version" SG_ 1026 SMK_PwrTransitionReq "24.01.03";
BA_ "Description" SG_ 1026 SMK_StndbyMdTmrSec "Information of Standby Mode Timer";
BA_ "GenSigSendType" SG_ 1026 SMK_StndbyMdTmrSec 4;
BA_ "UserSigValidity" SG_ 1026 SMK_StndbyMdTmrSec 0;
BA_ "Version" SG_ 1026 SMK_StndbyMdTmrSec "22.05.02";
BA_ "Description" SG_ 1026 SMK_VhclSlpSta "This Signal is used to calculate slope of the vehicle and to determine whether vehicle is in inclined condition or vehicle is in flat(inclination within the limits) condition for remote start operation (2nd CAN - C_VehicleSlopeState)";
BA_ "GenSigSendType" SG_ 1026 SMK_VhclSlpSta 4;
BA_ "UserSigValidity" SG_ 1026 SMK_VhclSlpSta 0;
BA_ "Version" SG_ 1026 SMK_VhclSlpSta "23.10.09";
BA_ "Description" SG_ 1026 USM_SmrtSldngModSta "Current USM setting value of Smart Sliding Door mode";
BA_ "GenSigSendType" SG_ 1026 USM_SmrtSldngModSta 4;
BA_ "UserSigValidity" SG_ 1026 USM_SmrtSldngModSta 0;
BA_ "Version" SG_ 1026 USM_SmrtSldngModSta "19.01.09";
BA_ "Description" SG_ 1026 SMK_EVPwrOffReq "EV Power Off Request";
BA_ "GenSigSendType" SG_ 1026 SMK_EVPwrOffReq 4;
BA_ "TimeoutValue" SG_ 1026 SMK_EVPwrOffReq "0x0";
BA_ "UserSigValidity" SG_ 1026 SMK_EVPwrOffReq 0;
BA_ "Version" SG_ 1026 SMK_EVPwrOffReq "23.04.05";
BA_ "Description" SG_ 1026 SMK_MaintenanceSrvMdReq "Maintenance Service mode request from BDC to VCU";
BA_ "GenSigSendType" SG_ 1026 SMK_MaintenanceSrvMdReq 4;
BA_ "TimeoutValue" SG_ 1026 SMK_MaintenanceSrvMdReq "0x0";
BA_ "UserSigValidity" SG_ 1026 SMK_MaintenanceSrvMdReq 0;
BA_ "Version" SG_ 1026 SMK_MaintenanceSrvMdReq "23.07.04";
BA_ "Description" SG_ 1026 Warn_DisWrngSta3 "SMK Warnng Display signal";
BA_ "GenSigSendType" SG_ 1026 Warn_DisWrngSta3 4;
BA_ "UserSigValidity" SG_ 1026 Warn_DisWrngSta3 0;
BA_ "Version" SG_ 1026 Warn_DisWrngSta3 "24.01.03";
BA_ "Description" SG_ 1026 BDC_FD_SMK_AlvCnt3Val "For the first transmission request for a data element the counter shall be initialized with 0 and shall be incremented by 1 for every subsequent send request. 

When the counter reaches the maximum value(0xFF), then it shall restart with 0 for the next s";
BA_ "GenSigSendType" SG_ 1026 BDC_FD_SMK_AlvCnt3Val 4;
BA_ "UserSigValidity" SG_ 1026 BDC_FD_SMK_AlvCnt3Val 0;
BA_ "Version" SG_ 1026 BDC_FD_SMK_AlvCnt3Val "22.11.04";
BA_ "Description" SG_ 1026 ESCL_EsclMngrSta "ESCL manager state";
BA_ "GenSigSendType" SG_ 1026 ESCL_EsclMngrSta 4;
BA_ "UserSigValidity" SG_ 1026 ESCL_EsclMngrSta 0;
BA_ "Version" SG_ 1026 ESCL_EsclMngrSta "17.12.00";
BA_ "Description" SG_ 1026 ESCL_EsclPwrSupSta "ESCL GND & BAT supply line status";
BA_ "GenSigSendType" SG_ 1026 ESCL_EsclPwrSupSta 4;
BA_ "UserSigValidity" SG_ 1026 ESCL_EsclPwrSupSta 0;
BA_ "Version" SG_ 1026 ESCL_EsclPwrSupSta "17.12.00";
BA_ "Description" SG_ 1026 Fob_FoundExtrnlIntArea "Exterior and Interior FOB Position recognize for Approach close function";
BA_ "GenSigSendType" SG_ 1026 Fob_FoundExtrnlIntArea 4;
BA_ "UserSigValidity" SG_ 1026 Fob_FoundExtrnlIntArea 0;
BA_ "Version" SG_ 1026 Fob_FoundExtrnlIntArea "20.06.02";
BA_ "Description" SG_ 1026 ESCL_EsclEnaSta "SMK ESCL Enable output status";
BA_ "GenSigSendType" SG_ 1026 ESCL_EsclEnaSta 4;
BA_ "UserSigValidity" SG_ 1026 ESCL_EsclEnaSta 0;
BA_ "Version" SG_ 1026 ESCL_EsclEnaSta "17.12.00";
BA_ "Description" SG_ 1026 ESCL_EsclUnitSta "ESCL unit status";
BA_ "GenSigSendType" SG_ 1026 ESCL_EsclUnitSta 4;
BA_ "UserSigValidity" SG_ 1026 ESCL_EsclUnitSta 0;
BA_ "Version" SG_ 1026 ESCL_EsclUnitSta "17.12.00";
BA_ "Description" SG_ 1026 ESCL_EsclBoltSta "ESCL bolt status";
BA_ "GenSigSendType" SG_ 1026 ESCL_EsclBoltSta 4;
BA_ "UserSigValidity" SG_ 1026 ESCL_EsclBoltSta 0;
BA_ "Version" SG_ 1026 ESCL_EsclBoltSta "17.12.00";
BA_ "Description" SG_ 1026 ESCL_EsclLoBattSta "Mirror value of ESCL Low Battery bit in ESCL Status bytes";
BA_ "GenSigSendType" SG_ 1026 ESCL_EsclLoBattSta 4;
BA_ "UserSigValidity" SG_ 1026 ESCL_EsclLoBattSta 0;
BA_ "Version" SG_ 1026 ESCL_EsclLoBattSta "17.12.00";
BA_ "Description" SG_ 1026 ESCL_EsclUnLkSwSta "ESCL unlock switch status";
BA_ "GenSigSendType" SG_ 1026 ESCL_EsclUnLkSwSta 4;
BA_ "UserSigValidity" SG_ 1026 ESCL_EsclUnLkSwSta 0;
BA_ "Version" SG_ 1026 ESCL_EsclUnLkSwSta "17.12.00";
BA_ "Description" SG_ 1026 Fob_FoundRrLftArea "This Signal Indicates direction of user approach to vehicle.

If Approach Open function is enabled and user Approach to vehicle Rear Left direction, 

This signal set On.";
BA_ "GenSigSendType" SG_ 1026 Fob_FoundRrLftArea 4;
BA_ "UserSigValidity" SG_ 1026 Fob_FoundRrLftArea 0;
BA_ "Version" SG_ 1026 Fob_FoundRrLftArea "20.06.02";
BA_ "Description" SG_ 1026 Fob_FoundRrRtArea "This Signal Indicates direction of user approach to vehicle.

If Approach Open function is enabled and user Approach to vehicle Rear Right direction, 

This signal set On.";
BA_ "GenSigSendType" SG_ 1026 Fob_FoundRrRtArea 4;
BA_ "UserSigValidity" SG_ 1026 Fob_FoundRrRtArea 0;
BA_ "Version" SG_ 1026 Fob_FoundRrRtArea "20.06.02";
BA_ "Description" SG_ 1026 Warn_StrtStpBtnWrngSta "-(Old)C_SSB_Warning";
BA_ "GenSigSendType" SG_ 1026 Warn_StrtStpBtnWrngSta 4;
BA_ "UserSigValidity" SG_ 1026 Warn_StrtStpBtnWrngSta 0;
BA_ "Version" SG_ 1026 Warn_StrtStpBtnWrngSta "17.12.00";
BA_ "Description" SG_ 1026 Warn_DeActvWrngSta "-(Old)C_Deactivation_Warning";
BA_ "GenSigSendType" SG_ 1026 Warn_DeActvWrngSta 4;
BA_ "UserSigValidity" SG_ 1026 Warn_DeActvWrngSta 0;
BA_ "Version" SG_ 1026 Warn_DeActvWrngSta "17.12.00";
BA_ "Description" SG_ 1026 Warn_GearPosPWrngReq "-(Old)C_Shift_P_Warning";
BA_ "GenSigSendType" SG_ 1026 Warn_GearPosPWrngReq 4;
BA_ "UserSigValidity" SG_ 1026 Warn_GearPosPWrngReq 0;
BA_ "Version" SG_ 1026 Warn_GearPosPWrngReq "17.12.00";
BA_ "Description" SG_ 1026 Warn_ExtrnlBuzWrngSta "-(Old)C_PICWarning";
BA_ "GenSigSendType" SG_ 1026 Warn_ExtrnlBuzWrngSta 4;
BA_ "UserSigValidity" SG_ 1026 Warn_ExtrnlBuzWrngSta 0;
BA_ "Version" SG_ 1026 Warn_ExtrnlBuzWrngSta "21.11.01";
BA_ "Description" SG_ 1026 Warn_IdOutWrngSta "-(Old)C_IDOUT_WNG";
BA_ "GenSigSendType" SG_ 1026 Warn_IdOutWrngSta 4;
BA_ "UserSigValidity" SG_ 1026 Warn_IdOutWrngSta 0;
BA_ "Version" SG_ 1026 Warn_IdOutWrngSta "22.11.00";
BA_ "Description" SG_ 1026 Warn_KeyBattLoWrngSta "-(Old)C_KeyBATDischargeWarning";
BA_ "GenSigSendType" SG_ 1026 Warn_KeyBattLoWrngSta 4;
BA_ "UserSigValidity" SG_ 1026 Warn_KeyBattLoWrngSta 0;
BA_ "Version" SG_ 1026 Warn_KeyBattLoWrngSta "17.12.00";
BA_ "Description" SG_ 1026 Warn_KeyOutLmpOnReq "-(Old)C_KeyoutLpWngCluster";
BA_ "GenSigSendType" SG_ 1026 Warn_KeyOutLmpOnReq 4;
BA_ "UserSigValidity" SG_ 1026 Warn_KeyOutLmpOnReq 0;
BA_ "Version" SG_ 1026 Warn_KeyOutLmpOnReq "17.12.00";
BA_ "Description" SG_ 1026 Warn_NotGearPosPWrngSta "-(Old)C_Vehicle_not_P_Warning";
BA_ "GenSigSendType" SG_ 1026 Warn_NotGearPosPWrngSta 4;
BA_ "UserSigValidity" SG_ 1026 Warn_NotGearPosPWrngSta 0;
BA_ "Version" SG_ 1026 Warn_NotGearPosPWrngSta "17.12.00";
BA_ "Description" SG_ 1026 Warn_EsclFlWrngSta "-(Old)C_ESCL_Fail_Warning";
BA_ "GenSigSendType" SG_ 1026 Warn_EsclFlWrngSta 4;
BA_ "UserSigValidity" SG_ 1026 Warn_EsclFlWrngSta 0;
BA_ "Version" SG_ 1026 Warn_EsclFlWrngSta "17.12.00";
BA_ "Description" SG_ 1026 Warn_EsclNotLkWrngSta "-(Old)C_ESCL_Notlocked_Warning";
BA_ "GenSigSendType" SG_ 1026 Warn_EsclNotLkWrngSta 4;
BA_ "UserSigValidity" SG_ 1026 Warn_EsclNotLkWrngSta 0;
BA_ "Version" SG_ 1026 Warn_EsclNotLkWrngSta "17.12.00";
BA_ "Description" SG_ 1026 Warn_EsclNotUnLkWrngSta "-(Old)C_ESCLNotUnlockWarning";
BA_ "GenSigSendType" SG_ 1026 Warn_EsclNotUnLkWrngSta 4;
BA_ "UserSigValidity" SG_ 1026 Warn_EsclNotUnLkWrngSta 0;
BA_ "Version" SG_ 1026 Warn_EsclNotUnLkWrngSta "17.12.00";
BA_ "Description" SG_ 1026 Warn_ImmoLmpOnReq "-(Old)C_ImmoLp";
BA_ "GenSigSendType" SG_ 1026 Warn_ImmoLmpOnReq 4;
BA_ "UserSigValidity" SG_ 1026 Warn_ImmoLmpOnReq 0;
BA_ "Version" SG_ 1026 Warn_ImmoLmpOnReq "17.12.00";
BA_ "Description" SG_ 1026 Warn_DisWrngSta2 "This signal is used for a request to SMK Display Warning on CLU.";
BA_ "GenSigSendType" SG_ 1026 Warn_DisWrngSta2 4;
BA_ "UserSigValidity" SG_ 1026 Warn_DisWrngSta2 0;
BA_ "Version" SG_ 1026 Warn_DisWrngSta2 "23.07.04";
BA_ "Description" SG_ 1026 Warn_DisWrngSta "-(Old)C_PICWarningIND



*Changed Value Table ('15 1/12)

: 0x4 : Not Locked Warning → AC_Plug_Connected_Warning

for EV/PHEV SMK Warning Logic(Cranking Trial with AC Plug Connected)



*Changed Value Table('18.11/15)

: 0xF : Vehicle_is_On(FingerPrint)";
BA_ "GenSigSendType" SG_ 1026 Warn_DisWrngSta 4;
BA_ "UserSigValidity" SG_ 1026 Warn_DisWrngSta 0;
BA_ "Version" SG_ 1026 Warn_DisWrngSta "22.12.03";
BA_ "Description" SG_ 1026 SMK_OTACrankInhState "Crank inhibit control state of OTA";
BA_ "GenSigSendType" SG_ 1026 SMK_OTACrankInhState 4;
BA_ "UserSigValidity" SG_ 1026 SMK_OTACrankInhState 0;
BA_ "Version" SG_ 1026 SMK_OTACrankInhState "21.09.05";
BA_ "Description" SG_ 1026 SMK_TgltAwaySrchResult "Fob key search result response for Tailgate Away Close function";
BA_ "GenSigSendType" SG_ 1026 SMK_TgltAwaySrchResult 4;
BA_ "UserSigValidity" SG_ 1026 SMK_TgltAwaySrchResult 0;
BA_ "Version" SG_ 1026 SMK_TgltAwaySrchResult "19.01.09";
BA_ "Description" SG_ 1026 SMKFOBID_CHNAVNT "This signal is used for china AVNT personalization function.";
BA_ "GenSigSendType" SG_ 1026 SMKFOBID_CHNAVNT 4;
BA_ "UserSigValidity" SG_ 1026 SMKFOBID_CHNAVNT 0;
BA_ "NetworkRequest" SG_ 1026 SMKFOBID_CHNAVNT 0;
BA_ "NetworkRequestHoldingTime" SG_ 1026 SMKFOBID_CHNAVNT 5000;
BA_ "Version" SG_ 1026 SMKFOBID_CHNAVNT "21.07.05";
BA_ "Description" SG_ 1026 SMK_TrmnlCtrlGrpStaBDC "Mirror Value of TerminalControlGroupState(BDC)";
BA_ "GenSigSendType" SG_ 1026 SMK_TrmnlCtrlGrpStaBDC 4;
BA_ "UserSigValidity" SG_ 1026 SMK_TrmnlCtrlGrpStaBDC 0;
BA_ "Version" SG_ 1026 SMK_TrmnlCtrlGrpStaBDC "22.01.06";
BA_ "Description" SG_ 1026 SMK_TrmnlCtrlGrpStaBDCEV "Mirror Value of TerminalControlGroupState(BDC-EV)";
BA_ "GenSigSendType" SG_ 1026 SMK_TrmnlCtrlGrpStaBDCEV 4;
BA_ "UserSigValidity" SG_ 1026 SMK_TrmnlCtrlGrpStaBDCEV 0;
BA_ "Version" SG_ 1026 SMK_TrmnlCtrlGrpStaBDCEV "23.07.04";
BA_ "Description" SG_ 1026 SMK_TrmnlCtrlStaBDC "Mirror Value of TerminalControlState(BDC)";
BA_ "GenSigSendType" SG_ 1026 SMK_TrmnlCtrlStaBDC 4;
BA_ "UserSigValidity" SG_ 1026 SMK_TrmnlCtrlStaBDC 0;
BA_ "Version" SG_ 1026 SMK_TrmnlCtrlStaBDC "22.01.06";
BA_ "Description" SG_ 830 SBCM_RL_FD_Crc1Val "The data area for CRC calculation is based on the data length (DLC) of the message DB.

The CRC shall be calculated over the entire data block (excluding the CRC bytes) including the user data, alive counter and Data ID



- CRC Polynomial (0x1021) , Ini";
BA_ "GenSigSendType" SG_ 830 SBCM_RL_FD_Crc1Val 4;
BA_ "GenSigStartValue" SG_ 830 SBCM_RL_FD_Crc1Val 65535;
BA_ "UserSigValidity" SG_ 830 SBCM_RL_FD_Crc1Val 3;
BA_ "Version" SG_ 830 SBCM_RL_FD_Crc1Val "22.10.20";
BA_ "GenSigSendType" SG_ 830 USM_RLGhostDoorSta 4;
BA_ "UserSigValidity" SG_ 830 USM_RLGhostDoorSta 0;
BA_ "NetworkRequest" SG_ 830 USM_RLGhostDoorSta 0;
BA_ "NetworkRequestHoldingTime" SG_ 830 USM_RLGhostDoorSta 5000;
BA_ "Version" SG_ 830 USM_RLGhostDoorSta "21.07.07";
BA_ "GenSigSendType" SG_ 830 DoorLock_PDSLkSwSta_RL 4;
BA_ "UserSigValidity" SG_ 830 DoorLock_PDSLkSwSta_RL 0;
BA_ "NetworkRequest" SG_ 830 DoorLock_PDSLkSwSta_RL 0;
BA_ "Version" SG_ 830 DoorLock_PDSLkSwSta_RL "21.09.05";
BA_ "GenSigSendType" SG_ 830 PDS_TypeOption_RL 4;
BA_ "UserSigValidity" SG_ 830 PDS_TypeOption_RL 0;
BA_ "NetworkRequest" SG_ 830 PDS_TypeOption_RL 0;
BA_ "Version" SG_ 830 PDS_TypeOption_RL "21.07.07";
BA_ "GenSigSendType" SG_ 830 RL_CrashMRActAlarm 4;
BA_ "UserSigValidity" SG_ 830 RL_CrashMRActAlarm 0;
BA_ "NetworkRequest" SG_ 830 RL_CrashMRActAlarm 0;
BA_ "NetworkRequestHoldingTime" SG_ 830 RL_CrashMRActAlarm 5000;
BA_ "Version" SG_ 830 RL_CrashMRActAlarm "21.07.07";
BA_ "GenSigSendType" SG_ 830 PwrDRBuzzerOut_RL 4;
BA_ "UserSigValidity" SG_ 830 PwrDRBuzzerOut_RL 0;
BA_ "NetworkRequest" SG_ 830 PwrDRBuzzerOut_RL 0;
BA_ "NetworkRequestHoldingTime" SG_ 830 PwrDRBuzzerOut_RL 5000;
BA_ "Version" SG_ 830 PwrDRBuzzerOut_RL "21.07.07";
BA_ "GenSigSendType" SG_ 830 PwrDRClosingRLDrSta 4;
BA_ "UserSigValidity" SG_ 830 PwrDRClosingRLDrSta 0;
BA_ "NetworkRequest" SG_ 830 PwrDRClosingRLDrSta 0;
BA_ "NetworkRequestHoldingTime" SG_ 830 PwrDRClosingRLDrSta 5000;
BA_ "Version" SG_ 830 PwrDRClosingRLDrSta "23.07.06";
BA_ "GenSigSendType" SG_ 830 AFH_RL_FldUnfldSta 4;
BA_ "UserSigValidity" SG_ 830 AFH_RL_FldUnfldSta 0;
BA_ "NetworkRequest" SG_ 830 AFH_RL_FldUnfldSta 0;
BA_ "NetworkRequestHoldingTime" SG_ 830 AFH_RL_FldUnfldSta 5000;
BA_ "Version" SG_ 830 AFH_RL_FldUnfldSta "23.01.01";
BA_ "Description" SG_ 830 SBCM_RL_FD_AlvCnt1Val "For the first transmission request for a data element the counter shall be initialized with 0 and shall be incremented by 1 for every subsequent send request. 

When the counter reaches the maximum value(0xFF), then it shall restart with 0 for the next s";
BA_ "GenSigSendType" SG_ 830 SBCM_RL_FD_AlvCnt1Val 4;
BA_ "UserSigValidity" SG_ 830 SBCM_RL_FD_AlvCnt1Val 3;
BA_ "Version" SG_ 830 SBCM_RL_FD_AlvCnt1Val "22.10.20";
BA_ "Description" SG_ 830 DoorLock_RrLtLkOutSta_SBCM "- Door Lock or Unlock Output State 

0x0 : Off (Door lock/unlock output Off state)

0x1 : On (Door lock/unlock output On state)";
BA_ "GenSigSendType" SG_ 830 DoorLock_RrLtLkOutSta_SBCM 4;
BA_ "UserSigValidity" SG_ 830 DoorLock_RrLtLkOutSta_SBCM 0;
BA_ "NetworkRequest" SG_ 830 DoorLock_RrLtLkOutSta_SBCM 0;
BA_ "NetworkRequestHoldingTime" SG_ 830 DoorLock_RrLtLkOutSta_SBCM 5000;
BA_ "Version" SG_ 830 DoorLock_RrLtLkOutSta_SBCM "23.02.09";
BA_ "GenSigSendType" SG_ 830 RrLt_DrLkRetryFail_SBCM 4;
BA_ "TimeoutValue" SG_ 830 RrLt_DrLkRetryFail_SBCM "0x0";
BA_ "UserSigValidity" SG_ 830 RrLt_DrLkRetryFail_SBCM 0;
BA_ "NetworkRequest" SG_ 830 RrLt_DrLkRetryFail_SBCM 0;
BA_ "NetworkRequestHoldingTime" SG_ 830 RrLt_DrLkRetryFail_SBCM 5000;
BA_ "Version" SG_ 830 RrLt_DrLkRetryFail_SBCM "23.03.00";
BA_ "GenSigSendType" SG_ 830 RL_DetectObj_warn 4;
BA_ "UserSigValidity" SG_ 830 RL_DetectObj_warn 0;
BA_ "NetworkRequest" SG_ 830 RL_DetectObj_warn 0;
BA_ "NetworkRequestHoldingTime" SG_ 830 RL_DetectObj_warn 5000;
BA_ "Version" SG_ 830 RL_DetectObj_warn "23.10.11";
BA_ "GenSigSendType" SG_ 830 RLRrDrCurtainPosition 4;
BA_ "UserSigValidity" SG_ 830 RLRrDrCurtainPosition 0;
BA_ "NetworkRequest" SG_ 830 RLRrDrCurtainPosition 0;
BA_ "NetworkRequestHoldingTime" SG_ 830 RLRrDrCurtainPosition 5000;
BA_ "Version" SG_ 830 RLRrDrCurtainPosition "23.07.06";
BA_ "GenSigSendType" SG_ 830 RDC_TypeOption 4;
BA_ "UserSigValidity" SG_ 830 RDC_TypeOption 0;
BA_ "NetworkRequest" SG_ 830 RDC_TypeOption 0;
BA_ "NetworkRequestHoldingTime" SG_ 830 RDC_TypeOption 5000;
BA_ "Version" SG_ 830 RDC_TypeOption "23.07.06";
BA_ "GenSigSendType" SG_ 830 RLRrDrCurtainDownInitState 4;
BA_ "UserSigValidity" SG_ 830 RLRrDrCurtainDownInitState 0;
BA_ "NetworkRequest" SG_ 830 RLRrDrCurtainDownInitState 0;
BA_ "NetworkRequestHoldingTime" SG_ 830 RLRrDrCurtainDownInitState 5000;
BA_ "Version" SG_ 830 RLRrDrCurtainDownInitState "24.01.05";
BA_ "Description" SG_ 830 PwrDRBuzzerOut_RL_New "JG~";
BA_ "GenSigSendType" SG_ 830 PwrDRBuzzerOut_RL_New 4;
BA_ "UserSigValidity" SG_ 830 PwrDRBuzzerOut_RL_New 0;
BA_ "NetworkRequest" SG_ 830 PwrDRBuzzerOut_RL_New 0;
BA_ "NetworkRequestHoldingTime" SG_ 830 PwrDRBuzzerOut_RL_New 5000;
BA_ "Version" SG_ 830 PwrDRBuzzerOut_RL_New "24.01.05";
BA_ "Description" SG_ 830 PwrDrSta_RrLt "JG~";
BA_ "GenSigSendType" SG_ 830 PwrDrSta_RrLt 4;
BA_ "UserSigValidity" SG_ 830 PwrDrSta_RrLt 0;
BA_ "NetworkRequest" SG_ 830 PwrDrSta_RrLt 0;
BA_ "NetworkRequestHoldingTime" SG_ 830 PwrDrSta_RrLt 5000;
BA_ "Version" SG_ 830 PwrDrSta_RrLt "24.01.05";
BA_ "Description" SG_ 830 SBCM_RL_SlidePosition "DHMC_RL_SlidePosition";
BA_ "GenSigSendType" SG_ 830 SBCM_RL_SlidePosition 4;
BA_ "GenSigStartValue" SG_ 830 SBCM_RL_SlidePosition 255;
BA_ "UserSigValidity" SG_ 830 SBCM_RL_SlidePosition 0;
BA_ "NetworkRequest" SG_ 830 SBCM_RL_SlidePosition 0;
BA_ "NetworkRequestHoldingTime" SG_ 830 SBCM_RL_SlidePosition 5000;
BA_ "Version" SG_ 830 SBCM_RL_SlidePosition "24.01.05";
BA_ "Description" SG_ 830 SBCM_RL_DoorAngle "PDSM_RL_DoorAngle";
BA_ "GenSigSendType" SG_ 830 SBCM_RL_DoorAngle 4;
BA_ "GenSigStartValue" SG_ 830 SBCM_RL_DoorAngle 100;
BA_ "UserSigValidity" SG_ 830 SBCM_RL_DoorAngle 0;
BA_ "NetworkRequest" SG_ 830 SBCM_RL_DoorAngle 0;
BA_ "NetworkRequestHoldingTime" SG_ 830 SBCM_RL_DoorAngle 5000;
BA_ "Version" SG_ 830 SBCM_RL_DoorAngle "24.01.05";
BA_ "GenSigSendType" SG_ 830 RLDoorPushAlarm 4;
BA_ "UserSigValidity" SG_ 830 RLDoorPushAlarm 0;
BA_ "NetworkRequest" SG_ 830 RLDoorPushAlarm 0;
BA_ "NetworkRequestHoldingTime" SG_ 830 RLDoorPushAlarm 5000;
BA_ "Version" SG_ 830 RLDoorPushAlarm "21.07.07";
BA_ "Description" SG_ 830 RL_CrashUnlockCmd "RearLefrCrashUnlockCommand";
BA_ "GenSigSendType" SG_ 830 RL_CrashUnlockCmd 4;
BA_ "UserSigValidity" SG_ 830 RL_CrashUnlockCmd 0;
BA_ "NetworkRequest" SG_ 830 RL_CrashUnlockCmd 0;
BA_ "Version" SG_ 830 RL_CrashUnlockCmd "21.07.07";
BA_ "Description" SG_ 830 Warn_RrLftDrSwSta_SBCM "Warning Rear Left Door Switch Status";
BA_ "GenSigSendType" SG_ 830 Warn_RrLftDrSwSta_SBCM 4;
BA_ "UserSigValidity" SG_ 830 Warn_RrLftDrSwSta_SBCM 0;
BA_ "NetworkRequest" SG_ 830 Warn_RrLftDrSwSta_SBCM 0;
BA_ "Version" SG_ 830 Warn_RrLftDrSwSta_SBCM "21.09.05";
BA_ "Description" SG_ 830 DoorLock_RrLftDrUnLkSta_SBCM "Rear Left Door Unlock Status";
BA_ "GenSigSendType" SG_ 830 DoorLock_RrLftDrUnLkSta_SBCM 4;
BA_ "UserSigValidity" SG_ 830 DoorLock_RrLftDrUnLkSta_SBCM 0;
BA_ "NetworkRequest" SG_ 830 DoorLock_RrLftDrUnLkSta_SBCM 0;
BA_ "Version" SG_ 830 DoorLock_RrLftDrUnLkSta_SBCM "21.07.07";
BA_ "Description" SG_ 830 RL_SEAActivated "Rear Left SEA Activated";
BA_ "GenSigSendType" SG_ 830 RL_SEAActivated 4;
BA_ "UserSigValidity" SG_ 830 RL_SEAActivated 0;
BA_ "NetworkRequest" SG_ 830 RL_SEAActivated 0;
BA_ "Version" SG_ 830 RL_SEAActivated "21.07.07";
BA_ "Description" SG_ 830 RL_SEAWarn "RearLeftSEAWarning";
BA_ "GenSigSendType" SG_ 830 RL_SEAWarn 4;
BA_ "UserSigValidity" SG_ 830 RL_SEAWarn 0;
BA_ "NetworkRequest" SG_ 830 RL_SEAWarn 0;
BA_ "Version" SG_ 830 RL_SEAWarn "21.07.07";
BA_ "GenSigSendType" SG_ 830 RL_SEWWarn 4;
BA_ "UserSigValidity" SG_ 830 RL_SEWWarn 0;
BA_ "NetworkRequest" SG_ 830 RL_SEWWarn 0;
BA_ "Version" SG_ 830 RL_SEWWarn "21.07.07";
BA_ "GenSigSendType" SG_ 830 RL_ReleaseWarn 4;
BA_ "UserSigValidity" SG_ 830 RL_ReleaseWarn 0;
BA_ "NetworkRequest" SG_ 830 RL_ReleaseWarn 0;
BA_ "NetworkRequestHoldingTime" SG_ 830 RL_ReleaseWarn 5000;
BA_ "Version" SG_ 830 RL_ReleaseWarn "21.09.05";
BA_ "GenSigSendType" SG_ 830 RL_SWFailAlarm 4;
BA_ "UserSigValidity" SG_ 830 RL_SWFailAlarm 0;
BA_ "NetworkRequest" SG_ 830 RL_SWFailAlarm 0;
BA_ "NetworkRequestHoldingTime" SG_ 830 RL_SWFailAlarm 5000;
BA_ "Version" SG_ 830 RL_SWFailAlarm "21.07.07";
BA_ "GenSigSendType" SG_ 830 RL_ChildLock_ActnFlSta 4;
BA_ "UserSigValidity" SG_ 830 RL_ChildLock_ActnFlSta 0;
BA_ "NetworkRequest" SG_ 830 RL_ChildLock_ActnFlSta 0;
BA_ "NetworkRequestHoldingTime" SG_ 830 RL_ChildLock_ActnFlSta 5000;
BA_ "Version" SG_ 830 RL_ChildLock_ActnFlSta "21.07.07";
BA_ "GenSigSendType" SG_ 830 RL_MRActivationAlarm 4;
BA_ "UserSigValidity" SG_ 830 RL_MRActivationAlarm 0;
BA_ "NetworkRequest" SG_ 830 RL_MRActivationAlarm 0;
BA_ "NetworkRequestHoldingTime" SG_ 830 RL_MRActivationAlarm 5000;
BA_ "Version" SG_ 830 RL_MRActivationAlarm "21.07.07";
BA_ "GenSigSendType" SG_ 830 RL_ChildLock_Status 4;
BA_ "UserSigValidity" SG_ 830 RL_ChildLock_Status 0;
BA_ "NetworkRequest" SG_ 830 RL_ChildLock_Status 0;
BA_ "NetworkRequestHoldingTime" SG_ 830 RL_ChildLock_Status 5000;
BA_ "Version" SG_ 830 RL_ChildLock_Status "21.07.07";
BA_ "Description" SG_ 193 BLTN_CAM_FD_Crc1Val "The data area for CRC calculation is based on the data length (DLC) of the message DB.

The CRC shall be calculated over the entire data block (excluding the CRC bytes) including the user data, alive counter and Data ID



- CRC Polynomial (0x1021) , Ini";
BA_ "GenSigSendType" SG_ 193 BLTN_CAM_FD_Crc1Val 4;
BA_ "GenSigStartValue" SG_ 193 BLTN_CAM_FD_Crc1Val 65535;
BA_ "UserSigValidity" SG_ 193 BLTN_CAM_FD_Crc1Val 3;
BA_ "Version" SG_ 193 BLTN_CAM_FD_Crc1Val "22.11.04";
BA_ "Description" SG_ 193 BLTN_CAM_FD_AlvCnt1Val "For the first transmission request for a data element the counter shall be initialized with 0 and shall be incremented by 1 for every subsequent send request. 

When the counter reaches the maximum value(0xFF), then it shall restart with 0 for the next s";
BA_ "GenSigSendType" SG_ 193 BLTN_CAM_FD_AlvCnt1Val 4;
BA_ "UserSigValidity" SG_ 193 BLTN_CAM_FD_AlvCnt1Val 3;
BA_ "Version" SG_ 193 BLTN_CAM_FD_AlvCnt1Val "22.11.04";
BA_ "Description" SG_ 193 BLTN_CAM_UI_Mode_Tmt_Req "Built-in Cam UI Mode terminate request.";
BA_ "GenSigSendType" SG_ 193 BLTN_CAM_UI_Mode_Tmt_Req 4;
BA_ "UserSigValidity" SG_ 193 BLTN_CAM_UI_Mode_Tmt_Req 1;
BA_ "Version" SG_ 193 BLTN_CAM_UI_Mode_Tmt_Req "21.05.02";
BA_ "Description" SG_ 193 BLTN_CAM_PopUp_Req "Built-in Cam Operating and SD Card related Popup Request on HU Display.";
BA_ "GenSigSendType" SG_ 193 BLTN_CAM_PopUp_Req 4;
BA_ "UserSigValidity" SG_ 193 BLTN_CAM_PopUp_Req 0;
BA_ "Version" SG_ 193 BLTN_CAM_PopUp_Req "23.02.02";
BA_ "Description" SG_ 193 BLTN_CAM_File_List_Renew "The Storage information is renewed inform to HU.";
BA_ "GenSigSendType" SG_ 193 BLTN_CAM_File_List_Renew 4;
BA_ "UserSigValidity" SG_ 193 BLTN_CAM_File_List_Renew 1;
BA_ "Version" SG_ 193 BLTN_CAM_File_List_Renew "21.05.02";
BA_ "Description" SG_ 193 BLTN_CAM_Wifi_Pwd_Chg_State "The Response, when HU change Wifi Passowrd via SOME/IP";
BA_ "GenSigSendType" SG_ 193 BLTN_CAM_Wifi_Pwd_Chg_State 4;
BA_ "UserSigValidity" SG_ 193 BLTN_CAM_Wifi_Pwd_Chg_State 1;
BA_ "Version" SG_ 193 BLTN_CAM_Wifi_Pwd_Chg_State "21.05.04";
BA_ "Description" SG_ 193 BLTN_CAM_Dis_Touch_BeepSound "Display Touch Beep Sound of valid space touch.";
BA_ "GenSigSendType" SG_ 193 BLTN_CAM_Dis_Touch_BeepSound 4;
BA_ "UserSigValidity" SG_ 193 BLTN_CAM_Dis_Touch_BeepSound 1;
BA_ "Version" SG_ 193 BLTN_CAM_Dis_Touch_BeepSound "21.09.05";
BA_ "Description" SG_ 194 BMS_FD_Crc1Val "The data area for CRC calculation is based on the data length (DLC) of the message DB.

The CRC shall be calculated over the entire data block (excluding the CRC bytes) including the user data, alive counter and Data ID



- CRC Polynomial (0x1021) , Ini";
BA_ "GenSigSendType" SG_ 194 BMS_FD_Crc1Val 2;
BA_ "GenSigStartValue" SG_ 194 BMS_FD_Crc1Val 65535;
BA_ "UserSigValidity" SG_ 194 BMS_FD_Crc1Val 3;
BA_ "Version" SG_ 194 BMS_FD_Crc1Val "22.10.20";
BA_ "Description" SG_ 194 BMS_FD_AlvCnt1Val "For the first transmission request for a data element the counter shall be initialized with 0 and shall be incremented by 1 for every subsequent send request. 

When the counter reaches the maximum value(0xFF), then it shall restart with 0 for the next s";
BA_ "GenSigSendType" SG_ 194 BMS_FD_AlvCnt1Val 2;
BA_ "UserSigValidity" SG_ 194 BMS_FD_AlvCnt1Val 3;
BA_ "Version" SG_ 194 BMS_FD_AlvCnt1Val "22.10.20";
BA_ "Description" SG_ 194 xEV_BatEvtAlarm_HS "Battery Emergency Event Alarm Flag";
BA_ "GenSigSendType" SG_ 194 xEV_BatEvtAlarm_HS 2;
BA_ "UserSigValidity" SG_ 194 xEV_BatEvtAlarm_HS 0;
BA_ "Version" SG_ 194 xEV_BatEvtAlarm_HS "20.04.06";
BA_ "Description" SG_ 194 xEV_BMS_WakeUpReqfor12V "BMS-PDC/ICU Wake Up, PLBM Discharge Reqest Signal for12V Li-thium Battery";
BA_ "GenSigSendType" SG_ 194 xEV_BMS_WakeUpReqfor12V 2;
BA_ "UserSigValidity" SG_ 194 xEV_BMS_WakeUpReqfor12V 0;
BA_ "Version" SG_ 194 xEV_BMS_WakeUpReqfor12V "22.04.02";
BA_ "Description" SG_ 194 xEV_AuxBattChrgReq_HS "(12V Lithium Battery) Aux. Battery Charge Request Flag (HS-CAN)

LV2 Charge Request : Battery Saver

LV1 Charge Request : Auxiliary Charge";
BA_ "GenSigSendType" SG_ 194 xEV_AuxBattChrgReq_HS 2;
BA_ "UserSigValidity" SG_ 194 xEV_AuxBattChrgReq_HS 7;
BA_ "Version" SG_ 194 xEV_AuxBattChrgReq_HS "23.02.01";
BA_ "Description" SG_ 194 xEV_12VBatAlarmReq_HS "BMS-PDC/ICU 3rd Cut-off, Alarm Request for12V Li-thium Battery";
BA_ "GenSigSendType" SG_ 194 xEV_12VBatAlarmReq_HS 2;
BA_ "UserSigValidity" SG_ 194 xEV_12VBatAlarmReq_HS 0;
BA_ "Version" SG_ 194 xEV_12VBatAlarmReq_HS "21.05.01";
BA_ "Description" SG_ 1048 GNSS_Crc6Val "The data area for CRC calculation is based on the data length (DLC) of the message DB.

The CRC shall be calculated over the entire data block (excluding the CRC bytes) including the user data, alive counter and Data ID



- CRC Polynomial (0x1021) , Ini";
BA_ "GenSigStartValue" SG_ 1048 GNSS_Crc6Val 65535;
BA_ "UserSigValidity" SG_ 1048 GNSS_Crc6Val 3;
BA_ "Version" SG_ 1048 GNSS_Crc6Val "22.10.20";
BA_ "Description" SG_ 1048 HU_MM_Altitude "MSL

range = -40000 <= Value <= 1000000

unit = cm";
BA_ "UserSigValidity" SG_ 1048 HU_MM_Altitude 1;
BA_ "Version" SG_ 1048 HU_MM_Altitude "22.07.05";
BA_ "Description" SG_ 1048 GNSS_AlvCnt6Val "For the first transmission request for a data element the counter shall be initialized with 0 and shall be incremented by 1 for every subsequent send request. 

When the counter reaches the maximum value(0xFF), then it shall restart with 0 for the next s";
BA_ "UserSigValidity" SG_ 1048 GNSS_AlvCnt6Val 3;
BA_ "Version" SG_ 1048 GNSS_AlvCnt6Val "22.10.20";
BA_ "Description" SG_ 1048 HU_MM_Heading "range = 0<=Valud <360";
BA_ "UserSigValidity" SG_ 1048 HU_MM_Heading 1;
BA_ "Version" SG_ 1048 HU_MM_Heading "22.07.05";
BA_ "GenSigStartValue" SG_ 1048 GNSS_MM_type 15;
BA_ "UserSigValidity" SG_ 1048 GNSS_MM_type 1;
BA_ "Version" SG_ 1048 GNSS_MM_type "22.07.05";
BA_ "Description" SG_ 1048 HU_MM_Latitude "range = -90*1,000,000 <= Value <=90*1,000,000

unit = degree*1,000,000";
BA_ "UserSigValidity" SG_ 1048 HU_MM_Latitude 1;
BA_ "Version" SG_ 1048 HU_MM_Latitude "22.07.05";
BA_ "Description" SG_ 1048 HU_MM_Longitude "range = -180*1,000,000 <= Value <= 180*1,000,000

unit = degree*1,000,000";
BA_ "UserSigValidity" SG_ 1048 HU_MM_Longitude 1;
BA_ "Version" SG_ 1048 HU_MM_Longitude "22.07.05";
BA_ "Description" SG_ 256 EMS_Crc2Val "The data area for CRC calculation is based on the data length (DLC) of the message DB.

The CRC shall be calculated over the entire data block (excluding the CRC bytes) including the user data, alive counter and Data ID



- CRC Polynomial (0x1021) , Ini";
BA_ "GenSigStartValue" SG_ 256 EMS_Crc2Val 65535;
BA_ "UserSigValidity" SG_ 256 EMS_Crc2Val 3;
BA_ "RoutingFactor" SG_ 256 EMS_Crc2Val 5;
BA_ "Version" SG_ 256 EMS_Crc2Val "21.09.03";
BA_ "Description" SG_ 256 ACC_CrsMainSwLmpSta "This signal indicates that an ECU requests cluster to turn on/off auto-cruise control “MAIN” switch indication lamp.



This signal is for the CAN-type cluster installed vehicled only.";
BA_ "UserSigValidity" SG_ 256 ACC_CrsMainSwLmpSta 3;
BA_ "RoutingFactor" SG_ 256 ACC_CrsMainSwLmpSta 5;
BA_ "Version" SG_ 256 ACC_CrsMainSwLmpSta "17.12.00";
BA_ "Description" SG_ 256 ACC_CrsSetSwLmpSta "This signal indicates that an ECU requests cluster to turn on/off auto-cruise control “SET” switch indication lamp.



This signal is for the CAN-type cluster installed vehicled only.";
BA_ "UserSigValidity" SG_ 256 ACC_CrsSetSwLmpSta 3;
BA_ "RoutingFactor" SG_ 256 ACC_CrsSetSwLmpSta 5;
BA_ "Version" SG_ 256 ACC_CrsSetSwLmpSta "17.12.00";
BA_ "Description" SG_ 256 ENG_LV_FUP_ENA_THD "The signal indicates that the status of the pressure on fuel rail is enough high to start engine.

(LPI)";
BA_ "UserSigValidity" SG_ 256 ENG_LV_FUP_ENA_THD 3;
BA_ "RoutingFactor" SG_ 256 ENG_LV_FUP_ENA_THD 5;
BA_ "Version" SG_ 256 ENG_LV_FUP_ENA_THD "18.12.01";
BA_ "Description" SG_ 256 ENG_SoakTimeErrSta "This signal indicates that information on soak time error.";
BA_ "UserSigValidity" SG_ 256 ENG_SoakTimeErrSta 3;
BA_ "RoutingFactor" SG_ 256 ENG_SoakTimeErrSta 5;
BA_ "Version" SG_ 256 ENG_SoakTimeErrSta "17.12.00";
BA_ "Description" SG_ 256 ENG_SoakTimeVal "The Signal SOAK_TIME means the duration from Engine Ignition Off to Ignition On.";
BA_ "UserSigValidity" SG_ 256 ENG_SoakTimeVal 3;
BA_ "RoutingFactor" SG_ 256 ENG_SoakTimeVal 5;
BA_ "Version" SG_ 256 ENG_SoakTimeVal "17.12.00";
BA_ "Description" SG_ 256 ENG_SprkTimeVal "This signal indicates output value of final spark timing from ECU which reflects torque intervention requests by ESC(TCS), SCC and TCU.



Physical range:

-35.625˚ … 0˚  =  00H .. 5FH (Retard)

0.375˚ … 60˚  =  60H .. FFH (Advance) 



Conversion:";
BA_ "UserSigValidity" SG_ 256 ENG_SprkTimeVal 3;
BA_ "RoutingFactor" SG_ 256 ENG_SprkTimeVal 5;
BA_ "Version" SG_ 256 ENG_SprkTimeVal "17.12.00";
BA_ "Description" SG_ 256 ENG_MinIndTqVal "The signal TQI_MIN is the minimum engine torque (minimum air charging rate) which can be fired without misfire including compensation factors such as atmospheric pressure and temperature.

It is not enough to keep the engine running without external powe";
BA_ "UserSigValidity" SG_ 256 ENG_MinIndTqVal 3;
BA_ "RoutingFactor" SG_ 256 ENG_MinIndTqVal 5;
BA_ "Version" SG_ 256 ENG_MinIndTqVal "18.01.01";
BA_ "Description" SG_ 256 ENG_TrgtTqVal "The signal TQI_TARGET is determined by an engine torque map with input which consists of  acceleration pedal value, MAF sensor, current RPM and etc. This signal reflects driver’s demand directly. 

But it does not depend on torque interventions realised";
BA_ "UserSigValidity" SG_ 256 ENG_TrgtTqVal 3;
BA_ "RoutingFactor" SG_ 256 ENG_TrgtTqVal 5;
BA_ "Version" SG_ 256 ENG_TrgtTqVal "18.01.01";
BA_ "Description" SG_ 256 EMS_AlvCnt2Val "For the first transmission request for a data element the counter shall be initialized with 0 and shall be incremented by 1 for every subsequent send request. 

When the counter reaches the maximum value(0xFF), then it shall restart with 0 for the next s";
BA_ "UserSigValidity" SG_ 256 EMS_AlvCnt2Val 3;
BA_ "RoutingFactor" SG_ 256 EMS_AlvCnt2Val 5;
BA_ "Version" SG_ 256 EMS_AlvCnt2Val "21.09.03";
BA_ "Description" SG_ 256 ENG_MaxIndTqVal "The signal TQI_MAX is the current maximum indicated engine torque. This signal reflects the maximum engine torque under current conditions (engine speed, etc…).



Note : TQI_MAX must be transmitted actual engine torque including COT, thermal/spark effi";
BA_ "UserSigValidity" SG_ 256 ENG_MaxIndTqVal 3;
BA_ "RoutingFactor" SG_ 256 ENG_MaxIndTqVal 5;
BA_ "Version" SG_ 256 ENG_MaxIndTqVal "18.01.01";
BA_ "Description" SG_ 256 ENG_AppAccelPdlSta "This signal indicates if the driver applies the accelerator pedal. 

The signal always indicates the actual operation of the accelerator pedal, independent from SCC mode.";
BA_ "UserSigValidity" SG_ 256 ENG_AppAccelPdlSta 3;
BA_ "RoutingFactor" SG_ 256 ENG_AppAccelPdlSta 5;
BA_ "Version" SG_ 256 ENG_AppAccelPdlSta "17.12.00";
BA_ "Description" SG_ 256 ENG_BrkCtrlReq "This signal indicates that if brake control request during cruise control or speed limiter is active or not. This signal is for prevention of unwanted vehicle speed increase during cruise control or speed limiter control mode.";
BA_ "UserSigValidity" SG_ 256 ENG_BrkCtrlReq 3;
BA_ "RoutingFactor" SG_ 256 ENG_BrkCtrlReq 5;
BA_ "Version" SG_ 256 ENG_BrkCtrlReq "17.12.00";
BA_ "Description" SG_ 256 ACC_DnShftCtrlReq "This signal indicates target gear for downshift control request during cruise control or speed limiter is active or not. This signal is for prevention of unwanted vehicle speed increase during cruise control or speed limiter control mode.";
BA_ "UserSigValidity" SG_ 256 ACC_DnShftCtrlReq 3;
BA_ "RoutingFactor" SG_ 256 ACC_DnShftCtrlReq 5;
BA_ "Version" SG_ 256 ACC_DnShftCtrlReq "17.12.00";
BA_ "Description" SG_ 256 ENG_DclBrkCntrlReq "When current vehicle speed goes over set vehicle speed in the downhill during cruise control or speed limiter, ECU requests brake control to TCS with target deceleration. This is function of (Current vehicle speed - Set vehicle speed).";
BA_ "GenSigStartValue" SG_ 256 ENG_DclBrkCntrlReq 4094;
BA_ "UserSigValidity" SG_ 256 ENG_DclBrkCntrlReq 3;
BA_ "RoutingFactor" SG_ 256 ENG_DclBrkCntrlReq 5;
BA_ "Version" SG_ 256 ENG_DclBrkCntrlReq "17.12.00";
BA_ "Description" SG_ 256 ENG_BstPrsrVal "Boost pressure for Turbo engine";
BA_ "UserSigValidity" SG_ 256 ENG_BstPrsrVal 3;
BA_ "RoutingFactor" SG_ 256 ENG_BstPrsrVal 5;
BA_ "Version" SG_ 256 ENG_BstPrsrVal "17.12.00";
BA_ "Description" SG_ 256 ENG_EngOilTempVal "engine oil temperature";
BA_ "GenSigStartValue" SG_ 256 ENG_EngOilTempVal 53;
BA_ "UserSigValidity" SG_ 256 ENG_EngOilTempVal 3;
BA_ "RoutingFactor" SG_ 256 ENG_EngOilTempVal 5;
BA_ "Version" SG_ 256 ENG_EngOilTempVal "17.12.00";
BA_ "Description" SG_ 256 ENG_AmbtTempModelVal "Modeled Ambient temperature";
BA_ "GenSigStartValue" SG_ 256 ENG_AmbtTempModelVal 164;
BA_ "UserSigValidity" SG_ 256 ENG_AmbtTempModelVal 3;
BA_ "RoutingFactor" SG_ 256 ENG_AmbtTempModelVal 5;
BA_ "Version" SG_ 256 ENG_AmbtTempModelVal "17.12.00";
BA_ "Description" SG_ 256 ENG_DpfWrngSta "The signal indicates the status of the 'DPF Warning Level'";
BA_ "UserSigValidity" SG_ 256 ENG_DpfWrngSta 3;
BA_ "RoutingFactor" SG_ 256 ENG_DpfWrngSta 5;
BA_ "Version" SG_ 256 ENG_DpfWrngSta "17.12.00";
BA_ "Description" SG_ 256 ENG_BattWrngLmpSta "The signal indicates the status of the 'Battery Warning Lamp'";
BA_ "UserSigValidity" SG_ 256 ENG_BattWrngLmpSta 3;
BA_ "RoutingFactor" SG_ 256 ENG_BattWrngLmpSta 5;
BA_ "Version" SG_ 256 ENG_BattWrngLmpSta "17.12.00";
BA_ "Description" SG_ 256 ENG_OilPrsrWrngLmpSta "The signal indicates the status of the 'Oil Pressure Warning Lamp'";
BA_ "UserSigValidity" SG_ 256 ENG_OilPrsrWrngLmpSta 3;
BA_ "RoutingFactor" SG_ 256 ENG_OilPrsrWrngLmpSta 5;
BA_ "Version" SG_ 256 ENG_OilPrsrWrngLmpSta "17.12.00";
BA_ "Description" SG_ 256 ENG_IsgInhbtLmpSta "The signal indicates the status of the 'ISG Inhibit Lamp'";
BA_ "UserSigValidity" SG_ 256 ENG_IsgInhbtLmpSta 3;
BA_ "RoutingFactor" SG_ 256 ENG_IsgInhbtLmpSta 5;
BA_ "Version" SG_ 256 ENG_IsgInhbtLmpSta "17.12.00";
BA_ "Description" SG_ 256 ENG_BrkSwSta "This signal indicates that a brake switch is activated or not. When the brake switch is activated(pressed) its value is 01H otherwise its value is 00H.

If the EMS does not support this signal the value is 02H.



Physical range : 0 ... 100

Conversion :";
BA_ "GenSigStartValue" SG_ 256 ENG_BrkSwSta 1;
BA_ "UserSigValidity" SG_ 256 ENG_BrkSwSta 3;
BA_ "RoutingFactor" SG_ 256 ENG_BrkSwSta 5;
BA_ "Version" SG_ 256 ENG_BrkSwSta "18.11.00";
BA_ "Description" SG_ 256 ENG_ObdFrzFrmSta "An ECU which detects an OBD fault, requires the EMS to store a set of environmental conditions

(freeze frame). If the EMS follows this requirement it is acknowledged in OBD_FRF_ACK. Also the synchronization of OBD relevant ECUs is made by this signal:

";
BA_ "UserSigValidity" SG_ 256 ENG_ObdFrzFrmSta 3;
BA_ "RoutingFactor" SG_ 256 ENG_ObdFrzFrmSta 5;
BA_ "Version" SG_ 256 ENG_ObdFrzFrmSta "17.12.00";
BA_ "Description" SG_ 256 ENG_EngClntTempVal "Engine coolant temperature in EMS sensed via an A/D converter; converted into degrees centigrade (°C).";
BA_ "GenSigStartValue" SG_ 256 ENG_EngClntTempVal 255;
BA_ "UserSigValidity" SG_ 256 ENG_EngClntTempVal 3;
BA_ "RoutingFactor" SG_ 256 ENG_EngClntTempVal 5;
BA_ "Version" SG_ 256 ENG_EngClntTempVal "17.12.00";
BA_ "Description" SG_ 256 ENG_MafCrctVal "The altitude correction factor MAF_FAC_ALTI_MMV is calculated from division of MAF by MAF_SUB_DIAG (=limp home-value for MAF) or from AMP_AD by 1013 mbar in order to take into account different atmospheric pressures at different altitudes.



The Initial";
BA_ "GenSigStartValue" SG_ 256 ENG_MafCrctVal 128;
BA_ "UserSigValidity" SG_ 256 ENG_MafCrctVal 3;
BA_ "RoutingFactor" SG_ 256 ENG_MafCrctVal 5;
BA_ "Version" SG_ 256 ENG_MafCrctVal "17.12.00";
BA_ "Description" SG_ 256 ENG_BattDscnctSta "The signal specifies that ECU has detected a disconnection of the battery since last driving cycle, and therefore has reset the adaptive values and failure memory.

If the EMS does not support this signal the value is 00H



The failure memory erasure is";
BA_ "UserSigValidity" SG_ 256 ENG_BattDscnctSta 3;
BA_ "RoutingFactor" SG_ 256 ENG_BattDscnctSta 5;
BA_ "Version" SG_ 256 ENG_BattDscnctSta "17.12.00";
BA_ "Description" SG_ 256 OBD_MilConfgVal "The signal specifies the Configuration of the MIL Handling and Failure Memory Management by ECU.";
BA_ "GenSigStartValue" SG_ 256 OBD_MilConfgVal 3;
BA_ "UserSigValidity" SG_ 256 OBD_MilConfgVal 3;
BA_ "RoutingFactor" SG_ 256 OBD_MilConfgVal 5;
BA_ "Version" SG_ 256 OBD_MilConfgVal "17.12.00";
BA_ "Description" SG_ 256 ENG_EngSta "This signal indicates that a status of engine.";
BA_ "UserSigValidity" SG_ 256 ENG_EngSta 3;
BA_ "RoutingFactor" SG_ 256 ENG_EngSta 5;
BA_ "Version" SG_ 256 ENG_EngSta "17.12.00";
BA_ "Description" SG_ 256 ENG_Ack4EngStpSta "The signal specifies the acknowledgement of the request for the operating state 'engine stopped'.";
BA_ "UserSigValidity" SG_ 256 ENG_Ack4EngStpSta 3;
BA_ "RoutingFactor" SG_ 256 ENG_Ack4EngStpSta 5;
BA_ "Version" SG_ 256 ENG_Ack4EngStpSta "17.12.00";
BA_ "Description" SG_ 256 ENG_OverDrvOffReq "This signal indicates that auto cruise control function requests over drive off of TCU. 

In general, the over drive off request is done by hardware. (i.e. line-to-line signal between an EMS and a TCU). However, some systems may not have external over dr";
BA_ "UserSigValidity" SG_ 256 ENG_OverDrvOffReq 3;
BA_ "RoutingFactor" SG_ 256 ENG_OverDrvOffReq 5;
BA_ "Version" SG_ 256 ENG_OverDrvOffReq "17.12.00";
BA_ "Description" SG_ 256 ENG_AccActSta "EMS sends the state of the cruise control via the signal ACC_ACT. 

If the EMS does not support this signal the value is 00H



If the cruise control is activated then ACC_ACT = 1. In this period, vehicle speed control (cruise control) is performed by th";
BA_ "UserSigValidity" SG_ 256 ENG_AccActSta 3;
BA_ "RoutingFactor" SG_ 256 ENG_AccActSta 5;
BA_ "Version" SG_ 256 ENG_AccActSta "17.12.00";
BA_ "Description" SG_ 256 ENG_CltchOpSta "This signal indicates that ECU has detected an operation of a clutch. Using this signal an ISG (Idle Stop & Go) system acts as an alternator or a starter.



If the EMS does not support this signal the value is 00H";
BA_ "UserSigValidity" SG_ 256 ENG_CltchOpSta 3;
BA_ "RoutingFactor" SG_ 256 ENG_CltchOpSta 5;
BA_ "Version" SG_ 256 ENG_CltchOpSta "17.12.00";
BA_ "Description" SG_ 256 EMS_BrkReq_Slope "Brake request at slope for anti-stall";
BA_ "UserSigValidity" SG_ 256 EMS_BrkReq_Slope 3;
BA_ "RoutingFactor" SG_ 256 EMS_BrkReq_Slope 5;
BA_ "Version" SG_ 256 EMS_BrkReq_Slope "20.04.06";
BA_ "Description" SG_ 256 ENG_AccDrvAlertDisp "If EMS sends the No Auto cruise engaged status or Auto cruise Disengaged status, 

Cluster shall display the status of Auto cruise.";
BA_ "TimeoutValue" SG_ 256 ENG_AccDrvAlertDisp "0x0";
BA_ "UserSigValidity" SG_ 256 ENG_AccDrvAlertDisp 3;
BA_ "RoutingFactor" SG_ 256 ENG_AccDrvAlertDisp 5;
BA_ "Version" SG_ 256 ENG_AccDrvAlertDisp "19.12.08";
BA_ "Description" SG_ 256 DSL_GlowCtrlReq "This signal indicates that a diesel ECU requests ISS system to control glow plugs. 



If the EMS does not support this signal the value is 00H";
BA_ "UserSigValidity" SG_ 256 DSL_GlowCtrlReq 3;
BA_ "RoutingFactor" SG_ 256 DSL_GlowCtrlReq 5;
BA_ "Version" SG_ 256 DSL_GlowCtrlReq "17.12.00";
BA_ "Description" SG_ 256 ENG_GlowLmpSta "This signal indicates that a status of glow lamp.



This signal is used for a Diesel or LPI Engine alternatively.";
BA_ "GenSigStartValue" SG_ 256 ENG_GlowLmpSta 1;
BA_ "UserSigValidity" SG_ 256 ENG_GlowLmpSta 3;
BA_ "RoutingFactor" SG_ 256 ENG_GlowLmpSta 5;
BA_ "Version" SG_ 256 ENG_GlowLmpSta "17.12.00";
BA_ "Description" SG_ 256 ENG_ThrPosVal "The signal TPS is a measure of the throttle position.

The throttle position is determined via a potentiometer, which is connected mechanically to the throttle shaft. The voltage value, which is adjusted in the port via the voltage divider, is sensed in ";
BA_ "GenSigStartValue" SG_ 256 ENG_ThrPosVal 32;
BA_ "UserSigValidity" SG_ 256 ENG_ThrPosVal 3;
BA_ "RoutingFactor" SG_ 256 ENG_ThrPosVal 5;
BA_ "Version" SG_ 256 ENG_ThrPosVal "17.12.00";
BA_ "Description" SG_ 256 ENG_AccelPdlVal "The signal PV_AV_CAN is a measure of the Accelerator Pedal value.

The accelerator pedal value is determined via 2 pedal sensors, which are connected mechanically to the

accelerator pedal. If the EMS-ECU recognizes that the accelerator pedal is not acti";
BA_ "UserSigValidity" SG_ 256 ENG_AccelPdlVal 3;
BA_ "RoutingFactor" SG_ 256 ENG_AccelPdlVal 5;
BA_ "Version" SG_ 256 ENG_AccelPdlVal "18.01.01";
BA_ "Description" SG_ 1051 HU_CLOCK_Crc1Val "The data area for CRC calculation is based on the data length (DLC) of the message DB.

The CRC shall be calculated over the entire data block (excluding the CRC bytes) including the user data, alive counter and Data ID



- CRC Polynomial (0x1021) , Ini";
BA_ "GenSigSendType" SG_ 1051 HU_CLOCK_Crc1Val 4;
BA_ "GenSigStartValue" SG_ 1051 HU_CLOCK_Crc1Val 65535;
BA_ "UserSigValidity" SG_ 1051 HU_CLOCK_Crc1Val 3;
BA_ "Version" SG_ 1051 HU_CLOCK_Crc1Val "22.10.20";
BA_ "GenSigSendType" SG_ 1051 HU_DisplayYear1 4;
BA_ "GenSigStartValue" SG_ 1051 HU_DisplayYear1 3;
BA_ "UserSigValidity" SG_ 1051 HU_DisplayYear1 0;
BA_ "NetworkRequest" SG_ 1051 HU_DisplayYear1 0;
BA_ "Version" SG_ 1051 HU_DisplayYear1 "18.09.02";
BA_ "GenSigSendType" SG_ 1051 HU_DisplayYear2 4;
BA_ "GenSigStartValue" SG_ 1051 HU_DisplayYear2 255;
BA_ "UserSigValidity" SG_ 1051 HU_DisplayYear2 0;
BA_ "NetworkRequest" SG_ 1051 HU_DisplayYear2 0;
BA_ "NetworkRequestHoldingTime" SG_ 1051 HU_DisplayYear2 200;
BA_ "Version" SG_ 1051 HU_DisplayYear2 "21.07.07";
BA_ "GenSigSendType" SG_ 1051 HU_DisplayDay 4;
BA_ "GenSigStartValue" SG_ 1051 HU_DisplayDay 255;
BA_ "UserSigValidity" SG_ 1051 HU_DisplayDay 0;
BA_ "NetworkRequest" SG_ 1051 HU_DisplayDay 0;
BA_ "NetworkRequestHoldingTime" SG_ 1051 HU_DisplayDay 200;
BA_ "Version" SG_ 1051 HU_DisplayDay "21.07.07";
BA_ "GenSigSendType" SG_ 1051 HU_AM_PM_INFO 4;
BA_ "GenSigStartValue" SG_ 1051 HU_AM_PM_INFO 3;
BA_ "UserSigValidity" SG_ 1051 HU_AM_PM_INFO 0;
BA_ "NetworkRequest" SG_ 1051 HU_AM_PM_INFO 0;
BA_ "Version" SG_ 1051 HU_AM_PM_INFO "18.09.02";
BA_ "GenSigSendType" SG_ 1051 HU_ComRefresh 4;
BA_ "GenSigStartValue" SG_ 1051 HU_ComRefresh 3;
BA_ "UserSigValidity" SG_ 1051 HU_ComRefresh 0;
BA_ "NetworkRequest" SG_ 1051 HU_ComRefresh 0;
BA_ "Version" SG_ 1051 HU_ComRefresh "18.09.02";
BA_ "GenSigSendType" SG_ 1051 HU_ClockInfo 4;
BA_ "GenSigStartValue" SG_ 1051 HU_ClockInfo 3;
BA_ "UserSigValidity" SG_ 1051 HU_ClockInfo 0;
BA_ "NetworkRequest" SG_ 1051 HU_ClockInfo 0;
BA_ "Version" SG_ 1051 HU_ClockInfo "18.09.02";
BA_ "Description" SG_ 1051 HU_CLOCK_AlvCnt1Val "For the first transmission request for a data element the counter shall be initialized with 0 and shall be incremented by 1 for every subsequent send request. 

When the counter reaches the maximum value(0xFF), then it shall restart with 0 for the next s";
BA_ "GenSigSendType" SG_ 1051 HU_CLOCK_AlvCnt1Val 4;
BA_ "UserSigValidity" SG_ 1051 HU_CLOCK_AlvCnt1Val 3;
BA_ "Version" SG_ 1051 HU_CLOCK_AlvCnt1Val "22.10.20";
BA_ "GenSigSendType" SG_ 1051 HU_TimeSetting 4;
BA_ "GenSigStartValue" SG_ 1051 HU_TimeSetting 3;
BA_ "UserSigValidity" SG_ 1051 HU_TimeSetting 0;
BA_ "NetworkRequest" SG_ 1051 HU_TimeSetting 0;
BA_ "Version" SG_ 1051 HU_TimeSetting "18.09.02";
BA_ "GenSigSendType" SG_ 1051 HU_Status 4;
BA_ "GenSigStartValue" SG_ 1051 HU_Status 15;
BA_ "UserSigValidity" SG_ 1051 HU_Status 0;
BA_ "NetworkRequest" SG_ 1051 HU_Status 0;
BA_ "NetworkRequestHoldingTime" SG_ 1051 HU_Status 200;
BA_ "Version" SG_ 1051 HU_Status "21.07.07";
BA_ "GenSigSendType" SG_ 1051 HU_TimeFormat 4;
BA_ "GenSigStartValue" SG_ 1051 HU_TimeFormat 3;
BA_ "UserSigValidity" SG_ 1051 HU_TimeFormat 0;
BA_ "NetworkRequest" SG_ 1051 HU_TimeFormat 0;
BA_ "Version" SG_ 1051 HU_TimeFormat "18.09.02";
BA_ "GenSigSendType" SG_ 1051 HU_DisplayHour 4;
BA_ "GenSigStartValue" SG_ 1051 HU_DisplayHour 255;
BA_ "UserSigValidity" SG_ 1051 HU_DisplayHour 0;
BA_ "NetworkRequest" SG_ 1051 HU_DisplayHour 0;
BA_ "NetworkRequestHoldingTime" SG_ 1051 HU_DisplayHour 200;
BA_ "Version" SG_ 1051 HU_DisplayHour "21.07.07";
BA_ "GenSigSendType" SG_ 1051 HU_DisplayMinute 4;
BA_ "GenSigStartValue" SG_ 1051 HU_DisplayMinute 255;
BA_ "UserSigValidity" SG_ 1051 HU_DisplayMinute 0;
BA_ "NetworkRequest" SG_ 1051 HU_DisplayMinute 0;
BA_ "NetworkRequestHoldingTime" SG_ 1051 HU_DisplayMinute 200;
BA_ "Version" SG_ 1051 HU_DisplayMinute "21.07.07";
BA_ "GenSigSendType" SG_ 1051 HU_DisplaySecond 4;
BA_ "GenSigStartValue" SG_ 1051 HU_DisplaySecond 255;
BA_ "UserSigValidity" SG_ 1051 HU_DisplaySecond 0;
BA_ "NetworkRequest" SG_ 1051 HU_DisplaySecond 0;
BA_ "NetworkRequestHoldingTime" SG_ 1051 HU_DisplaySecond 200;
BA_ "Version" SG_ 1051 HU_DisplaySecond "21.07.07";
BA_ "GenSigSendType" SG_ 1051 HU_DisplayMonth 4;
BA_ "GenSigStartValue" SG_ 1051 HU_DisplayMonth 15;
BA_ "UserSigValidity" SG_ 1051 HU_DisplayMonth 0;
BA_ "NetworkRequest" SG_ 1051 HU_DisplayMonth 0;
BA_ "NetworkRequestHoldingTime" SG_ 1051 HU_DisplayMonth 200;
BA_ "Version" SG_ 1051 HU_DisplayMonth "21.07.07";
BA_ "Description" SG_ 1052 HU_CLU_Crc2Val "The data area for CRC calculation is based on the data length (DLC) of the message DB.

The CRC shall be calculated over the entire data block (excluding the CRC bytes) including the user data, alive counter and Data ID



- CRC Polynomial (0x1021) , Ini";
BA_ "GenSigSendType" SG_ 1052 HU_CLU_Crc2Val 4;
BA_ "GenSigStartValue" SG_ 1052 HU_CLU_Crc2Val 65535;
BA_ "UserSigValidity" SG_ 1052 HU_CLU_Crc2Val 3;
BA_ "Version" SG_ 1052 HU_CLU_Crc2Val "22.10.20";
BA_ "Description" SG_ 1052 HU_EVSupport "Notification whether EV function support or not.";
BA_ "GenSigSendType" SG_ 1052 HU_EVSupport 4;
BA_ "GenSigStartValue" SG_ 1052 HU_EVSupport 3;
BA_ "UserSigValidity" SG_ 1052 HU_EVSupport 7;
BA_ "Version" SG_ 1052 HU_EVSupport "22.06.01";
BA_ "Description" SG_ 1052 HU_DayNightState "HU(AVNT) display day and night time state (When automatically adjusted)";
BA_ "GenSigSendType" SG_ 1052 HU_DayNightState 4;
BA_ "UserSigValidity" SG_ 1052 HU_DayNightState 0;
BA_ "Version" SG_ 1052 HU_DayNightState "22.06.01";
BA_ "Description" SG_ 1052 HU_AutoBrightState_New "HU Display Brightness State(When automatically adjusted)";
BA_ "GenSigSendType" SG_ 1052 HU_AutoBrightState_New 4;
BA_ "UserSigValidity" SG_ 1052 HU_AutoBrightState_New 0;
BA_ "Version" SG_ 1052 HU_AutoBrightState_New "22.06.01";
BA_ "Description" SG_ 1052 HU_CLU_AlvCnt2Val "For the first transmission request for a data element the counter shall be initialized with 0 and shall be incremented by 1 for every subsequent send request. 

When the counter reaches the maximum value(0xFF), then it shall restart with 0 for the next s";
BA_ "GenSigSendType" SG_ 1052 HU_CLU_AlvCnt2Val 4;
BA_ "UserSigValidity" SG_ 1052 HU_CLU_AlvCnt2Val 3;
BA_ "Version" SG_ 1052 HU_CLU_AlvCnt2Val "22.10.20";
BA_ "GenSigSendType" SG_ 1052 HU_LanguageInfo 4;
BA_ "GenSigStartValue" SG_ 1052 HU_LanguageInfo 255;
BA_ "UserSigValidity" SG_ 1052 HU_LanguageInfo 1;
BA_ "NetworkRequest" SG_ 1052 HU_LanguageInfo 0;
BA_ "NetworkRequestHoldingTime" SG_ 1052 HU_LanguageInfo 5000;
BA_ "Version" SG_ 1052 HU_LanguageInfo "22.06.01";
BA_ "GenSigSendType" SG_ 1052 HU_VolumeStatus 4;
BA_ "GenSigStartValue" SG_ 1052 HU_VolumeStatus 63;
BA_ "UserSigValidity" SG_ 1052 HU_VolumeStatus 1;
BA_ "NetworkRequest" SG_ 1052 HU_VolumeStatus 0;
BA_ "Version" SG_ 1052 HU_VolumeStatus "22.06.01";
BA_ "GenSigSendType" SG_ 1052 HU_MuteStatus 4;
BA_ "GenSigStartValue" SG_ 1052 HU_MuteStatus 3;
BA_ "UserSigValidity" SG_ 1052 HU_MuteStatus 1;
BA_ "NetworkRequest" SG_ 1052 HU_MuteStatus 0;
BA_ "Version" SG_ 1052 HU_MuteStatus "22.06.01";
BA_ "Description" SG_ 1052 HU_WelcomeReady "H/U playback ready signal to play welcome/goodbye animation video.";
BA_ "GenSigSendType" SG_ 1052 HU_WelcomeReady 4;
BA_ "UserSigValidity" SG_ 1052 HU_WelcomeReady 0;
BA_ "Version" SG_ 1052 HU_WelcomeReady "22.07.05";
BA_ "GenSigSendType" SG_ 1052 HU_UsmSupport 4;
BA_ "GenSigStartValue" SG_ 1052 HU_UsmSupport 3;
BA_ "UserSigValidity" SG_ 1052 HU_UsmSupport 1;
BA_ "Version" SG_ 1052 HU_UsmSupport "22.06.01";
BA_ "GenSigSendType" SG_ 1052 HU_NaviStatus 4;
BA_ "UserSigValidity" SG_ 1052 HU_NaviStatus 1;
BA_ "NetworkRequest" SG_ 1052 HU_NaviStatus 0;
BA_ "Version" SG_ 1052 HU_NaviStatus "22.06.01";
BA_ "GenSigSendType" SG_ 1052 HU_NaviDisp 4;
BA_ "GenSigStartValue" SG_ 1052 HU_NaviDisp 3;
BA_ "UserSigValidity" SG_ 1052 HU_NaviDisp 1;
BA_ "NetworkRequest" SG_ 1052 HU_NaviDisp 0;
BA_ "Version" SG_ 1052 HU_NaviDisp "22.06.01";
BA_ "GenSigSendType" SG_ 1052 HU_BVM_Display_Message 4;
BA_ "GenSigStartValue" SG_ 1052 HU_BVM_Display_Message 7;
BA_ "UserSigValidity" SG_ 1052 HU_BVM_Display_Message 3;
BA_ "Version" SG_ 1052 HU_BVM_Display_Message "22.06.01";
BA_ "GenSigSendType" SG_ 1052 HU_NaviCamSettingStatus 4;
BA_ "GenSigStartValue" SG_ 1052 HU_NaviCamSettingStatus 255;
BA_ "UserSigValidity" SG_ 1052 HU_NaviCamSettingStatus 1;
BA_ "NetworkRequest" SG_ 1052 HU_NaviCamSettingStatus 0;
BA_ "Version" SG_ 1052 HU_NaviCamSettingStatus "22.06.01";
BA_REL_ "GenSigTimeoutTime" BU_SG_REL_ BLTN_CAM_FD SG_ 1216 HU_Type 5000;
BA_REL_ "GenSigTimeoutTime" BU_SG_REL_ BLTN_CAM_FD SG_ 1216 HU_DistributeInfo 5000;
BA_REL_ "GenSigTimeoutTime" BU_SG_REL_ BLTN_CAM_FD SG_ 1216 HU_OptionInfo 5000;
BA_REL_ "GenSigTimeoutTime" BU_SG_REL_ RCM_FD SG_ 1216 HU_OptionInfo 5000;
BA_REL_ "GenSigTimeoutTime" BU_SG_REL_ WPC2_FD SG_ 1216 HU_OptionInfo 5000;
BA_REL_ "GenSigTimeoutTime" BU_SG_REL_ CGW_CCU SG_ 955 BLTN_CAM_DEV_Count 1500;
BA_REL_ "GenSigTimeoutTime" BU_SG_REL_ CGW_CCU SG_ 955 BLTN_CAM_PMD_Count 1500;
BA_REL_ "GenSigTimeoutTime" BU_SG_REL_ CGW_CCU SG_ 955 BLTN_CAM_HU_UI_Mode 1500;
BA_REL_ "GenSigTimeoutTime" BU_SG_REL_ CGW_CCU SG_ 955 BLTN_CAM_Display 1500;
BA_REL_ "GenSigTimeoutTime" BU_SG_REL_ CGW_CCU SG_ 955 BLTN_CAM_WiFi_State 1500;
BA_REL_ "GenSigTimeoutTime" BU_SG_REL_ CGW_CCU SG_ 955 BLTN_CAM_SD_Format_Op_State 1500;
BA_REL_ "GenSigTimeoutTime" BU_SG_REL_ CGW_CCU SG_ 955 BLTN_CAM_PEV_Recorded 1500;
BA_REL_ "GenSigTimeoutTime" BU_SG_REL_ CGW_CCU SG_ 955 BLTN_CAM_PEV_Count 1500;
BA_REL_ "GenSigTimeoutTime" BU_SG_REL_ CGW_CCU SG_ 955 BLTN_CAM_Ind_Req 1500;
BA_REL_ "GenSigTimeoutTime" BU_SG_REL_ CGW_CCU SG_ 955 BLTN_CAM_LVDS_Mode_State 1500;
BA_REL_ "GenSigTimeoutTime" BU_SG_REL_ CGW_CCU SG_ 955 BLTN_CAM_PrkOp_Termiate_Info 1500;
BA_REL_ "GenSigTimeoutTime" BU_SG_REL_ CGW_CCU SG_ 955 BLTN_CAM_DEV_Recorded 1500;
BA_REL_ "GenSigTimeoutTime" BU_SG_REL_ BLTN_CAM_FD SG_ 613 HEV_BrkLtSwSta 1500;
BA_REL_ "GenSigTimeoutTime" BU_SG_REL_ ATS_FD SG_ 829 PwrDRClosingRRDrSta 1500;
BA_REL_ "GenSigTimeoutTime" BU_SG_REL_ ATS_FD SG_ 829 RR_DetectObj_warn 1500;
BA_REL_ "GenSigTimeoutTime" BU_SG_REL_ ATS_FD SG_ 829 RRRrDrCurtainPosition 1500;
BA_REL_ "GenSigTimeoutTime" BU_SG_REL_ BLTN_CAM_FD SG_ 829 RR_CrashUnlockCmd 1500;
BA_REL_ "GenSigTimeoutTime" BU_SG_REL_ ATS_FD SG_ 829 Warn_RrRtDrSwSta_SBCM 1500;
BA_REL_ "GenSigTimeoutTime" BU_SG_REL_ BLTN_CAM_FD SG_ 829 Warn_RrRtDrSwSta_SBCM 1500;
BA_REL_ "GenSigTimeoutTime" BU_SG_REL_ GW_PSU_AST_FD SG_ 829 Warn_RrRtDrSwSta_SBCM 1500;
BA_REL_ "GenSigTimeoutTime" BU_SG_REL_ GW_PSU_RR_FD SG_ 829 Warn_RrRtDrSwSta_SBCM 1500;
BA_REL_ "GenSigTimeoutTime" BU_SG_REL_ RWPC_FD SG_ 829 Warn_RrRtDrSwSta_SBCM 1500;
BA_REL_ "GenSigTimeoutTime" BU_SG_REL_ WPC2_FD SG_ 829 Warn_RrRtDrSwSta_SBCM 1500;
BA_REL_ "GenSigTimeoutTime" BU_SG_REL_ WPC_FD SG_ 829 Warn_RrRtDrSwSta_SBCM 1500;
BA_REL_ "GenSigTimeoutTime" BU_SG_REL_ ATS_FD SG_ 829 DoorLock_RrRtDrUnLkSta_SBCM 1500;
BA_REL_ "GenSigTimeoutTime" BU_SG_REL_ BLTN_CAM_FD SG_ 1026 SMK_TrmnlCtrlStaBDCEV 1500;
BA_REL_ "GenSigTimeoutTime" BU_SG_REL_ BLTN_CAM_FD SG_ 1026 SMK_TrmnlCtrlGrpStaBDC 1500;
BA_REL_ "GenSigTimeoutTime" BU_SG_REL_ BLTN_CAM_FD SG_ 1026 SMK_TrmnlCtrlGrpStaBDCEV 1500;
BA_REL_ "GenSigTimeoutTime" BU_SG_REL_ ATS_FD SG_ 830 PwrDRClosingRLDrSta 1500;
BA_REL_ "GenSigTimeoutTime" BU_SG_REL_ ATS_FD SG_ 830 RL_DetectObj_warn 1500;
BA_REL_ "GenSigTimeoutTime" BU_SG_REL_ ATS_FD SG_ 830 RLRrDrCurtainPosition 1500;
BA_REL_ "GenSigTimeoutTime" BU_SG_REL_ ATS_FD SG_ 830 RDC_TypeOption 1500;
BA_REL_ "GenSigTimeoutTime" BU_SG_REL_ BLTN_CAM_FD SG_ 830 RL_CrashUnlockCmd 1500;
BA_REL_ "GenSigTimeoutTime" BU_SG_REL_ ATS_FD SG_ 830 Warn_RrLftDrSwSta_SBCM 1500;
BA_REL_ "GenSigTimeoutTime" BU_SG_REL_ BLTN_CAM_FD SG_ 830 Warn_RrLftDrSwSta_SBCM 1500;
BA_REL_ "GenSigTimeoutTime" BU_SG_REL_ GW_PSU_AST_FD SG_ 830 Warn_RrLftDrSwSta_SBCM 1500;
BA_REL_ "GenSigTimeoutTime" BU_SG_REL_ RWPC_FD SG_ 830 Warn_RrLftDrSwSta_SBCM 1500;
BA_REL_ "GenSigTimeoutTime" BU_SG_REL_ WPC2_FD SG_ 830 Warn_RrLftDrSwSta_SBCM 1500;
BA_REL_ "GenSigTimeoutTime" BU_SG_REL_ WPC_FD SG_ 830 Warn_RrLftDrSwSta_SBCM 1500;
BA_REL_ "GenSigTimeoutTime" BU_SG_REL_ ATS_FD SG_ 830 DoorLock_RrLftDrUnLkSta_SBCM 1500;
BA_REL_ "GenSigTimeoutTime" BU_SG_REL_ CGW_CCU SG_ 193 BLTN_CAM_UI_Mode_Tmt_Req 0;
BA_REL_ "GenSigTimeoutTime" BU_SG_REL_ CGW_CCU SG_ 193 BLTN_CAM_PopUp_Req 0;
BA_REL_ "GenSigTimeoutTime" BU_SG_REL_ CGW_CCU SG_ 193 BLTN_CAM_File_List_Renew 0;
BA_REL_ "GenSigTimeoutTime" BU_SG_REL_ CGW_CCU SG_ 193 BLTN_CAM_Wifi_Pwd_Chg_State 0;
BA_REL_ "GenSigTimeoutTime" BU_SG_REL_ CGW_CCU SG_ 193 BLTN_CAM_Dis_Touch_BeepSound 0;
BA_REL_ "GenSigTimeoutTime" BU_SG_REL_ BLTN_CAM_FD SG_ 194 xEV_AuxBattChrgReq_HS 0;
BA_REL_ "GenSigTimeoutTime" BU_SG_REL_ BLTN_CAM_FD SG_ 194 xEV_12VBatAlarmReq_HS 0;
BA_REL_ "GenSigTimeoutTime" BU_SG_REL_ BLTN_CAM_FD SG_ 1048 HU_MM_Altitude 5000;
BA_REL_ "GenSigTimeoutTime" BU_SG_REL_ BLTN_CAM_FD SG_ 1048 HU_MM_Heading 5000;
BA_REL_ "GenSigTimeoutTime" BU_SG_REL_ BLTN_CAM_FD SG_ 1048 GNSS_MM_type 5000;
BA_REL_ "GenSigTimeoutTime" BU_SG_REL_ BLTN_CAM_FD SG_ 1048 HU_MM_Latitude 5000;
BA_REL_ "GenSigTimeoutTime" BU_SG_REL_ BLTN_CAM_FD SG_ 1048 HU_MM_Longitude 5000;
BA_REL_ "GenSigTimeoutTime" BU_SG_REL_ ATS_FD SG_ 1051 HU_DisplayYear1 5000;
BA_REL_ "GenSigTimeoutTime" BU_SG_REL_ BLTN_CAM_FD SG_ 1051 HU_DisplayYear1 5000;
BA_REL_ "GenSigTimeoutTime" BU_SG_REL_ ATS_FD SG_ 1051 HU_DisplayYear2 5000;
BA_REL_ "GenSigTimeoutTime" BU_SG_REL_ BLTN_CAM_FD SG_ 1051 HU_DisplayYear2 5000;
BA_REL_ "GenSigTimeoutTime" BU_SG_REL_ ATS_FD SG_ 1051 HU_DisplayDay 5000;
BA_REL_ "GenSigTimeoutTime" BU_SG_REL_ BLTN_CAM_FD SG_ 1051 HU_DisplayDay 5000;
BA_REL_ "GenSigTimeoutTime" BU_SG_REL_ ATS_FD SG_ 1051 HU_AM_PM_INFO 5000;
BA_REL_ "GenSigTimeoutTime" BU_SG_REL_ BLTN_CAM_FD SG_ 1051 HU_AM_PM_INFO 5000;
BA_REL_ "GenSigTimeoutTime" BU_SG_REL_ ATS_FD SG_ 1051 HU_ComRefresh 5000;
BA_REL_ "GenSigTimeoutTime" BU_SG_REL_ BLTN_CAM_FD SG_ 1051 HU_ComRefresh 5000;
BA_REL_ "GenSigTimeoutTime" BU_SG_REL_ ATS_FD SG_ 1051 HU_ClockInfo 5000;
BA_REL_ "GenSigTimeoutTime" BU_SG_REL_ BLTN_CAM_FD SG_ 1051 HU_ClockInfo 5000;
BA_REL_ "GenSigTimeoutTime" BU_SG_REL_ ATS_FD SG_ 1051 HU_TimeSetting 5000;
BA_REL_ "GenSigTimeoutTime" BU_SG_REL_ BLTN_CAM_FD SG_ 1051 HU_TimeSetting 5000;
BA_REL_ "GenSigTimeoutTime" BU_SG_REL_ ATS_FD SG_ 1051 HU_Status 5000;
BA_REL_ "GenSigTimeoutTime" BU_SG_REL_ BLTN_CAM_FD SG_ 1051 HU_Status 5000;
BA_REL_ "GenSigTimeoutTime" BU_SG_REL_ ATS_FD SG_ 1051 HU_TimeFormat 5000;
BA_REL_ "GenSigTimeoutTime" BU_SG_REL_ BLTN_CAM_FD SG_ 1051 HU_TimeFormat 5000;
BA_REL_ "GenSigTimeoutTime" BU_SG_REL_ ATS_FD SG_ 1051 HU_DisplayHour 5000;
BA_REL_ "GenSigTimeoutTime" BU_SG_REL_ BLTN_CAM_FD SG_ 1051 HU_DisplayHour 5000;
BA_REL_ "GenSigTimeoutTime" BU_SG_REL_ ATS_FD SG_ 1051 HU_DisplayMinute 5000;
BA_REL_ "GenSigTimeoutTime" BU_SG_REL_ BLTN_CAM_FD SG_ 1051 HU_DisplayMinute 5000;
BA_REL_ "GenSigTimeoutTime" BU_SG_REL_ ATS_FD SG_ 1051 HU_DisplaySecond 5000;
BA_REL_ "GenSigTimeoutTime" BU_SG_REL_ BLTN_CAM_FD SG_ 1051 HU_DisplaySecond 5000;
BA_REL_ "GenSigTimeoutTime" BU_SG_REL_ ATS_FD SG_ 1051 HU_DisplayMonth 5000;
BA_REL_ "GenSigTimeoutTime" BU_SG_REL_ BLTN_CAM_FD SG_ 1051 HU_DisplayMonth 5000;
BA_REL_ "GenSigTimeoutTime" BU_SG_REL_ ATS_FD SG_ 1052 HU_LanguageInfo 5000;
BA_REL_ "GenSigTimeoutTime" BU_SG_REL_ BLTN_CAM_FD SG_ 1052 HU_LanguageInfo 5000;
VAL_ 1216 HU_MON_Crc1Val 0 "0x0x0~0xFFFF:CRCValue" 65535 "0x0x0~0xFFFF:CRCValue" ;
VAL_ 1216 HU_NaviHandshakingSupport 0 "Not Support" 1 "Support" 2 "Unknown" 3 "Invalid" ;
VAL_ 1216 HU_AMP_EQVariant 0 "Default" 1 "WGN" 2 "WGN PHEV" 3 "5DR" 4 "SB" 5 "CUV" 6 "HEV" 7 "PHEV" 8 "EV" 9 "Reserved" 10 "Reserved" 11 "Reserved" 12 "Reserved" 13 "Reserved" 14 "Reserved" 15 "Reserved" 16 "Reserved" 17 "Reserved" 18 "Reserved" 19 "Reserved" 20 "Reserved" 21 "Reserved" 22 "Reserved" 23 "Reserved" 24 "Reserved" 25 "Reserved" 26 "Reserved" 27 "Reserved" 28 "Reserved" 29 "Reserved" 30 "Reserved" ;
VAL_ 1216 HU_AdasSupport 0 "Not Support" 1 "ADAS Support(General Map)" 2 "ADAS Support(Map based ADAS v1)" 3 "ADAS Support(Map based ADAS v2)" 4 "ADAS Support(Map based ADAS v2 & Handshaking)" 5 "ADAS Support(Map based ADAS v2_3)" 6 "RESERVED" 7 "Invalid" ;
VAL_ 1216 HU_MON_AlvCnt1Val 0 "0x0x0~0xFF:AlvCntValue" 255 "0x0x0~0xFF:AlvCntValue" ;
VAL_ 1216 HU_Type 0 "RESERVED" 1 "RESERVED" 2 "RESERVED" 3 "RESERVED" 4 "RESERVED" 5 "RESERVED" 6 "RESERVED" 7 "RESERVED" 8 "RESERVED" 9 "RESERVED" 10 "RESERVED" 11 "RESERVED" 12 "RESERVED" 13 "RESERVED" 14 "RESERVED" 15 "RESERVED" 16 "AVN(Tuner DVD KOR)" 17 "AVN(Tuner DVD EUR)" 18 "AVN(Tuner DVD China)" 19 "AVN(Tuner DVD Japan)" 20 "AVN(Tuner DVD EUR)" 21 "AVN(Tuner CDP KOR)" 22 "AVN(Tuner CDP EUR)" 23 "AVN(Tuner CDP China)" 24 "AVN(Tuner CDP Japan)" 25 "AVN(Tuner CDP EUR)" 26 "RESERVED" 27 "RESERVED" 28 "RESERVED" 29 "RESERVED" 30 "RESERVED" 31 "RESERVED" 32 "AVNT (Open)" 33 "AVNT (Not open)" 34 "RESERVED" 35 "RESERVED" 36 "RESERVED" 37 "RESERVED" 38 "RESERVED" 39 "RESERVED" 40 "RESERVED" 41 "RESERVED" 42 "RESERVED" 43 "RESERVED" 44 "RESERVED" 45 "RESERVED" 46 "RESERVED" 47 "RESERVED" 48 "Economic Audio" 49 "RESERVED" 50 "RESERVED" 51 "RESERVED" 52 "RESERVED" 53 "RESERVED" 54 "RESERVED" 55 "RESERVED" 56 "RESERVED" 57 "RESERVED" 58 "RESERVED" 59 "RESERVED" 60 "RESERVED" 61 "RESERVED" 62 "RESERVED" 63 "RESERVED" 64 "Standard Audio (3.0 below)" 65 "Standard Audio 4.0" 66 "STD Audio-3.0Below,No interwork" 67 "Audio 4.0 Value" 68 "RESERVED" 69 "RESERVED" 70 "RESERVED" 71 "RESERVED" 72 "RESERVED" 73 "RESERVED" 74 "RESERVED" 75 "RESERVED" 76 "RESERVED" 77 "RESERVED" 78 "RESERVED" 79 "RESERVED" 80 "AV(Tuner DVD KOR)" 81 "AV(Tuner DVD EUR)" 82 "AV(Tuner DVD China)" 83 "AV(Tuner DVD Japan)" 84 "AV(Tuner DVD EUR)" 85 "AV(Tuner CDP KOR)" 86 "AV(Tuner CDP EUR)" 87 "AV(Tuner CDP China)" 88 "AV(Tuner CDP Japan)" 89 "AV(Tuner CDP EUR)" 90 "RESERVED" 91 "RESERVED" 92 "RESERVED" 93 "RESERVED" 94 "RESERVED" 95 "RESERVED" 96 "AVN 4.0" 97 "Premium AVN2.0" 98 "EU AVN 2.0" 99 "Super Premium w Navi" 100 "Super Premium w_o Navi" 101 "Premium w Navi" 102 "Premium w_o Navi" 103 "Display Audio w_o Navi" 104 "Integrated AVN 1.0 Mobis" 105 "Gen5 Standard Nav Wide" 106 "RESERVED" 107 "RESERVED" 108 "RESERVED" 109 "RESERVED" 110 "RESERVED" 111 "RESERVED" 112 "Compact AVN & Integrated AVN 1.0 LG" 113 "RESERVED" 114 "RESERVED" 115 "RESERVED" 116 "RESERVED" 117 "RESERVED" 118 "RESERVED" 119 "RESERVED" 120 "RESERVED" 121 "RESERVED" 122 "RESERVED" 123 "RESERVED" 124 "RESERVED" 125 "RESERVED" 126 "RESERVED" 127 "RESERVED" 128 "Premium Navi 5th Gen(w_Navi)" 129 "Premium Navi 5th Gen(w_o Navi)" 130 "Premium Navi 6th Gen(w_Navi)" 131 "Premium Navi 6th Gen(w_o Navi)" 132 "ccNC(w Navi)" 133 "ccNC(w_o Navi)" 134 "ccIC(w Navi)" 135 "ccIC(w_o Navi)" 136 "RESERVED" 137 "RESERVED" 138 "RESERVED" 139 "RESERVED" 140 "RESERVED" 141 "RESERVED" 142 "RESERVED" 143 "RESERVED" 144 "P-OIP (w_Navi)" 145 "P-OIP (w_o Navi)" 146 "S-OIP (w_Navi)" 147 "S-OIP (w_o Navi)" 148 "PBV IVI (w_Navi)" 149 "PBV IVI (w_o Navi)" 150 "RESERVED" 151 "RESERVED" 152 "RESERVED" 153 "RESERVED" 154 "RESERVED" 155 "RESERVED" 156 "RESERVED" 157 "RESERVED" 158 "RESERVED" 159 "RESERVED" 160 "RESERVED" 161 "RESERVED" 162 "RESERVED" 163 "RESERVED" 164 "RESERVED" 165 "RESERVED" 166 "RESERVED" 167 "RESERVED" 168 "RESERVED" 169 "RESERVED" 170 "RESERVED" 171 "RESERVED" 172 "RESERVED" 173 "RESERVED" 174 "RESERVED" 175 "RESERVED" 176 "RESERVED" 177 "RESERVED" 178 "RESERVED" 179 "RESERVED" 180 "RESERVED" 181 "RESERVED" 182 "RESERVED" 183 "RESERVED" 184 "RESERVED" 185 "RESERVED" 186 "RESERVED" 187 "RESERVED" 188 "RESERVED" 189 "RESERVED" 190 "RESERVED" 191 "RESERVED" 192 "RESERVED" 193 "RESERVED" 194 "RESERVED" 195 "RESERVED" 196 "RESERVED" 197 "RESERVED" 198 "RESERVED" 199 "RESERVED" 200 "RESERVED" 201 "RESERVED" 202 "RESERVED" 203 "RESERVED" 204 "RESERVED" 205 "RESERVED" 206 "RESERVED" 207 "RESERVED" 208 "RESERVED" 209 "RESERVED" 210 "RESERVED" 211 "RESERVED" 212 "RESERVED" 213 "RESERVED" 214 "RESERVED" 215 "RESERVED" 216 "RESERVED" 217 "RESERVED" 218 "RESERVED" 219 "RESERVED" 220 "RESERVED" 221 "RESERVED" 222 "RESERVED" 223 "RESERVED" 224 "RESERVED" 225 "RESERVED" 226 "RESERVED" 227 "RESERVED" 228 "RESERVED" 229 "RESERVED" 230 "RESERVED" 231 "RESERVED" 232 "RESERVED" 233 "RESERVED" 234 "RESERVED" 235 "RESERVED" 236 "RESERVED" 237 "RESERVED" 238 "India PIO w_o CLU interface" 239 "India PIO w_CLU interface" 240 "RESERVED" 241 "Gen 1 China OEM Navigation" 242 "RESERVED" 243 "RESERVED" 244 "RESERVED" 245 "RESERVED" 246 "RESERVED" 247 "RESERVED" 248 "RESERVED" 249 "RESERVED" 250 "PIO AVN" 251 "China  Local OEM Display Audio" 252 "China OPIO w_o CLU interface" 253 "China OPIO w_CLU interface" 254 "China Local OEM AVNT" 255 "Invalid" ;
VAL_ 1216 HU_Navi_RspADASMapMsg 0 "0x0x0~0xFFFF:Refer to Signal Description" 65535 "0x0x0~0xFFFF:Refer to Signal Description" ;
VAL_ 1216 HU_DistributeInfo 0 "Default (Korea)" 1 "Korea" 2 "North America" 3 "Canada" 4 "East Europe" 5 "West Europe" 6 "China" 7 "India" 8 "Australia" 9 "Middle East" 10 "Africa" 11 "South America" 12 "Russia" 13 "Japan" 14 "General" 15 "0x0F~0xFE:RESERVED" 254 "0x0F~0xFE:RESERVED" 255 "Invalid" ;
VAL_ 1216 HU_OptionInfo 0 "0x0x0000~0x01FF:Bit allocation" 511 "0x0x0000~0x01FF:Bit allocation" 512 "0x0200~0x7FFF:RESERVED" 32767 "0x0200~0x7FFF:RESERVED" 32768 "Invalid" 32769 "0x8001~0xFFFF:Not used" 65535 "0x8001~0xFFFF:Not used" ;
VAL_ 955 BLTN_CAM_FD_HU_Crc1Val 0 "0x0x0~0xFFFF:CRCValue" 65535 "0x0x0~0xFFFF:CRCValue" ;
VAL_ 955 BLTN_CAM_DEV_Count 0 "0x0x0~0xC8:the number of the Drive Event Record(0~200)" 200 "0x0x0~0xC8:the number of the Drive Event Record(0~200)" 201 "RESERVED" 202 "RESERVED" 203 "RESERVED" 204 "RESERVED" 205 "RESERVED" 206 "RESERVED" 207 "RESERVED" 208 "RESERVED" 209 "RESERVED" 210 "RESERVED" 211 "RESERVED" 212 "RESERVED" 213 "RESERVED" 214 "RESERVED" 215 "RESERVED" 216 "RESERVED" 217 "RESERVED" 218 "RESERVED" 219 "RESERVED" 220 "RESERVED" 221 "RESERVED" 222 "RESERVED" 223 "RESERVED" 224 "RESERVED" 225 "RESERVED" 226 "RESERVED" 227 "RESERVED" 228 "RESERVED" 229 "RESERVED" 230 "RESERVED" 231 "RESERVED" 232 "RESERVED" 233 "RESERVED" 234 "RESERVED" 235 "RESERVED" 236 "RESERVED" 237 "RESERVED" 238 "RESERVED" 239 "RESERVED" 240 "RESERVED" 241 "RESERVED" 242 "RESERVED" 243 "RESERVED" 244 "RESERVED" 245 "RESERVED" 246 "RESERVED" 247 "RESERVED" 248 "RESERVED" 249 "RESERVED" 250 "RESERVED" 251 "RESERVED" 252 "RESERVED" 254 "the drive event record is not recordable" 255 "Invalid" ;
VAL_ 955 BLTN_CAM_FD_HU_AlvCnt1Val 0 "0x0x0~0xFF:AlvCntValue" 255 "0x0x0~0xFF:AlvCntValue" ;
VAL_ 955 BLTN_CAM_PMD_Count 0 "0x0x0~0xC8:the number of the Park Event Record(0~200) in condition of set to PMD On" 200 "0x0x0~0xC8:the number of the Park Event Record(0~200) in condition of set to PMD On" 201 "RESERVED" 202 "RESERVED" 203 "RESERVED" 204 "RESERVED" 205 "RESERVED" 206 "RESERVED" 207 "RESERVED" 208 "RESERVED" 209 "RESERVED" 210 "RESERVED" 211 "RESERVED" 212 "RESERVED" 213 "RESERVED" 214 "RESERVED" 215 "RESERVED" 216 "RESERVED" 217 "RESERVED" 218 "RESERVED" 219 "RESERVED" 220 "RESERVED" 221 "RESERVED" 222 "RESERVED" 223 "RESERVED" 224 "RESERVED" 225 "RESERVED" 226 "RESERVED" 227 "RESERVED" 228 "RESERVED" 229 "RESERVED" 230 "RESERVED" 231 "RESERVED" 232 "RESERVED" 233 "RESERVED" 234 "RESERVED" 235 "RESERVED" 236 "RESERVED" 237 "RESERVED" 238 "RESERVED" 239 "RESERVED" 240 "RESERVED" 241 "RESERVED" 242 "RESERVED" 243 "RESERVED" 244 "RESERVED" 245 "RESERVED" 246 "RESERVED" 247 "RESERVED" 248 "RESERVED" 249 "RESERVED" 250 "RESERVED" 251 "RESERVED" 252 "RESERVED" 253 "Over than 200 count" 254 "PMD is not set" 255 "Invalid" ;
VAL_ 955 BLTN_CAM_HU_UI_Mode 0 "HU UI mode." 1 "BLTN_CAM mode" 2 "Preparing BLTN_CAM Mode" 3 "BLTN_CAM Setting Mode" 4 "RESERVED" 5 "RESERVED" 6 "RESERVED" 7 "RESERVED" 8 "RESERVED" 9 "RESERVED" 10 "RESERVED" 11 "RESERVED" 12 "RESERVED" 13 "BLTN_CAM Not Ready to be HU UI Mode" 14 "BLTN_CAM is in Error mode." 15 "Invalid" ;
VAL_ 955 BLTN_CAM_Display 0 "HU mode" 1 "Built-in Cam mode" 2 "popup mode" 3 "Built-in Cam mode Terminate Request by Home-button" 4 "Built-in Cam mode Terminate Request by Back-button" 5 "Built-in Cam update mode" 6 "Ready to update" 7 "Update complete" 8 "USB removed" 9 "Update fail (USB error)" 10 "Reserved" 11 "Reserved" 12 "Reserved" 13 "Reserved" 14 "Built-in Cam is in error mode" 15 "Invalid" ;
VAL_ 955 BLTN_CAM_WiFi_State 0 "Off" 1 "On, Ready to Connect Mobile Phone." 2 "On, Mobile Phone Connected." 3 "Off - Password is not Set." 4 "Reserved" 5 "Reserved" 6 "Reserved" 7 "Reserved" 8 "Reserved" 9 "Reserved" 10 "Reserved" 11 "Reserved" 12 "Reserved" 13 "Reserved" 14 "Reserved" 15 "invalid" ;
VAL_ 955 BLTN_CAM_SD_Format_Op_State 0 "Default" 1 "Formatting" 2 "Format Complete." 3 "invalid" ;
VAL_ 955 BLTN_CAM_PEV_Recorded 0 "Default" 1 "Off" 2 "Park Event Recorded" 3 "invalid" ;
VAL_ 955 BLTN_CAM_PEV_Count 0 "0x0x0~0xC8:the number of the Park Event Record(0~200)" 200 "0x0x0~0xC8:the number of the Park Event Record(0~200)" 201 "Reserved" 202 "Reserved" 203 "Reserved" 204 "Reserved" 205 "Reserved" 206 "Reserved" 207 "Reserved" 208 "Reserved" 209 "Reserved" 210 "Reserved" 211 "Reserved" 212 "Reserved" 213 "Reserved" 214 "Reserved" 215 "Reserved" 216 "Reserved" 217 "Reserved" 218 "Reserved" 219 "Reserved" 220 "Reserved" 221 "Reserved" 222 "Reserved" 223 "Reserved" 224 "Reserved" 225 "Reserved" 226 "Reserved" 227 "Reserved" 228 "Reserved" 229 "Reserved" 230 "Reserved" 231 "Reserved" 232 "Reserved" 233 "Reserved" 234 "Reserved" 235 "Reserved" 236 "Reserved" 237 "Reserved" 238 "Reserved" 239 "Reserved" 240 "Reserved" 241 "Reserved" 242 "Reserved" 243 "Reserved" 244 "Reserved" 245 "Reserved" 246 "Reserved" 247 "Reserved" 248 "Reserved" 249 "Reserved" 250 "Reserved" 251 "Reserved" 252 "Reserved" 253 "Over than 200 count" 254 "the park event record is not recorded" 255 "invalid" ;
VAL_ 955 BLTN_CAM_Ind_Req 0 "Default" 1 "Built-in Cam System or Camera Error" 2 "Manual Recording or Event Recording" 3 "Time-lapse Recording" 4 "Built-in Cam SD Card Replace Warning or SD Card Error" 5 "On while Driving Recording" 6 "On while Parked Recording" 7 "Smartphone Connected" 8 "RESERVED" 9 "RESERVED" 10 "RESERVED" 11 "RESERVED" 12 "RESERVED" 13 "RESERVED" 14 "RESERVED" 15 "RESERVED" 16 "RESERVED" 17 "RESERVED" 18 "RESERVED" 19 "RESERVED" 20 "RESERVED" 21 "RESERVED" 22 "RESERVED" 23 "RESERVED" 24 "RESERVED" 25 "RESERVED" 26 "RESERVED" 27 "RESERVED" 28 "RESERVED" 29 "RESERVED" 30 "RESERVED" 31 "Invalid" ;
VAL_ 955 BLTN_CAM_LVDS_Mode_State 0 "Front and Rear Camera" 1 "Front Camera for AR Navi." 2 "Built-In Cam Engineer Mode" 3 "Reserved" ;
VAL_ 955 BLTN_CAM_PrkOp_Termiate_Info 0 "Default" 1 "Park operation terminated earlier than user set because of Bat. SoC" 2 "Park operation terminated earlier than user set because of SD Card Problem" 3 "Park operation terminated earlier than user set because of Built-in Cam internal Error" 4 "Park operation terminated earlier than user set because of SD Card removed or not detected" 5 "Park operation started because of SD Card inserted" 6 "Park operation terminate on time which user set." 7 "Invalid" ;
VAL_ 955 BLTN_CAM_DEV_Recorded 0 "Default" 1 "Off" 2 "Drive Event Recorded" 3 "Invalid" ;
VAL_ 613 EMS_Crc8Val 0 "0x0x0~0xFFFF:CRCValue" 65535 "0x0x0~0xFFFF:CRCValue" ;
VAL_ 613 HEV_WarmUpReq_For_DATC 0 "Engine stop request" 1 "No engine stop request" ;
VAL_ 613 EMS_AlvCnt8Val 0 "0x0x0~0xFF:AlvCntValue" 255 "0x0x0~0xFF:AlvCntValue" ;
VAL_ 613 HEV_RbmInhbtSta 0 "Enable of standardized vehicle operation and all numerators_denominators for RBM" 1 "Inhibition of standardized vehicle operation and all numerators_denominators for RBM" 2 "Not used" 3 "Error indicator" ;
VAL_ 613 HEV_EhrsTempSta 0 "Normal" 1 "High" 3 "Fault" ;
VAL_ 613 HEV_Aaf_WrnLamp 0 "Lamp OFF" 1 "Lamp ON" ;
VAL_ 613 HEV_OPSFail 0 "Oil Pressure Warning Lamp OFF" 1 "Oil Pressure Warning Lamp ON" ;
VAL_ 613 HEV_EngDsplceTyp 255 "Error indicator" ;
VAL_ 613 HEV_EngTyp2 0 "LPI" 1 "MPI" 2 "GDI" 3 "TGDI" 4 "CVVL" 5 "CVVD" 6 "PDI" 7 "FFV" 8 "TCI" 9 "VGT" 10 "Turbo" 14 "Not used" 15 "Error indicator" ;
VAL_ 613 HEV_EngTyp1 0 "epsilon(ε)" 1 "gamma(γ)" 2 "kappa(κ)" 3 "theta(θ)" 4 "nu(ν)" 5 "lambda(λ)" 6 "tau(τ)" 10 "S" 11 "A" 12 "R" 13 "U" 14 "D" 15 "Error indicator" ;
VAL_ 613 HEV_S_F 0 "AMS" 1 "ISG" 2 "Reserved" 3 "Reserved" ;
VAL_ 613 HEV_S_F_GEN 0 "No AMS" 1 "1G Generation AMS" 2 "1.5G Generation AMS" 3 "2G Generation AMS" 4 "Reserved" 5 "Reserved" 6 "Reserved" 7 "Reserved" ;
VAL_ 613 HEV_RECTrigSta 0 "No detected" 1 "REC detected" ;
VAL_ 613 HEV_PendingTrigSta 0 "No detected" 1 "Pending detected" ;
VAL_ 613 HEV_OilLifeRatio 1 "Engine oil life ratio with % unit" 2 "Engine oil life ratio with % unit" 3 "Engine oil life ratio with % unit" 4 "Engine oil life ratio with % unit" 5 "Engine oil life ratio with % unit" 6 "Engine oil life ratio with % unit" 7 "Engine oil life ratio with % unit" 8 "Engine oil life ratio with % unit" 9 "Engine oil life ratio with % unit" 10 "Engine oil life ratio with % unit" 11 "Engine oil life ratio with % unit" 12 "Engine oil life ratio with % unit" 13 "Engine oil life ratio with % unit" 14 "Engine oil life ratio with % unit" 15 "Engine oil life ratio with % unit" 16 "Engine oil life ratio with % unit" 17 "Engine oil life ratio with % unit" 18 "Engine oil life ratio with % unit" 19 "Engine oil life ratio with % unit" 20 "Engine oil life ratio with % unit" 21 "Engine oil life ratio with % unit" 22 "Engine oil life ratio with % unit" 23 "Engine oil life ratio with % unit" 24 "Engine oil life ratio with % unit" 25 "Engine oil life ratio with % unit" 26 "Engine oil life ratio with % unit" 27 "Engine oil life ratio with % unit" 28 "Engine oil life ratio with % unit" 29 "Engine oil life ratio with % unit" 30 "Engine oil life ratio with % unit" 31 "Engine oil life ratio with % unit" 32 "Engine oil life ratio with % unit" 33 "Engine oil life ratio with % unit" 34 "Engine oil life ratio with % unit" 35 "Engine oil life ratio with % unit" 36 "Engine oil life ratio with % unit" 37 "Engine oil life ratio with % unit" 38 "Engine oil life ratio with % unit" 39 "Engine oil life ratio with % unit" 40 "Engine oil life ratio with % unit" 41 "Engine oil life ratio with % unit" 42 "Engine oil life ratio with % unit" 43 "Engine oil life ratio with % unit" 44 "Engine oil life ratio with % unit" 45 "Engine oil life ratio with % unit" 46 "Engine oil life ratio with % unit" 47 "Engine oil life ratio with % unit" 48 "Engine oil life ratio with % unit" 49 "Engine oil life ratio with % unit" 50 "Engine oil life ratio with % unit" 51 "Engine oil life ratio with % unit" 52 "Engine oil life ratio with % unit" 53 "Engine oil life ratio with % unit" 54 "Engine oil life ratio with % unit" 55 "Engine oil life ratio with % unit" 56 "Engine oil life ratio with % unit" 57 "Engine oil life ratio with % unit" 58 "Engine oil life ratio with % unit" 59 "Engine oil life ratio with % unit" 60 "Engine oil life ratio with % unit" 61 "Engine oil life ratio with % unit" 62 "Engine oil life ratio with % unit" 63 "Engine oil life ratio with % unit" 64 "Engine oil life ratio with % unit" 65 "Engine oil life ratio with % unit" 66 "Engine oil life ratio with % unit" 67 "Engine oil life ratio with % unit" 68 "Engine oil life ratio with % unit" 69 "Engine oil life ratio with % unit" 70 "Engine oil life ratio with % unit" 71 "Engine oil life ratio with % unit" 72 "Engine oil life ratio with % unit" 73 "Engine oil life ratio with % unit" 74 "Engine oil life ratio with % unit" 75 "Engine oil life ratio with % unit" 76 "Engine oil life ratio with % unit" 77 "Engine oil life ratio with % unit" 78 "Engine oil life ratio with % unit" 79 "Engine oil life ratio with % unit" 80 "Engine oil life ratio with % unit" 81 "Engine oil life ratio with % unit" 82 "Engine oil life ratio with % unit" 83 "Engine oil life ratio with % unit" 84 "Engine oil life ratio with % unit" 85 "Engine oil life ratio with % unit" 86 "Engine oil life ratio with % unit" 87 "Engine oil life ratio with % unit" 88 "Engine oil life ratio with % unit" 89 "Engine oil life ratio with % unit" 90 "Engine oil life ratio with % unit" 91 "Engine oil life ratio with % unit" 92 "Engine oil life ratio with % unit" 93 "Engine oil life ratio with % unit" 94 "Engine oil life ratio with % unit" 95 "Engine oil life ratio with % unit" 96 "Engine oil life ratio with % unit" 97 "Engine oil life ratio with % unit" 98 "Engine oil life ratio with % unit" 99 "Engine oil life ratio with % unit" 100 "Engine oil life ratio with % unit" 101 "Not used" 102 "Not used" 103 "Not used" 104 "Not used" 105 "Not used" 106 "Not used" 107 "Not used" 108 "Not used" 109 "Not used" 110 "Not used" 111 "Not used" 112 "Not used" 113 "Not used" 114 "Not used" 115 "Not used" 116 "Not used" 117 "Not used" 118 "Not used" 119 "Not used" 120 "Not used" 121 "Not used" 122 "Not used" 123 "Not used" 124 "Not used" 125 "Not used" 126 "Not used" 127 "Error" ;
VAL_ 613 HEV_OilLifeEna 0 "Oil life monitoring Not applied" 1 "Oil life monitoring Applied" 2 "Reserved" 3 "Error" ;
VAL_ 613 HEV_OilLifeWarn 0 "No display" 1 "'Change engine oil' warning, 1st step (Low urgency)" 2 "'Change engine oil' warning, 2nd step (High urgency)" 3 "Oil change question based on oil temperature" 4 "Oil change confirm based on oil temperature" 5 "Reserved" 6 "Reserved" 7 "Error" ;
VAL_ 613 HEV_VbOffActSta 0 "VB Off not Act" 1 "VB Off Act" 2 "Not used" 3 "Error indicator" ;
VAL_ 613 HEV_AirCompOffReq 0 "none" 1 "off request" 2 "Not used" 3 "Error indicator" ;
VAL_ 613 HEV_MilConfgVal 0 "No MIL" 1 "MIL/FMY treatment OBD1" 2 "MIL/FMY treatment OBD2" 3 "MIL/FMY treatment OBD2 (US)" 4 "MIL/FMY treatment EOBD" 5 "MIL/FMY treatment KOBD" ;
VAL_ 613 HEV_CF_EMS_LOCKUP 0 "Request Off" 1 "Request On" ;
VAL_ 613 HEV_OilLvlSta 0 "OIL LEVEL LAMP Off" 1 "OIL LEVEL LAMP On" 2 "Not used" 3 "Error indicator" ;
VAL_ 613 HEV_ImmoLmpReq 0 "Off" 1 "Blink" 2 "On" 3 "Error indicator" ;
VAL_ 613 HEV_MilReq 0 "Off" 1 "On" 2 "Not used" 3 "Error indicator" ;
VAL_ 613 HEV_WiperSwSta 0 "Off" 1 "On" 2 "Not used" 3 "Error indicator" ;
VAL_ 613 HEV_FanOpSta 0 "Off" 1 "On" 2 "Not used" 3 "Error indicator" ;
VAL_ 613 HEV_FanSta 0 "Off" 1 "Low" 2 "Middle" 3 "High" ;
VAL_ 613 HEV_BrkLtSwSta 0 "Not Support" 1 "Off" 2 "On" 3 "failure" ;
VAL_ 613 HEV_SoakTimeErrSta 0 "No failure detected" 1 "Failure detected" 2 "Not used" 3 "Error indicator" ;
VAL_ 613 HEV_SoakTimeOvrSta 0 "Engine soaking time < 360 min" 1 "Engine soaking time ≥ 360 min" 2 "Not used" 3 "Error indicator" ;
VAL_ 613 HEV_FuelRunOutSta 0 "None" 1 "Fuel RunOut" 2 "Not used" 3 "Error indicator" ;
VAL_ 613 HEV_FuelRunOutDetSta 0 "Inactive" 1 "Active" 2 "Not used" 3 "Error indicator" ;
VAL_ 829 SBCM_RR_FD_Crc1Val 0 "0x0x0~0xFFFF:CRCValue" 65535 "0x0x0~0xFFFF:CRCValue" ;
VAL_ 829 USM_RRGhostDoorSta 0 "Default" 1 "Off" 2 "On" 3 "RESERVED" ;
VAL_ 829 DoorLock_PDSLkSwSta_RR 0 "Lock" 1 "Unlock" 2 "RESERVED" 3 "Error Indicator" ;
VAL_ 829 PDS_TypeOption_RR 0 "Off" 1 "On" 2 "RESERVED" 3 "Error Indicator" ;
VAL_ 829 RR_CrashMRActAlarm 0 "Off" 1 "On" 2 "RESERVED" 3 "Error Indicator" ;
VAL_ 829 PwrDRBuzzerOut_RR 0 "OFF" 1 "Open" 2 "Close" 3 "Warning" ;
VAL_ 829 PwrDRClosingRRDrSta 0 "Default" 1 "Close" 2 "Open" 3 "Stop(during Close)" 4 "Stop(during Open)" 5 "RESERVED" 6 "RESERVED" 7 "Invalid" ;
VAL_ 829 AFH_RR_FldUnfldSta 0 "Invalid" 1 "Fold" 2 "Unfold" 3 "Inprogress" ;
VAL_ 829 SBCM_RR_FD_AlvCnt1Val 0 "0x0x0~0xFF:AlvCntValue" 255 "0x0x0~0xFF:AlvCntValue" ;
VAL_ 829 DoorLock_RrRtLkOutSta_SBCM 0 "Off" 1 "On" 2 "Not Used" 3 "Error Indicator" ;
VAL_ 829 RrRt_DrLkRetryFail_SBCM 0 "Normal" 1 "Fail" 2 "RESERVED" 3 "RESERVED" ;
VAL_ 829 RR_DetectObj_warn 0 "Detect Warning OFF" 1 "Detect Warning ON" 2 "RESERVED" 3 "RESERVED" ;
VAL_ 829 RRRrDrCurtainPosition 0 "Unkown" 1 "Bottom" 2 "Mid" 3 "Top" ;
VAL_ 829 RRRrDrCurtainDownInitState 0 "Decalibrated" 1 "Calibrated" 2 "RESERVED" 3 "Error Indicator" ;
VAL_ 829 PwrDrSta_RrRt 0 "Unavailable" 1 "Available" 2 "RESERVED" 3 "Error Indicator" ;
VAL_ 829 PwrDRBuzzerOut_RR_New 0 "OFF" 1 "Open" 2 "Close" 3 "Warning1" 4 "Warning2" ;
VAL_ 829 SBCM_RR_SlidePosition 0 "0x0x0~0x64:0% - 100%" 100 "0x0x0~0x64:0% - 100%" 101 "0x65~0xFE:RESERVED" 254 "0x65~0xFE:RESERVED" 255 "Unknown" ;
VAL_ 829 SBCM_RR_DoorAngle 0 "0° - 90°" 1 "0° - 90°" 2 "0° - 90°" 3 "0° - 90°" 4 "0° - 90°" 5 "0° - 90°" 6 "0° - 90°" 7 "0° - 90°" 8 "0° - 90°" 9 "0° - 90°" 10 "0° - 90°" 11 "0° - 90°" 12 "0° - 90°" 13 "0° - 90°" 14 "0° - 90°" 15 "0° - 90°" 16 "0° - 90°" 17 "0° - 90°" 18 "0° - 90°" 19 "0° - 90°" 20 "0° - 90°" 21 "0° - 90°" 22 "0° - 90°" 23 "0° - 90°" 24 "0° - 90°" 25 "0° - 90°" 26 "0° - 90°" 27 "0° - 90°" 28 "0° - 90°" 29 "0° - 90°" 30 "0° - 90°" 31 "0° - 90°" 32 "0° - 90°" 33 "0° - 90°" 34 "0° - 90°" 35 "0° - 90°" 36 "0° - 90°" 37 "0° - 90°" 38 "0° - 90°" 39 "0° - 90°" 40 "0° - 90°" 41 "0° - 90°" 42 "0° - 90°" 43 "0° - 90°" 44 "0° - 90°" 45 "0° - 90°" 46 "0° - 90°" 47 "0° - 90°" 48 "0° - 90°" 49 "0° - 90°" 50 "0° - 90°" 51 "0° - 90°" 52 "0° - 90°" 53 "0° - 90°" 54 "0° - 90°" 55 "0° - 90°" 56 "0° - 90°" 57 "0° - 90°" 58 "0° - 90°" 59 "0° - 90°" 60 "0° - 90°" 61 "0° - 90°" 62 "0° - 90°" 63 "0° - 90°" 64 "0° - 90°" 65 "0° - 90°" 66 "0° - 90°" 67 "0° - 90°" 68 "0° - 90°" 69 "0° - 90°" 70 "0° - 90°" 71 "0° - 90°" 72 "0° - 90°" 73 "0° - 90°" 74 "0° - 90°" 75 "0° - 90°" 76 "0° - 90°" 77 "0° - 90°" 78 "0° - 90°" 79 "0° - 90°" 80 "0° - 90°" 81 "0° - 90°" 82 "0° - 90°" 83 "0° - 90°" 84 "0° - 90°" 85 "0° - 90°" 86 "0° - 90°" 87 "0° - 90°" 88 "0° - 90°" 89 "0° - 90°" 90 "0° - 90°" 91 "Invalid" 92 "Invalid" 93 "Invalid" 94 "Invalid" 95 "Invalid" 96 "Invalid" 97 "Invalid" 98 "Invalid" 99 "Invalid" 100 "Unknown" 101 "Invalid" 102 "Invalid" 103 "Invalid" 104 "Invalid" 105 "Invalid" 106 "Invalid" 107 "Invalid" 108 "Invalid" 109 "Invalid" 110 "Invalid" 111 "Invalid" 112 "Invalid" 113 "Invalid" 114 "Invalid" 115 "Invalid" 116 "Invalid" 117 "Invalid" 118 "Invalid" 119 "Invalid" 120 "Invalid" 121 "Invalid" 122 "Invalid" 123 "Invalid" 124 "Invalid" 125 "Invalid" 126 "Invalid" 127 "Invalid" ;
VAL_ 829 RRDoorPushAlarm 0 "Off" 1 "On" 2 "RESERVED" 3 "Error Indicator" ;
VAL_ 829 RR_CrashUnlockCmd 0 "Off" 1 "Unlock (Crash)" ;
VAL_ 829 Warn_RrRtDrSwSta_SBCM 0 "Close" 1 "Open" 2 "RESERVED" 3 "Error Indicator" ;
VAL_ 829 DoorLock_RrRtDrUnLkSta_SBCM 0 "Lock" 1 "Unlock" 2 "RESERVED" 3 "Error Indicator" ;
VAL_ 829 RR_SEAActivated 0 "InActivated" 1 "Activated" 2 "RESERVED" 3 "Error Indicator" ;
VAL_ 829 RR_SEAWarn 0 "SEA Right Warning OFF" 1 "SEA Right Warning ON" 2 "RESERVED" 3 "RESERVED" ;
VAL_ 829 RR_SEWWarn 0 "SEW Right Warning OFF" 1 "SEW Right Warning ON" 2 "RESERVED" 3 "RESERVED" ;
VAL_ 829 RR_ReleaseWarn 0 "Release Warning OFF" 1 "Release Warning ON" 2 "RESERVED" 3 "RESERVED" ;
VAL_ 829 RR_SWFailAlarm 0 "Off" 1 "On" 2 "RESERVED" 3 "Error Indicator" ;
VAL_ 829 RR_ChildLock_ActnFlSta 0 "OK" 1 "Failed" 2 "RESERVED" 3 "Error Indicator" ;
VAL_ 829 RR_MRActivationAlarm 0 "Off" 1 "On" 2 "RESERVED" 3 "Error Indicator" ;
VAL_ 829 RR_ChildLock_Status 0 "ChildLock On" 1 "ChildLock Off" 2 "RESERVED" 3 "RESERVED" ;
VAL_ 1026 BDC_FD_SMK_Crc3Val 0 "0x0x0~0xFFFF:CRCValue" 65535 "0x0x0~0xFFFF:CRCValue" ;
VAL_ 1026 SMK_TrmnlCtrlStaBDCEV 0 "Off" 1 "Off_AuthWaiting" 2 "Off_CrankingAuthWaiting" 3 "Off_ESCLUnlockWaiting" 4 "PowerOn" 5 "PowerOn_ESCLUnlockWaiting" 6 "PowerOn_AuthWaiting" 7 "PowerOn_CrankingWait" 8 "Cranking" 9 "Ready" 10 "RESERVED" 11 "RESERVED" 12 "RESERVED" 13 "RESERVED" 14 "RESERVED" 15 "RESERVED" 16 "RESERVED" 17 "RESERVED" 18 "RESERVED" 19 "RESERVED" 20 "RESERVED" 21 "RESERVED" 22 "RESERVED" 23 "RESERVED" 24 "RESERVED" 25 "RESERVED" 26 "RESERVED" 27 "RESERVED" 28 "RESERVED" 29 "RESERVED" 30 "RESERVED" 31 "Error Indicator" ;
VAL_ 1026 SMK_PwrOnModeSta 0 "Off Mode" 1 "Power On Normal Mode" 2 "Utility Mode" 3 "Maintenance Service Mode" ;
VAL_ 1026 SMK_StndbyMdTmrMin 0 "Default (Timer Stop)" 1 "0min ~ 60min" 2 "0min ~ 60min" 3 "0min ~ 60min" 4 "0min ~ 60min" 5 "0min ~ 60min" 6 "0min ~ 60min" 7 "0min ~ 60min" 8 "0min ~ 60min" 9 "0min ~ 60min" 10 "0min ~ 60min" 11 "0min ~ 60min" 12 "0min ~ 60min" 13 "0min ~ 60min" 14 "0min ~ 60min" 15 "0min ~ 60min" 16 "0min ~ 60min" 17 "0min ~ 60min" 18 "0min ~ 60min" 19 "0min ~ 60min" 20 "0min ~ 60min" 21 "0min ~ 60min" 22 "0min ~ 60min" 23 "0min ~ 60min" 24 "0min ~ 60min" 25 "0min ~ 60min" 26 "0min ~ 60min" 27 "0min ~ 60min" 28 "0min ~ 60min" 29 "0min ~ 60min" 30 "0min ~ 60min" 31 "0min ~ 60min" 32 "0min ~ 60min" 33 "0min ~ 60min" 34 "0min ~ 60min" 35 "0min ~ 60min" 36 "0min ~ 60min" 37 "0min ~ 60min" 38 "0min ~ 60min" 39 "0min ~ 60min" 40 "0min ~ 60min" 41 "0min ~ 60min" 42 "0min ~ 60min" 43 "0min ~ 60min" 44 "0min ~ 60min" 45 "0min ~ 60min" 46 "0min ~ 60min" 47 "0min ~ 60min" 48 "0min ~ 60min" 49 "0min ~ 60min" 50 "0min ~ 60min" 51 "0min ~ 60min" 52 "0min ~ 60min" 53 "0min ~ 60min" 54 "0min ~ 60min" 55 "0min ~ 60min" 56 "0min ~ 60min" 57 "0min ~ 60min" 58 "0min ~ 60min" 59 "0min ~ 60min" 60 "0min ~ 60min" 61 "0min ~ 60min" 62 "RESERVED" 63 "Error Indicator" ;
VAL_ 1026 SMK_PwrTransitionReq 0 "Off" 1 "Request On" 2 "Not Used" 3 "Error Indicator" ;
VAL_ 1026 SMK_StndbyMdTmrSec 0 "Default (Timer Stop)" 1 "0sec ~ 59sec" 2 "0sec ~ 59sec" 3 "0sec ~ 59sec" 4 "0sec ~ 59sec" 5 "0sec ~ 59sec" 6 "0sec ~ 59sec" 7 "0sec ~ 59sec" 8 "0sec ~ 59sec" 9 "0sec ~ 59sec" 10 "0sec ~ 59sec" 11 "0sec ~ 59sec" 12 "0sec ~ 59sec" 13 "0sec ~ 59sec" 14 "0sec ~ 59sec" 15 "0sec ~ 59sec" 16 "0sec ~ 59sec" 17 "0sec ~ 59sec" 18 "0sec ~ 59sec" 19 "0sec ~ 59sec" 20 "0sec ~ 59sec" 21 "0sec ~ 59sec" 22 "0sec ~ 59sec" 23 "0sec ~ 59sec" 24 "0sec ~ 59sec" 25 "0sec ~ 59sec" 26 "0sec ~ 59sec" 27 "0sec ~ 59sec" 28 "0sec ~ 59sec" 29 "0sec ~ 59sec" 30 "0sec ~ 59sec" 31 "0sec ~ 59sec" 32 "0sec ~ 59sec" 33 "0sec ~ 59sec" 34 "0sec ~ 59sec" 35 "0sec ~ 59sec" 36 "0sec ~ 59sec" 37 "0sec ~ 59sec" 38 "0sec ~ 59sec" 39 "0sec ~ 59sec" 40 "0sec ~ 59sec" 41 "0sec ~ 59sec" 42 "0sec ~ 59sec" 43 "0sec ~ 59sec" 44 "0sec ~ 59sec" 45 "0sec ~ 59sec" 46 "0sec ~ 59sec" 47 "0sec ~ 59sec" 48 "0sec ~ 59sec" 49 "0sec ~ 59sec" 50 "0sec ~ 59sec" 51 "0sec ~ 59sec" 52 "0sec ~ 59sec" 53 "0sec ~ 59sec" 54 "0sec ~ 59sec" 55 "0sec ~ 59sec" 56 "0sec ~ 59sec" 57 "0sec ~ 59sec" 58 "0sec ~ 59sec" 59 "0sec ~ 59sec" 60 "0sec ~ 59sec" 61 "RESERVED" 62 "RESERVED" 63 "Error Indicator" ;
VAL_ 1026 SMK_VhclSlpSta 0 "Vehicle inclined(R/START not possible)" 1 "Vehicle flat or inclined within limit(R/START possible)" 2 "Not Used" 3 "Error Indicator" ;
VAL_ 1026 USM_SmrtSldngModSta 0 "Default Value" 1 "Smart Sliding Door Off" 2 "Smart Sliding Door On" 3 "Reserved" 4 "Invalid" 5 "Reserved" 6 "Not Used" 7 "Error Indicator" ;
VAL_ 1026 SMK_EVPwrOffReq 0 "Off" 1 "On" 2 "RESERVED" 3 "Error Indicator" ;
VAL_ 1026 SMK_MaintenanceSrvMdReq 0 "Request off" 1 "Request on" 2 "RESERVED" 3 "Error Indicator" ;
VAL_ 1026 Warn_DisWrngSta3 0 "Off" 1 "Tele/Monitor Position Not Confirmed" 31 "Error Indicator" 2 "Swivel Seat Position Not Confirmed" ;
VAL_ 1026 BDC_FD_SMK_AlvCnt3Val 0 "0x0x0~0xFF:AlvCntValue" 255 "0x0x0~0xFF:AlvCntValue" ;
VAL_ 1026 ESCL_EsclMngrSta 0 "NOT_POWER_SUPPLIED" 1 "POWER_SUPPLIED_FOR_UNLOCK" 2 "POWER_SUPPLIED_FOR_LOCK" 3 "PWR_SUPPL_FOR_LEARNIGN_NEUTRAL" 4 "UNLOCK_IN_PROGRESS" 5 "LOCK_IN_PROGRESS" 6 "POWER_OFF_CONFIRMATION" 7 "ANTI_SCANNING" 8 "Reserved" 9 "Reserved" 10 "Reserved" 11 "Reserved" 12 "Reserved" 13 "Reserved" 14 "Not Used" 15 "Error Indicator" ;
VAL_ 1026 ESCL_EsclPwrSupSta 0 "Off" 1 "On" 2 "Not Used" 3 "Error Indicator" ;
VAL_ 1026 Fob_FoundExtrnlIntArea 0 "Default" 1 "Can't recognize" 2 "Fob recognized" 3 "Error Indicator" ;
VAL_ 1026 ESCL_EsclEnaSta 0 "Off" 1 "On" 2 "Not Used" 3 "Error Indicator" ;
VAL_ 1026 ESCL_EsclUnitSta 0 "Retry (Fault)" 1 "In progress (Busy)" 2 "Reserved" 3 "OK" 4 "Unknown" 5 "Reseved" 6 "Not Used" 7 "Error Indicator" ;
VAL_ 1026 ESCL_EsclBoltSta 0 "Intermediate" 1 "Locked" 2 "Unlocked" 3 "Failure" 4 "Unknown" 5 "Reseved" 6 "Not Used" 7 "Error Indicator" ;
VAL_ 1026 ESCL_EsclLoBattSta 0 "ESCL Low Battery Bit = 0" 1 "ESCL Low Battery Bit = 1" 2 "Unknown" 3 "Reserved" 4 "Reserved" 5 "Reseved" 6 "Not Used" 7 "Error Indicator" ;
VAL_ 1026 ESCL_EsclUnLkSwSta 0 "EsclNotPowerSupplied" 1 "EsclPowerSupplied&Unlocked" 2 "EsclPowerSupplied&NotUnlocked" 3 "Reserved" 4 "Reserved" 5 "Reseved" 6 "Not Used" 7 "Error Indicator" ;
VAL_ 1026 Fob_FoundRrLftArea 0 "Default" 1 "Fob Found(RrLft)" 2 "Not Used" 3 "Error Indicator" ;
VAL_ 1026 Fob_FoundRrRtArea 0 "Default" 1 "Fob Found(RrRt)" 2 "Not Used" 3 "Error Indicator" ;
VAL_ 1026 Warn_StrtStpBtnWrngSta 0 "Off" 1 "On" 2 "Not Used" 3 "Error Indicator" ;
VAL_ 1026 Warn_DeActvWrngSta 0 "Off" 1 "On" 2 "Not Used" 3 "Error Indicator" ;
VAL_ 1026 Warn_GearPosPWrngReq 0 "Warning Off" 1 "Warning On" 2 "Not Used" 3 "Error Indicator" ;
VAL_ 1026 Warn_ExtrnlBuzWrngSta 0 "Off" 1 "SMK Door Lock1" 2 "SMK Door Lock2" 3 "ID Out" 4 "Trunk Warning" 5 "SMK Key Reminder2" 6 "SMK Door Lock3" 7 "Invalid" 8 "RSPA State Inform" 9 "Hand Free Trunk" 10 "Hand Free Trunk2" 11 "BLE Access Check" 12 "FP Authfail" 13 "ID Out For RSPA" 14 "Frunk Warning" 15 "Error Indicator" ;
VAL_ 1026 Warn_IdOutWrngSta 0 "Off" 1 "On(2kHz)" 2 "On(1.9kHz)" 3 "Error Indicator" ;
VAL_ 1026 Warn_KeyBattLoWrngSta 0 "Off" 1 "On" 2 "Not Used" 3 "Error Indicator" ;
VAL_ 1026 Warn_KeyOutLmpOnReq 0 "Off" 1 "On" 2 "Not Used" 3 "Error Indicator" ;
VAL_ 1026 Warn_NotGearPosPWrngSta 0 "Off" 1 "On" 2 "Not Used" 3 "Error Indicator" ;
VAL_ 1026 Warn_EsclFlWrngSta 0 "Off" 1 "On" 2 "Not Used" 3 "Error Indicator" ;
VAL_ 1026 Warn_EsclNotLkWrngSta 0 "Off" 1 "On" 2 "Not Used" 3 "Error Indicator" ;
VAL_ 1026 Warn_EsclNotUnLkWrngSta 0 "Off" 1 "On" 2 "Not Used" 3 "Error Indicator" ;
VAL_ 1026 Warn_ImmoLmpOnReq 0 "Off" 1 "On" 2 "Not Used" 3 "Error Indicator" ;
VAL_ 1026 Warn_DisWrngSta2 0 "Off" 1 "RESERVED" 2 "RESERVED" 3 "RESERVED" 4 "Vehicle_is_on(China BLE)" 5 "Engine_Start_Operation_IND (Brake)" 6 "Engine_Start_Operation_IND (Clutch)" 7 "Engine_Start_Operation_IND (Brake & Clutch)" 8 "P_N Off Warning (BDC)" 9 "P Off Warning (BDC)" 10 "Auth_Fail_Warning For IAU" 11 "ReAuth_Warning(FOB)" 12 "Maintenance Service Mode Fail" 13 "Not Used" 14 "Not Used" 15 "Error Indicator" ;
VAL_ 1026 Warn_DisWrngSta 0 "Off" 1 "Shift_P_Warning" 16 "Vehicle_is_On(DigitalKey)" 17 "Power Auto Off Ready" 18 "Auth_Fail_Waring2 (non-SSB immo coil)" 19 "ReAuth_Warning (Digital Key)" 20 "ReAuth_Warning (FingerPrint)" 21 "ReAuth_Warning (Digital Key&FingerPrint)" 22 "ReAuth_Warning (FOB&Digital Key)" 23 "ReAuth_Warning (FOB&Finger Print)" 24 "Reauth_Warning 2 (FOB&Digital Key&Finger Print)" 25 "Key_Out_Warning (FOB&Digital Key)" 26 "Auth_Fail_Warning 2 (Seperated Immo Coil type)" 27 "Not Used" 28 "Not Used" 29 "Not Used" 30 "Not Used" 31 "Error Indicator" 2 "Key_Bat_Discharge_Warning" 3 "Not_Unlocked_Warning" 4 "AC_Plug_Connected_Warning" 5 "Escl_Ecu_Fail_Warning" 6 "Engine_Start_Operation_IND" 7 "Auth_Fail_Warning" 8 "Key_Removal_IND" 9 "Key_Out_Warning" 10 "SSB_Warning" 11 "Auth_Fail_Warning2" 12 "Vehicle_Not_P_Warning" 13 "Stop Lamp Fuse Fail Warning" 14 "Not P_N Warning" 15 "Vehicle_is_On(FingerPrint)" ;
VAL_ 1026 SMK_OTACrankInhState 0 "Default" 1 "Cranking inhibit" 2 "IGN,Cranking inhibit" 3 "Reserved" 4 "Reserved" 5 "Reserved" 6 "Reserved" 7 "Error Indicator" ;
VAL_ 1026 SMK_TgltAwaySrchResult 0 "Default" 1 "Not Exist" 2 "Exist" 3 "Invalid" ;
VAL_ 1026 SMKFOBID_CHNAVNT 0 "None" 1 "ID1" 2 "ID2" 3 "ID3" 4 "ID4" 5 "Reserved" 6 "Reserved" 7 "Error Indicator" ;
VAL_ 1026 SMK_TrmnlCtrlGrpStaBDC 0 "Off" 1 "Acc" 2 "Ign" 3 "Cranking" 4 "Engine Running" 5 "RESERVED" 6 "RESERVED" 7 "Error Indicator" ;
VAL_ 1026 SMK_TrmnlCtrlGrpStaBDCEV 0 "Off" 1 "PowerOn" 2 "Cranking" 3 "Ready" 4 "RESERVED" 5 "RESERVED" 6 "RESERVED" 7 "Error Indicator" ;
VAL_ 1026 SMK_TrmnlCtrlStaBDC 0 "OFF" 1 "OFF_AUTHWAITING" 2 "OFF_CRANKINGAUTHWAITING" 3 "OFF_ESCLUNLOCKWAITING" 4 "ACC" 5 "ACC_AUTHWAITING" 6 "ACC_ESCLUNLOCKWAITING" 7 "IGN" 8 "IGN_AUTHWAITING" 9 "IGN_CRANKINGWAIT" 10 "CRANKING" 11 "ENGINERUNNING" 12 "RESERVED" 13 "RESERVED" 14 "RESERVED" 15 "RESERVED" 16 "RESERVED" 17 "RESERVED" 18 "RESERVED" 19 "RESERVED" 20 "RESERVED" 21 "RESERVED" 22 "RESERVED" 23 "RESERVED" 24 "RESERVED" 25 "RESERVED" 26 "RESERVED" 27 "RESERVED" 28 "RESERVED" 29 "RESERVED" 30 "RESERVED" 31 "Error Indicator" ;
VAL_ 830 SBCM_RL_FD_Crc1Val 0 "0x0x0~0xFFFF:CRCValue" 65535 "0x0x0~0xFFFF:CRCValue" ;
VAL_ 830 USM_RLGhostDoorSta 0 "Default" 1 "Off" 2 "On" 3 "RESERVED" ;
VAL_ 830 DoorLock_PDSLkSwSta_RL 0 "Lock" 1 "Unlock" 2 "RESERVED" 3 "Error Indicator" ;
VAL_ 830 PDS_TypeOption_RL 0 "Off" 1 "On" 2 "RESERVED" 3 "Error Indicator" ;
VAL_ 830 RL_CrashMRActAlarm 0 "Off" 1 "On" 2 "RESERVED" 3 "Error Indicator" ;
VAL_ 830 PwrDRBuzzerOut_RL 0 "OFF" 1 "Open" 2 "Close" 3 "Warning" ;
VAL_ 830 PwrDRClosingRLDrSta 0 "Default" 1 "Close" 2 "Open" 3 "Stop(during Close)" 4 "Stop(during Open)" 5 "RESERVED" 6 "RESERVED" 7 "Invalid" ;
VAL_ 830 AFH_RL_FldUnfldSta 0 "Invalid" 1 "Fold" 2 "Unfold" 3 "Inprogress" ;
VAL_ 830 SBCM_RL_FD_AlvCnt1Val 0 "0x0x0~0xFF:AlvCntValue" 255 "0x0x0~0xFF:AlvCntValue" ;
VAL_ 830 DoorLock_RrLtLkOutSta_SBCM 0 "Off" 1 "On" 2 "Not Used" 3 "Error Indicator" ;
VAL_ 830 RrLt_DrLkRetryFail_SBCM 0 "Normal" 1 "Fail" 2 "RESERVED" 3 "RESERVED" ;
VAL_ 830 RL_DetectObj_warn 0 "Detect Warning OFF" 1 "Detect Warning ON" 2 "RESERVED" 3 "RESERVED" ;
VAL_ 830 RLRrDrCurtainPosition 0 "Unkown" 1 "Bottom" 2 "Mid" 3 "Top" ;
VAL_ 830 RDC_TypeOption 0 "Off" 1 "On" 2 "RESERVED" 3 "Error Indicator" ;
VAL_ 830 RLRrDrCurtainDownInitState 0 "Decalibrated" 1 "Calibrated" 2 "RESERVED" 3 "Error Indicator" ;
VAL_ 830 PwrDRBuzzerOut_RL_New 0 "OFF" 1 "Open" 2 "Close" 3 "Warning1" 4 "Warning2" ;
VAL_ 830 PwrDrSta_RrLt 0 "Unavailable" 1 "Available" 2 "RESERVED" 3 "Error Indicator" ;
VAL_ 830 SBCM_RL_SlidePosition 0 "0x0x0~0x64:0% - 100%" 100 "0x0x0~0x64:0% - 100%" 101 "0x65~0xFE:RESERVED" 254 "0x65~0xFE:RESERVED" 255 "Unknown" ;
VAL_ 830 SBCM_RL_DoorAngle 0 "0° - 90°" 1 "0° - 90°" 2 "0° - 90°" 3 "0° - 90°" 4 "0° - 90°" 5 "0° - 90°" 6 "0° - 90°" 7 "0° - 90°" 8 "0° - 90°" 9 "0° - 90°" 10 "0° - 90°" 11 "0° - 90°" 12 "0° - 90°" 13 "0° - 90°" 14 "0° - 90°" 15 "0° - 90°" 16 "0° - 90°" 17 "0° - 90°" 18 "0° - 90°" 19 "0° - 90°" 20 "0° - 90°" 21 "0° - 90°" 22 "0° - 90°" 23 "0° - 90°" 24 "0° - 90°" 25 "0° - 90°" 26 "0° - 90°" 27 "0° - 90°" 28 "0° - 90°" 29 "0° - 90°" 30 "0° - 90°" 31 "0° - 90°" 32 "0° - 90°" 33 "0° - 90°" 34 "0° - 90°" 35 "0° - 90°" 36 "0° - 90°" 37 "0° - 90°" 38 "0° - 90°" 39 "0° - 90°" 40 "0° - 90°" 41 "0° - 90°" 42 "0° - 90°" 43 "0° - 90°" 44 "0° - 90°" 45 "0° - 90°" 46 "0° - 90°" 47 "0° - 90°" 48 "0° - 90°" 49 "0° - 90°" 50 "0° - 90°" 51 "0° - 90°" 52 "0° - 90°" 53 "0° - 90°" 54 "0° - 90°" 55 "0° - 90°" 56 "0° - 90°" 57 "0° - 90°" 58 "0° - 90°" 59 "0° - 90°" 60 "0° - 90°" 61 "0° - 90°" 62 "0° - 90°" 63 "0° - 90°" 64 "0° - 90°" 65 "0° - 90°" 66 "0° - 90°" 67 "0° - 90°" 68 "0° - 90°" 69 "0° - 90°" 70 "0° - 90°" 71 "0° - 90°" 72 "0° - 90°" 73 "0° - 90°" 74 "0° - 90°" 75 "0° - 90°" 76 "0° - 90°" 77 "0° - 90°" 78 "0° - 90°" 79 "0° - 90°" 80 "0° - 90°" 81 "0° - 90°" 82 "0° - 90°" 83 "0° - 90°" 84 "0° - 90°" 85 "0° - 90°" 86 "0° - 90°" 87 "0° - 90°" 88 "0° - 90°" 89 "0° - 90°" 90 "0° - 90°" 91 "Invalid" 92 "Invalid" 93 "Invalid" 94 "Invalid" 95 "Invalid" 96 "Invalid" 97 "Invalid" 98 "Invalid" 99 "Invalid" 100 "Unknown" 101 "Invalid" 102 "Invalid" 103 "Invalid" 104 "Invalid" 105 "Invalid" 106 "Invalid" 107 "Invalid" 108 "Invalid" 109 "Invalid" 110 "Invalid" 111 "Invalid" 112 "Invalid" 113 "Invalid" 114 "Invalid" 115 "Invalid" 116 "Invalid" 117 "Invalid" 118 "Invalid" 119 "Invalid" 120 "Invalid" 121 "Invalid" 122 "Invalid" 123 "Invalid" 124 "Invalid" 125 "Invalid" 126 "Invalid" 127 "Invalid" ;
VAL_ 830 RLDoorPushAlarm 0 "Off" 1 "On" 2 "RESERVED" 3 "Error Indicator" ;
VAL_ 830 RL_CrashUnlockCmd 0 "Off" 1 "Unlock(Crash)" ;
VAL_ 830 Warn_RrLftDrSwSta_SBCM 0 "Close" 1 "Open" 2 "RESERVED" 3 "Error Indicator" ;
VAL_ 830 DoorLock_RrLftDrUnLkSta_SBCM 0 "Lock" 1 "Unlock" 2 "RESERVED" 3 "Error Indicator" ;
VAL_ 830 RL_SEAActivated 0 "InActivated" 1 "Activated" 2 "RESERVED" 3 "Error Indicator" ;
VAL_ 830 RL_SEAWarn 0 "SEA Left Warning OFF" 1 "SEA Left Warning ON" 2 "RESERVED" 3 "RESERVED" ;
VAL_ 830 RL_SEWWarn 0 "SEW Left Warning OFF" 1 "SEW Left Warning ON" 2 "RESERVED" 3 "RESERVED" ;
VAL_ 830 RL_ReleaseWarn 0 "Release Warning OFF" 1 "Release Warning ON" 2 "RESERVED" 3 "RESERVED" ;
VAL_ 830 RL_SWFailAlarm 0 "Off" 1 "On" 2 "RESERVED" 3 "Error Indicator" ;
VAL_ 830 RL_ChildLock_ActnFlSta 0 "OK" 1 "Failed" 2 "RESERVED" 3 "Error Indicator" ;
VAL_ 830 RL_MRActivationAlarm 0 "Off" 1 "On" 2 "RESERVED" 3 "Error Indicator" ;
VAL_ 830 RL_ChildLock_Status 0 "ChildLock On" 1 "ChildLock Off" 2 "RESERVED" 3 "RESERVED" ;
VAL_ 193 BLTN_CAM_FD_Crc1Val 0 "0x0x0~0xFFFF:CRCValue" 65535 "0x0x0~0xFFFF:CRCValue" ;
VAL_ 193 BLTN_CAM_FD_AlvCnt1Val 0 "0x0x0~0xFF:AlvCntValue" 255 "0x0x0~0xFF:AlvCntValue" ;
VAL_ 193 BLTN_CAM_UI_Mode_Tmt_Req 0 "Default" 1 "BLTN_CAM UI Terminate Request" 2 "Reserved" 3 "invalid" ;
VAL_ 193 BLTN_CAM_PopUp_Req 0 "Default" 1 "Event Video Record On by manual switch" 2 "Time Lapse Record Started" 3 "Time Lapse Record Ended" 4 "micro SD card inserted" 5 "micro SD card removed" 6 "SD Card has problem(format required or need to be replaced)" 7 "Start Parking recording" 8 "Can not Start Parking recording (SD card is removed, not recognizable, or has problem)" 9 "Can not Record Event Video (SD card is removed, not recognizable, or has problem)" 10 "SD Card Unmounted" 11 "Time Lapse Record Ended without recorded file(Record frames are not enough to save.)" 12 "RESERVED" 13 "RESERVED" 14 "RESERVED" 15 "Invalid" ;
VAL_ 193 BLTN_CAM_File_List_Renew 0 "Defalut" 1 "the file list and storage space are renewed." 2 "reserved" 3 "Invalid" ;
VAL_ 193 BLTN_CAM_Wifi_Pwd_Chg_State 0 "Default" 1 "the password is changed" 2 "Failed, wrong password, can't change password" 3 "Invalid" ;
VAL_ 193 BLTN_CAM_Dis_Touch_BeepSound 0 "Off" 1 "ON" 2 "Keyboard On" 3 "invalid" ;
VAL_ 194 BMS_FD_Crc1Val 0 "0x0x0~0xFFFF:CRCValue" 65535 "0x0x0~0xFFFF:CRCValue" ;
VAL_ 194 BMS_FD_AlvCnt1Val 0 "0x0x0~0xFF:AlvCntValue" 255 "0x0x0~0xFF:AlvCntValue" ;
VAL_ 194 xEV_BatEvtAlarm_HS 0 "Default" 1 "Level 1" 2 "Level 2" 3 "Level 3" 4 "Level 4" ;
VAL_ 194 xEV_BMS_WakeUpReqfor12V 0 "Default" 1 "Discharge Request" 2 "Reserved(Not Used)" 3 "Error Indicator" ;
VAL_ 194 xEV_AuxBattChrgReq_HS 0 "Charge Finish Request" 1 "LV2 Charge Request" 2 "LV1 Charge Request" 3 "Error Indicator" ;
VAL_ 194 xEV_12VBatAlarmReq_HS 0 "Normal" 1 "3rd Cut Off" 2 "Warn. MSG & 3rd Cut Off Req" 3 "Reserved(Not Used)" ;
VAL_ 1048 GNSS_Crc6Val 0 "0x0x0~0xFFFF:CRCValue" 65535 "0x0x0~0xFFFF:CRCValue" ;
VAL_ 1048 GNSS_AlvCnt6Val 0 "0x0x0~0xFF:AlvCntValue" 255 "0x0x0~0xFF:AlvCntValue" ;
VAL_ 1048 GNSS_MM_type 0 "WGS84" 1 "Bessel" 2 "Coordshift(for china)" 15 "invalid" ;
VAL_ 256 EMS_Crc2Val 0 "0x0x0~0xFFFF:CRCValue" 65535 "0x0x0~0xFFFF:CRCValue" ;
VAL_ 256 ACC_CrsMainSwLmpSta 0 "Cruise MAIN switch indication lamp turn OFF" 1 "Cruise MAIN switch indication lamp turn ON" 2 "Not used" 3 "Error indicator" ;
VAL_ 256 ACC_CrsSetSwLmpSta 0 "Cruise SET switch indication lamp turn OFF" 1 "Cruise SET switch indication lamp turn ON" 2 "Not used" 3 "Error indicator" ;
VAL_ 256 ENG_LV_FUP_ENA_THD 0 "The pressure is too low to start engine" 1 "The pressure is enough high to start engine" ;
VAL_ 256 ENG_SoakTimeErrSta 0 "No Failure detected" 1 "Failure detected" 2 "Not used" 3 "Error indicator" ;
VAL_ 256 EMS_AlvCnt2Val 0 "0x0x0~0xFF:AlvCntValue" 255 "0x0x0~0xFF:AlvCntValue" ;
VAL_ 256 ENG_AppAccelPdlSta 0 "Accelerator pedal not pressed" 1 "Accelerator pedal pressed" 2 "Reserved" 3 "Accelerator pedal position sensor failure" ;
VAL_ 256 ENG_BrkCtrlReq 0 "Brake control request is not active" 1 "Brake control request is active" 2 "Not used" 3 "Error indicator" ;
VAL_ 256 ACC_DnShftCtrlReq 0 "Downshift control request is not active" 1 "Downshift request to 1st gear" 2 "Downshift request to 2nd gear" 3 "Downshift request to 3rd gear" 4 "Downshift request to 4th gear" 5 "Downshift request to 5th gear" 6 "Downshift request to 6th gear" 7 "Downshift request to 7th gear" 8 "Downshift request to 8th gear" 9 "Reserved" 10 "Reserved" 11 "Reserved" 12 "Reserved" 13 "Reserved" 14 "Reserved" 15 "Error indicator" ;
VAL_ 256 ENG_DclBrkCntrlReq 4095 "Error indicator" ;
VAL_ 256 ENG_BstPrsrVal 4095 "Error indicator" ;
VAL_ 256 ENG_EngOilTempVal 255 "Error indicator" ;
VAL_ 256 ENG_DpfWrngSta 0 "DPF Normal State" 1 "DPF Warning State Level 1" 2 "DPF Warning State Level 2" 3 "Reserved" ;
VAL_ 256 ENG_BattWrngLmpSta 0 "Battery Warning Lamp OFF" 1 "Battery Warning Lamp ON" 2 "Not used" 3 "Error indicator" ;
VAL_ 256 ENG_OilPrsrWrngLmpSta 0 "Oil Pressure Warning Lamp OFF" 1 "Oil Pressure Warning Lamp ON" 2 "Not used" 3 "Error indicator" ;
VAL_ 256 ENG_IsgInhbtLmpSta 0 "ISG Inhibit Lamp OFF" 1 "ISG Inhibit Lamp ON" 2 "Not used" 3 "Error indicator" ;
VAL_ 256 ENG_BrkSwSta 0 "Brake switch is not pressed (OFF)" 1 "Brake switch is pressed (ON)" 2 "EMS does not support this function." 3 "Brake switch failure" ;
VAL_ 256 ENG_EngClntTempVal 255 "Error indicator" ;
VAL_ 256 ENG_MafCrctVal 128 "Error indicator" ;
VAL_ 256 ENG_BattDscnctSta 0 "no battery disconnection detected" 1 "battery disconnection detected and failure memory erased" 2 "Not used" 3 "Error indicator" ;
VAL_ 256 OBD_MilConfgVal 0 "no MIL, Failure Memory Management OBD-I" 1 "MIL Treatment OBD-I, Failure Memory Management OBD-I" 2 "MIL Treatment OBD-II, Exception" 3 "MIL Treatment OBD-II, Failure Memory Management OBD-II" 4 "MIL Treatment E-OBD, Failure Memory Management E-OBD" 5 "MIL Treatment K-OBD, Failure Memory Management K-OBD" ;
VAL_ 256 ENG_EngSta 0 "Engine Stop" 1 "Cranking" 2 "Stalled" 3 "Running" 4 "Reserved" 5 "Reserved" 6 "Reserved" 7 "Fault" ;
VAL_ 256 ENG_Ack4EngStpSta 0 "No acknowledgement" 1 "Acknowledgement engine stopped" 2 "Not used" 3 "Error indicator" ;
VAL_ 256 ENG_OverDrvOffReq 0 "Normal operation" 1 "Over drive off request to TCU by the cruise control function" 2 "Not used" 3 "Error indicator" ;
VAL_ 256 ENG_AccActSta 0 "Auto cruise control is not active" 1 "Auto cruise control is active" 2 "Not used" 3 "Error indicator" ;
VAL_ 256 ENG_CltchOpSta 0 "Clutch is not operating" 1 "Clutch is operating" 2 "Not used" 3 "Error indicator" ;
VAL_ 256 EMS_BrkReq_Slope 0 "No Request" 1 "Brake Request" ;
VAL_ 256 ENG_AccDrvAlertDisp 0 "Default" 1 "Auto cruise Disengaged" 2 "No Auto cruise Engaged" 3 "Error indicator" ;
VAL_ 256 DSL_GlowCtrlReq 0 "Glow plug off request" 1 "Glow plug on request" 2 "System Error" 3 "Reserved" ;
VAL_ 256 ENG_GlowLmpSta 0 "Lamp Off" 1 "Lamp On" 2 "Not used" 3 "Error indicator" ;
VAL_ 256 ENG_ThrPosVal 32 "Idle (port value is learnt)" 245 "Throttle perpendicular" 255 "Throttle defective" ;
VAL_ 256 ENG_AccelPdlVal 0 "Accelerator Pedal not activated" 1022 "Accelerator Pedal fully activated" 1023 "Accelerator Pedal is defective (fail state) or Non-ETC system (APS is not installed), Error indicator" ;
VAL_ 1051 HU_CLOCK_Crc1Val 0 "0x0x0~0xFFFF:CRCValue" 65535 "0x0x0~0xFFFF:CRCValue" ;
VAL_ 1051 HU_DisplayYear1 0 "19" 1 "20" 2 "21" 3 "invalid" ;
VAL_ 1051 HU_DisplayYear2 0 "00 year" 1 "01~99 year" 2 "01~99 year" 3 "01~99 year" 4 "01~99 year" 5 "01~99 year" 6 "01~99 year" 7 "01~99 year" 8 "01~99 year" 9 "01~99 year" 10 "01~99 year" 11 "01~99 year" 12 "01~99 year" 13 "01~99 year" 14 "01~99 year" 15 "01~99 year" 16 "01~99 year" 17 "01~99 year" 18 "01~99 year" 19 "01~99 year" 20 "01~99 year" 21 "01~99 year" 22 "01~99 year" 23 "01~99 year" 24 "01~99 year" 25 "01~99 year" 26 "01~99 year" 27 "01~99 year" 28 "01~99 year" 29 "01~99 year" 30 "01~99 year" 31 "01~99 year" 32 "01~99 year" 33 "01~99 year" 34 "01~99 year" 35 "01~99 year" 36 "01~99 year" 37 "01~99 year" 38 "01~99 year" 39 "01~99 year" 40 "01~99 year" 41 "01~99 year" 42 "01~99 year" 43 "01~99 year" 44 "01~99 year" 45 "01~99 year" 46 "01~99 year" 47 "01~99 year" 48 "01~99 year" 49 "01~99 year" 50 "01~99 year" 51 "01~99 year" 52 "01~99 year" 53 "01~99 year" 54 "01~99 year" 55 "01~99 year" 56 "01~99 year" 57 "01~99 year" 58 "01~99 year" 59 "01~99 year" 60 "01~99 year" 61 "01~99 year" 62 "01~99 year" 63 "01~99 year" 64 "01~99 year" 65 "01~99 year" 66 "01~99 year" 67 "01~99 year" 68 "01~99 year" 69 "01~99 year" 70 "01~99 year" 71 "01~99 year" 72 "01~99 year" 73 "01~99 year" 74 "01~99 year" 75 "01~99 year" 76 "01~99 year" 77 "01~99 year" 78 "01~99 year" 79 "01~99 year" 80 "01~99 year" 81 "01~99 year" 82 "01~99 year" 83 "01~99 year" 84 "01~99 year" 85 "01~99 year" 86 "01~99 year" 87 "01~99 year" 88 "01~99 year" 89 "01~99 year" 90 "01~99 year" 91 "01~99 year" 92 "01~99 year" 93 "01~99 year" 94 "01~99 year" 95 "01~99 year" 96 "01~99 year" 97 "01~99 year" 98 "01~99 year" 99 "01~99 year" 100 "0x64~0xFE:RESERVED" 254 "0x64~0xFE:RESERVED" 255 "Invalid" ;
VAL_ 1051 HU_DisplayDay 0 "Not used" 1 "1~31 day" 2 "1~31 day" 3 "1~31 day" 4 "1~31 day" 5 "1~31 day" 6 "1~31 day" 7 "1~31 day" 8 "1~31 day" 9 "1~31 day" 10 "1~31 day" 11 "1~31 day" 12 "1~31 day" 13 "1~31 day" 14 "1~31 day" 15 "1~31 day" 16 "1~31 day" 17 "1~31 day" 18 "1~31 day" 19 "1~31 day" 20 "1~31 day" 21 "1~31 day" 22 "1~31 day" 23 "1~31 day" 24 "1~31 day" 25 "1~31 day" 26 "1~31 day" 27 "1~31 day" 28 "1~31 day" 29 "1~31 day" 30 "1~31 day" 31 "1~31 day" 32 "0x20~0xFE:RESERVED" 254 "0x20~0xFE:RESERVED" 255 "Invalid" ;
VAL_ 1051 HU_AM_PM_INFO 0 "Not Used" 1 "AM" 2 "PM" 3 "invalid" ;
VAL_ 1051 HU_ComRefresh 0 "Not Used" 1 "Internal Clock None" 2 "Internal Clock Exist" 3 "Invalid" ;
VAL_ 1051 HU_ClockInfo 0 "Not Used" 1 "ACLOCK Refresh" 2 "Not Used" 3 "invalid" ;
VAL_ 1051 HU_CLOCK_AlvCnt1Val 0 "0x0x0~0xFF:AlvCntValue" 255 "0x0x0~0xFF:AlvCntValue" ;
VAL_ 1051 HU_TimeSetting 0 "not used" 1 "User Time" 2 "GPS Time" 3 "invalid" ;
VAL_ 1051 HU_Status 0 "Not used" 1 "Booting Head Unit" 2 "GPS receiving" 3 "Setting Mode" 4 "GPS Unavailable Mode" 5 "No GPS" 6 "RESERVED" 7 "RESERVED" 8 "RESERVED" 9 "RESERVED" 10 "RESERVED" 11 "RESERVED" 12 "RESERVED" 13 "RESERVED" 14 "RESERVED" 15 "Invalid" ;
VAL_ 1051 HU_TimeFormat 0 "Not used" 1 "12Hour" 2 "24Hour" 3 "invalid" ;
VAL_ 1051 HU_DisplayHour 0 "0 hour" 1 "1~23 hour" 2 "1~23 hour" 3 "1~23 hour" 4 "1~23 hour" 5 "1~23 hour" 6 "1~23 hour" 7 "1~23 hour" 8 "1~23 hour" 9 "1~23 hour" 10 "1~23 hour" 11 "1~23 hour" 12 "1~23 hour" 13 "1~23 hour" 14 "1~23 hour" 15 "1~23 hour" 16 "1~23 hour" 17 "1~23 hour" 18 "1~23 hour" 19 "1~23 hour" 20 "1~23 hour" 21 "1~23 hour" 22 "1~23 hour" 23 "1~23 hour" 24 "0x18~0xFE:RESERVED" 254 "0x18~0xFE:RESERVED" 255 "Invalid" ;
VAL_ 1051 HU_DisplayMinute 0 "0 minute" 1 "1~59 minute" 2 "1~59 minute" 3 "1~59 minute" 4 "1~59 minute" 5 "1~59 minute" 6 "1~59 minute" 7 "1~59 minute" 8 "1~59 minute" 9 "1~59 minute" 10 "1~59 minute" 11 "1~59 minute" 12 "1~59 minute" 13 "1~59 minute" 14 "1~59 minute" 15 "1~59 minute" 16 "1~59 minute" 17 "1~59 minute" 18 "1~59 minute" 19 "1~59 minute" 20 "1~59 minute" 21 "1~59 minute" 22 "1~59 minute" 23 "1~59 minute" 24 "1~59 minute" 25 "1~59 minute" 26 "1~59 minute" 27 "1~59 minute" 28 "1~59 minute" 29 "1~59 minute" 30 "1~59 minute" 31 "1~59 minute" 32 "1~59 minute" 33 "1~59 minute" 34 "1~59 minute" 35 "1~59 minute" 36 "1~59 minute" 37 "1~59 minute" 38 "1~59 minute" 39 "1~59 minute" 40 "1~59 minute" 41 "1~59 minute" 42 "1~59 minute" 43 "1~59 minute" 44 "1~59 minute" 45 "1~59 minute" 46 "1~59 minute" 47 "1~59 minute" 48 "1~59 minute" 49 "1~59 minute" 50 "1~59 minute" 51 "1~59 minute" 52 "1~59 minute" 53 "1~59 minute" 54 "1~59 minute" 55 "1~59 minute" 56 "1~59 minute" 57 "1~59 minute" 58 "1~59 minute" 59 "1~59 minute" 60 "0x3C~0xFE:RESERVED" 254 "0x3C~0xFE:RESERVED" 255 "Invalid" ;
VAL_ 1051 HU_DisplaySecond 0 "0 second" 1 "1~59 second" 2 "1~59 second" 3 "1~59 second" 4 "1~59 second" 5 "1~59 second" 6 "1~59 second" 7 "1~59 second" 8 "1~59 second" 9 "1~59 second" 10 "1~59 second" 11 "1~59 second" 12 "1~59 second" 13 "1~59 second" 14 "1~59 second" 15 "1~59 second" 16 "1~59 second" 17 "1~59 second" 18 "1~59 second" 19 "1~59 second" 20 "1~59 second" 21 "1~59 second" 22 "1~59 second" 23 "1~59 second" 24 "1~59 second" 25 "1~59 second" 26 "1~59 second" 27 "1~59 second" 28 "1~59 second" 29 "1~59 second" 30 "1~59 second" 31 "1~59 second" 32 "1~59 second" 33 "1~59 second" 34 "1~59 second" 35 "1~59 second" 36 "1~59 second" 37 "1~59 second" 38 "1~59 second" 39 "1~59 second" 40 "1~59 second" 41 "1~59 second" 42 "1~59 second" 43 "1~59 second" 44 "1~59 second" 45 "1~59 second" 46 "1~59 second" 47 "1~59 second" 48 "1~59 second" 49 "1~59 second" 50 "1~59 second" 51 "1~59 second" 52 "1~59 second" 53 "1~59 second" 54 "1~59 second" 55 "1~59 second" 56 "1~59 second" 57 "1~59 second" 58 "1~59 second" 59 "1~59 second" 60 "0x3C~0xFE:RESERVED" 254 "0x3C~0xFE:RESERVED" 255 "Invalid" ;
VAL_ 1051 HU_DisplayMonth 0 "Not used" 1 "1~12 month" 2 "1~12 month" 3 "1~12 month" 4 "1~12 month" 5 "1~12 month" 6 "1~12 month" 7 "1~12 month" 8 "1~12 month" 9 "1~12 month" 10 "1~12 month" 11 "1~12 month" 12 "1~12 month" 13 "RESERVED" 14 "RESERVED" 15 "Invalid" ;
VAL_ 1052 HU_CLU_Crc2Val 0 "0x0x0~0xFFFF:CRCValue" 65535 "0x0x0~0xFFFF:CRCValue" ;
VAL_ 1052 HU_EVSupport 0 "Not support" 1 "Support" 2 "RESERVED" 3 "Invalid" ;
VAL_ 1052 HU_DayNightState 0 "Default" 1 "Day" 2 "Night" 3 "Invalid" ;
VAL_ 1052 HU_AutoBrightState_New 0 "Default" 1 "0x1~0x3FE:Brightness" 1022 "0x1~0x3FE:Brightness" 1023 "Invalid" ;
VAL_ 1052 HU_CLU_AlvCnt2Val 0 "0x0x0~0xFF:AlvCntValue" 255 "0x0x0~0xFF:AlvCntValue" ;
VAL_ 1052 HU_LanguageInfo 0 "Off" 1 "Korea" 2 "English(US)" 3 "English(UK)" 4 "Simplified chinese" 5 "Traditional chinese" 6 "French(EU)" 7 "Spanish(EU)" 8 "Arabic" 9 "Czech" 10 "Danish" 11 "German" 12 "Italian" 13 "Dutch" 14 "Polish" 15 "Portuguese" 16 "Russain" 17 "Slovak" 18 "Swedish" 19 "Turkish" 20 "French(US)" 21 "Spanish(US)" 22 "English(India)" 23 "Norwegian" 24 "Finnish" 25 "Indonesian" 26 "Brazilian Portuguese" 27 "Malay" 28 "Hungarian" 29 "English (Australia)" 30 "Japanese" 31 "Hindi" 32 "Hebrew" 33 "Greek" 34 "Ukrainian" 35 "Slovenian" 36 "Bulgarian" 37 "Croatian" 38 "Romanian" 39 "Bengali" 40 "Marathi" 41 "Telugu" 42 "Tamil" 43 "Gujarati" 44 "Kannada" 45 "Odia" 46 "Malayalam" 47 "Punjabi" 48 "Thai" 49 "Tagalog" 50 "Vietnamese" 51 "0x33~0xFE:RESERVED" 254 "0x33~0xFE:RESERVED" 255 "Invalid" ;
VAL_ 1052 HU_VolumeStatus 63 "Invalid" ;
VAL_ 1052 HU_MuteStatus 0 "Off" 1 "Mute On" 2 "RESERVED" 3 "Invalid" ;
VAL_ 1052 HU_WelcomeReady 0 "Default" 1 "Welcome ready" 2 "Goodbye ready" 3 "Invalid" ;
VAL_ 1052 HU_UsmSupport 0 "Not support" 1 "Support" 2 "RESERVED" 3 "Invalid" ;
VAL_ 1052 HU_NaviStatus 0 "Booting" 1 "Normal Operation" 2 "No SD Card(Map)" 3 "Invalid" ;
VAL_ 1052 HU_NaviDisp 0 "Non_Navi" 1 "Navi" 2 "RESERVED" 3 "Invalid" ;
VAL_ 1052 HU_BVM_Display_Message 0 "Not Used" 1 "No Message" 2 "Rain_Warning Message" 3 "RESERVED" 4 "RESERVED" 5 "RESERVED" 6 "RESERVED" 7 "Invalid" ;
VAL_ 1052 HU_NaviCamSettingStatus 0 "Navi Camera Alert Setting Status" 1 "Navi Camera Alert Setting Status" 2 "Navi Camera Alert Setting Status" 3 "Navi Camera Alert Setting Status" 4 "Navi Camera Alert Setting Status" 5 "Navi Camera Alert Setting Status" 6 "Navi Camera Alert Setting Status" 7 "Navi Camera Alert Setting Status" 8 "Navi Camera Alert Setting Status" 9 "Navi Camera Alert Setting Status" 10 "Navi Camera Alert Setting Status" 11 "Navi Camera Alert Setting Status" 12 "Navi Camera Alert Setting Status" 13 "Navi Camera Alert Setting Status" 14 "Navi Camera Alert Setting Status" 15 "Navi Camera Alert Setting Status" 16 "Navi Camera Alert Setting Status" 17 "Navi Camera Alert Setting Status" 18 "Navi Camera Alert Setting Status" 19 "Navi Camera Alert Setting Status" 20 "Navi Camera Alert Setting Status" 21 "Navi Camera Alert Setting Status" 22 "Navi Camera Alert Setting Status" 23 "Navi Camera Alert Setting Status" 24 "Navi Camera Alert Setting Status" 25 "Navi Camera Alert Setting Status" 26 "Navi Camera Alert Setting Status" 27 "Navi Camera Alert Setting Status" 28 "Navi Camera Alert Setting Status" 29 "Navi Camera Alert Setting Status" 30 "Navi Camera Alert Setting Status" 31 "Navi Camera Alert Setting Status" 32 "0x20~0xFE:RESERVED" 254 "0x20~0xFE:RESERVED" 255 "Invalid" ;
