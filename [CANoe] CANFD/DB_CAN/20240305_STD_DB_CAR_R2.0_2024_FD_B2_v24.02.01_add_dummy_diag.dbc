VERSION ""

NS_ :

BS_:

BU_: ARS_FD WPC_FD WPC2_FD SCM_FD SHVU_FRNT_FD GW_SAU_DRV_FD GW_PSU_AST_FD GW_PSU_3RD_FD RCS_FD GW_PSU_RL_FD RCM_FD SHVU_3RD_FD SHVU_RR_FD PSB_FD ATS_FD GW_PSU_RR_FD SHVU_RL_FD RWPC_FD CGW_CCU OHCL_FD SHVU_REAR_FD BLTN_CAM_FD SGU_FD GW_PSU_DRV_FD FCS_FD

BO_ 996 PDC_FD_10_200ms: 16 CGW_CCU
 SG_ PDC_FD_Crc10Val : 0|16@1+ (1,0) [0|0] "" Vector__XXX
 SG_ PDC_PwrOnModePowerReq : 107|2@1+ (1,0) [0|0] "" Vector__XXX
 SG_ PDC_LeadAcidBatType : 109|5@1+ (1,0) [0|0] "" Vector__XXX
 SG_ PDC_BatPwrClassOpt : 114|2@1+ (1,0) [0|0] "" Vector__XXX
 SG_ PDC_FD_AlvCnt10Val : 16|8@1+ (1,0) [0|0] "" Vector__XXX
 SG_ ICU_PowerAutoCutModSta : 64|2@1+ (1,0) [0|0] ""  BLTN_CAM_FD,GW_PSU_3RD_FD,GW_PSU_AST_FD,GW_PSU_DRV_FD,GW_PSU_RL_FD,GW_PSU_RR_FD,SHVU_3RD_FD,SHVU_FRNT_FD,SHVU_REAR_FD,SHVU_RL_FD,SHVU_RR_FD
 SG_ Autocut_DlvryModSta : 66|2@1+ (1,0) [0|0] "" Vector__XXX
 SG_ ICU_SoCBattStaMsgReq : 68|2@1+ (1,0) [0|0] "" Vector__XXX
 SG_ Batt_SoCWarningValue : 70|8@1+ (1,0) [0|0] "%" Vector__XXX
 SG_ ICU_BattAutoCutPreWrng : 78|2@1+ (1,0) [0|0] ""  BLTN_CAM_FD
 SG_ OTAModeACCOffReq : 80|2@1+ (1,0) [0|0] "" Vector__XXX
 SG_ C_ICUIGNOffReq : 82|2@1+ (1,0) [0|0] "" Vector__XXX
 SG_ IGN_AutoOff_WarnSta : 84|2@1+ (1,0) [0|0] "" Vector__XXX
 SG_ IGN_AutoOff_WarnSta_CLU : 86|2@1+ (1,0) [0|0] "" Vector__XXX
 SG_ PDC_BatPwrStateClassA : 88|2@1+ (1,0) [0|0] "" Vector__XXX
 SG_ PDC_BatPwrStateClassB : 90|2@1+ (1,0) [0|0] "" Vector__XXX
 SG_ PDC_BatPwrStateClassC : 92|2@1+ (1,0) [0|0] "" Vector__XXX
 SG_ PLBMAvailableState : 94|1@1+ (1,0) [0|0] "" Vector__XXX
 SG_ Bat_dischrg : 95|2@1+ (1,0) [0|0] "" Vector__XXX
 SG_ Bat12V_Chr_Req : 97|2@1+ (1,0) [0|0] "" Vector__XXX
 SG_ ICU_BattMngAlert : 99|8@1+ (1,0) [0|0] "" Vector__XXX

BO_ 1047 GNSS_05_1000ms: 32 CGW_CCU
 SG_ GNSS_Crc5Val : 0|16@1+ (1,0) [0|0] "" Vector__XXX
 SG_ HU_GNSS_UTC_min : 104|8@1+ (1,0) [0|0] ""  BLTN_CAM_FD
 SG_ HU_GNSS_UTC_sec : 112|8@1+ (1,0) [0|0] ""  BLTN_CAM_FD
 SG_ HU_GNSS_UTC_offset : 120|8@1+ (1,0) [0|0] "Sec"  BLTN_CAM_FD
 SG_ HU_GNSS_PDOP : 128|16@1+ (0.00390625,0) [0|0] "" Vector__XXX
 SG_ HU_GNSS_HDOP : 144|16@1+ (0.00390625,0) [0|0] "" Vector__XXX
 SG_ GNSS_AlvCnt5Val : 16|8@1+ (1,0) [0|0] "" Vector__XXX
 SG_ HU_GNSS_VDOP : 160|16@1+ (0.00390625,0) [0|0] "" Vector__XXX
 SG_ HU_GNSS_DGPS_age : 192|8@1+ (1,0) [0|0] "Sec" Vector__XXX
 SG_ HU_GNSS_Fix_status : 200|4@1+ (1,0) [0|0] "" Vector__XXX
 SG_ HU_GNSS_TimeSource : 204|2@1+ (1,0) [0|0] "" Vector__XXX
 SG_ HU_GNSS_search : 206|2@1+ (1,0) [0|0] "" Vector__XXX
 SG_ HU_GNSS_DST : 208|2@1+ (1,0) [0|0] ""  BLTN_CAM_FD
 SG_ HU_GNSS_SV_count : 210|8@1+ (1,0) [0|0] "" Vector__XXX
 SG_ HU_GNSS_TimezoneOffset : 218|8@1- (15,0) [0|0] "minute"  BLTN_CAM_FD
 SG_ HU_GNSS_UTC_year : 64|16@1+ (1,0) [0|0] ""  BLTN_CAM_FD
 SG_ HU_GNSS_UTC_month : 80|8@1+ (1,0) [0|0] ""  BLTN_CAM_FD
 SG_ HU_GNSS_UTC_day : 88|8@1+ (1,0) [0|0] ""  BLTN_CAM_FD
 SG_ HU_GNSS_UTC_hour : 96|8@1+ (1,0) [0|0] ""  BLTN_CAM_FD

BO_ 811 SBCM_AST_FD_01_200ms: 32 CGW_CCU
 SG_ SBCM_AST_FD_Crc1Val : 0|16@1+ (1,0) [0|0] "" Vector__XXX
 SG_ USM_AstGhostDoorSta : 100|2@1+ (1,0) [0|0] "" Vector__XXX
 SG_ AST_SWFailAlarm : 102|2@1+ (1,0) [0|0] "" Vector__XXX
 SG_ DoorLock_PDSLkSwSta_AST : 104|2@1+ (1,0) [0|0] "" Vector__XXX
 SG_ PDS_TypeOption_AST : 106|2@1+ (1,0) [0|0] "" Vector__XXX
 SG_ AFCU_AutoWashModeSta_SBCM_AST : 120|3@1+ (1,0) [0|0] "" Vector__XXX
 SG_ CDM_AutoWashModeSta_SBCM_AST : 123|3@1+ (1,0) [0|0] "" Vector__XXX
 SG_ AFH_AST_FldUnFldSta : 126|2@1+ (1,0) [0|0] "" Vector__XXX
 SG_ SBCM_AST_DiagSta : 136|2@1+ (1,0) [0|0] "" Vector__XXX
 SG_ CDM_TypeOption_AST : 138|2@1+ (1,0) [0|0] "" Vector__XXX
 SG_ CDM_ImmeChgSw_AST : 144|2@1+ (1,0) [0|0] "" Vector__XXX
 SG_ CDM_ChgDrSwFrt_AST : 146|2@1+ (1,0) [0|0] "" Vector__XXX
 SG_ CDM_OpnClsState_AST : 148|2@1+ (1,0) [0|0] "" Vector__XXX
 SG_ CDM_WarnMsg_AST : 150|2@1+ (1,0) [0|0] "" Vector__XXX
 SG_ Mirror_RH_FoldingSta : 152|2@1+ (1,0) [0|0] "" Vector__XXX
 SG_ Mirror_RH_UnfoldingSta : 154|2@1+ (1,0) [0|0] "" Vector__XXX
 SG_ CDM_CmdStatus_AST : 156|4@1+ (1,0) [0|0] "" Vector__XXX
 SG_ SBCM_AST_FD_AlvCnt1Val : 16|8@1+ (1,0) [0|0] "" Vector__XXX
 SG_ AST_CrashMRActAlarm : 160|2@1+ (1,0) [0|0] "" Vector__XXX
 SG_ PwrDRBuzzerOut_AST : 162|2@1+ (1,0) [0|0] "" Vector__XXX
 SG_ IMS_OSMirPlayBackSta_RH : 164|4@1+ (1,0) [0|0] ""  GW_PSU_DRV_FD
 SG_ PwrDRClosingASTDrSta : 168|3@1+ (1,0) [0|0] ""  ATS_FD
 SG_ CDM_OutsideOpnSwSta_AST : 172|2@1+ (1,0) [0|0] "" Vector__XXX
 SG_ SBCM_Longkey_ASTDrAtClsSwSta : 174|2@1+ (1,0) [0|0] "" Vector__XXX
 SG_ Hood_TypeOption_AST : 176|2@1+ (1,0) [0|0] "" Vector__XXX
 SG_ Warn_HoodSwSta_AST : 178|2@1+ (1,0) [0|0] "" Vector__XXX
 SG_ FrunkWarning_AST : 180|2@1+ (1,0) [0|0] "" Vector__XXX
 SG_ SBCM_FrunkSta_AST : 182|2@1+ (1,0) [0|0] "" Vector__XXX
 SG_ IMS_OSMirPlayBackSta_RH_New : 184|4@1+ (1,0) [0|0] ""  GW_PSU_DRV_FD
 SG_ Ast_DrLkRetryFail_SBCM : 188|2@1+ (1,0) [0|0] "" Vector__XXX
 SG_ DoorLock_AstLkOutSta_SBCM : 190|2@1+ (1,0) [0|0] "" Vector__XXX
 SG_ FrunkReleaseSwSta_SBCM_AST : 192|2@1+ (1,0) [0|0] "" Vector__XXX
 SG_ FrunkInsideRelSwSta_SBCM_AST : 194|2@1+ (1,0) [0|0] "" Vector__XXX
 SG_ FrunkEmergencySwSta_SBCM_AST : 196|2@1+ (1,0) [0|0] "" Vector__XXX
 SG_ PwrDrSta_Ast : 24|2@1+ (1,0) [0|0] "" Vector__XXX
 SG_ PwrDrSta_AstSd : 26|2@1+ (1,0) [0|0] "" Vector__XXX
 SG_ AST_DetectObj_warn_LH : 30|2@1+ (1,0) [0|0] ""  ATS_FD
 SG_ PwrDROpenClosingAstSdDRSta : 32|3@1+ (1,0) [0|0] ""  ATS_FD
 SG_ PwrDRBuzzerOut_AST_New : 35|3@1+ (1,0) [0|0] "" Vector__XXX
 SG_ SBCM_FR_DoorAngle : 40|7@1+ (1,0) [0|0] "˚" Vector__XXX
 SG_ EHL_TxInfo_SBCM_AST : 47|3@1+ (1,0) [0|0] "" Vector__XXX
 SG_ ASTDoorPushAlarm : 72|2@1+ (1,0) [0|0] "" Vector__XXX
 SG_ AST_CrashUnlockCmd : 74|1@1+ (1,0) [0|0] ""  BLTN_CAM_FD
 SG_ DoorLock_CtrlDrLkSwSta_SBCM : 80|2@1+ (1,0) [0|0] "" Vector__XXX
 SG_ DoorLock_CtrlDrUnLkSwSta_SBCM : 82|2@1+ (1,0) [0|0] "" Vector__XXX
 SG_ Warn_AsstDrSwSta_SBCM : 84|2@1+ (1,0) [0|0] ""  ATS_FD,BLTN_CAM_FD,GW_PSU_AST_FD,GW_SAU_DRV_FD,PSB_FD,RWPC_FD,WPC2_FD,WPC_FD
 SG_ DoorLock_AsstDrUnLkSta_SBCM : 86|2@1+ (1,0) [0|0] ""  ATS_FD
 SG_ AST_SEAWarn_RH : 88|2@1+ (1,0) [0|0] "" Vector__XXX
 SG_ AST_SEAWarn_LH : 90|2@1+ (1,0) [0|0] "" Vector__XXX
 SG_ AST_SEWWarn_LH : 92|2@1+ (1,0) [0|0] "" Vector__XXX
 SG_ AST_SEWWarn_RH : 94|2@1+ (1,0) [0|0] "" Vector__XXX
 SG_ AST_MRActivationAlarm : 96|2@1+ (1,0) [0|0] "" Vector__XXX
 SG_ AST_ReleaseWarn : 98|2@1+ (1,0) [0|0] "" Vector__XXX

BO_ 849 IAU_FD_04_200ms: 32 CGW_CCU
 SG_ IAU_FD_Crc4Val : 0|16@1+ (1,0) [0|0] "0" Vector__XXX
 SG_ IAU_DISPWrng : 104|4@1+ (1,0) [0|0] "" Vector__XXX
 SG_ IAU_DigitalKey2Opt : 120|3@1+ (1,0) [0|0] ""  WPC2_FD,WPC_FD
 SG_ IAUwFRULearnState : 124|2@1+ (1,0) [0|0] "" Vector__XXX
 SG_ IAUwFPMLearnState : 126|2@1+ (1,0) [0|0] "" Vector__XXX
 SG_ IAU_ValetDigitalkey : 128|2@1+ (1,0) [0|0] "" Vector__XXX
 SG_ IAU_DigitalKeyNumberOpt : 130|3@1+ (1,0) [0|0] "" Vector__XXX
 SG_ IAU_eSEReprogramSta : 133|2@1+ (1,0) [0|0] "" Vector__XXX
 SG_ IAU_DKOwnerSwapOption : 136|2@1+ (1,0) [0|0] "" Vector__XXX
 SG_ IAU_DgtKeyGrpPrflRval2 : 139|5@1+ (1,0) [0|0] "" Vector__XXX
 SG_ IAU_StartIdentifiedProfile : 144|3@1+ (1,0) [0|0] "" Vector__XXX
 SG_ IAU_DigitalKeyProfileRval2 : 147|5@1+ (1,0) [0|0] "" Vector__XXX
 SG_ IAU_NFCCard1SN : 152|32@1+ (1,0) [0|0] "" Vector__XXX
 SG_ IAU_FD_AlvCnt4Val : 16|8@1+ (1,0) [0|0] "0" Vector__XXX
 SG_ IAU_StartIdentifiedProfile_Ext : 24|4@1+ (1,0) [0|0] "" Vector__XXX
 SG_ RSPA_UWBRspaExtRngSta : 246|2@1+ (1,0) [0|0] "" Vector__XXX
 SG_ RSPA_CanFltSta : 250|2@1+ (1,0) [0|0] "" Vector__XXX
 SG_ RSPA_BLESigErrSta : 252|2@1+ (1,0) [0|0] "" Vector__XXX
 SG_ RSPA_ConStat : 254|2@1+ (1,0) [0|0] "" Vector__XXX
 SG_ IAU_ProfileIDRVal : 74|4@1+ (1,0) [0|0] ""  BLTN_CAM_FD,GW_PSU_DRV_FD,GW_SAU_DRV_FD,RCM_FD,RWPC_FD,SGU_FD,WPC2_FD,WPC_FD
 SG_ IAU_DigitalKeyProcessingSta : 80|4@1+ (1,0) [0|0] "" Vector__XXX
 SG_ IAU_DigitalKeyExit : 84|4@1+ (1,0) [0|0] "" Vector__XXX
 SG_ IAU_DigitalKeyEnblRVal : 88|2@1+ (1,0) [0|0] "" Vector__XXX
 SG_ IAU_OwnerPhnRegRVal : 90|2@1+ (1,0) [0|0] "" Vector__XXX
 SG_ IAU_NFCCard1RegRVal : 92|2@1+ (1,0) [0|0] "" Vector__XXX
 SG_ IAU_NFCCard2RegRVal : 94|2@1+ (1,0) [0|0] "" Vector__XXX

BO_ 518 GNSS_07_100ms: 32 CGW_CCU
 SG_ GNSS_Crc7Val : 0|16@1+ (1,0) [0|0] "" Vector__XXX
 SG_ HU_DR_Latitude : 128|32@1- (1,0) [0|0] "˚"  BLTN_CAM_FD
 SG_ GNSS_AlvCnt7Val : 16|8@1+ (1,0) [0|0] "" Vector__XXX
 SG_ HU_DR_Longitude : 160|32@1- (1,0) [0|0] "˚"  BLTN_CAM_FD
 SG_ HU_DR_Heading : 192|16@1+ (1,0) [0|0] "˚"  BLTN_CAM_FD
 SG_ HU_DR_Speed : 208|16@1- (0.01,0) [0|0] "m/s" Vector__XXX
 SG_ HU_DR_TimeOfWeek : 24|32@1+ (1,0) [0|0] "ms" Vector__XXX
 SG_ HU_DR_Position_Status : 64|1@1+ (1,0) [0|0] "" Vector__XXX
 SG_ HU_DR_Altitude_Status : 65|1@1+ (1,0) [0|0] "" Vector__XXX
 SG_ HU_DR_Heading_Status : 66|1@1+ (1,0) [0|0] "" Vector__XXX
 SG_ HU_DR_Speed_Status : 67|1@1+ (1,0) [0|0] "" Vector__XXX
 SG_ HU_DR_DirectionSwitch_Sta : 68|1@1+ (1,0) [0|0] "" Vector__XXX
 SG_ HU_DR_Direction : 69|1@1+ (1,0) [0|0] "" Vector__XXX
 SG_ HU_DR_GyroCalib_Sta : 70|1@1+ (1,0) [0|0] "" Vector__XXX
 SG_ HU_DR_TachoCalib_Sta : 71|1@1+ (1,0) [0|0] "" Vector__XXX
 SG_ HU_DR_Solution_Sta : 72|1@1+ (1,0) [0|0] "" Vector__XXX
 SG_ HU_DR_GNSS_Fix_Age : 73|8@1+ (1,0) [0|0] "Sec" Vector__XXX
 SG_ HU_DR_Altitude : 81|16@1- (1,0) [0|0] "m"  BLTN_CAM_FD

BO_ 101 IEB_01_10ms: 32 CGW_CCU
 SG_ IEB_Crc1Val : 0|16@1+ (1,0) [0|0] "" Vector__XXX
 SG_ IEB_StrkDpthPcVal : 104|8@1+ (0.39215,0) [0|0] "%" Vector__XXX
 SG_ IEB_EstDpthPcVal : 112|8@1+ (0.390625,0) [0|0] "%" Vector__XXX
 SG_ IEB_AbsNGearReq : 120|2@1+ (1,0) [0|0] "" Vector__XXX
 SG_ IEB_EstBrkPdlValVldSta : 122|2@1+ (1,0) [0|0] "" Vector__XXX
 SG_ IEB_FRAmode_Req : 124|2@1+ (1,0) [0|0] "" Vector__XXX
 SG_ IEB_DriftEscModSta_VDC : 126|2@1+ (1,0) [0|0] "" Vector__XXX
 SG_ IEB_RegenTqLimitNmVal_Rear : 128|16@1+ (1,0) [0|0] "Nm" Vector__XXX
 SG_ IEB_DrvWhlSlipFlg_Frnt : 144|1@1+ (1,0) [0|0] "" Vector__XXX
 SG_ IEB_IndDriftMode : 145|3@1+ (1,0) [0|0] "" Vector__XXX
 SG_ IEB_IndDriftEcsModSta : 148|2@1+ (1,0) [0|0] "" Vector__XXX
 SG_ IEB_IndDriftElsdModSta : 150|2@1+ (1,0) [0|0] "" Vector__XXX
 SG_ IEB_TCS_Req : 152|2@1+ (1,0) [0|0] "" Vector__XXX
 SG_ IEB_RSC_Req : 154|2@1+ (1,0) [0|0] "" Vector__XXX
 SG_ TCS_TqFlag_Frnt : 156|1@1+ (1,0) [0|0] "" Vector__XXX
 SG_ TCS_TqFlag_Rear : 157|1@1+ (1,0) [0|0] "" Vector__XXX
 SG_ RSC_TqFlag_Frnt : 158|1@1+ (1,0) [0|0] "" Vector__XXX
 SG_ RSC_TqFlag_Rear : 159|1@1+ (1,0) [0|0] "" Vector__XXX
 SG_ IEB_AlvCnt1Val : 16|8@1+ (1,0) [0|0] "" Vector__XXX
 SG_ TCS_TqIntrvntnVal_Frnt : 160|8@1+ (0.390625,0) [0|0] "%" Vector__XXX
 SG_ TCS_TqIntrvntnVal_Rear : 168|8@1+ (0.390625,0) [0|0] "%" Vector__XXX
 SG_ RSC_TqIntrvntnVal_Frnt : 176|8@1+ (0.390625,0) [0|0] "%" Vector__XXX
 SG_ RSC_TqIntrvntnVal_Rear : 184|8@1+ (0.390625,0) [0|0] "%" Vector__XXX
 SG_ TCS_MtrTrgtRpm_Flag_Frnt : 192|1@1+ (1,0) [0|0] "" Vector__XXX
 SG_ TCS_MtrTrgtRpm_Flag_Rear : 193|1@1+ (1,0) [0|0] "" Vector__XXX
 SG_ IEB_DriftElsdModSta : 194|2@1+ (1,0) [0|0] "" Vector__XXX
 SG_ IEB_DriftEcsModSta : 196|2@1+ (1,0) [0|0] "" Vector__XXX
 SG_ IEB_DriftMdpsModSta : 198|2@1+ (1,0) [0|0] "" Vector__XXX
 SG_ TCS_MtrTrgtRpm_Frnt : 200|12@1+ (8,0) [0|0] "rpm" Vector__XXX
 SG_ TCS_MtrTrgtRpm_Rear : 212|12@1+ (8,0) [0|0] "rpm" Vector__XXX
 SG_ IEB_DriftModeSta : 224|2@1+ (1,0) [0|0] "" Vector__XXX
 SG_ IEB_DriftModeActSta : 226|2@1+ (1,0) [0|0] "" Vector__XXX
 SG_ MCU_AntiJerk_Inhbtsta : 230|1@1+ (1,0) [0|0] "" Vector__XXX
 SG_ IEB_Motor_ProtectModSta : 231|1@1+ (1,0) [0|0] "" Vector__XXX
 SG_ IEB_EstBrkSacFrcNmVal : 232|16@1+ (1,0) [0|0] "" Vector__XXX
 SG_ IEB_SrvLmpDis : 24|2@1+ (1,0) [0|0] "" Vector__XXX
 SG_ IEB_IndDriftEscModSta_TCS : 248|4@1+ (1,0) [0|0] "" Vector__XXX
 SG_ IEB_IndDriftEscModSta_VDC : 252|2@1+ (1,0) [0|0] "" Vector__XXX
 SG_ IEB_IndDriftMdpsModSta : 254|2@1+ (1,0) [0|0] "" Vector__XXX
 SG_ IEB_DfctvSta : 26|2@1+ (1,0) [0|0] "" Vector__XXX
 SG_ IEB_ActvSta : 28|2@1+ (1,0) [0|0] "" Vector__XXX
 SG_ IEB_DiagSta : 30|2@1+ (1,0) [0|0] "" Vector__XXX
 SG_ IEB_WrngLmpDis : 32|2@1+ (1,0) [0|0] "" Vector__XXX
 SG_ IEB_MILReq : 34|2@1+ (1,0) [0|0] "" Vector__XXX
 SG_ IEB_DriftModeStaDis : 36|3@1+ (1,0) [0|0] "" Vector__XXX
 SG_ RSC_Sta : 39|1@1+ (1,0) [0|0] "" Vector__XXX
 SG_ IEB_StrkDpthmmVal : 40|16@1- (0.1,0) [0|0] "mm" Vector__XXX
 SG_ IEB_BrkActvSta : 56|2@1+ (1,0) [0|0] ""  BLTN_CAM_FD
 SG_ IEB_PdlTrvlSnsrFailSta : 58|2@1+ (1,0) [0|0] "" Vector__XXX
 SG_ IEB_PdlCalibSta : 60|2@1+ (1,0) [0|0] "" Vector__XXX
 SG_ IEB_BzrSta : 62|2@1+ (1,0) [0|0] "" Vector__XXX
 SG_ IEB_Sta : 64|2@1+ (1,0) [0|0] "" Vector__XXX
 SG_ IEB_SnsrFailSta : 66|2@1+ (1,0) [0|0] "" Vector__XXX
 SG_ IEB_RbsWrngLmpSta : 68|2@1+ (1,0) [0|0] "" Vector__XXX
 SG_ IEB_VacSysDfctvSta : 70|2@1+ (1,0) [0|0] "" Vector__XXX
 SG_ IEB_RegenTqLimitNmVal_Frnt : 72|16@1+ (1,0) [0|0] "Nm" Vector__XXX
 SG_ IEB_EstTtlBrkFrcNmVal : 88|16@1+ (1,0) [0|0] "Nm" Vector__XXX

BO_ 309 BAT_01_10ms: 16 CGW_CCU
 SG_ BAT_Crc1Val : 0|16@1+ (1,0) [0|0] "" Vector__XXX
 SG_ BAT_AlvCnt1Val : 16|8@1+ (1,0) [0|0] "" Vector__XXX
 SG_ BAT_CurrVal : 24|16@1+ (0.01,-327) [0|0] "A" Vector__XXX
 SG_ BAT_SocVal : 40|8@1+ (1,0) [0|0] "%"  BLTN_CAM_FD
 SG_ BAT_VoltVal : 48|14@1+ (0.001,6) [0|0] "V" Vector__XXX
 SG_ BAT_AuxBattOpt : 62|2@1+ (1,0) [0|0] "" Vector__XXX
 SG_ BAT_TempVal : 64|9@1+ (0.5,-40) [0|0] "℃" Vector__XXX
 SG_ BAT_SocErrSta : 73|2@1+ (1,0) [0|0] "" Vector__XXX
 SG_ BAT_SohVal : 75|7@1+ (1,0) [0|0] "%" Vector__XXX
 SG_ BAT_SnsrInvldSta : 82|2@1+ (1,0) [0|0] "" Vector__XXX
 SG_ BAT_SofVal : 84|7@1+ (0.1,0) [0|0] "V" Vector__XXX
 SG_ BAT_RspErrSta : 91|2@1+ (1,0) [0|0] "" Vector__XXX
 SG_ BAT_CapacityVal : 96|8@1+ (1,0) [0|0] "" Vector__XXX

BO_ 920 CTM_FD_02_200ms: 16 CGW_CCU
 SG_ CTM_FD_Crc2Val : 0|16@1+ (1,0) [0|0] "" Vector__XXX
 SG_ CTM_FD_AlvCnt2Val : 16|8@1+ (1,0) [0|0] "" Vector__XXX
 SG_ USM_TrailerTypSta : 27|3@1+ (1,0) [0|0] "" Vector__XXX
 SG_ ITBC_TrailerDisplayAppliedSta : 30|2@1+ (1,0) [0|0] "" Vector__XXX
 SG_ ITBC_TrailerBrkOut : 40|7@1+ (1,0) [0|0] "%" Vector__XXX
 SG_ ITBC_TrailerBrkGainVal : 48|5@1+ (0.5,0) [0|0] "%" Vector__XXX
 SG_ ITBC_SysWarn : 53|3@1+ (1,0) [0|0] "" Vector__XXX
 SG_ CTM_TrailerAct : 64|2@1+ (1,0) [0|0] ""  BLTN_CAM_FD
 SG_ CTM_RearfogAct : 66|2@1+ (1,0) [0|0] "" Vector__XXX
 SG_ CTM_StpLmpOpnSta : 68|2@1+ (1,0) [0|0] "" Vector__XXX
 SG_ CTM_TrnSigLmpLftOpnSta : 70|2@1+ (1,0) [0|0] "" Vector__XXX
 SG_ CTM_TrnSigLmpRtOpnSta : 72|2@1+ (1,0) [0|0] "" Vector__XXX
 SG_ CTM_ExtTailLmpLftOpnSta : 74|2@1+ (1,0) [0|0] "" Vector__XXX
 SG_ CTM_ExtTailLmpRtOpnSta : 76|2@1+ (1,0) [0|0] "" Vector__XXX
 SG_ CTM_Exra_EbrakSta : 78|2@1+ (1,0) [0|0] "" Vector__XXX
 SG_ CTM_TrlAngl_200ms : 80|16@1+ (0.0055,-180) [0|0] "" Vector__XXX

BO_ 1059 HU_GW_04_1000ms: 16 CGW_CCU
 SG_ HU_GW_Crc4Val : 0|16@1+ (1,0) [0|0] "" Vector__XXX
 SG_ CF_AVN_AutoWashModeSta : 101|3@1+ (1,0) [0|0] "" Vector__XXX
 SG_ OMUOSMirCtrl_Vr : 110|2@1+ (1,0) [0|0] "" Vector__XXX
 SG_ HU_GW_AlvCnt4Val : 16|8@1+ (1,0) [0|0] "" Vector__XXX
 SG_ HU_IG3_Request : 76|2@1+ (1,0) [0|0] "" Vector__XXX
 SG_ HU_DigitalKeyGroupingSupport : 80|2@1+ (1,0) [0|0] "" Vector__XXX
 SG_ HU_Background : 82|3@1+ (1,0) [0|0] ""  ATS_FD,BLTN_CAM_FD
 SG_ HU_BackgroundFadeInOut : 88|10@1+ (0.1,0) [0|0] "%"  ATS_FD,BLTN_CAM_FD

BO_ 979 BDC_FD_04_200ms: 32 CGW_CCU
 SG_ BDC_FD_Crc4Val : 0|16@1+ (1,0) [0|0] "" Vector__XXX
 SG_ BDC_FD_AlvCnt4Val : 16|8@1+ (1,0) [0|0] "" Vector__XXX
 SG_ BAlarm_BglrAlrm_CurrentSta : 24|4@1+ (1,0) [0|0] ""  BLTN_CAM_FD
 SG_ BAlarm_BglrAlrm_Sta : 28|2@1+ (1,0) [0|0] "" Vector__XXX
 SG_ BAlarm_PncAlrmSta : 30|2@1+ (1,0) [0|0] "" Vector__XXX
 SG_ SBR_StBltStpWrngBzrSta : 34|3@1+ (1,0) [0|0] "" Vector__XXX
 SG_ SBR_StBltWrngBzrSta : 37|3@1+ (1,0) [0|0] "" Vector__XXX
 SG_ BAlarm_BrglrHrnRlySta : 40|2@1+ (1,0) [0|0] "" Vector__XXX
 SG_ SBR_DrvStBltIndSta : 42|2@1+ (1,0) [0|0] "" Vector__XXX
 SG_ SBR_RrLftStBltWrngIndSta : 44|2@1+ (1,0) [0|0] "" Vector__XXX
 SG_ SBR_RrRtStBltWrngIndSta : 46|2@1+ (1,0) [0|0] "" Vector__XXX
 SG_ SBR_RrCtrStBltIndSta : 48|2@1+ (1,0) [0|0] "" Vector__XXX
 SG_ SBR_3rdLftStBltWrngIndSta : 50|2@1+ (1,0) [0|0] "" Vector__XXX
 SG_ SBR_3rdRtStBltWrngIndSta : 52|2@1+ (1,0) [0|0] "" Vector__XXX
 SG_ SBR_3rdCtrStBltWrngIndSta : 54|2@1+ (1,0) [0|0] "" Vector__XXX
 SG_ Warn_BzrWrngSta : 56|4@1+ (1,0) [0|0] "" Vector__XXX
 SG_ Warn_BCMWrngSta : 60|4@1+ (1,0) [0|0] "" Vector__XXX
 SG_ ROA_RrBlwAutoOffReq : 64|2@1+ (1,0) [0|0] "" Vector__XXX
 SG_ ROA_RegionOpt : 66|2@1+ (1,0) [0|0] "" Vector__XXX
 SG_ Warn_RrStRmndOpt : 68|2@1+ (1,0) [0|0] "" Vector__XXX
 SG_ Warn_RrStRmndAlrmOnReq : 70|2@1+ (1,0) [0|0] "" Vector__XXX
 SG_ Warn_RrStRmndSysSta : 72|2@1+ (1,0) [0|0] "" Vector__XXX
 SG_ Warn_RrStRmndAlrmInfo : 74|3@1+ (1,0) [0|0] "" Vector__XXX
 SG_ Warn_RoaErr : 77|3@1+ (1,0) [0|0] "" Vector__XXX
 SG_ Warn_RrStRmndDelay : 80|2@1+ (1,0) [0|0] "" Vector__XXX
 SG_ Warn_RrStRmndSysAct : 82|2@1+ (1,0) [0|0] "" Vector__XXX
 SG_ WAL_FobSearching : 84|2@1+ (1,0) [0|0] "" Vector__XXX
 SG_ Warn_RrStRmndSysOffIND : 86|2@1+ (1,0) [0|0] "" Vector__XXX
 SG_ Warn_VehNotPWrngSta : 88|3@1+ (1,0) [0|0] "" Vector__XXX

BO_ 983 BDC_FD_08_200ms: 24 CGW_CCU
 SG_ BDC_FD_Crc8Val : 0|16@1+ (1,0) [0|0] "" Vector__XXX
 SG_ Mirror_MnlFldModSta : 102|2@1+ (1,0) [0|0] "" Vector__XXX
 SG_ Mirror_SelSwSta : 112|3@1+ (1,0) [0|0] "" Vector__XXX
 SG_ Mirror_LHPosMnlReq : 115|3@1+ (1,0) [0|0] "" Vector__XXX
 SG_ Mirror_AutoWashModeSta_TypeC : 118|2@1+ (1,0) [0|0] "" Vector__XXX
 SG_ Mirror_RHPosMnlReq : 120|3@1+ (1,0) [0|0] "" Vector__XXX
 SG_ Mirror_LHPosMnlCmd : 124|3@1+ (1,0) [0|0] "" Vector__XXX
 SG_ Mirror_RHPosMnlCmd : 128|3@1+ (1,0) [0|0] "" Vector__XXX
 SG_ Wiper_FrWiperLowAct : 132|2@1+ (1,0) [0|0] "" Vector__XXX
 SG_ Wiper_FrWiperHighAct : 134|2@1+ (1,0) [0|0] "" Vector__XXX
 SG_ Wiper_FrtWiperLowCmd : 136|2@1+ (1,0) [0|0] "" Vector__XXX
 SG_ Wiper_FrtWiperHighCmd : 138|2@1+ (1,0) [0|0] "" Vector__XXX
 SG_ Wiper_RrWiperCmd : 140|2@1+ (1,0) [0|0] "" Vector__XXX
 SG_ Wiper_PowerEnableCmd : 142|2@1+ (1,0) [0|0] "" Vector__XXX
 SG_ Wiper_FrtWasherCmd : 144|2@1+ (1,0) [0|0] "" Vector__XXX
 SG_ Wiper_RrWasherCmd : 146|2@1+ (1,0) [0|0] "" Vector__XXX
 SG_ Wiper_HeadLampWasherCmd : 148|2@1+ (1,0) [0|0] "" Vector__XXX
 SG_ Wiper_AutoWashModeSta_TypeC : 150|2@1+ (1,0) [0|0] "" Vector__XXX
 SG_ Mirror_LHPosMnlPlyCmd : 152|3@1+ (1,0) [0|0] "" Vector__XXX
 SG_ Mirror_RHPosMnlPlyCmd : 155|3@1+ (1,0) [0|0] "" Vector__XXX
 SG_ BDC_FD_AlvCnt8Val : 16|8@1+ (1,0) [0|0] "" Vector__XXX
 SG_ Mirror_LHPosAutoPlyCmd : 160|4@1+ (1,0) [0|0] "" Vector__XXX
 SG_ Mirror_RHPosAutoPlyCmd : 164|4@1+ (1,0) [0|0] "" Vector__XXX
 SG_ Mirror_IMSMemoryCmd : 168|3@1+ (1,0) [0|0] "" Vector__XXX
 SG_ Wiper_RainAmount : 24|8@1+ (0.1,0) [0|0] "" Vector__XXX
 SG_ Wiper_AutoWashModeSta : 32|2@1+ (1,0) [0|0] "" Vector__XXX
 SG_ Wiper_PrkngPosSta : 34|2@1+ (1,0) [0|0] ""  BLTN_CAM_FD
 SG_ Wiper_RainSnsrOptionTyp : 36|2@1+ (1,0) [0|0] "" Vector__XXX
 SG_ Wiper_HtWshNzzlCmd : 38|2@1+ (1,0) [0|0] "" Vector__XXX
 SG_ Wiper_RainSnsrSta : 40|4@1+ (1,0) [0|0] ""  BLTN_CAM_FD
 SG_ Wiper_RainSnsrPartNum : 44|4@1+ (1,0) [0|0] "" Vector__XXX
 SG_ ECW_Fault : 48|2@1+ (1,0) [0|0] "" Vector__XXX
 SG_ ECW_FaultActv : 50|2@1+ (1,0) [0|0] "" Vector__XXX
 SG_ ECW_HiVolt : 52|2@1+ (1,0) [0|0] "" Vector__XXX
 SG_ ECW_HiVoltActv : 54|2@1+ (1,0) [0|0] "" Vector__XXX
 SG_ ECW_LoVolt : 56|2@1+ (1,0) [0|0] "" Vector__XXX
 SG_ ECW_LoVoltActv : 58|2@1+ (1,0) [0|0] "" Vector__XXX
 SG_ ECW_Overload : 60|2@1+ (1,0) [0|0] "" Vector__XXX
 SG_ ECW_OverloadActv : 62|2@1+ (1,0) [0|0] "" Vector__XXX
 SG_ ECW_CommErr : 64|2@1+ (1,0) [0|0] "" Vector__XXX
 SG_ BCM_SolSnsrRt : 72|8@1+ (4.72441,0) [0|0] "W/m2" Vector__XXX
 SG_ BCM_SolSnsrLft : 80|8@1+ (4.72441,0) [0|0] "W/m2" Vector__XXX
 SG_ Mirror_MirFldOpt : 88|2@1+ (1,0) [0|0] "" Vector__XXX
 SG_ Mirror_FldUnfldCmd : 90|2@1+ (1,0) [0|0] "" Vector__XXX
 SG_ Mirror_FldCtrlSta : 92|2@1+ (1,0) [0|0] "" Vector__XXX
 SG_ Mirror_UnFldCtrlSta : 94|2@1+ (1,0) [0|0] "" Vector__XXX
 SG_ Mirror_PosMnlCmd : 96|3@1+ (1,0) [0|0] "" Vector__XXX
 SG_ Mirror_SelSwIndCmd : 99|3@1+ (1,0) [0|0] "" Vector__XXX

CM_ BO_ 996 "[PE] Periodic and On Event";
CM_ SG_ 996 PDC_FD_Crc10Val "PDC_FD_CyclicRedundancyCheck10Value";
CM_ SG_ 996 PDC_PwrOnModePowerReq "This is for high voltage battery discharge request at Power On mode of EV";
CM_ SG_ 996 PDC_LeadAcidBatType "Lead Acid Battery Type Information";
CM_ SG_ 996 PDC_FD_AlvCnt10Val "PDC_FD_AliveCounter10Value";
CM_ SG_ 996 ICU_PowerAutoCutModSta "##2G## -  - CF_Gway_ICUPowerAutoCutMode";
CM_ SG_ 996 Autocut_DlvryModSta "Autocut_DeliveryModeStatus ##2G## -  - C_SJBDeliveryMode,CF_Gway_SJBDeliveryMode";
CM_ SG_ 996 ICU_SoCBattStaMsgReq "##2G## -  - Batt_SoCWarningAlertMsgReq";
CM_ SG_ 996 Batt_SoCWarningValue "Value of SoC warning level. ##2G## -  - Batt_SoCWarningValue";
CM_ SG_ 996 ICU_BattAutoCutPreWrng "This is a warning signal before blocking the dark current of the ICU by the battery SOC.";
CM_ SG_ 996 OTAModeACCOffReq "ACC off request during OTA mode for battery saver";
CM_ SG_ 996 C_ICUIGNOffReq "IGN off request(Not engine running state only) for battery saver";
CM_ SG_ 996 IGN_AutoOff_WarnSta "this signal is defined as the warning signal related with battery discharge";
CM_ SG_ 996 IGN_AutoOff_WarnSta_CLU "this signal is defined as the warning signal related with battery discharge";
CM_ SG_ 996 PDC_BatPwrStateClassA "Vehicle Low-Voltage Power State Class A";
CM_ SG_ 996 PDC_BatPwrStateClassB "Vehicle Low-Voltage Power State Class  B";
CM_ SG_ 996 PDC_BatPwrStateClassC "Vehicle Low-Voltage Power State Class  C";
CM_ SG_ 996 Bat_dischrg "Battery discharge notification flag #2G# Bat_dischrg";
CM_ SG_ 996 Bat12V_Chr_Req "12V lead acid battery charging request signal";
CM_ SG_ 996 ICU_BattMngAlert "This signal is for battery discharge warning.";
CM_ BO_ 1047 "[P] Periodic";
CM_ SG_ 1047 GNSS_Crc5Val "GNSS_CyclicRedundancyCheck5Value";
CM_ SG_ 1047 GNSS_AlvCnt5Val "GNSS_AliveCounter5Value";
CM_ SG_ 1047 HU_GNSS_Fix_status "GNSS fix status";
CM_ SG_ 1047 HU_GNSS_TimeSource "Time Source란 일종의 Module이 출력할 수 있는 시간정보의 유효성레벨을 타나내며, User는 RTC  or GPS(<1ms)  일때만 시간 정보 사용 가능";
CM_ SG_ 1047 HU_GNSS_DST "DST setting";
CM_ SG_ 1047 HU_GNSS_TimezoneOffset "Timezone Offset";
CM_ SG_ 1047 HU_GNSS_UTC_year "UTC year";
CM_ SG_ 1047 HU_GNSS_UTC_hour "UTC_HOUR";
CM_ BO_ 811 "[PE] Periodic and On Event";
CM_ SG_ 811 SBCM_AST_FD_Crc1Val "SBCM_AST_FD_CyclicRedundancyCheck1Value";
CM_ SG_ 811 SBCM_AST_FD_AlvCnt1Val "SBCM_AST_FD_AliveCounter1Value";
CM_ SG_ 811 SBCM_Longkey_ASTDrAtClsSwSta "FCS Power Door Long key Status";
CM_ SG_ 811 Hood_TypeOption_AST "E-Hood_Option Type";
CM_ SG_ 811 FrunkReleaseSwSta_SBCM_AST "FrunkReleaseState (SBCM_AST_FD to SBCM_DRV_FD) RHD Spec";
CM_ SG_ 811 FrunkInsideRelSwSta_SBCM_AST "FrunkInsideReleaseSwState (SBCM_AST_FD to SBCM_DRV_FD) RHD Spec";
CM_ SG_ 811 FrunkEmergencySwSta_SBCM_AST "FrunkEmergencySwState (SBCM_AST_FD to SBCM_DRV_FD) RHD Spec";
CM_ SG_ 811 EHL_TxInfo_SBCM_AST "Electronic hood latch status signal transfer for dual hood latch type";
CM_ SG_ 811 AST_CrashUnlockCmd "AssistCrashUnlockCommand";
CM_ SG_ 811 DoorLock_CtrlDrLkSwSta_SBCM "DoorLock_CentralDoorLockAssistSwitchStatus";
CM_ SG_ 811 DoorLock_CtrlDrUnLkSwSta_SBCM "DoorLock_CentralDoorUnLockAssistSwitchStatus";
CM_ SG_ 811 Warn_AsstDrSwSta_SBCM "Warn_AssistDoorSwitchStatus ##2G## -  - C_AstDrSw,CF_Gway_AstDrSw,Warn_AsstDrSwSta";
CM_ SG_ 811 DoorLock_AsstDrUnLkSta_SBCM "DoorLock_AssistDoorUnLockStatus ##2G## -  - C_AstUnlockState,DoorLock_AsstDrUnLkSta";
CM_ SG_ 811 AST_SEAWarn_RH "Assist SEA Warning (LHD)";
CM_ BO_ 849 "[PE] Periodic and On Event";
CM_ SG_ 849 IAU_FD_Crc4Val "IAU_FD_CyclicRedundancyCheck4Value";
CM_ SG_ 849 IAU_DigitalKey2Opt "Digital Key2 Option Signal";
CM_ SG_ 849 IAU_ValetDigitalkey "Digital Key Valet Mode";
CM_ SG_ 849 IAU_DigitalKeyNumberOpt "This signal is for the digital key number type.";
CM_ SG_ 849 IAU_eSEReprogramSta "this signal is to mornitor the state of eSE reprograming.";
CM_ SG_ 849 IAU_DgtKeyGrpPrflRval2 "This signal indiactes digital key group number paired with selected profile";
CM_ SG_ 849 IAU_StartIdentifiedProfile "This signal Indicate Profile of vehicle start Identified";
CM_ SG_ 849 IAU_DigitalKeyProfileRval2 "This signal indiactes digital key number paired with selected profile";
CM_ SG_ 849 IAU_FD_AlvCnt4Val "IAU_FD_AliveCounter4Value";
CM_ SG_ 849 IAU_StartIdentifiedProfile_Ext "This signal indicate Profile of vehicle start Identified";
CM_ SG_ 849 RSPA_UWBRspaExtRngSta "RSPA remote control range of UWB";
CM_ SG_ 849 RSPA_CanFltSta "RSPA_CANErrorState";
CM_ SG_ 849 RSPA_BLESigErrSta "RSPA_RFSignalErrorState";
CM_ SG_ 849 IAU_ProfileIDRVal "This signal Indicate the Current detected Profile ID by IAU.";
CM_ SG_ 849 IAU_DigitalKeyProcessingSta "Digital Key USM settitng Process State";
CM_ SG_ 849 IAU_DigitalKeyExit "Digital Key USM setting Exit Condition";
CM_ SG_ 849 IAU_DigitalKeyEnblRVal "Digital Key Function Enable / Disable flag (Fob is required for changing flag)";
CM_ SG_ 849 IAU_OwnerPhnRegRVal "Vehicle Owner's Phone is Registered for Digital Key function";
CM_ SG_ 849 IAU_NFCCard1RegRVal "NFC Card 1 is Registered for Digital Key function";
CM_ SG_ 849 IAU_NFCCard2RegRVal "NFC Card 2 is Registered for Digital Key function";
CM_ BO_ 518 "[P] Periodic";
CM_ SG_ 518 GNSS_Crc7Val "GNSS_CyclicRedundancyCheck7Value";
CM_ SG_ 518 HU_DR_Latitude "1sc(semi-cicle)= pi rad=180  /   unit : 2^-31sc  /  range [-1/2~1/2] sc";
CM_ SG_ 518 GNSS_AlvCnt7Val "GNSS_AliveCounter7Value";
CM_ SG_ 518 HU_DR_Longitude "1sc(semi-circle)=pi rad=180 / unit:2^-31sc / range:[-1, 1]sc";
CM_ SG_ 518 HU_DR_Heading "1sc(semi-circle)=pi rad=180 / unit=2^-15sc / range:[0,2]SC";
CM_ SG_ 518 HU_DR_Speed "unit : 1cm/s";
CM_ SG_ 518 HU_DR_TimeOfWeek "Local Time which DR data is transmitted";
CM_ SG_ 518 HU_DR_Position_Status "DR Position status";
CM_ SG_ 518 HU_DR_Altitude_Status "DR Altitude Status";
CM_ SG_ 518 HU_DR_Heading_Status "DR Heading Status";
CM_ SG_ 518 HU_DR_Speed_Status "DR Speed status";
CM_ SG_ 518 HU_DR_DirectionSwitch_Sta "DR DirectionSwitch Status";
CM_ SG_ 518 HU_DR_Direction "DR Direction, Backward";
CM_ SG_ 518 HU_DR_GyroCalib_Sta "DR Gyro Calibration Status";
CM_ SG_ 518 HU_DR_TachoCalib_Sta "DR Tacho Calibration Status";
CM_ SG_ 518 HU_DR_GNSS_Fix_Age "Time since last GNSS fix";
CM_ SG_ 518 HU_DR_Altitude "range [-400,10000]";
CM_ BO_ 101 "[P] Periodic";
CM_ SG_ 101 IEB_Crc1Val "IEB_CyclicRedundancyCheck1Value";
CM_ SG_ 101 IEB_StrkDpthPcVal "IEB_StrokeDepthPcValue ##2G##ESC - EBS2 - CR_Brk_StkDep_Pc";
CM_ SG_ 101 IEB_EstDpthPcVal "IEB_EstimatedPedalDepthValue ##2G##ESC - EBS2 - CR_Brk_Est_StkDep_Pc";
CM_ SG_ 101 IEB_AbsNGearReq "IEB_AbsNGearRequest ##2G##ESC - TCS11 - CF_Brk_AbsNReq";
CM_ SG_ 101 IEB_EstBrkPdlValVldSta "IEB_EstimatedBrakePedalValueValidityStatus ##2G##ESC - EBS2 - CF_Brk_Est_StkValid";
CM_ SG_ 101 IEB_DriftEscModSta_VDC "ESC/VDC mode command from DMIC by AVNT custom mode select";
CM_ SG_ 101 IEB_RegenTqLimitNmVal_Rear "IEB_RegenTorqueLimitValue Rear";
CM_ SG_ 101 IEB_DrvWhlSlipFlg_Frnt "Slip status of driving wheel ##2G##ESC ? EBS2 ? CF_Brk_DrvWhlSlipFlg";
CM_ SG_ 101 IEB_IndDriftMode "Signal for feedback from AVNT drift mode ON/OFF command";
CM_ SG_ 101 IEB_IndDriftEcsModSta "Signal for feed back of  ECS mode command from DMIC by AVNT custom mode select";
CM_ SG_ 101 IEB_IndDriftElsdModSta "Signal for feed back of ELSD mode command from DMIC by AVNT custom mode select";
CM_ SG_ 101 IEB_TCS_Req "IEB_TCS_Request";
CM_ SG_ 101 IEB_RSC_Req "IEB_RSC_Request";
CM_ SG_ 101 TCS_TqFlag_Frnt "TCS_TorqueFlag_Front";
CM_ SG_ 101 TCS_TqFlag_Rear "TCS_TorqueFlag_Rear";
CM_ SG_ 101 RSC_TqFlag_Frnt "RSC_TorqueFlag_Front";
CM_ SG_ 101 RSC_TqFlag_Rear "RSC_TorqueFlag_Rear";
CM_ SG_ 101 IEB_AlvCnt1Val "IEB_AliveCounter1Value";
CM_ SG_ 101 TCS_TqIntrvntnVal_Frnt "TCS_TorqueInterventionValue_Front";
CM_ SG_ 101 TCS_TqIntrvntnVal_Rear "TCS_TorqueInterventionValue_Rear";
CM_ SG_ 101 RSC_TqIntrvntnVal_Frnt "RSC_TorqueInterventionValue_Front";
CM_ SG_ 101 RSC_TqIntrvntnVal_Rear "RSC_TorqueInterventionValue_Rear";
CM_ SG_ 101 TCS_MtrTrgtRpm_Flag_Frnt "TCS_MotorTargetRPM_Flag_Front";
CM_ SG_ 101 TCS_MtrTrgtRpm_Flag_Rear "TCS_MotorTargetRPM_Flag_Rear";
CM_ SG_ 101 IEB_DriftElsdModSta "ELSD mode command from DMIC by AVNT custom mode select";
CM_ SG_ 101 IEB_DriftEcsModSta "ECS mode command from DMIC by AVNT custom mode select";
CM_ SG_ 101 IEB_DriftMdpsModSta "MDPS mode command from DMIC by AVNT custom mode select";
CM_ SG_ 101 TCS_MtrTrgtRpm_Frnt "TCS_MotorTargetRPM_Front";
CM_ SG_ 101 TCS_MtrTrgtRpm_Rear "TCS_MotorTargetRPM_Rear";
CM_ SG_ 101 IEB_DriftModeSta "Display";
CM_ SG_ 101 IEB_DriftModeActSta "ON/OFF status, Symbol";
CM_ SG_ 101 MCU_AntiJerk_Inhbtsta "MCU_AntiJerk_Inhbtsta is a signal to inform the MCU of anti-jerk control prohibition in order to prevent side effects caused by intervention in the IEB when ABS control and MCU anti-jerk control overlap.";
CM_ SG_ 101 IEB_Motor_ProtectModSta "It is a signal to notify when the internal motor protection mode of the electric integrated booster is activated.";
CM_ SG_ 101 IEB_EstBrkSacFrcNmVal "Estimated brake force value for stop assist control";
CM_ SG_ 101 IEB_SrvLmpDis "IEB_ServiceLampDisplay ##2G##ESC - AHB1 - CF_Ahb_SLmp";
CM_ SG_ 101 IEB_IndDriftEscModSta_TCS "Signal for feed back of TCS mode change from DMIC by AVNT custom mode select";
CM_ SG_ 101 IEB_IndDriftEscModSta_VDC "Signal for feed back of ESC/VDC mode command from DMIC by AVNT custom mode select";
CM_ SG_ 101 IEB_IndDriftMdpsModSta "Signal for feed back of MDPS mode command from DMIC by AVNT custom mode select";
CM_ SG_ 101 IEB_DfctvSta "IEB_DefectiveStatus ##2G##ESC - AHB1 - CF_Ahb_Def";
CM_ SG_ 101 IEB_ActvSta "IEB_ActiveStatus ##2G##ESC - AHB1 - CF_Ahb_Act";
CM_ SG_ 101 IEB_DiagSta "IEB_DiagnosticStatus ##2G##ESC - AHB1 - CF_Ahb_Diag";
CM_ SG_ 101 IEB_WrngLmpDis "IEB_WarningLampDisplay ##2G##ESC - AHB1 - CF_Ahb_WLmp";
CM_ SG_ 101 IEB_MILReq "MIL Requeset";
CM_ SG_ 101 IEB_DriftModeStaDis "This signal is for a pop-up display on restriction status of drift mode activation";
CM_ SG_ 101 RSC_Sta "RSC Ready Status";
CM_ SG_ 101 IEB_StrkDpthmmVal "IEB_StrokeDepthmmValue ##2G##ESC - AHB1 - CR_Ahb_StDep_mm";
CM_ SG_ 101 IEB_BrkActvSta "IEB_BrakeActiveStatus ##2G##ESC - AHB1 - CF_Esc_BrakeAct";
CM_ SG_ 101 IEB_PdlTrvlSnsrFailSta "IEB_PedalTravelSensorFailStatus ##2G##ESC - AHB1 - CF_Ahb_SnsFail";
CM_ SG_ 101 IEB_PdlCalibSta "IEB_PedalCalibrationStatus ##2G##ESC - AHB1 - CF_Ahb_PedalCalStat";
CM_ SG_ 101 IEB_BzrSta "IEB_BuzzerStatus ##2G##ESC - AHB1 - CF_Ahb_Bzzr";
CM_ SG_ 101 IEB_Sta "IEB_Status ##2G##ESC - EBS1 - CF_Brk_EBSStat";
CM_ SG_ 101 IEB_SnsrFailSta "IEB_SensorFailStatus ##2G##ESC - EBS1 - CF_Brk_SnsFail";
CM_ SG_ 101 IEB_RbsWrngLmpSta "IEB_RbsWarningLamp ##2G##ESC - EBS1 - CF_Brk_RBSWLamp";
CM_ SG_ 101 IEB_VacSysDfctvSta "IEB_VacuumSystemDefectiveStatus ##2G##ESC - EBS1 - CF_Brk_VacuumSysDef";
CM_ SG_ 101 IEB_RegenTqLimitNmVal_Frnt "IEB_RegenTorqueLimitValue ##2G##ESC - EBS1 - CR_Brk_RegenTqLimit_Nm";
CM_ SG_ 101 IEB_EstTtlBrkFrcNmVal "IEB_EstimatedTotalBrakeForceValue ##2G##ESC - EBS1 - CR_Brk_EstTot_Nm";
CM_ BO_ 309 "[P] Periodic";
CM_ SG_ 309 BAT_Crc1Val "BAT_CyclicRedundancyCheck1Value";
CM_ SG_ 309 BAT_AlvCnt1Val "BAT_AliveCounter1Value";
CM_ SG_ 309 BAT_CurrVal "BAT_CurrentValue";
CM_ SG_ 309 BAT_SocVal "BAT_StateOfChargeValue";
CM_ SG_ 309 BAT_VoltVal "BAT_VoltageValue";
CM_ SG_ 309 BAT_AuxBattOpt "12V Battery Option Value(LFP 12V Battery)";
CM_ SG_ 309 BAT_TempVal "BAT_TemperatureValue";
CM_ SG_ 309 BAT_SocErrSta "BAT_SoCErrorStatus";
CM_ SG_ 309 BAT_SohVal "BAT_StateOfHealthValue";
CM_ SG_ 309 BAT_SnsrInvldSta "BAT_SensorInvalidStatus";
CM_ SG_ 309 BAT_SofVal "BAT_StateOfFunctionValue";
CM_ SG_ 309 BAT_RspErrSta "BAT_ResponseErrorStatus";
CM_ SG_ 309 BAT_CapacityVal "12V Battery Capacity Value";
CM_ BO_ 920 "[PE] Periodic and On Event";
CM_ SG_ 920 CTM_FD_Crc2Val "CTM_FD_CyclicRedundancyCheck2Value";
CM_ SG_ 920 CTM_FD_AlvCnt2Val "CTM_FD_AliveCounter2Value";
CM_ SG_ 920 USM_TrailerTypSta "Trailer type status";
CM_ SG_ 920 ITBC_TrailerDisplayAppliedSta "Determination of ITBC application";
CM_ SG_ 920 ITBC_TrailerBrkOut "Trailer Brake Output sent to cluster. PWM duty cycle 0 - 100%.";
CM_ SG_ 920 ITBC_TrailerBrkGainVal "Gain setting 0 - 10 in steps of 0.5 on cluster.";
CM_ SG_ 920 ITBC_SysWarn "Request for cluster to provide audible warning & pop up (conditions TBD eg fault).";
CM_ SG_ 920 CTM_TrailerAct "This signal is used for control the Trailer Act function.";
CM_ SG_ 920 CTM_RearfogAct "This signal is used for display the rear fog lamp mounted on the trailer.";
CM_ SG_ 920 CTM_StpLmpOpnSta "Trailer Stop Lamp OpenStatus";
CM_ SG_ 920 CTM_TrnSigLmpLftOpnSta "Trailer T/SIG Lamp Left OpenStatus";
CM_ SG_ 920 CTM_TrnSigLmpRtOpnSta "Trailer T/SIG Lamp Right OpenStatus";
CM_ SG_ 920 CTM_ExtTailLmpLftOpnSta "Trailer Exterior Tail Lamp Left OpenStatus";
CM_ SG_ 920 CTM_ExtTailLmpRtOpnSta "Trailer Exterior Tail Lamp Right OpenStatus";
CM_ SG_ 920 CTM_Exra_EbrakSta "Trailer Exterior Ebrake Out OnOffStatus";
CM_ SG_ 920 CTM_TrlAngl_200ms "CTM_TrailerAngle_200ms";
CM_ BO_ 1059 "[PE] Periodic and On Event";
CM_ SG_ 1059 HU_GW_Crc4Val "HU_GW_CyclicRedundancyCheck4Value";
CM_ SG_ 1059 OMUOSMirCtrl_Vr "This signal is for the OutSide Mirror Control (Fold or Unfold)";
CM_ SG_ 1059 HU_GW_AlvCnt4Val "HU_GW_AliveCounter4Value";
CM_ SG_ 1059 HU_IG3_Request "IG3 wake up and sleep request for EV/PHEV";
CM_ SG_ 1059 HU_DigitalKeyGroupingSupport "Digital Key Grouping Support";
CM_ SG_ 1059 HU_Background "HU Backgound image info";
CM_ SG_ 1059 HU_BackgroundFadeInOut "HU Background Fade in/out info - (HEX * Factor) %";
CM_ BO_ 979 "[PE] Periodic and On Event";
CM_ SG_ 979 BDC_FD_Crc4Val "BDC_FD_CyclicRedundancyCheck4Value";
CM_ SG_ 979 BDC_FD_AlvCnt4Val "BDC_FD_AliveCounter4Value";
CM_ SG_ 979 BAlarm_BglrAlrm_CurrentSta "Only for CAN FD (SV~)";
CM_ SG_ 979 BAlarm_BglrAlrm_Sta "Only for CAN FD (SV~)";
CM_ SG_ 979 BAlarm_PncAlrmSta "BAlarm_PanicAlarmStatus ##2G##BCM - BCMmsg17 - C_PanicState";
CM_ SG_ 979 SBR_StBltStpWrngBzrSta "SBR_SeatBeltStepWarningBuzzerStatus ##2G##BCM - BCMmsg32 - C_SeatBeltWngBuzStep";
CM_ SG_ 979 SBR_StBltWrngBzrSta "SBR_SeatBeltWarningBuzzerStatus ##2G##BCM - BCMmsg32 - C_SeatBeltWngBuz";
CM_ SG_ 979 BAlarm_BrglrHrnRlySta "BAlarm_BurglarHornRelayStatus ##2G##BCM - BCMmsg19 - C_BurglarHornRly";
CM_ SG_ 979 SBR_DrvStBltIndSta "SBR_DriverSeatBeltIndicatorStatus ##2G##BCM - BCMmsg32 - C_DrvSeatBeltInd";
CM_ SG_ 979 SBR_RrLftStBltWrngIndSta "SBR_RearLeftSeatBeltWarningIndicatorStatus ##2G##BCM - BCMmsg32 - C_RLSeatBeltInd";
CM_ SG_ 979 SBR_RrRtStBltWrngIndSta "SBR_RearRightSeatBeltWarningIndicatorStatus ##2G##BCM - BCMmsg32 - C_RRSeatBeltInd";
CM_ SG_ 979 SBR_RrCtrStBltIndSta "SBR_RearCenterSeatBeltIndicatorStatus ##2G##BCM - BCMmsg32 - C_RCSeatBeltInd";
CM_ SG_ 979 SBR_3rdLftStBltWrngIndSta "SBR_3rdLeftSeatBeltWarningIndicatorStatus ##2G##BCM - BCMmsg32 - C_3LSeatBeltInd";
CM_ SG_ 979 SBR_3rdRtStBltWrngIndSta "SBR_3rdRightSeatBeltWarningIndicatorStatus ##2G##BCM - BCMmsg32 - C_3RSeatBeltInd";
CM_ SG_ 979 SBR_3rdCtrStBltWrngIndSta "SBR_3rdCeterSeatBeltWarningIndicatorStatus ##2G##BCM - BCMmsg32 - C_3CSeatBeltInd";
CM_ SG_ 979 Warn_BzrWrngSta "Warn_BuzzerWarningStatus ##2G##BCM - BCMmsg18 - C_WngBuz";
CM_ SG_ 979 Warn_BCMWrngSta "Warn_BCMWarningStatus ##2G##BCM - BCMmsg19 - C_BCMWarning";
CM_ SG_ 979 ROA_RegionOpt "A Euro NCAP Option signal (BDC only)";
CM_ SG_ 979 Warn_RrStRmndOpt "Warn_RearSeatReminderOption ##2G##BCM - BCMmsg22 - C_RrSeatRemindOpt";
CM_ SG_ 979 Warn_RrStRmndAlrmOnReq "Warn_RearSeatReminderAlarmOnRequest ##2G##BCM - BCMmsg22 - C_RrSeatRemindAlarm";
CM_ SG_ 979 Warn_RrStRmndSysSta "Warn_RearSeatReminderSystemStatus ##2G##BCM - BCMmsg22 - C_RrSeatRemindState";
CM_ SG_ 979 Warn_RrStRmndAlrmInfo "Warn_RearSeatReminderAlarmInformaion ##2G##BCM - BCMmsg22 - C_RrSeatRemindInfo";
CM_ SG_ 979 Warn_RoaErr "Warn_RoaError##2G##BCM - BCMmsg22 - C_RoaError";
CM_ SG_ 979 Warn_RrStRmndDelay "Warn_RStRmndDelay";
CM_ SG_ 979 Warn_RrStRmndSysAct "Warn_RrStRmndSysAct";
CM_ SG_ 979 WAL_FobSearching "IBU Walk Away Lock Fob Searching State for Radar ROA";
CM_ SG_ 979 Warn_RrStRmndSysOffIND "Warning_RearSeatRemindSystemOffIND";
CM_ SG_ 979 Warn_VehNotPWrngSta "Vehicle Not P Warning";
CM_ BO_ 983 "[PE] Periodic and On Event";
CM_ SG_ 983 BDC_FD_Crc8Val "BDC_FD_CyclicRedundancyCheck8Value";
CM_ SG_ 983 Mirror_MnlFldModSta "Mirror Manual Fold State";
CM_ SG_ 983 Mirror_SelSwSta "Outside Mirror Select Button Status";
CM_ SG_ 983 Mirror_LHPosMnlReq "Left Outside Mirror Positioning Request";
CM_ SG_ 983 Mirror_RHPosMnlReq "Right Outside Mirror Positioning Request";
CM_ SG_ 983 Mirror_LHPosMnlCmd "Left Outside Mirror Positioning Command";
CM_ SG_ 983 Mirror_RHPosMnlCmd "Right Outside Mirror Positioning Command";
CM_ SG_ 983 Wiper_FrtWiperLowCmd "Front Wiper Low Output";
CM_ SG_ 983 Wiper_FrtWiperHighCmd "Front Wiper High Output";
CM_ SG_ 983 Wiper_RrWiperCmd "Rear Wiper Output";
CM_ SG_ 983 Wiper_PowerEnableCmd "Wiper Power Enable Output";
CM_ SG_ 983 Wiper_FrtWasherCmd "Front Washer Output";
CM_ SG_ 983 Wiper_RrWasherCmd "Rear Washer Output";
CM_ SG_ 983 Wiper_HeadLampWasherCmd "Head Lamp Washer Output";
CM_ SG_ 983 BDC_FD_AlvCnt8Val "BDC_FD_AliveCounter8Value";
CM_ SG_ 983 Wiper_AutoWashModeSta "Auto Wash Mode Wiper State";
CM_ SG_ 983 Wiper_PrkngPosSta "Wiper_ParkingPositionStatus ##2G##BCM - BCMmsg22 - C_WiperParkPosition";
CM_ SG_ 983 Wiper_RainSnsrOptionTyp "Wiper_RainSensorOptionType ##2G##BCM - BCMmsg24 - C_RainSnsOption";
CM_ SG_ 983 Wiper_RainSnsrSta "Wiper_RainSensorStatus ##2G##BCM - BCMmsg24 - C_RainSnsState";
CM_ SG_ 983 BCM_SolSnsrRt "BCM_SolarSensorRightOutputVoltageValue ##2G##BCM - BCMmsg24 - C_PhotosensorRH";
CM_ SG_ 983 BCM_SolSnsrLft "BCM_SolarSensorLeftOutputVoltageValue ##2G##BCM - BCMmsg24 - C_PhotosensorLH";
CM_ SG_ 983 Mirror_MirFldOpt "Outside Mirror Electric Fold Option Signal";
CM_ SG_ 983 Mirror_FldUnfldCmd "Mirror Folding Unfolding Command";
CM_ SG_ 983 Mirror_FldCtrlSta "Mirror Fold and Folding Control State";
CM_ SG_ 983 Mirror_UnFldCtrlSta "Mirror Unfold and Unfolding Control State";
CM_ SG_ 983 Mirror_PosMnlCmd "Mirror Positioning Command";
CM_ SG_ 983 Mirror_SelSwIndCmd "Mirror Select Switch Indicator Command";
BA_DEF_ BO_  "CANFD_BRS" ENUM  "0","1";
BA_DEF_ BO_  "GenMsgEVName" STRING ;
BA_DEF_ BO_  "NmAsrMessage" ENUM  "No","Yes";
BA_DEF_ BO_  "DiagState" ENUM  "No","Yes";
BA_DEF_ BO_  "DiagResponse" ENUM  "No","Yes";
BA_DEF_ BO_  "DiagRequest" ENUM  "No","Yes";
BA_DEF_ BO_  "TpMessage" ENUM  "No","Yes";
BA_DEF_ BO_  "UsrMsgIDSforwardDeviation" INT 0 100;
BA_DEF_ BO_  "UsrMsgIDSbackwardDeviation" INT 50 1000;
BA_DEF_ BO_  "GenMsgCycleTime" INT 0 2000;
BA_DEF_ BO_  "GenMsgStartDelayTime" INT 0 2000;
BA_DEF_ BO_  "GenMsgSendType" ENUM  "Cyclic","NoMsgSendType";
BA_DEF_ BO_  "GenMsgCycleTimeFast" INT 0 500;
BA_DEF_ BO_  "GenMsgDelayTime" INT 0 20;
BA_DEF_ BO_  "GenMsgILSupport" ENUM  "No","Yes";
BA_DEF_ BO_  "GenMsgNrOfRepetition" INT 0 3;
BA_DEF_ BO_  "VFrameFormat" ENUM  "StandardCAN","ExtendedCAN","reserved","reserved","reserved","reserved","reserved","reserved","reserved","reserved","reserved","reserved","reserved","reserved","StandardCAN_FD","ExtendedCAN_FD";
BA_DEF_ SG_  "UserSigValidity" ENUM  "B+","ACC","IG","IG1","IG2","IG3","IG1 or IG2","IG1 or IG3","Undef";
BA_DEF_ SG_  "TimeoutValue" STRING ;
BA_DEF_ SG_  "UsrSigPurpose" ENUM  "Undef","FN","DIAG","DIAG(Req)","DIAG(Res)","DIAG(Func)","DEV","CCP","NM","TP";
BA_DEF_ SG_  "GenSigStartValue" INT 0 1215752192;
BA_DEF_ SG_  "NetworkRequest" ENUM  "Yes","No";
BA_DEF_ SG_  "NetworkRequestHoldingTime" INT 0 65535;
BA_DEF_ SG_  "Description" STRING ;
BA_DEF_ SG_  "Version" STRING ;
BA_DEF_ SG_  "GenSigEnvVarType" ENUM  "Int","Float","Undef";
BA_DEF_ SG_  "GenSigSendType" ENUM  "Cyclic","OnWrite","OnWriteWithRepetition","OnChange","OnChangeWithRepetition","IfActive","IfActiveWithRepetition","NoSigSendType","OnChangeAndIfActive","OnChangeAndIfActiveWithRepetition";
BA_DEF_ SG_  "GwSigLatencyTime" INT 0 65536;
BA_DEF_ SG_  "GwSigMissingSourceType" ENUM  "Undef","OldValue","DefaultValue","InitialValue";
BA_DEF_ SG_  "NWM-WakeupAllowed" ENUM  "<n.a.>";
BA_DEF_ SG_  "RoutingFactor" INT 1 1215752192;
BA_DEF_ SG_  "SystemSignalLongSymbol" STRING ;
BA_DEF_REL_ BU_SG_REL_  "GenSigTimeoutTime" INT 0 7000;
BA_DEF_DEF_  "CANFD_BRS" "1";
BA_DEF_DEF_  "GenMsgEVName" "@Signame";
BA_DEF_DEF_  "NmAsrMessage" "No";
BA_DEF_DEF_  "DiagState" "No";
BA_DEF_DEF_  "DiagResponse" "No";
BA_DEF_DEF_  "DiagRequest" "No";
BA_DEF_DEF_  "TpMessage" "No";
BA_DEF_DEF_  "UsrMsgIDSforwardDeviation" 10;
BA_DEF_DEF_  "UsrMsgIDSbackwardDeviation" 100;
BA_DEF_DEF_  "GenMsgCycleTime" 200;
BA_DEF_DEF_  "GenMsgStartDelayTime" 0;
BA_DEF_DEF_  "GenMsgSendType" "NoMsgSendType";
BA_DEF_DEF_  "GenMsgCycleTimeFast" 40;
BA_DEF_DEF_  "GenMsgDelayTime" 20;
BA_DEF_DEF_  "GenMsgILSupport" "Yes";
BA_DEF_DEF_  "GenMsgNrOfRepetition" 3;
BA_DEF_DEF_  "VFrameFormat" "StandardCAN";
BA_DEF_DEF_  "UserSigValidity" "IG";
BA_DEF_DEF_  "TimeoutValue" "";
BA_DEF_DEF_  "UsrSigPurpose" "FN";
BA_DEF_DEF_  "GenSigStartValue" 0;
BA_DEF_DEF_  "NetworkRequest" "No";
BA_DEF_DEF_  "NetworkRequestHoldingTime" 0;
BA_DEF_DEF_  "Description" "";
BA_DEF_DEF_  "Version" "";
BA_DEF_DEF_  "GenSigEnvVarType" "Undef";
BA_DEF_DEF_  "GenSigSendType" "NoSigSendType";
BA_DEF_DEF_  "GwSigLatencyTime" 40;
BA_DEF_DEF_  "GwSigMissingSourceType" "Undef";
BA_DEF_DEF_  "NWM-WakeupAllowed" "<n.a.>";
BA_DEF_DEF_  "RoutingFactor" 1;
BA_DEF_DEF_REL_ "GenSigTimeoutTime" 500;
BA_DEF_DEF_  "SystemSignalLongSymbol" "";
BA_ "GenMsgSendType" BO_ 996 0;
BA_ "GenMsgStartDelayTime" BO_ 996 10;
BA_ "VFrameFormat" BO_ 996 14;
BA_ "GenMsgSendType" BO_ 1047 0;
BA_ "GenMsgCycleTime" BO_ 1047 1000;
BA_ "GenMsgCycleTimeFast" BO_ 1047 0;
BA_ "GenMsgNrOfRepetition" BO_ 1047 0;
BA_ "VFrameFormat" BO_ 1047 14;
BA_ "GenMsgSendType" BO_ 811 0;
BA_ "VFrameFormat" BO_ 811 14;
BA_ "GenMsgSendType" BO_ 849 0;
BA_ "GenMsgStartDelayTime" BO_ 849 40;
BA_ "VFrameFormat" BO_ 849 14;
BA_ "GenMsgSendType" BO_ 518 0;
BA_ "GenMsgCycleTime" BO_ 518 100;
BA_ "GenMsgCycleTimeFast" BO_ 518 0;
BA_ "GenMsgNrOfRepetition" BO_ 518 0;
BA_ "VFrameFormat" BO_ 518 14;
BA_ "GenMsgSendType" BO_ 101 0;
BA_ "GenMsgCycleTime" BO_ 101 50;
BA_ "GenMsgCycleTimeFast" BO_ 101 0;
BA_ "GenMsgNrOfRepetition" BO_ 101 0;
BA_ "VFrameFormat" BO_ 101 14;
BA_ "GenMsgSendType" BO_ 309 0;
BA_ "GenMsgCycleTime" BO_ 309 50;
BA_ "GenMsgCycleTimeFast" BO_ 309 0;
BA_ "GenMsgNrOfRepetition" BO_ 309 0;
BA_ "VFrameFormat" BO_ 309 14;
BA_ "GenMsgSendType" BO_ 920 0;
BA_ "VFrameFormat" BO_ 920 14;
BA_ "GenMsgSendType" BO_ 1059 0;
BA_ "GenMsgCycleTime" BO_ 1059 1000;
BA_ "GenMsgStartDelayTime" BO_ 1059 20;
BA_ "VFrameFormat" BO_ 1059 14;
BA_ "GenMsgSendType" BO_ 979 0;
BA_ "VFrameFormat" BO_ 979 14;
BA_ "GenMsgSendType" BO_ 983 0;
BA_ "GenMsgStartDelayTime" BO_ 983 20;
BA_ "VFrameFormat" BO_ 983 14;
BA_ "Description" SG_ 996 PDC_FD_Crc10Val "The data area for CRC calculation is based on the data length (DLC) of the message DB.

The CRC shall be calculated over the entire data block (excluding the CRC bytes) including the user data, alive counter and Data ID



- CRC Polynomial (0x1021) , Ini";
BA_ "GenSigSendType" SG_ 996 PDC_FD_Crc10Val 4;
BA_ "GenSigStartValue" SG_ 996 PDC_FD_Crc10Val 65535;
BA_ "UserSigValidity" SG_ 996 PDC_FD_Crc10Val 3;
BA_ "Version" SG_ 996 PDC_FD_Crc10Val "22.10.20";
BA_ "Description" SG_ 996 PDC_PwrOnModePowerReq "This is for high voltage battery discharge request at Power On mode of EV";
BA_ "GenSigSendType" SG_ 996 PDC_PwrOnModePowerReq 4;
BA_ "TimeoutValue" SG_ 996 PDC_PwrOnModePowerReq "0x0";
BA_ "UserSigValidity" SG_ 996 PDC_PwrOnModePowerReq 0;
BA_ "Version" SG_ 996 PDC_PwrOnModePowerReq "23.07.05";
BA_ "Description" SG_ 996 PDC_LeadAcidBatType "Lead Acid Battery Type Information

 - Validity

After EOL coding

 - Value Table

0x00:Not Applied

0x01:CMF 35Ah

0x02:CMF 40Ah

0x03:CMF 45Ah

0x04:CMF 50Ah

0x05:CMF 60Ah

0x06:CMF 68Ah

0x07:CMF 70Ah

0x08:CMF 80Ah

0x09:CMF 90Ah

0x0A:CMF 110Ah

0x";
BA_ "GenSigSendType" SG_ 996 PDC_LeadAcidBatType 4;
BA_ "UserSigValidity" SG_ 996 PDC_LeadAcidBatType 0;
BA_ "Version" SG_ 996 PDC_LeadAcidBatType "23.06.02";
BA_ "Description" SG_ 996 PDC_BatPwrClassOpt "This signal informs which signal among soc and batpwrstateclass is regarded as the state of power.";
BA_ "GenSigSendType" SG_ 996 PDC_BatPwrClassOpt 4;
BA_ "UserSigValidity" SG_ 996 PDC_BatPwrClassOpt 0;
BA_ "Version" SG_ 996 PDC_BatPwrClassOpt "23.07.05";
BA_ "Description" SG_ 996 PDC_FD_AlvCnt10Val "For the first transmission request for a data element the counter shall be initialized with 0 and shall be incremented by 1 for every subsequent send request. 

When the counter reaches the maximum value(0xFF), then it shall restart with 0 for the next s";
BA_ "GenSigSendType" SG_ 996 PDC_FD_AlvCnt10Val 4;
BA_ "UserSigValidity" SG_ 996 PDC_FD_AlvCnt10Val 3;
BA_ "Version" SG_ 996 PDC_FD_AlvCnt10Val "22.10.20";
BA_ "Description" SG_ 996 ICU_PowerAutoCutModSta "ICU Delivery Mode State";
BA_ "GenSigSendType" SG_ 996 ICU_PowerAutoCutModSta 4;
BA_ "UserSigValidity" SG_ 996 ICU_PowerAutoCutModSta 0;
BA_ "Version" SG_ 996 ICU_PowerAutoCutModSta "22.06.05";
BA_ "Description" SG_ 996 Autocut_DlvryModSta "-(Old)C_SJB_DeliveryMode

-Initial value: 1";
BA_ "GenSigSendType" SG_ 996 Autocut_DlvryModSta 4;
BA_ "GenSigStartValue" SG_ 996 Autocut_DlvryModSta 1;
BA_ "UserSigValidity" SG_ 996 Autocut_DlvryModSta 0;
BA_ "NetworkRequest" SG_ 996 Autocut_DlvryModSta 0;
BA_ "NetworkRequestHoldingTime" SG_ 996 Autocut_DlvryModSta 5000;
BA_ "Version" SG_ 996 Autocut_DlvryModSta "17.12.00";
BA_ "Description" SG_ 996 ICU_SoCBattStaMsgReq "Determine if soc level is warning or alert.";
BA_ "GenSigSendType" SG_ 996 ICU_SoCBattStaMsgReq 4;
BA_ "GenSigStartValue" SG_ 996 ICU_SoCBattStaMsgReq 3;
BA_ "UserSigValidity" SG_ 996 ICU_SoCBattStaMsgReq 0;
BA_ "Version" SG_ 996 ICU_SoCBattStaMsgReq "17.12.00";
BA_ "Description" SG_ 996 Batt_SoCWarningValue "This signal is Battery SOC from battery sensor.";
BA_ "GenSigSendType" SG_ 996 Batt_SoCWarningValue 4;
BA_ "GenSigStartValue" SG_ 996 Batt_SoCWarningValue 255;
BA_ "UserSigValidity" SG_ 996 Batt_SoCWarningValue 0;
BA_ "Version" SG_ 996 Batt_SoCWarningValue "21.11.00";
BA_ "Description" SG_ 996 ICU_BattAutoCutPreWrng "This is a warning signal before blocking the dark current of the ICU by the battery SOC.";
BA_ "GenSigSendType" SG_ 996 ICU_BattAutoCutPreWrng 4;
BA_ "GenSigStartValue" SG_ 996 ICU_BattAutoCutPreWrng 3;
BA_ "UserSigValidity" SG_ 996 ICU_BattAutoCutPreWrng 0;
BA_ "Version" SG_ 996 ICU_BattAutoCutPreWrng "20.04.06";
BA_ "Description" SG_ 996 OTAModeACCOffReq "ACC off request during OTA mode for battery saver";
BA_ "GenSigSendType" SG_ 996 OTAModeACCOffReq 4;
BA_ "TimeoutValue" SG_ 996 OTAModeACCOffReq "0x0";
BA_ "UserSigValidity" SG_ 996 OTAModeACCOffReq 0;
BA_ "NetworkRequest" SG_ 996 OTAModeACCOffReq 0;
BA_ "Version" SG_ 996 OTAModeACCOffReq "21.11.00";
BA_ "Description" SG_ 996 C_ICUIGNOffReq "IGN off request(Not engine running state only) for battery saver";
BA_ "GenSigSendType" SG_ 996 C_ICUIGNOffReq 4;
BA_ "TimeoutValue" SG_ 996 C_ICUIGNOffReq "0x0";
BA_ "UserSigValidity" SG_ 996 C_ICUIGNOffReq 0;
BA_ "NetworkRequest" SG_ 996 C_ICUIGNOffReq 0;
BA_ "Version" SG_ 996 C_ICUIGNOffReq "21.11.00";
BA_ "Description" SG_ 996 IGN_AutoOff_WarnSta "This signal is for battery discharge warning (engine not running && IGN/ACC on)

To prevent battery discharge, ICU requests the head unit to display warning and requests IBU to turn IGN/ACC off.";
BA_ "GenSigSendType" SG_ 996 IGN_AutoOff_WarnSta 4;
BA_ "UserSigValidity" SG_ 996 IGN_AutoOff_WarnSta 3;
BA_ "Version" SG_ 996 IGN_AutoOff_WarnSta "21.11.00";
BA_ "Description" SG_ 996 IGN_AutoOff_WarnSta_CLU "This signal is for battery discharge warning (engine not running && IGN/ACC on)

To prevent battery discharge, ICU requests the Cluster to display warning and requests IBU to turn IGN/ACC off.";
BA_ "GenSigSendType" SG_ 996 IGN_AutoOff_WarnSta_CLU 4;
BA_ "UserSigValidity" SG_ 996 IGN_AutoOff_WarnSta_CLU 3;
BA_ "Version" SG_ 996 IGN_AutoOff_WarnSta_CLU "21.11.00";
BA_ "Description" SG_ 996 PDC_BatPwrStateClassA "This signal is used to inform whether the power state is good for the operation of the function using the low voltage.

0x1 : power state level is low

0x2: power staest level is good(high)";
BA_ "GenSigSendType" SG_ 996 PDC_BatPwrStateClassA 4;
BA_ "UserSigValidity" SG_ 996 PDC_BatPwrStateClassA 0;
BA_ "Version" SG_ 996 PDC_BatPwrStateClassA "23.07.06";
BA_ "Description" SG_ 996 PDC_BatPwrStateClassB "This signal is used to inform whether the power state is good for the operation of the function using the low voltage.

0x1 : power state level is low

0x2: power staest level is good(high)";
BA_ "GenSigSendType" SG_ 996 PDC_BatPwrStateClassB 4;
BA_ "UserSigValidity" SG_ 996 PDC_BatPwrStateClassB 0;
BA_ "Version" SG_ 996 PDC_BatPwrStateClassB "23.07.06";
BA_ "Description" SG_ 996 PDC_BatPwrStateClassC "This signal is used to inform whether the power state is good for the operation of the function using the low voltage.

0x1 : power state level is low

0x2: power staest level is good(high)";
BA_ "GenSigSendType" SG_ 996 PDC_BatPwrStateClassC 4;
BA_ "UserSigValidity" SG_ 996 PDC_BatPwrStateClassC 0;
BA_ "Version" SG_ 996 PDC_BatPwrStateClassC "23.07.06";
BA_ "Description" SG_ 996 PLBMAvailableState "Power supply Available status notification at PLBM. If this value is Set, BMS can request Discharge-request to PDC during parking mode";
BA_ "GenSigSendType" SG_ 996 PLBMAvailableState 4;
BA_ "UserSigValidity" SG_ 996 PLBMAvailableState 0;
BA_ "Version" SG_ 996 PLBMAvailableState "21.06.11";
BA_ "Description" SG_ 996 Bat_dischrg "Battery discharge notification flag";
BA_ "GenSigSendType" SG_ 996 Bat_dischrg 4;
BA_ "UserSigValidity" SG_ 996 Bat_dischrg 3;
BA_ "Version" SG_ 996 Bat_dischrg "21.11.00";
BA_ "Description" SG_ 996 Bat12V_Chr_Req "12V lead acid battery charging request signal 

0x0:Off (Default)

0x1:On_IBS

0x2:On_OTA

0x3:On_Load";
BA_ "GenSigSendType" SG_ 996 Bat12V_Chr_Req 4;
BA_ "TimeoutValue" SG_ 996 Bat12V_Chr_Req "0x0";
BA_ "UserSigValidity" SG_ 996 Bat12V_Chr_Req 0;
BA_ "Version" SG_ 996 Bat12V_Chr_Req "22.02.04";
BA_ "Description" SG_ 996 ICU_BattMngAlert "This signal is for battery discharge warning.

1bit : Hazard

2bit : Tail

3bit~8bit : Reserved";
BA_ "GenSigSendType" SG_ 996 ICU_BattMngAlert 4;
BA_ "UserSigValidity" SG_ 996 ICU_BattMngAlert 0;
BA_ "Version" SG_ 996 ICU_BattMngAlert "21.07.05";
BA_ "Description" SG_ 1047 GNSS_Crc5Val "The data area for CRC calculation is based on the data length (DLC) of the message DB.

The CRC shall be calculated over the entire data block (excluding the CRC bytes) including the user data, alive counter and Data ID



- CRC Polynomial (0x1021) , Ini";
BA_ "GenSigStartValue" SG_ 1047 GNSS_Crc5Val 65535;
BA_ "UserSigValidity" SG_ 1047 GNSS_Crc5Val 3;
BA_ "Version" SG_ 1047 GNSS_Crc5Val "22.10.20";
BA_ "Description" SG_ 1047 HU_GNSS_UTC_min "range : [0,59]";
BA_ "UserSigValidity" SG_ 1047 HU_GNSS_UTC_min 1;
BA_ "Version" SG_ 1047 HU_GNSS_UTC_min "22.07.05";
BA_ "Description" SG_ 1047 HU_GNSS_UTC_sec "ragne : [0, 60]  /  60 only for the leap second";
BA_ "UserSigValidity" SG_ 1047 HU_GNSS_UTC_sec 1;
BA_ "Version" SG_ 1047 HU_GNSS_UTC_sec "22.07.05";
BA_ "Description" SG_ 1047 HU_GNSS_UTC_offset "GPS = UTC + offset";
BA_ "UserSigValidity" SG_ 1047 HU_GNSS_UTC_offset 1;
BA_ "Version" SG_ 1047 HU_GNSS_UTC_offset "22.07.05";
BA_ "Description" SG_ 1047 HU_GNSS_PDOP "unit : 2^-8";
BA_ "UserSigValidity" SG_ 1047 HU_GNSS_PDOP 1;
BA_ "Version" SG_ 1047 HU_GNSS_PDOP "22.07.05";
BA_ "Description" SG_ 1047 HU_GNSS_HDOP "unit : 2^-8";
BA_ "UserSigValidity" SG_ 1047 HU_GNSS_HDOP 1;
BA_ "Version" SG_ 1047 HU_GNSS_HDOP "22.07.05";
BA_ "Description" SG_ 1047 GNSS_AlvCnt5Val "For the first transmission request for a data element the counter shall be initialized with 0 and shall be incremented by 1 for every subsequent send request. 

When the counter reaches the maximum value(0xFF), then it shall restart with 0 for the next s";
BA_ "UserSigValidity" SG_ 1047 GNSS_AlvCnt5Val 3;
BA_ "Version" SG_ 1047 GNSS_AlvCnt5Val "22.10.20";
BA_ "Description" SG_ 1047 HU_GNSS_VDOP "unit : 2^-8";
BA_ "UserSigValidity" SG_ 1047 HU_GNSS_VDOP 1;
BA_ "Version" SG_ 1047 HU_GNSS_VDOP "22.07.05";
BA_ "Description" SG_ 1047 HU_GNSS_DGPS_age "whed using DGPS, (DGPS time - current time.)";
BA_ "UserSigValidity" SG_ 1047 HU_GNSS_DGPS_age 1;
BA_ "Version" SG_ 1047 HU_GNSS_DGPS_age "22.07.05";
BA_ "UserSigValidity" SG_ 1047 HU_GNSS_Fix_status 1;
BA_ "Version" SG_ 1047 HU_GNSS_Fix_status "22.07.05";
BA_ "UserSigValidity" SG_ 1047 HU_GNSS_TimeSource 1;
BA_ "Version" SG_ 1047 HU_GNSS_TimeSource "22.07.05";
BA_ "UserSigValidity" SG_ 1047 HU_GNSS_search 1;
BA_ "Version" SG_ 1047 HU_GNSS_search "22.07.05";
BA_ "Description" SG_ 1047 HU_GNSS_DST "DST setting";
BA_ "GenSigStartValue" SG_ 1047 HU_GNSS_DST 3;
BA_ "UserSigValidity" SG_ 1047 HU_GNSS_DST 1;
BA_ "Version" SG_ 1047 HU_GNSS_DST "22.07.05";
BA_ "UserSigValidity" SG_ 1047 HU_GNSS_SV_count 1;
BA_ "Version" SG_ 1047 HU_GNSS_SV_count "22.07.05";
BA_ "Description" SG_ 1047 HU_GNSS_TimezoneOffset "offset = [ value * factor(15) ] min.";
BA_ "UserSigValidity" SG_ 1047 HU_GNSS_TimezoneOffset 1;
BA_ "Version" SG_ 1047 HU_GNSS_TimezoneOffset "22.07.05";
BA_ "UserSigValidity" SG_ 1047 HU_GNSS_UTC_year 1;
BA_ "Version" SG_ 1047 HU_GNSS_UTC_year "23.08.10";
BA_ "Description" SG_ 1047 HU_GNSS_UTC_month "range : [1, 12]";
BA_ "UserSigValidity" SG_ 1047 HU_GNSS_UTC_month 1;
BA_ "Version" SG_ 1047 HU_GNSS_UTC_month "22.07.05";
BA_ "Description" SG_ 1047 HU_GNSS_UTC_day "range : [1, 31]";
BA_ "UserSigValidity" SG_ 1047 HU_GNSS_UTC_day 1;
BA_ "Version" SG_ 1047 HU_GNSS_UTC_day "22.07.05";
BA_ "Description" SG_ 1047 HU_GNSS_UTC_hour "range : [0, 23]";
BA_ "UserSigValidity" SG_ 1047 HU_GNSS_UTC_hour 1;
BA_ "Version" SG_ 1047 HU_GNSS_UTC_hour "22.07.05";
BA_ "Description" SG_ 811 SBCM_AST_FD_Crc1Val "The data area for CRC calculation is based on the data length (DLC) of the message DB.

The CRC shall be calculated over the entire data block (excluding the CRC bytes) including the user data, alive counter and Data ID



- CRC Polynomial (0x1021) , Ini";
BA_ "GenSigSendType" SG_ 811 SBCM_AST_FD_Crc1Val 4;
BA_ "GenSigStartValue" SG_ 811 SBCM_AST_FD_Crc1Val 65535;
BA_ "UserSigValidity" SG_ 811 SBCM_AST_FD_Crc1Val 3;
BA_ "Version" SG_ 811 SBCM_AST_FD_Crc1Val "22.10.20";
BA_ "GenSigSendType" SG_ 811 USM_AstGhostDoorSta 4;
BA_ "UserSigValidity" SG_ 811 USM_AstGhostDoorSta 0;
BA_ "NetworkRequest" SG_ 811 USM_AstGhostDoorSta 0;
BA_ "NetworkRequestHoldingTime" SG_ 811 USM_AstGhostDoorSta 5000;
BA_ "Version" SG_ 811 USM_AstGhostDoorSta "21.07.07";
BA_ "GenSigSendType" SG_ 811 AST_SWFailAlarm 4;
BA_ "UserSigValidity" SG_ 811 AST_SWFailAlarm 0;
BA_ "NetworkRequest" SG_ 811 AST_SWFailAlarm 0;
BA_ "NetworkRequestHoldingTime" SG_ 811 AST_SWFailAlarm 5000;
BA_ "Version" SG_ 811 AST_SWFailAlarm "21.07.07";
BA_ "GenSigSendType" SG_ 811 DoorLock_PDSLkSwSta_AST 4;
BA_ "UserSigValidity" SG_ 811 DoorLock_PDSLkSwSta_AST 0;
BA_ "NetworkRequest" SG_ 811 DoorLock_PDSLkSwSta_AST 0;
BA_ "Version" SG_ 811 DoorLock_PDSLkSwSta_AST "21.09.05";
BA_ "GenSigSendType" SG_ 811 PDS_TypeOption_AST 4;
BA_ "UserSigValidity" SG_ 811 PDS_TypeOption_AST 0;
BA_ "NetworkRequest" SG_ 811 PDS_TypeOption_AST 0;
BA_ "Version" SG_ 811 PDS_TypeOption_AST "21.07.07";
BA_ "GenSigSendType" SG_ 811 AFCU_AutoWashModeSta_SBCM_AST 4;
BA_ "UserSigValidity" SG_ 811 AFCU_AutoWashModeSta_SBCM_AST 0;
BA_ "NetworkRequest" SG_ 811 AFCU_AutoWashModeSta_SBCM_AST 0;
BA_ "NetworkRequestHoldingTime" SG_ 811 AFCU_AutoWashModeSta_SBCM_AST 5000;
BA_ "Version" SG_ 811 AFCU_AutoWashModeSta_SBCM_AST "22.07.00";
BA_ "GenSigSendType" SG_ 811 CDM_AutoWashModeSta_SBCM_AST 4;
BA_ "UserSigValidity" SG_ 811 CDM_AutoWashModeSta_SBCM_AST 0;
BA_ "NetworkRequest" SG_ 811 CDM_AutoWashModeSta_SBCM_AST 0;
BA_ "NetworkRequestHoldingTime" SG_ 811 CDM_AutoWashModeSta_SBCM_AST 5000;
BA_ "Version" SG_ 811 CDM_AutoWashModeSta_SBCM_AST "22.07.00";
BA_ "GenSigSendType" SG_ 811 AFH_AST_FldUnFldSta 4;
BA_ "UserSigValidity" SG_ 811 AFH_AST_FldUnFldSta 0;
BA_ "NetworkRequest" SG_ 811 AFH_AST_FldUnFldSta 0;
BA_ "NetworkRequestHoldingTime" SG_ 811 AFH_AST_FldUnFldSta 5000;
BA_ "Version" SG_ 811 AFH_AST_FldUnFldSta "23.01.01";
BA_ "GenSigSendType" SG_ 811 SBCM_AST_DiagSta 4;
BA_ "UserSigValidity" SG_ 811 SBCM_AST_DiagSta 0;
BA_ "NetworkRequest" SG_ 811 SBCM_AST_DiagSta 0;
BA_ "NetworkRequestHoldingTime" SG_ 811 SBCM_AST_DiagSta 5000;
BA_ "Version" SG_ 811 SBCM_AST_DiagSta "21.07.07";
BA_ "GenSigSendType" SG_ 811 CDM_TypeOption_AST 4;
BA_ "UserSigValidity" SG_ 811 CDM_TypeOption_AST 7;
BA_ "NetworkRequest" SG_ 811 CDM_TypeOption_AST 0;
BA_ "NetworkRequestHoldingTime" SG_ 811 CDM_TypeOption_AST 5000;
BA_ "Version" SG_ 811 CDM_TypeOption_AST "21.07.07";
BA_ "GenSigSendType" SG_ 811 CDM_ImmeChgSw_AST 4;
BA_ "UserSigValidity" SG_ 811 CDM_ImmeChgSw_AST 7;
BA_ "NetworkRequest" SG_ 811 CDM_ImmeChgSw_AST 0;
BA_ "NetworkRequestHoldingTime" SG_ 811 CDM_ImmeChgSw_AST 5000;
BA_ "Version" SG_ 811 CDM_ImmeChgSw_AST "21.07.07";
BA_ "GenSigSendType" SG_ 811 CDM_ChgDrSwFrt_AST 4;
BA_ "UserSigValidity" SG_ 811 CDM_ChgDrSwFrt_AST 7;
BA_ "NetworkRequest" SG_ 811 CDM_ChgDrSwFrt_AST 0;
BA_ "NetworkRequestHoldingTime" SG_ 811 CDM_ChgDrSwFrt_AST 5000;
BA_ "Version" SG_ 811 CDM_ChgDrSwFrt_AST "21.07.07";
BA_ "GenSigSendType" SG_ 811 CDM_OpnClsState_AST 4;
BA_ "UserSigValidity" SG_ 811 CDM_OpnClsState_AST 7;
BA_ "NetworkRequest" SG_ 811 CDM_OpnClsState_AST 0;
BA_ "NetworkRequestHoldingTime" SG_ 811 CDM_OpnClsState_AST 5000;
BA_ "Version" SG_ 811 CDM_OpnClsState_AST "21.07.07";
BA_ "GenSigSendType" SG_ 811 CDM_WarnMsg_AST 4;
BA_ "UserSigValidity" SG_ 811 CDM_WarnMsg_AST 7;
BA_ "NetworkRequest" SG_ 811 CDM_WarnMsg_AST 0;
BA_ "NetworkRequestHoldingTime" SG_ 811 CDM_WarnMsg_AST 5000;
BA_ "Version" SG_ 811 CDM_WarnMsg_AST "21.07.07";
BA_ "GenSigSendType" SG_ 811 Mirror_RH_FoldingSta 4;
BA_ "UserSigValidity" SG_ 811 Mirror_RH_FoldingSta 0;
BA_ "NetworkRequest" SG_ 811 Mirror_RH_FoldingSta 0;
BA_ "NetworkRequestHoldingTime" SG_ 811 Mirror_RH_FoldingSta 5000;
BA_ "Version" SG_ 811 Mirror_RH_FoldingSta "21.07.07";
BA_ "GenSigSendType" SG_ 811 Mirror_RH_UnfoldingSta 4;
BA_ "UserSigValidity" SG_ 811 Mirror_RH_UnfoldingSta 0;
BA_ "NetworkRequest" SG_ 811 Mirror_RH_UnfoldingSta 0;
BA_ "NetworkRequestHoldingTime" SG_ 811 Mirror_RH_UnfoldingSta 5000;
BA_ "Version" SG_ 811 Mirror_RH_UnfoldingSta "21.07.07";
BA_ "GenSigSendType" SG_ 811 CDM_CmdStatus_AST 4;
BA_ "GenSigStartValue" SG_ 811 CDM_CmdStatus_AST 15;
BA_ "UserSigValidity" SG_ 811 CDM_CmdStatus_AST 7;
BA_ "NetworkRequest" SG_ 811 CDM_CmdStatus_AST 0;
BA_ "NetworkRequestHoldingTime" SG_ 811 CDM_CmdStatus_AST 5000;
BA_ "Version" SG_ 811 CDM_CmdStatus_AST "22.08.03";
BA_ "Description" SG_ 811 SBCM_AST_FD_AlvCnt1Val "For the first transmission request for a data element the counter shall be initialized with 0 and shall be incremented by 1 for every subsequent send request. 

When the counter reaches the maximum value(0xFF), then it shall restart with 0 for the next s";
BA_ "GenSigSendType" SG_ 811 SBCM_AST_FD_AlvCnt1Val 4;
BA_ "UserSigValidity" SG_ 811 SBCM_AST_FD_AlvCnt1Val 3;
BA_ "Version" SG_ 811 SBCM_AST_FD_AlvCnt1Val "22.10.20";
BA_ "GenSigSendType" SG_ 811 AST_CrashMRActAlarm 4;
BA_ "UserSigValidity" SG_ 811 AST_CrashMRActAlarm 0;
BA_ "NetworkRequest" SG_ 811 AST_CrashMRActAlarm 0;
BA_ "NetworkRequestHoldingTime" SG_ 811 AST_CrashMRActAlarm 5000;
BA_ "Version" SG_ 811 AST_CrashMRActAlarm "21.07.07";
BA_ "GenSigSendType" SG_ 811 PwrDRBuzzerOut_AST 4;
BA_ "UserSigValidity" SG_ 811 PwrDRBuzzerOut_AST 0;
BA_ "NetworkRequest" SG_ 811 PwrDRBuzzerOut_AST 0;
BA_ "NetworkRequestHoldingTime" SG_ 811 PwrDRBuzzerOut_AST 5000;
BA_ "Version" SG_ 811 PwrDRBuzzerOut_AST "21.07.07";
BA_ "GenSigSendType" SG_ 811 IMS_OSMirPlayBackSta_RH 4;
BA_ "UserSigValidity" SG_ 811 IMS_OSMirPlayBackSta_RH 0;
BA_ "NetworkRequest" SG_ 811 IMS_OSMirPlayBackSta_RH 0;
BA_ "NetworkRequestHoldingTime" SG_ 811 IMS_OSMirPlayBackSta_RH 5000;
BA_ "Version" SG_ 811 IMS_OSMirPlayBackSta_RH "21.07.07";
BA_ "GenSigSendType" SG_ 811 PwrDRClosingASTDrSta 4;
BA_ "UserSigValidity" SG_ 811 PwrDRClosingASTDrSta 0;
BA_ "NetworkRequest" SG_ 811 PwrDRClosingASTDrSta 0;
BA_ "NetworkRequestHoldingTime" SG_ 811 PwrDRClosingASTDrSta 5000;
BA_ "Version" SG_ 811 PwrDRClosingASTDrSta "23.07.06";
BA_ "Description" SG_ 811 CDM_OutsideOpnSwSta_AST "Charging Door O/S SW State";
BA_ "GenSigSendType" SG_ 811 CDM_OutsideOpnSwSta_AST 4;
BA_ "UserSigValidity" SG_ 811 CDM_OutsideOpnSwSta_AST 7;
BA_ "NetworkRequest" SG_ 811 CDM_OutsideOpnSwSta_AST 0;
BA_ "NetworkRequestHoldingTime" SG_ 811 CDM_OutsideOpnSwSta_AST 5000;
BA_ "Version" SG_ 811 CDM_OutsideOpnSwSta_AST "23.02.02";
BA_ "GenSigSendType" SG_ 811 SBCM_Longkey_ASTDrAtClsSwSta 4;
BA_ "UserSigValidity" SG_ 811 SBCM_Longkey_ASTDrAtClsSwSta 0;
BA_ "NetworkRequest" SG_ 811 SBCM_Longkey_ASTDrAtClsSwSta 0;
BA_ "NetworkRequestHoldingTime" SG_ 811 SBCM_Longkey_ASTDrAtClsSwSta 5000;
BA_ "Version" SG_ 811 SBCM_Longkey_ASTDrAtClsSwSta "22.04.02";
BA_ "Description" SG_ 811 Hood_TypeOption_AST "If the E-Hood is applied, the signal will be send.

Frunk signal from SBCM_AST to SBCM_DRV (RHD specification)";
BA_ "GenSigSendType" SG_ 811 Hood_TypeOption_AST 4;
BA_ "UserSigValidity" SG_ 811 Hood_TypeOption_AST 0;
BA_ "NetworkRequest" SG_ 811 Hood_TypeOption_AST 0;
BA_ "NetworkRequestHoldingTime" SG_ 811 Hood_TypeOption_AST 5000;
BA_ "Version" SG_ 811 Hood_TypeOption_AST "22.10.19";
BA_ "Description" SG_ 811 Warn_HoodSwSta_AST "Frunk signal from SBCM_AST to SBCM_DRV (RHD specification)";
BA_ "GenSigSendType" SG_ 811 Warn_HoodSwSta_AST 4;
BA_ "UserSigValidity" SG_ 811 Warn_HoodSwSta_AST 0;
BA_ "NetworkRequest" SG_ 811 Warn_HoodSwSta_AST 0;
BA_ "NetworkRequestHoldingTime" SG_ 811 Warn_HoodSwSta_AST 5000;
BA_ "Version" SG_ 811 Warn_HoodSwSta_AST "22.10.19";
BA_ "Description" SG_ 811 FrunkWarning_AST "Frunk signal from SBCM_AST to SBCM_DRV (RHD specification)";
BA_ "GenSigSendType" SG_ 811 FrunkWarning_AST 4;
BA_ "UserSigValidity" SG_ 811 FrunkWarning_AST 0;
BA_ "NetworkRequest" SG_ 811 FrunkWarning_AST 0;
BA_ "NetworkRequestHoldingTime" SG_ 811 FrunkWarning_AST 5000;
BA_ "Version" SG_ 811 FrunkWarning_AST "22.10.19";
BA_ "Description" SG_ 811 SBCM_FrunkSta_AST "Frunk signal from SBCM_AST to SBCM_DRV (RHD specification)";
BA_ "GenSigSendType" SG_ 811 SBCM_FrunkSta_AST 4;
BA_ "UserSigValidity" SG_ 811 SBCM_FrunkSta_AST 0;
BA_ "NetworkRequest" SG_ 811 SBCM_FrunkSta_AST 0;
BA_ "NetworkRequestHoldingTime" SG_ 811 SBCM_FrunkSta_AST 5000;
BA_ "Version" SG_ 811 SBCM_FrunkSta_AST "22.10.19";
BA_ "Description" SG_ 811 IMS_OSMirPlayBackSta_RH_New "Applied from standard DB 2.0";
BA_ "GenSigSendType" SG_ 811 IMS_OSMirPlayBackSta_RH_New 4;
BA_ "UserSigValidity" SG_ 811 IMS_OSMirPlayBackSta_RH_New 0;
BA_ "NetworkRequest" SG_ 811 IMS_OSMirPlayBackSta_RH_New 0;
BA_ "NetworkRequestHoldingTime" SG_ 811 IMS_OSMirPlayBackSta_RH_New 5000;
BA_ "Version" SG_ 811 IMS_OSMirPlayBackSta_RH_New "23.01.03";
BA_ "GenSigSendType" SG_ 811 Ast_DrLkRetryFail_SBCM 4;
BA_ "TimeoutValue" SG_ 811 Ast_DrLkRetryFail_SBCM "0x0";
BA_ "UserSigValidity" SG_ 811 Ast_DrLkRetryFail_SBCM 0;
BA_ "NetworkRequest" SG_ 811 Ast_DrLkRetryFail_SBCM 0;
BA_ "NetworkRequestHoldingTime" SG_ 811 Ast_DrLkRetryFail_SBCM 5000;
BA_ "Version" SG_ 811 Ast_DrLkRetryFail_SBCM "23.03.00";
BA_ "Description" SG_ 811 DoorLock_AstLkOutSta_SBCM "- Door Lock or Unlock Output State 

0x0 : Off (Door lock/unlock output Off state)

0x1 : On (Door lock/unlock output On state)";
BA_ "GenSigSendType" SG_ 811 DoorLock_AstLkOutSta_SBCM 4;
BA_ "UserSigValidity" SG_ 811 DoorLock_AstLkOutSta_SBCM 0;
BA_ "NetworkRequest" SG_ 811 DoorLock_AstLkOutSta_SBCM 0;
BA_ "NetworkRequestHoldingTime" SG_ 811 DoorLock_AstLkOutSta_SBCM 5000;
BA_ "Version" SG_ 811 DoorLock_AstLkOutSta_SBCM "23.02.09";
BA_ "Description" SG_ 811 FrunkReleaseSwSta_SBCM_AST "FrunkReleaseState (SBCM_AST_FD to SBCM_DRV_FD) RHD Spec";
BA_ "GenSigSendType" SG_ 811 FrunkReleaseSwSta_SBCM_AST 4;
BA_ "UserSigValidity" SG_ 811 FrunkReleaseSwSta_SBCM_AST 0;
BA_ "NetworkRequest" SG_ 811 FrunkReleaseSwSta_SBCM_AST 0;
BA_ "NetworkRequestHoldingTime" SG_ 811 FrunkReleaseSwSta_SBCM_AST 5000;
BA_ "Version" SG_ 811 FrunkReleaseSwSta_SBCM_AST "23.03.01";
BA_ "Description" SG_ 811 FrunkInsideRelSwSta_SBCM_AST "FrunkInsideReleaseSwState (SBCM_AST_FD to SBCM_DRV_FD) RHD Spec";
BA_ "GenSigSendType" SG_ 811 FrunkInsideRelSwSta_SBCM_AST 4;
BA_ "UserSigValidity" SG_ 811 FrunkInsideRelSwSta_SBCM_AST 0;
BA_ "NetworkRequest" SG_ 811 FrunkInsideRelSwSta_SBCM_AST 0;
BA_ "NetworkRequestHoldingTime" SG_ 811 FrunkInsideRelSwSta_SBCM_AST 5000;
BA_ "Version" SG_ 811 FrunkInsideRelSwSta_SBCM_AST "23.03.01";
BA_ "Description" SG_ 811 FrunkEmergencySwSta_SBCM_AST "FrunkEmergencySwState (SBCM_AST_FD to SBCM_DRV_FD) RHD Spec";
BA_ "GenSigSendType" SG_ 811 FrunkEmergencySwSta_SBCM_AST 4;
BA_ "UserSigValidity" SG_ 811 FrunkEmergencySwSta_SBCM_AST 0;
BA_ "NetworkRequest" SG_ 811 FrunkEmergencySwSta_SBCM_AST 0;
BA_ "NetworkRequestHoldingTime" SG_ 811 FrunkEmergencySwSta_SBCM_AST 5000;
BA_ "Version" SG_ 811 FrunkEmergencySwSta_SBCM_AST "23.03.01";
BA_ "GenSigSendType" SG_ 811 PwrDrSta_Ast 4;
BA_ "UserSigValidity" SG_ 811 PwrDrSta_Ast 0;
BA_ "NetworkRequest" SG_ 811 PwrDrSta_Ast 0;
BA_ "NetworkRequestHoldingTime" SG_ 811 PwrDrSta_Ast 5000;
BA_ "Version" SG_ 811 PwrDrSta_Ast "24.01.05";
BA_ "GenSigSendType" SG_ 811 PwrDrSta_AstSd 4;
BA_ "UserSigValidity" SG_ 811 PwrDrSta_AstSd 0;
BA_ "NetworkRequest" SG_ 811 PwrDrSta_AstSd 0;
BA_ "NetworkRequestHoldingTime" SG_ 811 PwrDrSta_AstSd 5000;
BA_ "Version" SG_ 811 PwrDrSta_AstSd "24.01.05";
BA_ "GenSigSendType" SG_ 811 AST_DetectObj_warn_LH 4;
BA_ "UserSigValidity" SG_ 811 AST_DetectObj_warn_LH 0;
BA_ "NetworkRequest" SG_ 811 AST_DetectObj_warn_LH 0;
BA_ "NetworkRequestHoldingTime" SG_ 811 AST_DetectObj_warn_LH 5000;
BA_ "Version" SG_ 811 AST_DetectObj_warn_LH "23.10.11";
BA_ "GenSigSendType" SG_ 811 PwrDROpenClosingAstSdDRSta 4;
BA_ "UserSigValidity" SG_ 811 PwrDROpenClosingAstSdDRSta 0;
BA_ "NetworkRequest" SG_ 811 PwrDROpenClosingAstSdDRSta 0;
BA_ "NetworkRequestHoldingTime" SG_ 811 PwrDROpenClosingAstSdDRSta 5000;
BA_ "Version" SG_ 811 PwrDROpenClosingAstSdDRSta "23.10.11";
BA_ "Description" SG_ 811 PwrDRBuzzerOut_AST_New "JG~";
BA_ "GenSigSendType" SG_ 811 PwrDRBuzzerOut_AST_New 4;
BA_ "UserSigValidity" SG_ 811 PwrDRBuzzerOut_AST_New 0;
BA_ "NetworkRequest" SG_ 811 PwrDRBuzzerOut_AST_New 0;
BA_ "NetworkRequestHoldingTime" SG_ 811 PwrDRBuzzerOut_AST_New 5000;
BA_ "Version" SG_ 811 PwrDRBuzzerOut_AST_New "24.01.05";
BA_ "Description" SG_ 811 SBCM_FR_DoorAngle "PDSM_FR_DoorAngle";
BA_ "GenSigSendType" SG_ 811 SBCM_FR_DoorAngle 4;
BA_ "GenSigStartValue" SG_ 811 SBCM_FR_DoorAngle 100;
BA_ "UserSigValidity" SG_ 811 SBCM_FR_DoorAngle 0;
BA_ "NetworkRequest" SG_ 811 SBCM_FR_DoorAngle 0;
BA_ "NetworkRequestHoldingTime" SG_ 811 SBCM_FR_DoorAngle 5000;
BA_ "Version" SG_ 811 SBCM_FR_DoorAngle "24.01.05";
BA_ "Description" SG_ 811 EHL_TxInfo_SBCM_AST "Electronic hood latch status signal transfer for dual hood latch type";
BA_ "GenSigSendType" SG_ 811 EHL_TxInfo_SBCM_AST 4;
BA_ "UserSigValidity" SG_ 811 EHL_TxInfo_SBCM_AST 0;
BA_ "NetworkRequest" SG_ 811 EHL_TxInfo_SBCM_AST 0;
BA_ "NetworkRequestHoldingTime" SG_ 811 EHL_TxInfo_SBCM_AST 5000;
BA_ "Version" SG_ 811 EHL_TxInfo_SBCM_AST "24.01.04";
BA_ "GenSigSendType" SG_ 811 ASTDoorPushAlarm 4;
BA_ "UserSigValidity" SG_ 811 ASTDoorPushAlarm 0;
BA_ "NetworkRequest" SG_ 811 ASTDoorPushAlarm 0;
BA_ "NetworkRequestHoldingTime" SG_ 811 ASTDoorPushAlarm 5000;
BA_ "Version" SG_ 811 ASTDoorPushAlarm "21.07.07";
BA_ "Description" SG_ 811 AST_CrashUnlockCmd "Assist Crash Unlock Command";
BA_ "GenSigSendType" SG_ 811 AST_CrashUnlockCmd 4;
BA_ "UserSigValidity" SG_ 811 AST_CrashUnlockCmd 0;
BA_ "NetworkRequest" SG_ 811 AST_CrashUnlockCmd 0;
BA_ "Version" SG_ 811 AST_CrashUnlockCmd "21.07.07";
BA_ "Description" SG_ 811 DoorLock_CtrlDrLkSwSta_SBCM "Central Door Lock Assist Switch Status";
BA_ "GenSigSendType" SG_ 811 DoorLock_CtrlDrLkSwSta_SBCM 4;
BA_ "UserSigValidity" SG_ 811 DoorLock_CtrlDrLkSwSta_SBCM 0;
BA_ "NetworkRequest" SG_ 811 DoorLock_CtrlDrLkSwSta_SBCM 0;
BA_ "Version" SG_ 811 DoorLock_CtrlDrLkSwSta_SBCM "21.07.07";
BA_ "Description" SG_ 811 DoorLock_CtrlDrUnLkSwSta_SBCM "Central Door Unlock Assist Switch Status";
BA_ "GenSigSendType" SG_ 811 DoorLock_CtrlDrUnLkSwSta_SBCM 4;
BA_ "UserSigValidity" SG_ 811 DoorLock_CtrlDrUnLkSwSta_SBCM 0;
BA_ "NetworkRequest" SG_ 811 DoorLock_CtrlDrUnLkSwSta_SBCM 0;
BA_ "Version" SG_ 811 DoorLock_CtrlDrUnLkSwSta_SBCM "21.07.07";
BA_ "Description" SG_ 811 Warn_AsstDrSwSta_SBCM "Warning Assist Door Switch Status";
BA_ "GenSigSendType" SG_ 811 Warn_AsstDrSwSta_SBCM 4;
BA_ "UserSigValidity" SG_ 811 Warn_AsstDrSwSta_SBCM 0;
BA_ "NetworkRequest" SG_ 811 Warn_AsstDrSwSta_SBCM 0;
BA_ "Version" SG_ 811 Warn_AsstDrSwSta_SBCM "21.09.05";
BA_ "Description" SG_ 811 DoorLock_AsstDrUnLkSta_SBCM "Assist Door Unlock Status";
BA_ "GenSigSendType" SG_ 811 DoorLock_AsstDrUnLkSta_SBCM 4;
BA_ "UserSigValidity" SG_ 811 DoorLock_AsstDrUnLkSta_SBCM 0;
BA_ "NetworkRequest" SG_ 811 DoorLock_AsstDrUnLkSta_SBCM 0;
BA_ "Version" SG_ 811 DoorLock_AsstDrUnLkSta_SBCM "21.07.07";
BA_ "Description" SG_ 811 AST_SEAWarn_RH "Assist (FRH) SEA Warning";
BA_ "GenSigSendType" SG_ 811 AST_SEAWarn_RH 4;
BA_ "UserSigValidity" SG_ 811 AST_SEAWarn_RH 0;
BA_ "NetworkRequest" SG_ 811 AST_SEAWarn_RH 0;
BA_ "Version" SG_ 811 AST_SEAWarn_RH "21.07.07";
BA_ "Description" SG_ 811 AST_SEAWarn_LH "Assist (FLH) Door SEA Warning";
BA_ "GenSigSendType" SG_ 811 AST_SEAWarn_LH 4;
BA_ "UserSigValidity" SG_ 811 AST_SEAWarn_LH 0;
BA_ "NetworkRequest" SG_ 811 AST_SEAWarn_LH 0;
BA_ "Version" SG_ 811 AST_SEAWarn_LH "21.07.07";
BA_ "GenSigSendType" SG_ 811 AST_SEWWarn_LH 4;
BA_ "UserSigValidity" SG_ 811 AST_SEWWarn_LH 0;
BA_ "NetworkRequest" SG_ 811 AST_SEWWarn_LH 0;
BA_ "Version" SG_ 811 AST_SEWWarn_LH "21.07.07";
BA_ "GenSigSendType" SG_ 811 AST_SEWWarn_RH 4;
BA_ "UserSigValidity" SG_ 811 AST_SEWWarn_RH 0;
BA_ "NetworkRequest" SG_ 811 AST_SEWWarn_RH 0;
BA_ "Version" SG_ 811 AST_SEWWarn_RH "21.07.07";
BA_ "GenSigSendType" SG_ 811 AST_MRActivationAlarm 4;
BA_ "UserSigValidity" SG_ 811 AST_MRActivationAlarm 0;
BA_ "NetworkRequest" SG_ 811 AST_MRActivationAlarm 0;
BA_ "NetworkRequestHoldingTime" SG_ 811 AST_MRActivationAlarm 5000;
BA_ "Version" SG_ 811 AST_MRActivationAlarm "21.07.07";
BA_ "GenSigSendType" SG_ 811 AST_ReleaseWarn 4;
BA_ "UserSigValidity" SG_ 811 AST_ReleaseWarn 0;
BA_ "NetworkRequest" SG_ 811 AST_ReleaseWarn 0;
BA_ "NetworkRequestHoldingTime" SG_ 811 AST_ReleaseWarn 5000;
BA_ "Version" SG_ 811 AST_ReleaseWarn "21.09.05";
BA_ "Description" SG_ 849 IAU_FD_Crc4Val "The data area for CRC calculation is based on the data length (DLC) of the message DB.

The CRC shall be calculated over the entire data block (excluding the CRC bytes) including the user data, alive counter and Data ID



- CRC Polynomial (0x1021) , Ini";
BA_ "GenSigSendType" SG_ 849 IAU_FD_Crc4Val 4;
BA_ "GenSigStartValue" SG_ 849 IAU_FD_Crc4Val 65535;
BA_ "UserSigValidity" SG_ 849 IAU_FD_Crc4Val 0;
BA_ "Version" SG_ 849 IAU_FD_Crc4Val "22.11.04";
BA_ "Description" SG_ 849 IAU_DISPWrng "This siganl warning from IAU

- 0x9 (WPCNFC_PreStartAuth_Success) : CLU display when workaround or LPCD Start Auth succeeded (before SSB pressed).";
BA_ "GenSigSendType" SG_ 849 IAU_DISPWrng 4;
BA_ "UserSigValidity" SG_ 849 IAU_DISPWrng 0;
BA_ "NetworkRequest" SG_ 849 IAU_DISPWrng 0;
BA_ "NetworkRequestHoldingTime" SG_ 849 IAU_DISPWrng 5000;
BA_ "Version" SG_ 849 IAU_DISPWrng "22.06.04";
BA_ "Description" SG_ 849 IAU_DigitalKey2Opt "This signal describe Digital Key capability";
BA_ "GenSigSendType" SG_ 849 IAU_DigitalKey2Opt 4;
BA_ "UserSigValidity" SG_ 849 IAU_DigitalKey2Opt 0;
BA_ "NetworkRequest" SG_ 849 IAU_DigitalKey2Opt 0;
BA_ "NetworkRequestHoldingTime" SG_ 849 IAU_DigitalKey2Opt 5000;
BA_ "Version" SG_ 849 IAU_DigitalKey2Opt "20.08.00";
BA_ "Description" SG_ 849 IAUwFRULearnState "This signal indicates learning process stste between IAU and FRU";
BA_ "GenSigSendType" SG_ 849 IAUwFRULearnState 4;
BA_ "UserSigValidity" SG_ 849 IAUwFRULearnState 0;
BA_ "NetworkRequest" SG_ 849 IAUwFRULearnState 0;
BA_ "NetworkRequestHoldingTime" SG_ 849 IAUwFRULearnState 5000;
BA_ "Version" SG_ 849 IAUwFRULearnState "20.04.05";
BA_ "Description" SG_ 849 IAUwFPMLearnState "This signal indicates learning process stste between IAU and FPM";
BA_ "GenSigSendType" SG_ 849 IAUwFPMLearnState 4;
BA_ "UserSigValidity" SG_ 849 IAUwFPMLearnState 0;
BA_ "NetworkRequest" SG_ 849 IAUwFPMLearnState 0;
BA_ "NetworkRequestHoldingTime" SG_ 849 IAUwFPMLearnState 5000;
BA_ "Version" SG_ 849 IAUwFPMLearnState "20.04.05";
BA_ "GenSigSendType" SG_ 849 IAU_ValetDigitalkey 4;
BA_ "UserSigValidity" SG_ 849 IAU_ValetDigitalkey 0;
BA_ "NetworkRequest" SG_ 849 IAU_ValetDigitalkey 0;
BA_ "NetworkRequestHoldingTime" SG_ 849 IAU_ValetDigitalkey 5000;
BA_ "Version" SG_ 849 IAU_ValetDigitalkey "20.08.05";
BA_ "Description" SG_ 849 IAU_DigitalKeyNumberOpt "This signal is for the digital key number type. 

(Ex. Max 16 of digital keys in total can be saved and shared)";
BA_ "GenSigSendType" SG_ 849 IAU_DigitalKeyNumberOpt 4;
BA_ "UserSigValidity" SG_ 849 IAU_DigitalKeyNumberOpt 0;
BA_ "NetworkRequest" SG_ 849 IAU_DigitalKeyNumberOpt 0;
BA_ "NetworkRequestHoldingTime" SG_ 849 IAU_DigitalKeyNumberOpt 5000;
BA_ "Version" SG_ 849 IAU_DigitalKeyNumberOpt "23.04.04";
BA_ "Description" SG_ 849 IAU_eSEReprogramSta "eSE Reprograming Status";
BA_ "GenSigSendType" SG_ 849 IAU_eSEReprogramSta 4;
BA_ "TimeoutValue" SG_ 849 IAU_eSEReprogramSta "0";
BA_ "UserSigValidity" SG_ 849 IAU_eSEReprogramSta 0;
BA_ "NetworkRequest" SG_ 849 IAU_eSEReprogramSta 0;
BA_ "NetworkRequestHoldingTime" SG_ 849 IAU_eSEReprogramSta 5000;
BA_ "Version" SG_ 849 IAU_eSEReprogramSta "22.07.04";
BA_ "Description" SG_ 849 IAU_DKOwnerSwapOption "Digital key owner swap option signal";
BA_ "GenSigSendType" SG_ 849 IAU_DKOwnerSwapOption 4;
BA_ "UserSigValidity" SG_ 849 IAU_DKOwnerSwapOption 0;
BA_ "Version" SG_ 849 IAU_DKOwnerSwapOption "24.01.04";
BA_ "Description" SG_ 849 IAU_DgtKeyGrpPrflRval2 "Digital Key Group number(max : 16 )";
BA_ "GenSigSendType" SG_ 849 IAU_DgtKeyGrpPrflRval2 4;
BA_ "UserSigValidity" SG_ 849 IAU_DgtKeyGrpPrflRval2 0;
BA_ "NetworkRequest" SG_ 849 IAU_DgtKeyGrpPrflRval2 0;
BA_ "NetworkRequestHoldingTime" SG_ 849 IAU_DgtKeyGrpPrflRval2 5000;
BA_ "Version" SG_ 849 IAU_DgtKeyGrpPrflRval2 "23.02.13";
BA_ "GenSigSendType" SG_ 849 IAU_StartIdentifiedProfile 4;
BA_ "TimeoutValue" SG_ 849 IAU_StartIdentifiedProfile "0x0";
BA_ "UserSigValidity" SG_ 849 IAU_StartIdentifiedProfile 0;
BA_ "NetworkRequest" SG_ 849 IAU_StartIdentifiedProfile 0;
BA_ "NetworkRequestHoldingTime" SG_ 849 IAU_StartIdentifiedProfile 5000;
BA_ "Version" SG_ 849 IAU_StartIdentifiedProfile "20.05.02";
BA_ "Description" SG_ 849 IAU_DigitalKeyProfileRval2 "digital key number : max. 16";
BA_ "GenSigSendType" SG_ 849 IAU_DigitalKeyProfileRval2 4;
BA_ "UserSigValidity" SG_ 849 IAU_DigitalKeyProfileRval2 0;
BA_ "NetworkRequest" SG_ 849 IAU_DigitalKeyProfileRval2 0;
BA_ "NetworkRequestHoldingTime" SG_ 849 IAU_DigitalKeyProfileRval2 5000;
BA_ "Version" SG_ 849 IAU_DigitalKeyProfileRval2 "22.05.04";
BA_ "GenSigSendType" SG_ 849 IAU_NFCCard1SN 4;
BA_ "UserSigValidity" SG_ 849 IAU_NFCCard1SN 0;
BA_ "NetworkRequest" SG_ 849 IAU_NFCCard1SN 0;
BA_ "NetworkRequestHoldingTime" SG_ 849 IAU_NFCCard1SN 5000;
BA_ "Version" SG_ 849 IAU_NFCCard1SN "21.07.05";
BA_ "Description" SG_ 849 IAU_FD_AlvCnt4Val "For the first transmission request for a data element the counter shall be initialized with 0 and shall be incremented by 1 for every subsequent send request. 

When the counter reaches the maximum value(0xFF), then it shall restart with 0 for the next s";
BA_ "GenSigSendType" SG_ 849 IAU_FD_AlvCnt4Val 4;
BA_ "UserSigValidity" SG_ 849 IAU_FD_AlvCnt4Val 0;
BA_ "Version" SG_ 849 IAU_FD_AlvCnt4Val "22.11.04";
BA_ "GenSigSendType" SG_ 849 IAU_StartIdentifiedProfile_Ext 4;
BA_ "UserSigValidity" SG_ 849 IAU_StartIdentifiedProfile_Ext 0;
BA_ "NetworkRequest" SG_ 849 IAU_StartIdentifiedProfile_Ext 0;
BA_ "NetworkRequestHoldingTime" SG_ 849 IAU_StartIdentifiedProfile_Ext 5000;
BA_ "Version" SG_ 849 IAU_StartIdentifiedProfile_Ext "23.04.04";
BA_ "GenSigSendType" SG_ 849 RSPA_UWBRspaExtRngSta 4;
BA_ "UserSigValidity" SG_ 849 RSPA_UWBRspaExtRngSta 0;
BA_ "NetworkRequest" SG_ 849 RSPA_UWBRspaExtRngSta 0;
BA_ "NetworkRequestHoldingTime" SG_ 849 RSPA_UWBRspaExtRngSta 5000;
BA_ "Version" SG_ 849 RSPA_UWBRspaExtRngSta "20.03.05";
BA_ "Description" SG_ 849 RSPA_CanFltSta "Error status of RSPA control signals.";
BA_ "GenSigSendType" SG_ 849 RSPA_CanFltSta 4;
BA_ "UserSigValidity" SG_ 849 RSPA_CanFltSta 0;
BA_ "Version" SG_ 849 RSPA_CanFltSta "20.02.00";
BA_ "Description" SG_ 849 RSPA_BLESigErrSta "Error status of Digital Key BLE_BtnReq signal.



If BLE frame data from Digital Key defferent with CAN signal data, 

RSPA_BLESigErrSta signal send 0x1 Signal Invalid.";
BA_ "GenSigSendType" SG_ 849 RSPA_BLESigErrSta 4;
BA_ "UserSigValidity" SG_ 849 RSPA_BLESigErrSta 0;
BA_ "NetworkRequest" SG_ 849 RSPA_BLESigErrSta 0;
BA_ "NetworkRequestHoldingTime" SG_ 849 RSPA_BLESigErrSta 5000;
BA_ "Version" SG_ 849 RSPA_BLESigErrSta "20.02.00";
BA_ "Description" SG_ 849 RSPA_ConStat "Connection Status among RSPA, IAU, BLE and SmartPhone";
BA_ "GenSigSendType" SG_ 849 RSPA_ConStat 4;
BA_ "UserSigValidity" SG_ 849 RSPA_ConStat 0;
BA_ "NetworkRequest" SG_ 849 RSPA_ConStat 0;
BA_ "NetworkRequestHoldingTime" SG_ 849 RSPA_ConStat 5000;
BA_ "Version" SG_ 849 RSPA_ConStat "20.02.00";
BA_ "GenSigSendType" SG_ 849 IAU_ProfileIDRVal 4;
BA_ "UserSigValidity" SG_ 849 IAU_ProfileIDRVal 0;
BA_ "NetworkRequest" SG_ 849 IAU_ProfileIDRVal 0;
BA_ "NetworkRequestHoldingTime" SG_ 849 IAU_ProfileIDRVal 5000;
BA_ "Version" SG_ 849 IAU_ProfileIDRVal "23.02.02";
BA_ "GenSigSendType" SG_ 849 IAU_DigitalKeyProcessingSta 4;
BA_ "UserSigValidity" SG_ 849 IAU_DigitalKeyProcessingSta 3;
BA_ "NetworkRequest" SG_ 849 IAU_DigitalKeyProcessingSta 0;
BA_ "NetworkRequestHoldingTime" SG_ 849 IAU_DigitalKeyProcessingSta 5000;
BA_ "Version" SG_ 849 IAU_DigitalKeyProcessingSta "23.02.13";
BA_ "Description" SG_ 849 IAU_DigitalKeyExit "Digital Key USM setting Exit Condition";
BA_ "GenSigSendType" SG_ 849 IAU_DigitalKeyExit 4;
BA_ "UserSigValidity" SG_ 849 IAU_DigitalKeyExit 3;
BA_ "NetworkRequest" SG_ 849 IAU_DigitalKeyExit 0;
BA_ "NetworkRequestHoldingTime" SG_ 849 IAU_DigitalKeyExit 5000;
BA_ "Version" SG_ 849 IAU_DigitalKeyExit "23.07.03";
BA_ "GenSigSendType" SG_ 849 IAU_DigitalKeyEnblRVal 4;
BA_ "UserSigValidity" SG_ 849 IAU_DigitalKeyEnblRVal 0;
BA_ "NetworkRequest" SG_ 849 IAU_DigitalKeyEnblRVal 0;
BA_ "NetworkRequestHoldingTime" SG_ 849 IAU_DigitalKeyEnblRVal 5000;
BA_ "Version" SG_ 849 IAU_DigitalKeyEnblRVal "20.05.02";
BA_ "GenSigSendType" SG_ 849 IAU_OwnerPhnRegRVal 4;
BA_ "UserSigValidity" SG_ 849 IAU_OwnerPhnRegRVal 0;
BA_ "NetworkRequest" SG_ 849 IAU_OwnerPhnRegRVal 0;
BA_ "NetworkRequestHoldingTime" SG_ 849 IAU_OwnerPhnRegRVal 5000;
BA_ "Version" SG_ 849 IAU_OwnerPhnRegRVal "20.05.02";
BA_ "GenSigSendType" SG_ 849 IAU_NFCCard1RegRVal 4;
BA_ "UserSigValidity" SG_ 849 IAU_NFCCard1RegRVal 0;
BA_ "NetworkRequest" SG_ 849 IAU_NFCCard1RegRVal 0;
BA_ "NetworkRequestHoldingTime" SG_ 849 IAU_NFCCard1RegRVal 5000;
BA_ "Version" SG_ 849 IAU_NFCCard1RegRVal "17.12.08";
BA_ "GenSigSendType" SG_ 849 IAU_NFCCard2RegRVal 4;
BA_ "UserSigValidity" SG_ 849 IAU_NFCCard2RegRVal 0;
BA_ "NetworkRequest" SG_ 849 IAU_NFCCard2RegRVal 0;
BA_ "NetworkRequestHoldingTime" SG_ 849 IAU_NFCCard2RegRVal 5000;
BA_ "Version" SG_ 849 IAU_NFCCard2RegRVal "17.12.08";
BA_ "Description" SG_ 518 GNSS_Crc7Val "The data area for CRC calculation is based on the data length (DLC) of the message DB.

The CRC shall be calculated over the entire data block (excluding the CRC bytes) including the user data, alive counter and Data ID



- CRC Polynomial (0x1021) , Ini";
BA_ "GenSigStartValue" SG_ 518 GNSS_Crc7Val 65535;
BA_ "UserSigValidity" SG_ 518 GNSS_Crc7Val 3;
BA_ "Version" SG_ 518 GNSS_Crc7Val "22.10.20";
BA_ "UserSigValidity" SG_ 518 HU_DR_Latitude 1;
BA_ "Version" SG_ 518 HU_DR_Latitude "22.07.05";
BA_ "Description" SG_ 518 GNSS_AlvCnt7Val "For the first transmission request for a data element the counter shall be initialized with 0 and shall be incremented by 1 for every subsequent send request. 

When the counter reaches the maximum value(0xFF), then it shall restart with 0 for the next s";
BA_ "UserSigValidity" SG_ 518 GNSS_AlvCnt7Val 3;
BA_ "Version" SG_ 518 GNSS_AlvCnt7Val "22.10.20";
BA_ "UserSigValidity" SG_ 518 HU_DR_Longitude 1;
BA_ "Version" SG_ 518 HU_DR_Longitude "22.07.05";
BA_ "UserSigValidity" SG_ 518 HU_DR_Heading 1;
BA_ "Version" SG_ 518 HU_DR_Heading "22.07.05";
BA_ "Description" SG_ 518 HU_DR_Speed "negative if the direction is backward.";
BA_ "UserSigValidity" SG_ 518 HU_DR_Speed 1;
BA_ "Version" SG_ 518 HU_DR_Speed "22.07.05";
BA_ "Description" SG_ 518 HU_DR_TimeOfWeek "0x0~0x23FD41BF: PHY VALUE";
BA_ "UserSigValidity" SG_ 518 HU_DR_TimeOfWeek 1;
BA_ "Version" SG_ 518 HU_DR_TimeOfWeek "23.07.03";
BA_ "Description" SG_ 518 HU_DR_Position_Status "0x1:Valid";
BA_ "UserSigValidity" SG_ 518 HU_DR_Position_Status 1;
BA_ "Version" SG_ 518 HU_DR_Position_Status "22.07.05";
BA_ "Description" SG_ 518 HU_DR_Altitude_Status "0x1=Valid";
BA_ "UserSigValidity" SG_ 518 HU_DR_Altitude_Status 1;
BA_ "Version" SG_ 518 HU_DR_Altitude_Status "22.07.05";
BA_ "Description" SG_ 518 HU_DR_Heading_Status "0x1=Valid";
BA_ "UserSigValidity" SG_ 518 HU_DR_Heading_Status 1;
BA_ "Version" SG_ 518 HU_DR_Heading_Status "22.07.05";
BA_ "Description" SG_ 518 HU_DR_Speed_Status "0x1=Valid";
BA_ "UserSigValidity" SG_ 518 HU_DR_Speed_Status 1;
BA_ "Version" SG_ 518 HU_DR_Speed_Status "22.07.05";
BA_ "Description" SG_ 518 HU_DR_DirectionSwitch_Sta "0x1=valid";
BA_ "UserSigValidity" SG_ 518 HU_DR_DirectionSwitch_Sta 1;
BA_ "Version" SG_ 518 HU_DR_DirectionSwitch_Sta "22.07.05";
BA_ "Description" SG_ 518 HU_DR_Direction "0x1=Backward";
BA_ "UserSigValidity" SG_ 518 HU_DR_Direction 1;
BA_ "Version" SG_ 518 HU_DR_Direction "22.07.05";
BA_ "Description" SG_ 518 HU_DR_GyroCalib_Sta "0x1=Calibrated";
BA_ "UserSigValidity" SG_ 518 HU_DR_GyroCalib_Sta 1;
BA_ "Version" SG_ 518 HU_DR_GyroCalib_Sta "22.07.05";
BA_ "Description" SG_ 518 HU_DR_TachoCalib_Sta "0x1=Calibrated";
BA_ "UserSigValidity" SG_ 518 HU_DR_TachoCalib_Sta 1;
BA_ "Version" SG_ 518 HU_DR_TachoCalib_Sta "22.07.05";
BA_ "Description" SG_ 518 HU_DR_Solution_Sta "0x1 : Dr is fully calibrated and DR position is valid";
BA_ "UserSigValidity" SG_ 518 HU_DR_Solution_Sta 1;
BA_ "Version" SG_ 518 HU_DR_Solution_Sta "22.07.05";
BA_ "Description" SG_ 518 HU_DR_GNSS_Fix_Age "0-254 = Time since last GNSS fix

255= No GNSS fix yet";
BA_ "UserSigValidity" SG_ 518 HU_DR_GNSS_Fix_Age 1;
BA_ "Version" SG_ 518 HU_DR_GNSS_Fix_Age "22.07.05";
BA_ "Description" SG_ 518 HU_DR_Altitude "MSL";
BA_ "UserSigValidity" SG_ 518 HU_DR_Altitude 1;
BA_ "Version" SG_ 518 HU_DR_Altitude "22.07.05";
BA_ "Description" SG_ 101 IEB_Crc1Val "The data area for CRC calculation is based on the data length (DLC) of the message DB.

The CRC shall be calculated over the entire data block (excluding the CRC bytes) including the user data, alive counter and Data ID



- CRC Polynomial (0x1021) , Ini";
BA_ "GenSigStartValue" SG_ 101 IEB_Crc1Val 65535;
BA_ "UserSigValidity" SG_ 101 IEB_Crc1Val 3;
BA_ "RoutingFactor" SG_ 101 IEB_Crc1Val 5;
BA_ "Version" SG_ 101 IEB_Crc1Val "21.09.03";
BA_ "Description" SG_ 101 IEB_StrkDpthPcVal "Brake Pedal Stroke Depth";
BA_ "UserSigValidity" SG_ 101 IEB_StrkDpthPcVal 3;
BA_ "RoutingFactor" SG_ 101 IEB_StrkDpthPcVal 5;
BA_ "Version" SG_ 101 IEB_StrkDpthPcVal "19.05.02";
BA_ "Description" SG_ 101 IEB_EstDpthPcVal "Estimated Brake Pedal Depth for SCC";
BA_ "UserSigValidity" SG_ 101 IEB_EstDpthPcVal 3;
BA_ "RoutingFactor" SG_ 101 IEB_EstDpthPcVal 5;
BA_ "Version" SG_ 101 IEB_EstDpthPcVal "19.05.02";
BA_ "Description" SG_ 101 IEB_AbsNGearReq "indigates N gear position request while ABS activation";
BA_ "UserSigValidity" SG_ 101 IEB_AbsNGearReq 3;
BA_ "RoutingFactor" SG_ 101 IEB_AbsNGearReq 5;
BA_ "Version" SG_ 101 IEB_AbsNGearReq "19.05.02";
BA_ "Description" SG_ 101 IEB_EstBrkPdlValVldSta "Estimated Brake pedal value Validity";
BA_ "GenSigStartValue" SG_ 101 IEB_EstBrkPdlValVldSta 1;
BA_ "UserSigValidity" SG_ 101 IEB_EstBrkPdlValVldSta 3;
BA_ "RoutingFactor" SG_ 101 IEB_EstBrkPdlValVldSta 5;
BA_ "Version" SG_ 101 IEB_EstBrkPdlValVldSta "19.05.02";
BA_ "Description" SG_ 101 IEB_FRAmode_Req "This signal requests braking load reduction logic when braking the ABS based on an electric vehicle";
BA_ "UserSigValidity" SG_ 101 IEB_FRAmode_Req 3;
BA_ "RoutingFactor" SG_ 101 IEB_FRAmode_Req 5;
BA_ "Version" SG_ 101 IEB_FRAmode_Req "22.10.20";
BA_ "Description" SG_ 101 IEB_DriftEscModSta_VDC "ESC/VDC mode command from DMIC by AVNT custom mode select";
BA_ "UserSigValidity" SG_ 101 IEB_DriftEscModSta_VDC 3;
BA_ "RoutingFactor" SG_ 101 IEB_DriftEscModSta_VDC 5;
BA_ "Version" SG_ 101 IEB_DriftEscModSta_VDC "22.07.06";
BA_ "Description" SG_ 101 IEB_RegenTqLimitNmVal_Rear "Regen Brake Torque limit at rear wheel";
BA_ "UserSigValidity" SG_ 101 IEB_RegenTqLimitNmVal_Rear 3;
BA_ "RoutingFactor" SG_ 101 IEB_RegenTqLimitNmVal_Rear 5;
BA_ "Version" SG_ 101 IEB_RegenTqLimitNmVal_Rear "19.05.03";
BA_ "Description" SG_ 101 IEB_DrvWhlSlipFlg_Frnt "This signal is to indicate the slip status of the driving wheels.";
BA_ "UserSigValidity" SG_ 101 IEB_DrvWhlSlipFlg_Frnt 3;
BA_ "RoutingFactor" SG_ 101 IEB_DrvWhlSlipFlg_Frnt 5;
BA_ "Version" SG_ 101 IEB_DrvWhlSlipFlg_Frnt "20.10.02";
BA_ "Description" SG_ 101 IEB_IndDriftMode "Signal for feedback from AVNT drift mode ON/OFF command";
BA_ "UserSigValidity" SG_ 101 IEB_IndDriftMode 3;
BA_ "RoutingFactor" SG_ 101 IEB_IndDriftMode 5;
BA_ "Version" SG_ 101 IEB_IndDriftMode "22.02.04";
BA_ "Description" SG_ 101 IEB_IndDriftEcsModSta "Signal for feed back of  ECS mode command from DMIC by AVNT custom mode select";
BA_ "UserSigValidity" SG_ 101 IEB_IndDriftEcsModSta 3;
BA_ "RoutingFactor" SG_ 101 IEB_IndDriftEcsModSta 5;
BA_ "Version" SG_ 101 IEB_IndDriftEcsModSta "22.07.06";
BA_ "Description" SG_ 101 IEB_IndDriftElsdModSta "Signal for feed back of ELSD mode command from DMIC by AVNT custom mode select";
BA_ "UserSigValidity" SG_ 101 IEB_IndDriftElsdModSta 3;
BA_ "RoutingFactor" SG_ 101 IEB_IndDriftElsdModSta 5;
BA_ "Version" SG_ 101 IEB_IndDriftElsdModSta "22.07.06";
BA_ "Description" SG_ 101 IEB_TCS_Req "이 신호는 IEB_01_10ms 메시지의 TCS 토크 신호에 대한 Validity를 의미한다.



0x1 : TCS_TqIntrvntnVal_Frnt, TCS_TqIntrvntnVal_Rear 신호에 의한 TCS 제어

0x2 : TCS_MtrTrgtRpm_Frnt, TCS_MtrTrgtRpm_Rear 신호에 의한 TCS 제어";
BA_ "UserSigValidity" SG_ 101 IEB_TCS_Req 3;
BA_ "RoutingFactor" SG_ 101 IEB_TCS_Req 5;
BA_ "Version" SG_ 101 IEB_TCS_Req "20.04.05";
BA_ "Description" SG_ 101 IEB_RSC_Req "Validity of RSC torque signal from IEB_01_10ms";
BA_ "UserSigValidity" SG_ 101 IEB_RSC_Req 3;
BA_ "RoutingFactor" SG_ 101 IEB_RSC_Req 5;
BA_ "Version" SG_ 101 IEB_RSC_Req "22.01.02";
BA_ "Description" SG_ 101 TCS_TqFlag_Frnt "이 신호는 IEB_01_10ms 메시지의 TCS 전륜 토크 신호에 대한 부호를 의미한다.";
BA_ "UserSigValidity" SG_ 101 TCS_TqFlag_Frnt 3;
BA_ "RoutingFactor" SG_ 101 TCS_TqFlag_Frnt 5;
BA_ "Version" SG_ 101 TCS_TqFlag_Frnt "19.05.03";
BA_ "Description" SG_ 101 TCS_TqFlag_Rear "이 신호는 IEB_01_10ms 메시지의 TCS 후륜 토크 신호에 대한 부호를 의미한다.";
BA_ "UserSigValidity" SG_ 101 TCS_TqFlag_Rear 3;
BA_ "RoutingFactor" SG_ 101 TCS_TqFlag_Rear 5;
BA_ "Version" SG_ 101 TCS_TqFlag_Rear "19.05.03";
BA_ "Description" SG_ 101 RSC_TqFlag_Frnt "이 신호는 IEB_01_10ms 메시지의 RSC 전륜 토크 신호에 대한 부호를 의미한다.";
BA_ "UserSigValidity" SG_ 101 RSC_TqFlag_Frnt 3;
BA_ "RoutingFactor" SG_ 101 RSC_TqFlag_Frnt 5;
BA_ "Version" SG_ 101 RSC_TqFlag_Frnt "19.05.03";
BA_ "Description" SG_ 101 RSC_TqFlag_Rear "이 신호는 IEB_01_10ms 메시지의 RSC 후륜 토크 신호에 대한 부호를 의미한다.";
BA_ "UserSigValidity" SG_ 101 RSC_TqFlag_Rear 3;
BA_ "RoutingFactor" SG_ 101 RSC_TqFlag_Rear 5;
BA_ "Version" SG_ 101 RSC_TqFlag_Rear "19.05.03";
BA_ "Description" SG_ 101 IEB_AlvCnt1Val "For the first transmission request for a data element the counter shall be initialized with 0 and shall be incremented by 1 for every subsequent send request. 

When the counter reaches the maximum value(0xFF), then it shall restart with 0 for the next s";
BA_ "UserSigValidity" SG_ 101 IEB_AlvCnt1Val 3;
BA_ "RoutingFactor" SG_ 101 IEB_AlvCnt1Val 5;
BA_ "Version" SG_ 101 IEB_AlvCnt1Val "21.09.03";
BA_ "Description" SG_ 101 TCS_TqIntrvntnVal_Frnt "TCS 제어를 위한 전륜 구동토크의 요구값을 의미.

부호는 TCS_TqFlag_Frnt 신호를 참조.";
BA_ "UserSigValidity" SG_ 101 TCS_TqIntrvntnVal_Frnt 3;
BA_ "RoutingFactor" SG_ 101 TCS_TqIntrvntnVal_Frnt 5;
BA_ "Version" SG_ 101 TCS_TqIntrvntnVal_Frnt "19.05.03";
BA_ "Description" SG_ 101 TCS_TqIntrvntnVal_Rear "TCS 제어를 위한 후륜 구동토크의 요구값을 의미.

부호는 TCS_TqFlag_Rear 신호를 참조.";
BA_ "UserSigValidity" SG_ 101 TCS_TqIntrvntnVal_Rear 3;
BA_ "RoutingFactor" SG_ 101 TCS_TqIntrvntnVal_Rear 5;
BA_ "Version" SG_ 101 TCS_TqIntrvntnVal_Rear "19.05.03";
BA_ "Description" SG_ 101 RSC_TqIntrvntnVal_Frnt "RSC 제어를 위한 전륜 구동토크의 요구값을 의미.

부호는 RSC_TqFlag_Frnt 신호를 참조.";
BA_ "UserSigValidity" SG_ 101 RSC_TqIntrvntnVal_Frnt 3;
BA_ "RoutingFactor" SG_ 101 RSC_TqIntrvntnVal_Frnt 5;
BA_ "Version" SG_ 101 RSC_TqIntrvntnVal_Frnt "19.05.03";
BA_ "Description" SG_ 101 RSC_TqIntrvntnVal_Rear "RSC 제어를 위한 후륜 구동토크의 요구값을 의미.

부호는 RSC_TqFlag_Rear 신호를 참조.";
BA_ "UserSigValidity" SG_ 101 RSC_TqIntrvntnVal_Rear 3;
BA_ "RoutingFactor" SG_ 101 RSC_TqIntrvntnVal_Rear 5;
BA_ "Version" SG_ 101 RSC_TqIntrvntnVal_Rear "19.05.03";
BA_ "Description" SG_ 101 TCS_MtrTrgtRpm_Flag_Frnt "이 신호는 IEB_01_10ms 메시지의 TCS 작동시 전륜 모터의 타겟 RPM 신호(TCS_MtrTrgtRpm_Frnt)에 대한 부호를 의미한다.";
BA_ "UserSigValidity" SG_ 101 TCS_MtrTrgtRpm_Flag_Frnt 3;
BA_ "RoutingFactor" SG_ 101 TCS_MtrTrgtRpm_Flag_Frnt 5;
BA_ "Version" SG_ 101 TCS_MtrTrgtRpm_Flag_Frnt "20.04.05";
BA_ "Description" SG_ 101 TCS_MtrTrgtRpm_Flag_Rear "이 신호는 IEB_01_10ms 메시지의 TCS 작동시 후륜 모터의 타겟 RPM 신호(TCS_MtrTrgtRpm_Rear)에 대한 부호를 의미한다.";
BA_ "UserSigValidity" SG_ 101 TCS_MtrTrgtRpm_Flag_Rear 3;
BA_ "RoutingFactor" SG_ 101 TCS_MtrTrgtRpm_Flag_Rear 5;
BA_ "Version" SG_ 101 TCS_MtrTrgtRpm_Flag_Rear "20.04.05";
BA_ "Description" SG_ 101 IEB_DriftElsdModSta "ELSD mode command from DMIC by AVNT custom mode select";
BA_ "UserSigValidity" SG_ 101 IEB_DriftElsdModSta 3;
BA_ "RoutingFactor" SG_ 101 IEB_DriftElsdModSta 5;
BA_ "Version" SG_ 101 IEB_DriftElsdModSta "22.07.06";
BA_ "Description" SG_ 101 IEB_DriftEcsModSta "ECS mode command from DMIC by AVNT custom mode select";
BA_ "UserSigValidity" SG_ 101 IEB_DriftEcsModSta 3;
BA_ "RoutingFactor" SG_ 101 IEB_DriftEcsModSta 5;
BA_ "Version" SG_ 101 IEB_DriftEcsModSta "22.07.06";
BA_ "Description" SG_ 101 IEB_DriftMdpsModSta "MDPS mode command from DMIC by AVNT custom mode select";
BA_ "UserSigValidity" SG_ 101 IEB_DriftMdpsModSta 3;
BA_ "RoutingFactor" SG_ 101 IEB_DriftMdpsModSta 5;
BA_ "Version" SG_ 101 IEB_DriftMdpsModSta "22.07.06";
BA_ "Description" SG_ 101 TCS_MtrTrgtRpm_Frnt "TCS 제어를 위한 전륜 모터의 RPM 요구값을 의미.

부호는 TCS_MtrTrgtRpm_Flag_Frnt 신호를 참조.";
BA_ "UserSigValidity" SG_ 101 TCS_MtrTrgtRpm_Frnt 3;
BA_ "RoutingFactor" SG_ 101 TCS_MtrTrgtRpm_Frnt 5;
BA_ "Version" SG_ 101 TCS_MtrTrgtRpm_Frnt "20.04.05";
BA_ "Description" SG_ 101 TCS_MtrTrgtRpm_Rear "TCS 제어를 위한 후륜 모터의 RPM 요구값을 의미.

부호는 TCS_MtrTrgtRpm_Flag_Rear 신호를 참조.";
BA_ "UserSigValidity" SG_ 101 TCS_MtrTrgtRpm_Rear 3;
BA_ "RoutingFactor" SG_ 101 TCS_MtrTrgtRpm_Rear 5;
BA_ "Version" SG_ 101 TCS_MtrTrgtRpm_Rear "20.04.05";
BA_ "Description" SG_ 101 IEB_DriftModeSta "This signal is for a pop-up display on drift mode.";
BA_ "UserSigValidity" SG_ 101 IEB_DriftModeSta 3;
BA_ "RoutingFactor" SG_ 101 IEB_DriftModeSta 5;
BA_ "Version" SG_ 101 IEB_DriftModeSta "20.12.02";
BA_ "Description" SG_ 101 IEB_DriftModeActSta "This signal is for drift mode ON/OFF status";
BA_ "UserSigValidity" SG_ 101 IEB_DriftModeActSta 3;
BA_ "RoutingFactor" SG_ 101 IEB_DriftModeActSta 5;
BA_ "Version" SG_ 101 IEB_DriftModeActSta "20.12.02";
BA_ "Description" SG_ 101 MCU_AntiJerk_Inhbtsta "MCU_AntiJerk_Inhbtsta is a signal to inform the MCU of anti-jerk control prohibition in order to prevent side effects caused by intervention in the IEB when ABS control and MCU anti-jerk control overlap.";
BA_ "UserSigValidity" SG_ 101 MCU_AntiJerk_Inhbtsta 3;
BA_ "RoutingFactor" SG_ 101 MCU_AntiJerk_Inhbtsta 5;
BA_ "Version" SG_ 101 MCU_AntiJerk_Inhbtsta "22.11.03";
BA_ "Description" SG_ 101 IEB_Motor_ProtectModSta "It is a signal to notify when the internal motor protection mode of the electric integrated booster is activated.

When the corresponding signal becomes a flag (0x1), the braking pressure is limited to a maximum of 60bar in the stop state.

It is not aff";
BA_ "UserSigValidity" SG_ 101 IEB_Motor_ProtectModSta 3;
BA_ "RoutingFactor" SG_ 101 IEB_Motor_ProtectModSta 5;
BA_ "Version" SG_ 101 IEB_Motor_ProtectModSta "22.08.03";
BA_ "Description" SG_ 101 IEB_EstBrkSacFrcNmVal "Estimated brake force value for stop assist control";
BA_ "UserSigValidity" SG_ 101 IEB_EstBrkSacFrcNmVal 3;
BA_ "RoutingFactor" SG_ 101 IEB_EstBrkSacFrcNmVal 5;
BA_ "Version" SG_ 101 IEB_EstBrkSacFrcNmVal "21.11.00";
BA_ "Description" SG_ 101 IEB_SrvLmpDis "The signal indicates the status of the “AHB Service lamp”";
BA_ "UserSigValidity" SG_ 101 IEB_SrvLmpDis 3;
BA_ "RoutingFactor" SG_ 101 IEB_SrvLmpDis 5;
BA_ "Version" SG_ 101 IEB_SrvLmpDis "19.05.02";
BA_ "Description" SG_ 101 IEB_IndDriftEscModSta_TCS "Signal for feed back of TCS mode change from DMIC by AVNT custom mode select";
BA_ "UserSigValidity" SG_ 101 IEB_IndDriftEscModSta_TCS 3;
BA_ "RoutingFactor" SG_ 101 IEB_IndDriftEscModSta_TCS 5;
BA_ "Version" SG_ 101 IEB_IndDriftEscModSta_TCS "22.07.06";
BA_ "Description" SG_ 101 IEB_IndDriftEscModSta_VDC "Signal for feed back of ESC/VDC mode command from DMIC by AVNT custom mode select";
BA_ "UserSigValidity" SG_ 101 IEB_IndDriftEscModSta_VDC 3;
BA_ "RoutingFactor" SG_ 101 IEB_IndDriftEscModSta_VDC 5;
BA_ "Version" SG_ 101 IEB_IndDriftEscModSta_VDC "22.07.06";
BA_ "Description" SG_ 101 IEB_IndDriftMdpsModSta "Signal for feed back of MDPS mode command from DMIC by AVNT custom mode select";
BA_ "UserSigValidity" SG_ 101 IEB_IndDriftMdpsModSta 3;
BA_ "RoutingFactor" SG_ 101 IEB_IndDriftMdpsModSta 5;
BA_ "Version" SG_ 101 IEB_IndDriftMdpsModSta "22.07.06";
BA_ "Description" SG_ 101 IEB_DfctvSta "Information regarding the AHB 'defective' indication.";
BA_ "UserSigValidity" SG_ 101 IEB_DfctvSta 3;
BA_ "RoutingFactor" SG_ 101 IEB_DfctvSta 5;
BA_ "Version" SG_ 101 IEB_DfctvSta "19.05.02";
BA_ "Description" SG_ 101 IEB_ActvSta "Information regarding AHB “Control Active” signal";
BA_ "UserSigValidity" SG_ 101 IEB_ActvSta 3;
BA_ "RoutingFactor" SG_ 101 IEB_ActvSta 5;
BA_ "Version" SG_ 101 IEB_ActvSta "19.05.02";
BA_ "Description" SG_ 101 IEB_DiagSta "Information regarding the AHB “diagnostic mode” indication.";
BA_ "UserSigValidity" SG_ 101 IEB_DiagSta 3;
BA_ "RoutingFactor" SG_ 101 IEB_DiagSta 5;
BA_ "Version" SG_ 101 IEB_DiagSta "19.05.02";
BA_ "Description" SG_ 101 IEB_WrngLmpDis "The signal indicates the status of the “AHB Warning lamp”";
BA_ "UserSigValidity" SG_ 101 IEB_WrngLmpDis 3;
BA_ "RoutingFactor" SG_ 101 IEB_WrngLmpDis 5;
BA_ "Version" SG_ 101 IEB_WrngLmpDis "19.05.02";
BA_ "Description" SG_ 101 IEB_MILReq "IEB sends this signal to turn on the Malfunction Indicator Lamp (MIL).";
BA_ "UserSigValidity" SG_ 101 IEB_MILReq 3;
BA_ "RoutingFactor" SG_ 101 IEB_MILReq 5;
BA_ "Version" SG_ 101 IEB_MILReq "19.05.02";
BA_ "Description" SG_ 101 IEB_DriftModeStaDis "This signal is for a pop-up display on restriction status of drift mode activation";
BA_ "UserSigValidity" SG_ 101 IEB_DriftModeStaDis 3;
BA_ "RoutingFactor" SG_ 101 IEB_DriftModeStaDis 5;
BA_ "Version" SG_ 101 IEB_DriftModeStaDis "22.11.03";
BA_ "Description" SG_ 101 RSC_Sta "RSC Ready Status";
BA_ "UserSigValidity" SG_ 101 RSC_Sta 3;
BA_ "RoutingFactor" SG_ 101 RSC_Sta 5;
BA_ "Version" SG_ 101 RSC_Sta "23.04.06";
BA_ "Description" SG_ 101 IEB_StrkDpthmmVal "The signal indicates the depth of brake pedal";
BA_ "UserSigValidity" SG_ 101 IEB_StrkDpthmmVal 3;
BA_ "RoutingFactor" SG_ 101 IEB_StrkDpthmmVal 5;
BA_ "Version" SG_ 101 IEB_StrkDpthmmVal "19.05.02";
BA_ "Description" SG_ 101 IEB_BrkActvSta "This signal indicates that a brake switch is activated or not. When the brake switch is activated(pressed) its value is 02H otherwise its value is 01H.

If the ECU does not support this signal the value is 00H.



이 신호는 EV, FCEV 에서만 사용될 수 있음";
BA_ "UserSigValidity" SG_ 101 IEB_BrkActvSta 3;
BA_ "RoutingFactor" SG_ 101 IEB_BrkActvSta 5;
BA_ "Version" SG_ 101 IEB_BrkActvSta "19.05.05";
BA_ "Description" SG_ 101 IEB_PdlTrvlSnsrFailSta "Information regarding the pedal travel sensor fail status";
BA_ "UserSigValidity" SG_ 101 IEB_PdlTrvlSnsrFailSta 3;
BA_ "RoutingFactor" SG_ 101 IEB_PdlTrvlSnsrFailSta 5;
BA_ "Version" SG_ 101 IEB_PdlTrvlSnsrFailSta "19.05.02";
BA_ "Description" SG_ 101 IEB_PdlCalibSta "Information regarding the pedal travel sensor’s calibration status";
BA_ "UserSigValidity" SG_ 101 IEB_PdlCalibSta 3;
BA_ "RoutingFactor" SG_ 101 IEB_PdlCalibSta 5;
BA_ "Version" SG_ 101 IEB_PdlCalibSta "19.05.02";
BA_ "Description" SG_ 101 IEB_BzrSta "The signal indicates the status of the “Buzzer”";
BA_ "UserSigValidity" SG_ 101 IEB_BzrSta 3;
BA_ "RoutingFactor" SG_ 101 IEB_BzrSta 5;
BA_ "Version" SG_ 101 IEB_BzrSta "19.05.02";
BA_ "Description" SG_ 101 IEB_Sta "EBS Ready Status

※ 전/후륜에 대한 구분이 없는 경우에는 0x0 (Not Ready) / 0x1(Ready) 만 사용한다.

     : 전륜 구동 회생제동 차량의 경우, 0x0 는 Front not Ready / 0x1은 Front only Ready를 의미함.";
BA_ "UserSigValidity" SG_ 101 IEB_Sta 3;
BA_ "RoutingFactor" SG_ 101 IEB_Sta 5;
BA_ "Version" SG_ 101 IEB_Sta "19.06.01";
BA_ "UserSigValidity" SG_ 101 IEB_SnsrFailSta 3;
BA_ "RoutingFactor" SG_ 101 IEB_SnsrFailSta 5;
BA_ "Version" SG_ 101 IEB_SnsrFailSta "19.05.02";
BA_ "Description" SG_ 101 IEB_RbsWrngLmpSta "This signal indicates RBS warning lamp status.";
BA_ "UserSigValidity" SG_ 101 IEB_RbsWrngLmpSta 3;
BA_ "RoutingFactor" SG_ 101 IEB_RbsWrngLmpSta 5;
BA_ "Version" SG_ 101 IEB_RbsWrngLmpSta "19.05.02";
BA_ "Description" SG_ 101 IEB_VacSysDfctvSta "This signal indicates Vacuum pump “defective”.";
BA_ "UserSigValidity" SG_ 101 IEB_VacSysDfctvSta 3;
BA_ "RoutingFactor" SG_ 101 IEB_VacSysDfctvSta 5;
BA_ "Version" SG_ 101 IEB_VacSysDfctvSta "19.05.02";
BA_ "Description" SG_ 101 IEB_RegenTqLimitNmVal_Frnt "Regen Brake Torque limit at front wheel";
BA_ "UserSigValidity" SG_ 101 IEB_RegenTqLimitNmVal_Frnt 3;
BA_ "RoutingFactor" SG_ 101 IEB_RegenTqLimitNmVal_Frnt 5;
BA_ "Version" SG_ 101 IEB_RegenTqLimitNmVal_Frnt "19.05.03";
BA_ "Description" SG_ 101 IEB_EstTtlBrkFrcNmVal "Estimated Total Brake Force";
BA_ "UserSigValidity" SG_ 101 IEB_EstTtlBrkFrcNmVal 3;
BA_ "RoutingFactor" SG_ 101 IEB_EstTtlBrkFrcNmVal 5;
BA_ "Version" SG_ 101 IEB_EstTtlBrkFrcNmVal "19.05.02";
BA_ "Description" SG_ 309 BAT_Crc1Val "The data area for CRC calculation is based on the data length (DLC) of the message DB.

The CRC shall be calculated over the entire data block (excluding the CRC bytes) including the user data, alive counter and Data ID



- CRC Polynomial (0x1021) , Ini";
BA_ "GenSigStartValue" SG_ 309 BAT_Crc1Val 65535;
BA_ "UserSigValidity" SG_ 309 BAT_Crc1Val 7;
BA_ "RoutingFactor" SG_ 309 BAT_Crc1Val 5;
BA_ "Version" SG_ 309 BAT_Crc1Val "21.09.03";
BA_ "Description" SG_ 309 BAT_AlvCnt1Val "For the first transmission request for a data element the counter shall be initialized with 0 and shall be incremented by 1 for every subsequent send request. 

When the counter reaches the maximum value(0xFF), then it shall restart with 0 for the next s";
BA_ "UserSigValidity" SG_ 309 BAT_AlvCnt1Val 7;
BA_ "RoutingFactor" SG_ 309 BAT_AlvCnt1Val 5;
BA_ "Version" SG_ 309 BAT_AlvCnt1Val "21.09.03";
BA_ "Description" SG_ 309 BAT_CurrVal "[For 12V Lithium Battery vehicle model]

This is Battery current as measured by battery sensor.

This value is  

   - IRANGE : 1 (medium current)

   - Resolution : 10mA";
BA_ "GenSigStartValue" SG_ 309 BAT_CurrVal 65535;
BA_ "UserSigValidity" SG_ 309 BAT_CurrVal 7;
BA_ "RoutingFactor" SG_ 309 BAT_CurrVal 5;
BA_ "Version" SG_ 309 BAT_CurrVal "17.11.00";
BA_ "Description" SG_ 309 BAT_SocVal "[For 12V Lithium Battery vehicle model]

This signal is battery State of Charge as calculated by battery sensor.";
BA_ "UserSigValidity" SG_ 309 BAT_SocVal 7;
BA_ "RoutingFactor" SG_ 309 BAT_SocVal 5;
BA_ "Version" SG_ 309 BAT_SocVal "19.01.00";
BA_ "Description" SG_ 309 BAT_VoltVal "[For 12V Lithium Battery vehicle model]

This is the actual battery voltage as measured on the battery pole by battery sensor.

The Resolution is 1mV.";
BA_ "GenSigStartValue" SG_ 309 BAT_VoltVal 16383;
BA_ "UserSigValidity" SG_ 309 BAT_VoltVal 7;
BA_ "RoutingFactor" SG_ 309 BAT_VoltVal 5;
BA_ "Version" SG_ 309 BAT_VoltVal "17.11.00";
BA_ "Description" SG_ 309 BAT_AuxBattOpt "12V Battery Option Value(LFP 12V Battery)";
BA_ "UserSigValidity" SG_ 309 BAT_AuxBattOpt 7;
BA_ "RoutingFactor" SG_ 309 BAT_AuxBattOpt 5;
BA_ "Version" SG_ 309 BAT_AuxBattOpt "21.10.05";
BA_ "Description" SG_ 309 BAT_TempVal "This is actual battery electrolyte temperature value by battery sensor.

The value is calculated by a Battery Temperature Model, depending on measured temperature of the battery pole.

The resolution is 0.5℃.";
BA_ "GenSigStartValue" SG_ 309 BAT_TempVal 511;
BA_ "UserSigValidity" SG_ 309 BAT_TempVal 7;
BA_ "RoutingFactor" SG_ 309 BAT_TempVal 5;
BA_ "Version" SG_ 309 BAT_TempVal "20.03.05";
BA_ "Description" SG_ 309 BAT_SocErrSta "[For 12V Lithium Battery vehicle model]

This bit is flags for indication whether battery SOC detection value is plausible or not by battery sensor.

If it is set to value 0, then it means battery SOC is normal state.

If it is set to value 1, then it me";
BA_ "GenSigStartValue" SG_ 309 BAT_SocErrSta 1;
BA_ "UserSigValidity" SG_ 309 BAT_SocErrSta 7;
BA_ "RoutingFactor" SG_ 309 BAT_SocErrSta 5;
BA_ "Version" SG_ 309 BAT_SocErrSta "19.01.00";
BA_ "Description" SG_ 309 BAT_SohVal "[For 12V Lithium Battery vehicle model]

This signal is battery State of Health(SOH) as calculated by battery sensor.

This value shows reduction rate of nominal capacity.

This value can be used for diagnosis information of application system.";
BA_ "GenSigStartValue" SG_ 309 BAT_SohVal 127;
BA_ "UserSigValidity" SG_ 309 BAT_SohVal 7;
BA_ "RoutingFactor" SG_ 309 BAT_SohVal 5;
BA_ "Version" SG_ 309 BAT_SohVal "17.11.00";
BA_ "Description" SG_ 309 BAT_SnsrInvldSta "[For 12V Lithium Battery vehicle model]

This bit is Battery Sensor Invalid flag and setting condition is depending on Battery Sensor self diagnosis information.

 BS Invalid = 0 : BS is Valid Condition

 BS Invalid = 1 : BS is Invalid Condition";
BA_ "GenSigStartValue" SG_ 309 BAT_SnsrInvldSta 1;
BA_ "UserSigValidity" SG_ 309 BAT_SnsrInvldSta 7;
BA_ "RoutingFactor" SG_ 309 BAT_SnsrInvldSta 5;
BA_ "Version" SG_ 309 BAT_SnsrInvldSta "17.11.00";
BA_ "Description" SG_ 309 BAT_SofVal "[For 12V Lithium Battery vehicle model]

This signal is battery State of Function(SOF) as calculated by battery sensor.

This value shows information about the battery ability to crank the engine (both of warm & cold cranking).

This value is prediction ";
BA_ "GenSigStartValue" SG_ 309 BAT_SofVal 127;
BA_ "UserSigValidity" SG_ 309 BAT_SofVal 7;
BA_ "RoutingFactor" SG_ 309 BAT_SofVal 5;
BA_ "Version" SG_ 309 BAT_SofVal "17.11.00";
BA_ "Description" SG_ 309 BAT_RspErrSta "[For 12V Lithium Battery vehicle model]

Battery Sensor shall send one status bit signal, Response_Error. Response_Error shall be set whenever a frame received by the node or a frame transmitted by the node contains an error in the response field.

Respo";
BA_ "GenSigStartValue" SG_ 309 BAT_RspErrSta 1;
BA_ "UserSigValidity" SG_ 309 BAT_RspErrSta 7;
BA_ "RoutingFactor" SG_ 309 BAT_RspErrSta 5;
BA_ "Version" SG_ 309 BAT_RspErrSta "17.11.00";
BA_ "Description" SG_ 309 BAT_CapacityVal "12V Battery Capacity Value";
BA_ "UserSigValidity" SG_ 309 BAT_CapacityVal 7;
BA_ "RoutingFactor" SG_ 309 BAT_CapacityVal 5;
BA_ "Version" SG_ 309 BAT_CapacityVal "21.07.06";
BA_ "Description" SG_ 920 CTM_FD_Crc2Val "The data area for CRC calculation is based on the data length (DLC) of the message DB.

The CRC shall be calculated over the entire data block (excluding the CRC bytes) including the user data, alive counter and Data ID



- CRC Polynomial (0x1021) , Ini";
BA_ "GenSigSendType" SG_ 920 CTM_FD_Crc2Val 4;
BA_ "GenSigStartValue" SG_ 920 CTM_FD_Crc2Val 65535;
BA_ "UserSigValidity" SG_ 920 CTM_FD_Crc2Val 3;
BA_ "Version" SG_ 920 CTM_FD_Crc2Val "22.10.21";
BA_ "Description" SG_ 920 CTM_FD_AlvCnt2Val "For the first transmission request for a data element the counter shall be initialized with 0 and shall be incremented by 1 for every subsequent send request. 

When the counter reaches the maximum value(0xFF), then it shall restart with 0 for the next s";
BA_ "GenSigSendType" SG_ 920 CTM_FD_AlvCnt2Val 4;
BA_ "UserSigValidity" SG_ 920 CTM_FD_AlvCnt2Val 3;
BA_ "Version" SG_ 920 CTM_FD_AlvCnt2Val "22.10.21";
BA_ "Description" SG_ 920 USM_TrailerTypSta "Trailer type status";
BA_ "GenSigSendType" SG_ 920 USM_TrailerTypSta 4;
BA_ "UserSigValidity" SG_ 920 USM_TrailerTypSta 3;
BA_ "Version" SG_ 920 USM_TrailerTypSta "24.02.00";
BA_ "Description" SG_ 920 ITBC_TrailerDisplayAppliedSta "ITBC_TrailerDisplayAppliedSta == 0x1 Determines whether to apply ITBC content based on input.

- Display related information only when the signal is valid (TBC page and pop-up display)";
BA_ "GenSigSendType" SG_ 920 ITBC_TrailerDisplayAppliedSta 4;
BA_ "UserSigValidity" SG_ 920 ITBC_TrailerDisplayAppliedSta 3;
BA_ "Version" SG_ 920 ITBC_TrailerDisplayAppliedSta "24.02.00";
BA_ "Description" SG_ 920 ITBC_TrailerBrkOut "Trailer Brake Output sent to cluster. PWM duty cycle 0 - 100%.";
BA_ "GenSigSendType" SG_ 920 ITBC_TrailerBrkOut 4;
BA_ "UserSigValidity" SG_ 920 ITBC_TrailerBrkOut 3;
BA_ "Version" SG_ 920 ITBC_TrailerBrkOut "24.02.00";
BA_ "Description" SG_ 920 ITBC_TrailerBrkGainVal "Gain setting 0 - 10 in steps of 0.5 on cluster.";
BA_ "GenSigSendType" SG_ 920 ITBC_TrailerBrkGainVal 4;
BA_ "UserSigValidity" SG_ 920 ITBC_TrailerBrkGainVal 3;
BA_ "Version" SG_ 920 ITBC_TrailerBrkGainVal "24.02.00";
BA_ "Description" SG_ 920 ITBC_SysWarn "Request for cluster to provide audible warning & pop up (conditions TBD eg fault).";
BA_ "GenSigSendType" SG_ 920 ITBC_SysWarn 4;
BA_ "UserSigValidity" SG_ 920 ITBC_SysWarn 3;
BA_ "Version" SG_ 920 ITBC_SysWarn "24.02.00";
BA_ "Description" SG_ 920 CTM_TrailerAct "This signal is used for control the Trailer Act function.";
BA_ "GenSigSendType" SG_ 920 CTM_TrailerAct 4;
BA_ "UserSigValidity" SG_ 920 CTM_TrailerAct 3;
BA_ "NetworkRequest" SG_ 920 CTM_TrailerAct 0;
BA_ "Version" SG_ 920 CTM_TrailerAct "18.04.01";
BA_ "Description" SG_ 920 CTM_RearfogAct "This signal is used for display the rear fog lamp mounted on the trailer.";
BA_ "GenSigSendType" SG_ 920 CTM_RearfogAct 4;
BA_ "UserSigValidity" SG_ 920 CTM_RearfogAct 3;
BA_ "NetworkRequest" SG_ 920 CTM_RearfogAct 0;
BA_ "Version" SG_ 920 CTM_RearfogAct "18.10.07";
BA_ "Description" SG_ 920 CTM_StpLmpOpnSta "Trailer Stop Lamp OpenStatus";
BA_ "GenSigSendType" SG_ 920 CTM_StpLmpOpnSta 4;
BA_ "UserSigValidity" SG_ 920 CTM_StpLmpOpnSta 3;
BA_ "NetworkRequest" SG_ 920 CTM_StpLmpOpnSta 0;
BA_ "Version" SG_ 920 CTM_StpLmpOpnSta "18.10.07";
BA_ "Description" SG_ 920 CTM_TrnSigLmpLftOpnSta "Trailer T/SIG Lamp Left OpenStatus";
BA_ "GenSigSendType" SG_ 920 CTM_TrnSigLmpLftOpnSta 4;
BA_ "UserSigValidity" SG_ 920 CTM_TrnSigLmpLftOpnSta 3;
BA_ "NetworkRequest" SG_ 920 CTM_TrnSigLmpLftOpnSta 0;
BA_ "Version" SG_ 920 CTM_TrnSigLmpLftOpnSta "18.10.07";
BA_ "Description" SG_ 920 CTM_TrnSigLmpRtOpnSta "Trailer T/SIG Lamp Right OpenStatus";
BA_ "GenSigSendType" SG_ 920 CTM_TrnSigLmpRtOpnSta 4;
BA_ "UserSigValidity" SG_ 920 CTM_TrnSigLmpRtOpnSta 3;
BA_ "NetworkRequest" SG_ 920 CTM_TrnSigLmpRtOpnSta 0;
BA_ "Version" SG_ 920 CTM_TrnSigLmpRtOpnSta "18.10.07";
BA_ "Description" SG_ 920 CTM_ExtTailLmpLftOpnSta "Trailer Exterior Tail Lamp Left OpenStatus";
BA_ "GenSigSendType" SG_ 920 CTM_ExtTailLmpLftOpnSta 4;
BA_ "UserSigValidity" SG_ 920 CTM_ExtTailLmpLftOpnSta 3;
BA_ "NetworkRequest" SG_ 920 CTM_ExtTailLmpLftOpnSta 0;
BA_ "Version" SG_ 920 CTM_ExtTailLmpLftOpnSta "18.10.07";
BA_ "Description" SG_ 920 CTM_ExtTailLmpRtOpnSta "Trailer Exterior Tail Lamp Right OpenStatus";
BA_ "GenSigSendType" SG_ 920 CTM_ExtTailLmpRtOpnSta 4;
BA_ "UserSigValidity" SG_ 920 CTM_ExtTailLmpRtOpnSta 3;
BA_ "NetworkRequest" SG_ 920 CTM_ExtTailLmpRtOpnSta 0;
BA_ "Version" SG_ 920 CTM_ExtTailLmpRtOpnSta "18.10.07";
BA_ "Description" SG_ 920 CTM_Exra_EbrakSta "Trailer Ebrake Controller ActiveStatus";
BA_ "GenSigSendType" SG_ 920 CTM_Exra_EbrakSta 4;
BA_ "UserSigValidity" SG_ 920 CTM_Exra_EbrakSta 0;
BA_ "Version" SG_ 920 CTM_Exra_EbrakSta "21.06.10";
BA_ "Description" SG_ 920 CTM_TrlAngl_200ms "This signal is used to provide the Trailer Angle(Kink Angle) between vehicle and trailer(200ms).";
BA_ "GenSigSendType" SG_ 920 CTM_TrlAngl_200ms 4;
BA_ "UserSigValidity" SG_ 920 CTM_TrlAngl_200ms 3;
BA_ "Version" SG_ 920 CTM_TrlAngl_200ms "22.07.06";
BA_ "Description" SG_ 1059 HU_GW_Crc4Val "The data area for CRC calculation is based on the data length (DLC) of the message DB.

The CRC shall be calculated over the entire data block (excluding the CRC bytes) including the user data, alive counter and Data ID



- CRC Polynomial (0x1021) , Ini";
BA_ "GenSigSendType" SG_ 1059 HU_GW_Crc4Val 4;
BA_ "GenSigStartValue" SG_ 1059 HU_GW_Crc4Val 65535;
BA_ "UserSigValidity" SG_ 1059 HU_GW_Crc4Val 3;
BA_ "Version" SG_ 1059 HU_GW_Crc4Val "22.10.20";
BA_ "Description" SG_ 1059 CF_AVN_AutoWashModeSta "Washer Mode status signal";
BA_ "GenSigSendType" SG_ 1059 CF_AVN_AutoWashModeSta 4;
BA_ "UserSigValidity" SG_ 1059 CF_AVN_AutoWashModeSta 3;
BA_ "Version" SG_ 1059 CF_AVN_AutoWashModeSta "23.04.05";
BA_ "GenSigSendType" SG_ 1059 OMUOSMirCtrl_Vr 4;
BA_ "GenSigStartValue" SG_ 1059 OMUOSMirCtrl_Vr 3;
BA_ "UserSigValidity" SG_ 1059 OMUOSMirCtrl_Vr 3;
BA_ "Version" SG_ 1059 OMUOSMirCtrl_Vr "22.07.05";
BA_ "Description" SG_ 1059 HU_GW_AlvCnt4Val "For the first transmission request for a data element the counter shall be initialized with 0 and shall be incremented by 1 for every subsequent send request. 

When the counter reaches the maximum value(0xFF), then it shall restart with 0 for the next s";
BA_ "GenSigSendType" SG_ 1059 HU_GW_AlvCnt4Val 4;
BA_ "UserSigValidity" SG_ 1059 HU_GW_AlvCnt4Val 3;
BA_ "Version" SG_ 1059 HU_GW_AlvCnt4Val "22.10.20";
BA_ "Description" SG_ 1059 HU_IG3_Request "IG3 wake up and sleep Request signal for EV/PHEV/HEV



Please apply this signal after checking ICU on your vehicle.";
BA_ "GenSigSendType" SG_ 1059 HU_IG3_Request 4;
BA_ "GenSigStartValue" SG_ 1059 HU_IG3_Request 3;
BA_ "UserSigValidity" SG_ 1059 HU_IG3_Request 0;
BA_ "Version" SG_ 1059 HU_IG3_Request "22.07.05";
BA_ "Description" SG_ 1059 HU_DigitalKeyGroupingSupport "This signal indicates whether the H/U can support the grouping specification for digital key.";
BA_ "GenSigSendType" SG_ 1059 HU_DigitalKeyGroupingSupport 4;
BA_ "UserSigValidity" SG_ 1059 HU_DigitalKeyGroupingSupport 1;
BA_ "Version" SG_ 1059 HU_DigitalKeyGroupingSupport "23.05.01";
BA_ "Description" SG_ 1059 HU_Background "HU Backgound image info";
BA_ "GenSigSendType" SG_ 1059 HU_Background 4;
BA_ "GenSigStartValue" SG_ 1059 HU_Background 7;
BA_ "UserSigValidity" SG_ 1059 HU_Background 1;
BA_ "Version" SG_ 1059 HU_Background "22.11.03";
BA_ "Description" SG_ 1059 HU_BackgroundFadeInOut "HU Background Fade in/out info

(HEX * Factor) %";
BA_ "GenSigSendType" SG_ 1059 HU_BackgroundFadeInOut 4;
BA_ "GenSigStartValue" SG_ 1059 HU_BackgroundFadeInOut 1023;
BA_ "UserSigValidity" SG_ 1059 HU_BackgroundFadeInOut 1;
BA_ "Version" SG_ 1059 HU_BackgroundFadeInOut "22.07.05";
BA_ "Description" SG_ 979 BDC_FD_Crc4Val "The data area for CRC calculation is based on the data length (DLC) of the message DB.

The CRC shall be calculated over the entire data block (excluding the CRC bytes) including the user data, alive counter and Data ID



- CRC Polynomial (0x1021) , Ini";
BA_ "GenSigSendType" SG_ 979 BDC_FD_Crc4Val 4;
BA_ "GenSigStartValue" SG_ 979 BDC_FD_Crc4Val 65535;
BA_ "UserSigValidity" SG_ 979 BDC_FD_Crc4Val 0;
BA_ "Version" SG_ 979 BDC_FD_Crc4Val "22.11.04";
BA_ "Description" SG_ 979 BDC_FD_AlvCnt4Val "For the first transmission request for a data element the counter shall be initialized with 0 and shall be incremented by 1 for every subsequent send request. 

When the counter reaches the maximum value(0xFF), then it shall restart with 0 for the next s";
BA_ "GenSigSendType" SG_ 979 BDC_FD_AlvCnt4Val 4;
BA_ "UserSigValidity" SG_ 979 BDC_FD_AlvCnt4Val 0;
BA_ "Version" SG_ 979 BDC_FD_AlvCnt4Val "22.11.04";
BA_ "GenSigSendType" SG_ 979 BAlarm_BglrAlrm_CurrentSta 4;
BA_ "UserSigValidity" SG_ 979 BAlarm_BglrAlrm_CurrentSta 0;
BA_ "NetworkRequest" SG_ 979 BAlarm_BglrAlrm_CurrentSta 0;
BA_ "NetworkRequestHoldingTime" SG_ 979 BAlarm_BglrAlrm_CurrentSta 5000;
BA_ "Version" SG_ 979 BAlarm_BglrAlrm_CurrentSta "22.11.02";
BA_ "GenSigSendType" SG_ 979 BAlarm_BglrAlrm_Sta 4;
BA_ "UserSigValidity" SG_ 979 BAlarm_BglrAlrm_Sta 0;
BA_ "NetworkRequest" SG_ 979 BAlarm_BglrAlrm_Sta 0;
BA_ "NetworkRequestHoldingTime" SG_ 979 BAlarm_BglrAlrm_Sta 5000;
BA_ "Version" SG_ 979 BAlarm_BglrAlrm_Sta "22.11.02";
BA_ "Description" SG_ 979 BAlarm_PncAlrmSta "-For TeleCranking Panic Function

-This signal send to IBOX";
BA_ "GenSigSendType" SG_ 979 BAlarm_PncAlrmSta 4;
BA_ "UserSigValidity" SG_ 979 BAlarm_PncAlrmSta 0;
BA_ "NetworkRequest" SG_ 979 BAlarm_PncAlrmSta 0;
BA_ "NetworkRequestHoldingTime" SG_ 979 BAlarm_PncAlrmSta 5000;
BA_ "Version" SG_ 979 BAlarm_PncAlrmSta "21.09.05";
BA_ "Description" SG_ 979 SBR_StBltStpWrngBzrSta "This signal is used for control the Seatbelt Step Warning Buzzer function with 3 bits.

It provides pre-warning, 1st warning, 2nd warning and 3rd warning.";
BA_ "GenSigSendType" SG_ 979 SBR_StBltStpWrngBzrSta 4;
BA_ "UserSigValidity" SG_ 979 SBR_StBltStpWrngBzrSta 0;
BA_ "NetworkRequest" SG_ 979 SBR_StBltStpWrngBzrSta 0;
BA_ "NetworkRequestHoldingTime" SG_ 979 SBR_StBltStpWrngBzrSta 5000;
BA_ "Version" SG_ 979 SBR_StBltStpWrngBzrSta "18.07.03";
BA_ "Description" SG_ 979 SBR_StBltWrngBzrSta "-Seat belt Warning (Reminder) buzzer";
BA_ "GenSigSendType" SG_ 979 SBR_StBltWrngBzrSta 4;
BA_ "UserSigValidity" SG_ 979 SBR_StBltWrngBzrSta 0;
BA_ "NetworkRequest" SG_ 979 SBR_StBltWrngBzrSta 0;
BA_ "NetworkRequestHoldingTime" SG_ 979 SBR_StBltWrngBzrSta 5000;
BA_ "Version" SG_ 979 SBR_StBltWrngBzrSta "17.12.00";
BA_ "GenSigSendType" SG_ 979 BAlarm_BrglrHrnRlySta 4;
BA_ "UserSigValidity" SG_ 979 BAlarm_BrglrHrnRlySta 0;
BA_ "NetworkRequest" SG_ 979 BAlarm_BrglrHrnRlySta 0;
BA_ "NetworkRequestHoldingTime" SG_ 979 BAlarm_BrglrHrnRlySta 5000;
BA_ "Version" SG_ 979 BAlarm_BrglrHrnRlySta "17.12.00";
BA_ "GenSigSendType" SG_ 979 SBR_DrvStBltIndSta 4;
BA_ "UserSigValidity" SG_ 979 SBR_DrvStBltIndSta 0;
BA_ "NetworkRequest" SG_ 979 SBR_DrvStBltIndSta 0;
BA_ "NetworkRequestHoldingTime" SG_ 979 SBR_DrvStBltIndSta 5000;
BA_ "Version" SG_ 979 SBR_DrvStBltIndSta "17.12.00";
BA_ "GenSigSendType" SG_ 979 SBR_RrLftStBltWrngIndSta 4;
BA_ "UserSigValidity" SG_ 979 SBR_RrLftStBltWrngIndSta 0;
BA_ "NetworkRequest" SG_ 979 SBR_RrLftStBltWrngIndSta 0;
BA_ "NetworkRequestHoldingTime" SG_ 979 SBR_RrLftStBltWrngIndSta 5000;
BA_ "Version" SG_ 979 SBR_RrLftStBltWrngIndSta "18.06.01";
BA_ "GenSigSendType" SG_ 979 SBR_RrRtStBltWrngIndSta 4;
BA_ "UserSigValidity" SG_ 979 SBR_RrRtStBltWrngIndSta 0;
BA_ "NetworkRequest" SG_ 979 SBR_RrRtStBltWrngIndSta 0;
BA_ "NetworkRequestHoldingTime" SG_ 979 SBR_RrRtStBltWrngIndSta 5000;
BA_ "Version" SG_ 979 SBR_RrRtStBltWrngIndSta "18.06.01";
BA_ "GenSigSendType" SG_ 979 SBR_RrCtrStBltIndSta 4;
BA_ "UserSigValidity" SG_ 979 SBR_RrCtrStBltIndSta 0;
BA_ "NetworkRequest" SG_ 979 SBR_RrCtrStBltIndSta 0;
BA_ "NetworkRequestHoldingTime" SG_ 979 SBR_RrCtrStBltIndSta 5000;
BA_ "Version" SG_ 979 SBR_RrCtrStBltIndSta "20.01.01";
BA_ "Description" SG_ 979 SBR_3rdLftStBltWrngIndSta "This signal is used for control the 3th Row Left Seatbelt indicator function.";
BA_ "GenSigSendType" SG_ 979 SBR_3rdLftStBltWrngIndSta 4;
BA_ "UserSigValidity" SG_ 979 SBR_3rdLftStBltWrngIndSta 0;
BA_ "NetworkRequest" SG_ 979 SBR_3rdLftStBltWrngIndSta 0;
BA_ "NetworkRequestHoldingTime" SG_ 979 SBR_3rdLftStBltWrngIndSta 5000;
BA_ "Version" SG_ 979 SBR_3rdLftStBltWrngIndSta "18.06.01";
BA_ "Description" SG_ 979 SBR_3rdRtStBltWrngIndSta "This signal is used for control the 3th Row Right Seatbelt indicator function.";
BA_ "GenSigSendType" SG_ 979 SBR_3rdRtStBltWrngIndSta 4;
BA_ "UserSigValidity" SG_ 979 SBR_3rdRtStBltWrngIndSta 0;
BA_ "NetworkRequest" SG_ 979 SBR_3rdRtStBltWrngIndSta 0;
BA_ "NetworkRequestHoldingTime" SG_ 979 SBR_3rdRtStBltWrngIndSta 5000;
BA_ "Version" SG_ 979 SBR_3rdRtStBltWrngIndSta "18.06.01";
BA_ "Description" SG_ 979 SBR_3rdCtrStBltWrngIndSta "This signal is used for control the 3th Row Center Seatbelt indicator function.";
BA_ "GenSigSendType" SG_ 979 SBR_3rdCtrStBltWrngIndSta 4;
BA_ "UserSigValidity" SG_ 979 SBR_3rdCtrStBltWrngIndSta 0;
BA_ "NetworkRequest" SG_ 979 SBR_3rdCtrStBltWrngIndSta 0;
BA_ "NetworkRequestHoldingTime" SG_ 979 SBR_3rdCtrStBltWrngIndSta 5000;
BA_ "Version" SG_ 979 SBR_3rdCtrStBltWrngIndSta "20.01.01";
BA_ "Description" SG_ 979 Warn_BzrWrngSta "-(Old)C_WngBuzzer";
BA_ "GenSigSendType" SG_ 979 Warn_BzrWrngSta 4;
BA_ "UserSigValidity" SG_ 979 Warn_BzrWrngSta 0;
BA_ "NetworkRequest" SG_ 979 Warn_BzrWrngSta 0;
BA_ "NetworkRequestHoldingTime" SG_ 979 Warn_BzrWrngSta 5000;
BA_ "Version" SG_ 979 Warn_BzrWrngSta "17.12.00";
BA_ "Description" SG_ 979 Warn_BCMWrngSta "Warning command og BCM";
BA_ "GenSigSendType" SG_ 979 Warn_BCMWrngSta 4;
BA_ "UserSigValidity" SG_ 979 Warn_BCMWrngSta 0;
BA_ "NetworkRequest" SG_ 979 Warn_BCMWrngSta 0;
BA_ "NetworkRequestHoldingTime" SG_ 979 Warn_BCMWrngSta 5000;
BA_ "Version" SG_ 979 Warn_BCMWrngSta "23.04.04";
BA_ "Description" SG_ 979 ROA_RrBlwAutoOffReq "This signal is used for a request to Rear Blow Off (Auto Cut)";
BA_ "GenSigSendType" SG_ 979 ROA_RrBlwAutoOffReq 4;
BA_ "UserSigValidity" SG_ 979 ROA_RrBlwAutoOffReq 0;
BA_ "NetworkRequest" SG_ 979 ROA_RrBlwAutoOffReq 0;
BA_ "NetworkRequestHoldingTime" SG_ 979 ROA_RrBlwAutoOffReq 5000;
BA_ "Version" SG_ 979 ROA_RrBlwAutoOffReq "21.04.00";
BA_ "Description" SG_ 979 ROA_RegionOpt "A Euro NCAP Option signal (BDC only)";
BA_ "GenSigSendType" SG_ 979 ROA_RegionOpt 4;
BA_ "UserSigValidity" SG_ 979 ROA_RegionOpt 0;
BA_ "NetworkRequest" SG_ 979 ROA_RegionOpt 0;
BA_ "NetworkRequestHoldingTime" SG_ 979 ROA_RegionOpt 5000;
BA_ "Version" SG_ 979 ROA_RegionOpt "21.11.07";
BA_ "Description" SG_ 979 Warn_RrStRmndOpt "Rear Seat Reminder System Appled Option

(BDC Only Use 0x0 and 0x2 in Signal Value Table)";
BA_ "GenSigSendType" SG_ 979 Warn_RrStRmndOpt 4;
BA_ "UserSigValidity" SG_ 979 Warn_RrStRmndOpt 0;
BA_ "NetworkRequest" SG_ 979 Warn_RrStRmndOpt 0;
BA_ "NetworkRequestHoldingTime" SG_ 979 Warn_RrStRmndOpt 5000;
BA_ "Version" SG_ 979 Warn_RrStRmndOpt "21.04.00";
BA_ "Description" SG_ 979 Warn_RrStRmndAlrmOnReq "Rear Seat Reminder Alarm State";
BA_ "GenSigSendType" SG_ 979 Warn_RrStRmndAlrmOnReq 4;
BA_ "UserSigValidity" SG_ 979 Warn_RrStRmndAlrmOnReq 0;
BA_ "NetworkRequest" SG_ 979 Warn_RrStRmndAlrmOnReq 0;
BA_ "NetworkRequestHoldingTime" SG_ 979 Warn_RrStRmndAlrmOnReq 5000;
BA_ "Version" SG_ 979 Warn_RrStRmndAlrmOnReq "17.12.00";
BA_ "Description" SG_ 979 Warn_RrStRmndSysSta "Rear Seat Reminder Alarm System Enable(On)/Disable(Off) state";
BA_ "GenSigSendType" SG_ 979 Warn_RrStRmndSysSta 4;
BA_ "UserSigValidity" SG_ 979 Warn_RrStRmndSysSta 0;
BA_ "NetworkRequest" SG_ 979 Warn_RrStRmndSysSta 0;
BA_ "NetworkRequestHoldingTime" SG_ 979 Warn_RrStRmndSysSta 5000;
BA_ "Version" SG_ 979 Warn_RrStRmndSysSta "17.12.00";
BA_ "Description" SG_ 979 Warn_RrStRmndAlrmInfo "Rear Seat Reminder Warning request signal";
BA_ "GenSigSendType" SG_ 979 Warn_RrStRmndAlrmInfo 4;
BA_ "UserSigValidity" SG_ 979 Warn_RrStRmndAlrmInfo 0;
BA_ "NetworkRequest" SG_ 979 Warn_RrStRmndAlrmInfo 0;
BA_ "NetworkRequestHoldingTime" SG_ 979 Warn_RrStRmndAlrmInfo 5000;
BA_ "Version" SG_ 979 Warn_RrStRmndAlrmInfo "22.03.04";
BA_ "Description" SG_ 979 Warn_RoaErr "ROA SENSOR Error(Malfunction)  signal";
BA_ "GenSigSendType" SG_ 979 Warn_RoaErr 4;
BA_ "UserSigValidity" SG_ 979 Warn_RoaErr 0;
BA_ "NetworkRequest" SG_ 979 Warn_RoaErr 0;
BA_ "NetworkRequestHoldingTime" SG_ 979 Warn_RoaErr 5000;
BA_ "Version" SG_ 979 Warn_RoaErr "18.07.01";
BA_ "GenSigSendType" SG_ 979 Warn_RrStRmndDelay 4;
BA_ "TimeoutValue" SG_ 979 Warn_RrStRmndDelay "0x0";
BA_ "UserSigValidity" SG_ 979 Warn_RrStRmndDelay 0;
BA_ "NetworkRequest" SG_ 979 Warn_RrStRmndDelay 0;
BA_ "NetworkRequestHoldingTime" SG_ 979 Warn_RrStRmndDelay 5000;
BA_ "Version" SG_ 979 Warn_RrStRmndDelay "22.03.04";
BA_ "GenSigSendType" SG_ 979 Warn_RrStRmndSysAct 4;
BA_ "TimeoutValue" SG_ 979 Warn_RrStRmndSysAct "0x0";
BA_ "UserSigValidity" SG_ 979 Warn_RrStRmndSysAct 0;
BA_ "NetworkRequest" SG_ 979 Warn_RrStRmndSysAct 0;
BA_ "NetworkRequestHoldingTime" SG_ 979 Warn_RrStRmndSysAct 5000;
BA_ "Version" SG_ 979 Warn_RrStRmndSysAct "22.03.04";
BA_ "Description" SG_ 979 WAL_FobSearching "IBU Walk Away Lock Fob Searching State for Radar ROA

(LIN_IBU_WAL_FobSearching for UIP ROA)";
BA_ "GenSigSendType" SG_ 979 WAL_FobSearching 4;
BA_ "UserSigValidity" SG_ 979 WAL_FobSearching 0;
BA_ "NetworkRequest" SG_ 979 WAL_FobSearching 0;
BA_ "NetworkRequestHoldingTime" SG_ 979 WAL_FobSearching 5000;
BA_ "Version" SG_ 979 WAL_FobSearching "19.06.00";
BA_ "GenSigSendType" SG_ 979 Warn_RrStRmndSysOffIND 4;
BA_ "TimeoutValue" SG_ 979 Warn_RrStRmndSysOffIND "0x0";
BA_ "UserSigValidity" SG_ 979 Warn_RrStRmndSysOffIND 0;
BA_ "NetworkRequest" SG_ 979 Warn_RrStRmndSysOffIND 0;
BA_ "NetworkRequestHoldingTime" SG_ 979 Warn_RrStRmndSysOffIND 5000;
BA_ "Version" SG_ 979 Warn_RrStRmndSysOffIND "22.08.01";
BA_ "Description" SG_ 979 Warn_VehNotPWrngSta "Vehicle Not P Warning";
BA_ "GenSigSendType" SG_ 979 Warn_VehNotPWrngSta 4;
BA_ "UserSigValidity" SG_ 979 Warn_VehNotPWrngSta 0;
BA_ "NetworkRequest" SG_ 979 Warn_VehNotPWrngSta 0;
BA_ "NetworkRequestHoldingTime" SG_ 979 Warn_VehNotPWrngSta 5000;
BA_ "Version" SG_ 979 Warn_VehNotPWrngSta "23.05.01";
BA_ "Description" SG_ 983 BDC_FD_Crc8Val "The data area for CRC calculation is based on the data length (DLC) of the message DB.

The CRC shall be calculated over the entire data block (excluding the CRC bytes) including the user data, alive counter and Data ID



- CRC Polynomial (0x1021) , Ini";
BA_ "GenSigSendType" SG_ 983 BDC_FD_Crc8Val 4;
BA_ "GenSigStartValue" SG_ 983 BDC_FD_Crc8Val 65535;
BA_ "UserSigValidity" SG_ 983 BDC_FD_Crc8Val 0;
BA_ "Version" SG_ 983 BDC_FD_Crc8Val "22.11.04";
BA_ "Description" SG_ 983 Mirror_MnlFldModSta "Mirror Manual Fold State

0x0:None = AutoFold Mode or Unfold Mode

0x1: ManualFold = ManualFold Mode";
BA_ "GenSigSendType" SG_ 983 Mirror_MnlFldModSta 4;
BA_ "UserSigValidity" SG_ 983 Mirror_MnlFldModSta 0;
BA_ "NetworkRequest" SG_ 983 Mirror_MnlFldModSta 0;
BA_ "NetworkRequestHoldingTime" SG_ 983 Mirror_MnlFldModSta 5000;
BA_ "Version" SG_ 983 Mirror_MnlFldModSta "23.01.03";
BA_ "Description" SG_ 983 Mirror_SelSwSta "Outside Mirror Select Button Status";
BA_ "GenSigSendType" SG_ 983 Mirror_SelSwSta 4;
BA_ "UserSigValidity" SG_ 983 Mirror_SelSwSta 0;
BA_ "NetworkRequest" SG_ 983 Mirror_SelSwSta 0;
BA_ "NetworkRequestHoldingTime" SG_ 983 Mirror_SelSwSta 5000;
BA_ "Version" SG_ 983 Mirror_SelSwSta "20.12.00";
BA_ "Description" SG_ 983 Mirror_LHPosMnlReq "Left Outside Mirror Positioning Request";
BA_ "GenSigSendType" SG_ 983 Mirror_LHPosMnlReq 4;
BA_ "UserSigValidity" SG_ 983 Mirror_LHPosMnlReq 0;
BA_ "NetworkRequest" SG_ 983 Mirror_LHPosMnlReq 0;
BA_ "NetworkRequestHoldingTime" SG_ 983 Mirror_LHPosMnlReq 5000;
BA_ "Version" SG_ 983 Mirror_LHPosMnlReq "22.01.05";
BA_ "GenSigSendType" SG_ 983 Mirror_AutoWashModeSta_TypeC 4;
BA_ "UserSigValidity" SG_ 983 Mirror_AutoWashModeSta_TypeC 0;
BA_ "NetworkRequest" SG_ 983 Mirror_AutoWashModeSta_TypeC 0;
BA_ "NetworkRequestHoldingTime" SG_ 983 Mirror_AutoWashModeSta_TypeC 5000;
BA_ "Version" SG_ 983 Mirror_AutoWashModeSta_TypeC "23.04.00";
BA_ "Description" SG_ 983 Mirror_RHPosMnlReq "Right Outside Mirror Positioning Request";
BA_ "GenSigSendType" SG_ 983 Mirror_RHPosMnlReq 4;
BA_ "UserSigValidity" SG_ 983 Mirror_RHPosMnlReq 0;
BA_ "NetworkRequest" SG_ 983 Mirror_RHPosMnlReq 0;
BA_ "NetworkRequestHoldingTime" SG_ 983 Mirror_RHPosMnlReq 5000;
BA_ "Version" SG_ 983 Mirror_RHPosMnlReq "22.01.05";
BA_ "Description" SG_ 983 Mirror_LHPosMnlCmd "Left Outside Mirror Positioning Command";
BA_ "GenSigSendType" SG_ 983 Mirror_LHPosMnlCmd 4;
BA_ "UserSigValidity" SG_ 983 Mirror_LHPosMnlCmd 0;
BA_ "NetworkRequest" SG_ 983 Mirror_LHPosMnlCmd 0;
BA_ "NetworkRequestHoldingTime" SG_ 983 Mirror_LHPosMnlCmd 5000;
BA_ "Version" SG_ 983 Mirror_LHPosMnlCmd "22.11.03";
BA_ "Description" SG_ 983 Mirror_RHPosMnlCmd "Right Outside Mirror Positioning Command";
BA_ "GenSigSendType" SG_ 983 Mirror_RHPosMnlCmd 4;
BA_ "UserSigValidity" SG_ 983 Mirror_RHPosMnlCmd 0;
BA_ "NetworkRequest" SG_ 983 Mirror_RHPosMnlCmd 0;
BA_ "NetworkRequestHoldingTime" SG_ 983 Mirror_RHPosMnlCmd 5000;
BA_ "Version" SG_ 983 Mirror_RHPosMnlCmd "22.11.03";
BA_ "Description" SG_ 983 Wiper_FrWiperLowAct "Wiper Low Speed Output";
BA_ "GenSigSendType" SG_ 983 Wiper_FrWiperLowAct 4;
BA_ "UserSigValidity" SG_ 983 Wiper_FrWiperLowAct 0;
BA_ "NetworkRequest" SG_ 983 Wiper_FrWiperLowAct 0;
BA_ "NetworkRequestHoldingTime" SG_ 983 Wiper_FrWiperLowAct 5000;
BA_ "Version" SG_ 983 Wiper_FrWiperLowAct "22.11.03";
BA_ "Description" SG_ 983 Wiper_FrWiperHighAct "Wiper High Speed Output";
BA_ "GenSigSendType" SG_ 983 Wiper_FrWiperHighAct 4;
BA_ "UserSigValidity" SG_ 983 Wiper_FrWiperHighAct 0;
BA_ "NetworkRequest" SG_ 983 Wiper_FrWiperHighAct 0;
BA_ "NetworkRequestHoldingTime" SG_ 983 Wiper_FrWiperHighAct 5000;
BA_ "Version" SG_ 983 Wiper_FrWiperHighAct "22.11.03";
BA_ "GenSigSendType" SG_ 983 Wiper_FrtWiperLowCmd 4;
BA_ "UserSigValidity" SG_ 983 Wiper_FrtWiperLowCmd 0;
BA_ "NetworkRequest" SG_ 983 Wiper_FrtWiperLowCmd 0;
BA_ "NetworkRequestHoldingTime" SG_ 983 Wiper_FrtWiperLowCmd 5000;
BA_ "Version" SG_ 983 Wiper_FrtWiperLowCmd "23.02.02";
BA_ "GenSigSendType" SG_ 983 Wiper_FrtWiperHighCmd 4;
BA_ "UserSigValidity" SG_ 983 Wiper_FrtWiperHighCmd 0;
BA_ "NetworkRequest" SG_ 983 Wiper_FrtWiperHighCmd 0;
BA_ "NetworkRequestHoldingTime" SG_ 983 Wiper_FrtWiperHighCmd 5000;
BA_ "Version" SG_ 983 Wiper_FrtWiperHighCmd "23.02.02";
BA_ "GenSigSendType" SG_ 983 Wiper_RrWiperCmd 4;
BA_ "UserSigValidity" SG_ 983 Wiper_RrWiperCmd 0;
BA_ "NetworkRequest" SG_ 983 Wiper_RrWiperCmd 0;
BA_ "NetworkRequestHoldingTime" SG_ 983 Wiper_RrWiperCmd 5000;
BA_ "Version" SG_ 983 Wiper_RrWiperCmd "23.02.02";
BA_ "GenSigSendType" SG_ 983 Wiper_PowerEnableCmd 4;
BA_ "UserSigValidity" SG_ 983 Wiper_PowerEnableCmd 0;
BA_ "NetworkRequest" SG_ 983 Wiper_PowerEnableCmd 0;
BA_ "NetworkRequestHoldingTime" SG_ 983 Wiper_PowerEnableCmd 5000;
BA_ "Version" SG_ 983 Wiper_PowerEnableCmd "23.02.02";
BA_ "GenSigSendType" SG_ 983 Wiper_FrtWasherCmd 4;
BA_ "UserSigValidity" SG_ 983 Wiper_FrtWasherCmd 0;
BA_ "NetworkRequest" SG_ 983 Wiper_FrtWasherCmd 0;
BA_ "NetworkRequestHoldingTime" SG_ 983 Wiper_FrtWasherCmd 5000;
BA_ "Version" SG_ 983 Wiper_FrtWasherCmd "23.02.02";
BA_ "GenSigSendType" SG_ 983 Wiper_RrWasherCmd 4;
BA_ "UserSigValidity" SG_ 983 Wiper_RrWasherCmd 0;
BA_ "NetworkRequest" SG_ 983 Wiper_RrWasherCmd 0;
BA_ "NetworkRequestHoldingTime" SG_ 983 Wiper_RrWasherCmd 5000;
BA_ "Version" SG_ 983 Wiper_RrWasherCmd "23.02.02";
BA_ "GenSigSendType" SG_ 983 Wiper_HeadLampWasherCmd 4;
BA_ "UserSigValidity" SG_ 983 Wiper_HeadLampWasherCmd 0;
BA_ "NetworkRequest" SG_ 983 Wiper_HeadLampWasherCmd 0;
BA_ "NetworkRequestHoldingTime" SG_ 983 Wiper_HeadLampWasherCmd 5000;
BA_ "Version" SG_ 983 Wiper_HeadLampWasherCmd "23.02.02";
BA_ "Description" SG_ 983 Wiper_AutoWashModeSta_TypeC "Auto Wash Mode Wiper State";
BA_ "GenSigSendType" SG_ 983 Wiper_AutoWashModeSta_TypeC 4;
BA_ "UserSigValidity" SG_ 983 Wiper_AutoWashModeSta_TypeC 0;
BA_ "NetworkRequest" SG_ 983 Wiper_AutoWashModeSta_TypeC 0;
BA_ "NetworkRequestHoldingTime" SG_ 983 Wiper_AutoWashModeSta_TypeC 5000;
BA_ "Version" SG_ 983 Wiper_AutoWashModeSta_TypeC "23.03.01";
BA_ "GenSigSendType" SG_ 983 Mirror_LHPosMnlPlyCmd 4;
BA_ "UserSigValidity" SG_ 983 Mirror_LHPosMnlPlyCmd 0;
BA_ "NetworkRequest" SG_ 983 Mirror_LHPosMnlPlyCmd 0;
BA_ "NetworkRequestHoldingTime" SG_ 983 Mirror_LHPosMnlPlyCmd 5000;
BA_ "Version" SG_ 983 Mirror_LHPosMnlPlyCmd "23.02.13";
BA_ "GenSigSendType" SG_ 983 Mirror_RHPosMnlPlyCmd 4;
BA_ "UserSigValidity" SG_ 983 Mirror_RHPosMnlPlyCmd 0;
BA_ "NetworkRequest" SG_ 983 Mirror_RHPosMnlPlyCmd 0;
BA_ "NetworkRequestHoldingTime" SG_ 983 Mirror_RHPosMnlPlyCmd 5000;
BA_ "Version" SG_ 983 Mirror_RHPosMnlPlyCmd "23.02.13";
BA_ "Description" SG_ 983 BDC_FD_AlvCnt8Val "For the first transmission request for a data element the counter shall be initialized with 0 and shall be incremented by 1 for every subsequent send request. 

When the counter reaches the maximum value(0xFF), then it shall restart with 0 for the next s";
BA_ "GenSigSendType" SG_ 983 BDC_FD_AlvCnt8Val 4;
BA_ "UserSigValidity" SG_ 983 BDC_FD_AlvCnt8Val 0;
BA_ "Version" SG_ 983 BDC_FD_AlvCnt8Val "22.11.04";
BA_ "GenSigSendType" SG_ 983 Mirror_LHPosAutoPlyCmd 4;
BA_ "UserSigValidity" SG_ 983 Mirror_LHPosAutoPlyCmd 0;
BA_ "NetworkRequest" SG_ 983 Mirror_LHPosAutoPlyCmd 0;
BA_ "NetworkRequestHoldingTime" SG_ 983 Mirror_LHPosAutoPlyCmd 5000;
BA_ "Version" SG_ 983 Mirror_LHPosAutoPlyCmd "23.02.13";
BA_ "GenSigSendType" SG_ 983 Mirror_RHPosAutoPlyCmd 4;
BA_ "UserSigValidity" SG_ 983 Mirror_RHPosAutoPlyCmd 0;
BA_ "NetworkRequest" SG_ 983 Mirror_RHPosAutoPlyCmd 0;
BA_ "NetworkRequestHoldingTime" SG_ 983 Mirror_RHPosAutoPlyCmd 5000;
BA_ "Version" SG_ 983 Mirror_RHPosAutoPlyCmd "23.02.13";
BA_ "GenSigSendType" SG_ 983 Mirror_IMSMemoryCmd 4;
BA_ "UserSigValidity" SG_ 983 Mirror_IMSMemoryCmd 0;
BA_ "NetworkRequest" SG_ 983 Mirror_IMSMemoryCmd 0;
BA_ "NetworkRequestHoldingTime" SG_ 983 Mirror_IMSMemoryCmd 5000;
BA_ "Version" SG_ 983 Mirror_IMSMemoryCmd "23.02.13";
BA_ "Description" SG_ 983 Wiper_RainAmount "Amount of rain on windshield (LIN to CAN Signal)

- LIN Signal Name : VAL_RAIN_AMOUNT

- 0~150 : PH=0.1*HEX(mm/Hr)

- 151~254 : Reserved

- 255 (1111 1111) : Invalid 



RainSnsrPartNum CU000's Factor is 0.5

- 0~150 : PH=0.5*HEX(%)

- 151~254 : Reserved";
BA_ "GenSigSendType" SG_ 983 Wiper_RainAmount 4;
BA_ "GenSigStartValue" SG_ 983 Wiper_RainAmount 255;
BA_ "UserSigValidity" SG_ 983 Wiper_RainAmount 0;
BA_ "NetworkRequest" SG_ 983 Wiper_RainAmount 0;
BA_ "NetworkRequestHoldingTime" SG_ 983 Wiper_RainAmount 5000;
BA_ "Version" SG_ 983 Wiper_RainAmount "23.02.01";
BA_ "Description" SG_ 983 Wiper_AutoWashModeSta "Auto Wash Mode Wiper State";
BA_ "GenSigSendType" SG_ 983 Wiper_AutoWashModeSta 4;
BA_ "UserSigValidity" SG_ 983 Wiper_AutoWashModeSta 0;
BA_ "NetworkRequest" SG_ 983 Wiper_AutoWashModeSta 0;
BA_ "NetworkRequestHoldingTime" SG_ 983 Wiper_AutoWashModeSta 5000;
BA_ "Version" SG_ 983 Wiper_AutoWashModeSta "21.12.00";
BA_ "GenSigSendType" SG_ 983 Wiper_PrkngPosSta 4;
BA_ "UserSigValidity" SG_ 983 Wiper_PrkngPosSta 0;
BA_ "NetworkRequest" SG_ 983 Wiper_PrkngPosSta 0;
BA_ "NetworkRequestHoldingTime" SG_ 983 Wiper_PrkngPosSta 5000;
BA_ "Version" SG_ 983 Wiper_PrkngPosSta "17.12.00";
BA_ "Description" SG_ 983 Wiper_RainSnsrOptionTyp "Rain Sensor Option Information";
BA_ "GenSigSendType" SG_ 983 Wiper_RainSnsrOptionTyp 4;
BA_ "UserSigValidity" SG_ 983 Wiper_RainSnsrOptionTyp 0;
BA_ "NetworkRequest" SG_ 983 Wiper_RainSnsrOptionTyp 0;
BA_ "NetworkRequestHoldingTime" SG_ 983 Wiper_RainSnsrOptionTyp 5000;
BA_ "Version" SG_ 983 Wiper_RainSnsrOptionTyp "17.12.00";
BA_ "Description" SG_ 983 Wiper_HtWshNzzlCmd "Heated Washer Nozzle Command";
BA_ "GenSigSendType" SG_ 983 Wiper_HtWshNzzlCmd 4;
BA_ "UserSigValidity" SG_ 983 Wiper_HtWshNzzlCmd 0;
BA_ "NetworkRequest" SG_ 983 Wiper_HtWshNzzlCmd 0;
BA_ "NetworkRequestHoldingTime" SG_ 983 Wiper_HtWshNzzlCmd 5000;
BA_ "Version" SG_ 983 Wiper_HtWshNzzlCmd "20.08.07";
BA_ "Description" SG_ 983 Wiper_RainSnsrSta "This signal represents the status of Rain Sensor signal state. 

- '20. 8/3 : Changed value table (0x5, 0x6 : Fault2/3 → Reserved)";
BA_ "GenSigSendType" SG_ 983 Wiper_RainSnsrSta 4;
BA_ "UserSigValidity" SG_ 983 Wiper_RainSnsrSta 0;
BA_ "NetworkRequest" SG_ 983 Wiper_RainSnsrSta 0;
BA_ "NetworkRequestHoldingTime" SG_ 983 Wiper_RainSnsrSta 5000;
BA_ "Version" SG_ 983 Wiper_RainSnsrSta "20.08.00";
BA_ "Description" SG_ 983 Wiper_RainSnsrPartNum "Rain Sensor PartNumber (LIN to CAN Signal)

- LIN Signal Name : INFO_PARTNUMBER

▶HELLA

 0x00(0000):NI000 / 0x01(0001):EV000 / 0x02(0010):XA000 / 0x03(0011)~0x0E(1110):Reserved / 0x0F(1111):N9000

▶BCS(舊 TRW)

 0x00(0000):T6000 / 0x01(0001):DV000 / 0";
BA_ "GenSigSendType" SG_ 983 Wiper_RainSnsrPartNum 4;
BA_ "UserSigValidity" SG_ 983 Wiper_RainSnsrPartNum 0;
BA_ "NetworkRequest" SG_ 983 Wiper_RainSnsrPartNum 0;
BA_ "NetworkRequestHoldingTime" SG_ 983 Wiper_RainSnsrPartNum 5000;
BA_ "Version" SG_ 983 Wiper_RainSnsrPartNum "24.01.00";
BA_ "Description" SG_ 983 ECW_Fault "ECW LIN to CAN Signal 

- LIN Signal Name : FAULT_ECW";
BA_ "GenSigSendType" SG_ 983 ECW_Fault 4;
BA_ "UserSigValidity" SG_ 983 ECW_Fault 0;
BA_ "NetworkRequest" SG_ 983 ECW_Fault 0;
BA_ "NetworkRequestHoldingTime" SG_ 983 ECW_Fault 5000;
BA_ "Version" SG_ 983 ECW_Fault "20.05.02";
BA_ "Description" SG_ 983 ECW_FaultActv "ECW LIN to CAN Signal

- LIN Signal Name : FAULT_ACTIVE";
BA_ "GenSigSendType" SG_ 983 ECW_FaultActv 4;
BA_ "GenSigStartValue" SG_ 983 ECW_FaultActv 1;
BA_ "UserSigValidity" SG_ 983 ECW_FaultActv 0;
BA_ "NetworkRequest" SG_ 983 ECW_FaultActv 0;
BA_ "NetworkRequestHoldingTime" SG_ 983 ECW_FaultActv 5000;
BA_ "Version" SG_ 983 ECW_FaultActv "20.05.02";
BA_ "Description" SG_ 983 ECW_HiVolt "ECW LIN to CAN Signal

- LIN Signal Name : HIGH_VOLT_ECW";
BA_ "GenSigSendType" SG_ 983 ECW_HiVolt 4;
BA_ "UserSigValidity" SG_ 983 ECW_HiVolt 0;
BA_ "NetworkRequest" SG_ 983 ECW_HiVolt 0;
BA_ "NetworkRequestHoldingTime" SG_ 983 ECW_HiVolt 5000;
BA_ "Version" SG_ 983 ECW_HiVolt "20.05.02";
BA_ "Description" SG_ 983 ECW_HiVoltActv "ECW LIN to CAN Signal

- LIN Signal Name : HIGH_VOLT_ACTIVE";
BA_ "GenSigSendType" SG_ 983 ECW_HiVoltActv 4;
BA_ "GenSigStartValue" SG_ 983 ECW_HiVoltActv 1;
BA_ "UserSigValidity" SG_ 983 ECW_HiVoltActv 0;
BA_ "NetworkRequest" SG_ 983 ECW_HiVoltActv 0;
BA_ "NetworkRequestHoldingTime" SG_ 983 ECW_HiVoltActv 5000;
BA_ "Version" SG_ 983 ECW_HiVoltActv "20.05.02";
BA_ "Description" SG_ 983 ECW_LoVolt "ECW LIN to CAN Signal

- LIN Signal Name : LOW_VOLT_ECW";
BA_ "GenSigSendType" SG_ 983 ECW_LoVolt 4;
BA_ "UserSigValidity" SG_ 983 ECW_LoVolt 0;
BA_ "NetworkRequest" SG_ 983 ECW_LoVolt 0;
BA_ "NetworkRequestHoldingTime" SG_ 983 ECW_LoVolt 5000;
BA_ "Version" SG_ 983 ECW_LoVolt "20.05.02";
BA_ "Description" SG_ 983 ECW_LoVoltActv "ECW LIN to CAN Signal

- LIN Signal Name : LOW_VOLT_ACTIVE";
BA_ "GenSigSendType" SG_ 983 ECW_LoVoltActv 4;
BA_ "GenSigStartValue" SG_ 983 ECW_LoVoltActv 1;
BA_ "UserSigValidity" SG_ 983 ECW_LoVoltActv 0;
BA_ "NetworkRequest" SG_ 983 ECW_LoVoltActv 0;
BA_ "NetworkRequestHoldingTime" SG_ 983 ECW_LoVoltActv 5000;
BA_ "Version" SG_ 983 ECW_LoVoltActv "20.05.02";
BA_ "Description" SG_ 983 ECW_Overload "ECW LIN to CAN Signal

- LIN Signal Name : OVERLOAD_ECW";
BA_ "GenSigSendType" SG_ 983 ECW_Overload 4;
BA_ "UserSigValidity" SG_ 983 ECW_Overload 0;
BA_ "NetworkRequest" SG_ 983 ECW_Overload 0;
BA_ "NetworkRequestHoldingTime" SG_ 983 ECW_Overload 5000;
BA_ "Version" SG_ 983 ECW_Overload "20.05.02";
BA_ "Description" SG_ 983 ECW_OverloadActv "ECW LIN to CAN Signal

- LIN Signal Name : OVERLOAD_ACTIVE";
BA_ "GenSigSendType" SG_ 983 ECW_OverloadActv 4;
BA_ "GenSigStartValue" SG_ 983 ECW_OverloadActv 1;
BA_ "UserSigValidity" SG_ 983 ECW_OverloadActv 0;
BA_ "NetworkRequest" SG_ 983 ECW_OverloadActv 0;
BA_ "NetworkRequestHoldingTime" SG_ 983 ECW_OverloadActv 5000;
BA_ "Version" SG_ 983 ECW_OverloadActv "20.05.02";
BA_ "Description" SG_ 983 ECW_CommErr "ECW LIN to CAN Signal

- LIN Signal Name : ERR_COMM_ECW";
BA_ "GenSigSendType" SG_ 983 ECW_CommErr 4;
BA_ "UserSigValidity" SG_ 983 ECW_CommErr 0;
BA_ "NetworkRequest" SG_ 983 ECW_CommErr 0;
BA_ "NetworkRequestHoldingTime" SG_ 983 ECW_CommErr 5000;
BA_ "Version" SG_ 983 ECW_CommErr "20.05.02";
BA_ "Description" SG_ 983 BCM_SolSnsrRt "This signal indicates solar sensor output W/m^2 - RH";
BA_ "GenSigSendType" SG_ 983 BCM_SolSnsrRt 4;
BA_ "UserSigValidity" SG_ 983 BCM_SolSnsrRt 0;
BA_ "NetworkRequest" SG_ 983 BCM_SolSnsrRt 0;
BA_ "NetworkRequestHoldingTime" SG_ 983 BCM_SolSnsrRt 5000;
BA_ "Version" SG_ 983 BCM_SolSnsrRt "21.11.04";
BA_ "Description" SG_ 983 BCM_SolSnsrLft "This signal indicates solar sensor output W/m^2 - LH";
BA_ "GenSigSendType" SG_ 983 BCM_SolSnsrLft 4;
BA_ "UserSigValidity" SG_ 983 BCM_SolSnsrLft 0;
BA_ "NetworkRequest" SG_ 983 BCM_SolSnsrLft 0;
BA_ "NetworkRequestHoldingTime" SG_ 983 BCM_SolSnsrLft 5000;
BA_ "Version" SG_ 983 BCM_SolSnsrLft "21.11.04";
BA_ "Description" SG_ 983 Mirror_MirFldOpt "Outside Mirror Electric Fold Option Signal";
BA_ "GenSigSendType" SG_ 983 Mirror_MirFldOpt 4;
BA_ "UserSigValidity" SG_ 983 Mirror_MirFldOpt 0;
BA_ "NetworkRequest" SG_ 983 Mirror_MirFldOpt 0;
BA_ "NetworkRequestHoldingTime" SG_ 983 Mirror_MirFldOpt 5000;
BA_ "Version" SG_ 983 Mirror_MirFldOpt "21.04.00";
BA_ "Description" SG_ 983 Mirror_FldUnfldCmd "Mirror Folding Unfolding Command";
BA_ "GenSigSendType" SG_ 983 Mirror_FldUnfldCmd 4;
BA_ "UserSigValidity" SG_ 983 Mirror_FldUnfldCmd 0;
BA_ "NetworkRequest" SG_ 983 Mirror_FldUnfldCmd 0;
BA_ "NetworkRequestHoldingTime" SG_ 983 Mirror_FldUnfldCmd 5000;
BA_ "Version" SG_ 983 Mirror_FldUnfldCmd "21.03.00";
BA_ "Description" SG_ 983 Mirror_FldCtrlSta "Mirror Fold and Folding Control State";
BA_ "GenSigSendType" SG_ 983 Mirror_FldCtrlSta 4;
BA_ "UserSigValidity" SG_ 983 Mirror_FldCtrlSta 0;
BA_ "NetworkRequest" SG_ 983 Mirror_FldCtrlSta 0;
BA_ "NetworkRequestHoldingTime" SG_ 983 Mirror_FldCtrlSta 5000;
BA_ "Version" SG_ 983 Mirror_FldCtrlSta "21.03.00";
BA_ "Description" SG_ 983 Mirror_UnFldCtrlSta "Mirror Unfold and Unfolding Control State";
BA_ "GenSigSendType" SG_ 983 Mirror_UnFldCtrlSta 4;
BA_ "UserSigValidity" SG_ 983 Mirror_UnFldCtrlSta 0;
BA_ "NetworkRequest" SG_ 983 Mirror_UnFldCtrlSta 0;
BA_ "NetworkRequestHoldingTime" SG_ 983 Mirror_UnFldCtrlSta 5000;
BA_ "Version" SG_ 983 Mirror_UnFldCtrlSta "21.03.00";
BA_ "Description" SG_ 983 Mirror_PosMnlCmd "Mirror Positioning Command";
BA_ "GenSigSendType" SG_ 983 Mirror_PosMnlCmd 4;
BA_ "UserSigValidity" SG_ 983 Mirror_PosMnlCmd 0;
BA_ "NetworkRequest" SG_ 983 Mirror_PosMnlCmd 0;
BA_ "NetworkRequestHoldingTime" SG_ 983 Mirror_PosMnlCmd 5000;
BA_ "Version" SG_ 983 Mirror_PosMnlCmd "21.10.04";
BA_ "Description" SG_ 983 Mirror_SelSwIndCmd "Mirror Select Switch Indicator Command";
BA_ "GenSigSendType" SG_ 983 Mirror_SelSwIndCmd 4;
BA_ "UserSigValidity" SG_ 983 Mirror_SelSwIndCmd 0;
BA_ "NetworkRequest" SG_ 983 Mirror_SelSwIndCmd 0;
BA_ "NetworkRequestHoldingTime" SG_ 983 Mirror_SelSwIndCmd 5000;
BA_ "Version" SG_ 983 Mirror_SelSwIndCmd "21.03.00";
BA_REL_ "GenSigTimeoutTime" BU_SG_REL_ BLTN_CAM_FD SG_ 996 ICU_PowerAutoCutModSta 1500;
BA_REL_ "GenSigTimeoutTime" BU_SG_REL_ GW_PSU_3RD_FD SG_ 996 ICU_PowerAutoCutModSta 1500;
BA_REL_ "GenSigTimeoutTime" BU_SG_REL_ GW_PSU_AST_FD SG_ 996 ICU_PowerAutoCutModSta 1500;
BA_REL_ "GenSigTimeoutTime" BU_SG_REL_ GW_PSU_DRV_FD SG_ 996 ICU_PowerAutoCutModSta 1500;
BA_REL_ "GenSigTimeoutTime" BU_SG_REL_ GW_PSU_RL_FD SG_ 996 ICU_PowerAutoCutModSta 1500;
BA_REL_ "GenSigTimeoutTime" BU_SG_REL_ GW_PSU_RR_FD SG_ 996 ICU_PowerAutoCutModSta 1500;
BA_REL_ "GenSigTimeoutTime" BU_SG_REL_ SHVU_3RD_FD SG_ 996 ICU_PowerAutoCutModSta 1500;
BA_REL_ "GenSigTimeoutTime" BU_SG_REL_ SHVU_FRNT_FD SG_ 996 ICU_PowerAutoCutModSta 1500;
BA_REL_ "GenSigTimeoutTime" BU_SG_REL_ SHVU_REAR_FD SG_ 996 ICU_PowerAutoCutModSta 1500;
BA_REL_ "GenSigTimeoutTime" BU_SG_REL_ SHVU_RL_FD SG_ 996 ICU_PowerAutoCutModSta 1500;
BA_REL_ "GenSigTimeoutTime" BU_SG_REL_ SHVU_RR_FD SG_ 996 ICU_PowerAutoCutModSta 1500;
BA_REL_ "GenSigTimeoutTime" BU_SG_REL_ BLTN_CAM_FD SG_ 996 ICU_BattAutoCutPreWrng 1500;
BA_REL_ "GenSigTimeoutTime" BU_SG_REL_ BLTN_CAM_FD SG_ 1047 HU_GNSS_UTC_min 5000;
BA_REL_ "GenSigTimeoutTime" BU_SG_REL_ BLTN_CAM_FD SG_ 1047 HU_GNSS_UTC_sec 5000;
BA_REL_ "GenSigTimeoutTime" BU_SG_REL_ BLTN_CAM_FD SG_ 1047 HU_GNSS_UTC_offset 5000;
BA_REL_ "GenSigTimeoutTime" BU_SG_REL_ BLTN_CAM_FD SG_ 1047 HU_GNSS_DST 5000;
BA_REL_ "GenSigTimeoutTime" BU_SG_REL_ BLTN_CAM_FD SG_ 1047 HU_GNSS_TimezoneOffset 5000;
BA_REL_ "GenSigTimeoutTime" BU_SG_REL_ BLTN_CAM_FD SG_ 1047 HU_GNSS_UTC_year 5000;
BA_REL_ "GenSigTimeoutTime" BU_SG_REL_ BLTN_CAM_FD SG_ 1047 HU_GNSS_UTC_month 5000;
BA_REL_ "GenSigTimeoutTime" BU_SG_REL_ BLTN_CAM_FD SG_ 1047 HU_GNSS_UTC_day 5000;
BA_REL_ "GenSigTimeoutTime" BU_SG_REL_ BLTN_CAM_FD SG_ 1047 HU_GNSS_UTC_hour 5000;
BA_REL_ "GenSigTimeoutTime" BU_SG_REL_ GW_PSU_DRV_FD SG_ 811 IMS_OSMirPlayBackSta_RH 1500;
BA_REL_ "GenSigTimeoutTime" BU_SG_REL_ ATS_FD SG_ 811 PwrDRClosingASTDrSta 1500;
BA_REL_ "GenSigTimeoutTime" BU_SG_REL_ GW_PSU_DRV_FD SG_ 811 IMS_OSMirPlayBackSta_RH_New 1500;
BA_REL_ "GenSigTimeoutTime" BU_SG_REL_ ATS_FD SG_ 811 AST_DetectObj_warn_LH 1500;
BA_REL_ "GenSigTimeoutTime" BU_SG_REL_ ATS_FD SG_ 811 PwrDROpenClosingAstSdDRSta 1500;
BA_REL_ "GenSigTimeoutTime" BU_SG_REL_ BLTN_CAM_FD SG_ 811 AST_CrashUnlockCmd 1500;
BA_REL_ "GenSigTimeoutTime" BU_SG_REL_ ATS_FD SG_ 811 Warn_AsstDrSwSta_SBCM 1500;
BA_REL_ "GenSigTimeoutTime" BU_SG_REL_ BLTN_CAM_FD SG_ 811 Warn_AsstDrSwSta_SBCM 1500;
BA_REL_ "GenSigTimeoutTime" BU_SG_REL_ GW_PSU_AST_FD SG_ 811 Warn_AsstDrSwSta_SBCM 1500;
BA_REL_ "GenSigTimeoutTime" BU_SG_REL_ GW_SAU_DRV_FD SG_ 811 Warn_AsstDrSwSta_SBCM 1500;
BA_REL_ "GenSigTimeoutTime" BU_SG_REL_ PSB_FD SG_ 811 Warn_AsstDrSwSta_SBCM 1500;
BA_REL_ "GenSigTimeoutTime" BU_SG_REL_ RWPC_FD SG_ 811 Warn_AsstDrSwSta_SBCM 1500;
BA_REL_ "GenSigTimeoutTime" BU_SG_REL_ WPC2_FD SG_ 811 Warn_AsstDrSwSta_SBCM 1500;
BA_REL_ "GenSigTimeoutTime" BU_SG_REL_ WPC_FD SG_ 811 Warn_AsstDrSwSta_SBCM 1500;
BA_REL_ "GenSigTimeoutTime" BU_SG_REL_ ATS_FD SG_ 811 DoorLock_AsstDrUnLkSta_SBCM 1500;
BA_REL_ "GenSigTimeoutTime" BU_SG_REL_ WPC2_FD SG_ 849 IAU_DigitalKey2Opt 1500;
BA_REL_ "GenSigTimeoutTime" BU_SG_REL_ WPC_FD SG_ 849 IAU_DigitalKey2Opt 1500;
BA_REL_ "GenSigTimeoutTime" BU_SG_REL_ BLTN_CAM_FD SG_ 849 IAU_ProfileIDRVal 1500;
BA_REL_ "GenSigTimeoutTime" BU_SG_REL_ GW_PSU_DRV_FD SG_ 849 IAU_ProfileIDRVal 1500;
BA_REL_ "GenSigTimeoutTime" BU_SG_REL_ GW_SAU_DRV_FD SG_ 849 IAU_ProfileIDRVal 1500;
BA_REL_ "GenSigTimeoutTime" BU_SG_REL_ RCM_FD SG_ 849 IAU_ProfileIDRVal 1500;
BA_REL_ "GenSigTimeoutTime" BU_SG_REL_ RWPC_FD SG_ 849 IAU_ProfileIDRVal 1500;
BA_REL_ "GenSigTimeoutTime" BU_SG_REL_ SGU_FD SG_ 849 IAU_ProfileIDRVal 1500;
BA_REL_ "GenSigTimeoutTime" BU_SG_REL_ WPC2_FD SG_ 849 IAU_ProfileIDRVal 1500;
BA_REL_ "GenSigTimeoutTime" BU_SG_REL_ WPC_FD SG_ 849 IAU_ProfileIDRVal 1500;
BA_REL_ "GenSigTimeoutTime" BU_SG_REL_ BLTN_CAM_FD SG_ 518 HU_DR_Latitude 1500;
BA_REL_ "GenSigTimeoutTime" BU_SG_REL_ BLTN_CAM_FD SG_ 518 HU_DR_Longitude 1500;
BA_REL_ "GenSigTimeoutTime" BU_SG_REL_ BLTN_CAM_FD SG_ 518 HU_DR_Heading 1500;
BA_REL_ "GenSigTimeoutTime" BU_SG_REL_ BLTN_CAM_FD SG_ 518 HU_DR_Altitude 1500;
BA_REL_ "GenSigTimeoutTime" BU_SG_REL_ BLTN_CAM_FD SG_ 920 CTM_TrailerAct 1500;
BA_REL_ "GenSigTimeoutTime" BU_SG_REL_ ATS_FD SG_ 1059 HU_Background 5000;
BA_REL_ "GenSigTimeoutTime" BU_SG_REL_ BLTN_CAM_FD SG_ 1059 HU_Background 5000;
BA_REL_ "GenSigTimeoutTime" BU_SG_REL_ ATS_FD SG_ 1059 HU_BackgroundFadeInOut 5000;
BA_REL_ "GenSigTimeoutTime" BU_SG_REL_ BLTN_CAM_FD SG_ 1059 HU_BackgroundFadeInOut 5000;
BA_REL_ "GenSigTimeoutTime" BU_SG_REL_ BLTN_CAM_FD SG_ 979 BAlarm_BglrAlrm_CurrentSta 1500;
BA_REL_ "GenSigTimeoutTime" BU_SG_REL_ BLTN_CAM_FD SG_ 983 Wiper_PrkngPosSta 1500;
BA_REL_ "GenSigTimeoutTime" BU_SG_REL_ BLTN_CAM_FD SG_ 983 Wiper_RainSnsrSta 1500;
VAL_ 996 PDC_FD_Crc10Val 0 "0x0x0~0xFFFF:CRCValue" 65535 "0x0x0~0xFFFF:CRCValue" ;
VAL_ 996 PDC_PwrOnModePowerReq 0 "Default" 1 "Request On" 2 "RESERVED" 3 "Error" ;
VAL_ 996 PDC_LeadAcidBatType 0 "Not Applied" 1 "CMF 35Ah" 2 "CMF 40Ah" 3 "CMF 45Ah" 4 "CMF 50Ah" 5 "CMF 60Ah" 6 "CMF 68Ah" 7 "CMF 70Ah" 8 "CMF 80Ah" 9 "CMF 90Ah" 10 "CMF 110Ah" 11 "MF 40Ah" 12 "MF 45Ah" 13 "MF 60Ah" 14 "MF 68Ah" 15 "MF 80Ah" 16 "MF 90Ah" 17 "MF 110Ah" 18 "AGM 60Ah" 19 "AGM 70Ah" 20 "AGM 80Ah" 21 "AGM 50Ah" 22 "AGM 105Ah" 23 "AGM 90Ah" 24 "EFB 50Ah" 25 "EFB 60Ah" 26 "EFB 70Ah" 27 "RESERVED" 28 "RESERVED" 29 "RESERVED" 30 "RESERVED" 31 "RESERVED" ;
VAL_ 996 PDC_BatPwrClassOpt 0 "Invalid" 1 "SOC type" 2 "Class type" 3 "RESERVED" ;
VAL_ 996 PDC_FD_AlvCnt10Val 0 "0x0x0~0xFF:AlvCntValue" 255 "0x0x0~0xFF:AlvCntValue" ;
VAL_ 996 ICU_PowerAutoCutModSta 0 "Factory Mode (default)" 1 "Dealer Mode" 2 "Customer Mode" 3 "Error Indicator" ;
VAL_ 996 Autocut_DlvryModSta 0 "Before Delivery(Welcome Off)" 1 "After Delivery(Welcome On)" 2 "Not Used" 3 "Error Indicator" ;
VAL_ 996 ICU_SoCBattStaMsgReq 0 "Default" 1 "Alert" 2 "Warning" 3 "Invalid" ;
VAL_ 996 Batt_SoCWarningValue 0 "0x0x0~0x64:0 ~ 100%" 100 "0x0x0~0x64:0 ~ 100%" 101 "0x65~0xFE:RESERVED" 254 "0x65~0xFE:RESERVED" 255 "Invalid" ;
VAL_ 996 ICU_BattAutoCutPreWrng 0 "No Warning" 1 "Warning" 2 "Not Used" 3 "Invalid" ;
VAL_ 996 OTAModeACCOffReq 0 "Default" 1 "Off(ACC Off Request)" 2 "RESERVED" 3 "RESERVED" ;
VAL_ 996 C_ICUIGNOffReq 0 "Default" 1 "Off(IGN Off Request)" 2 "RESERVED" 3 "RESERVED" ;
VAL_ 996 IGN_AutoOff_WarnSta 0 "No Warning" 1 "Power Off Warning" 2 "RESERVED" 3 "Error Indicator" ;
VAL_ 996 IGN_AutoOff_WarnSta_CLU 0 "No Warning" 1 "Power Off Warning" 2 "RESERVED" 3 "Error Indicator" ;
VAL_ 996 PDC_BatPwrStateClassA 0 "Invalid" 1 "Low power condition for ClassA-load operation" 2 "High power condition for ClassA-load operation" 3 "RESERVED" ;
VAL_ 996 PDC_BatPwrStateClassB 0 "Invalid" 1 "Low power condition for ClassB-load operation" 2 "High power condition for ClassB-load operation" 3 "RESERVED" ;
VAL_ 996 PDC_BatPwrStateClassC 0 "Invalid" 1 "Low power condition for ClassC-load operation" 2 "High power condition for ClassC-load operation" 3 "RESERVED" ;
VAL_ 996 PLBMAvailableState 0 "Invaild" 1 "PLBM Power is available" ;
VAL_ 996 Bat_dischrg 0 "Flag OFF" 1 "Flag ON" 2 "RESERVED" 3 "RESERVED" ;
VAL_ 996 Bat12V_Chr_Req 0 "Off (Default)" 1 "On_IBS" 2 "On_OTA" 3 "On_Load" ;
VAL_ 996 ICU_BattMngAlert 0 "No Warning(Default)" 1 "Hazard On" 2 "Tail On" 3 "Hazard/Tail On" 4 "0x4~0xFE:RESERVED" 254 "0x4~0xFE:RESERVED" 255 "Invalid" ;
VAL_ 1047 GNSS_Crc5Val 0 "0x0x0~0xFFFF:CRCValue" 65535 "0x0x0~0xFFFF:CRCValue" ;
VAL_ 1047 GNSS_AlvCnt5Val 0 "0x0x0~0xFF:AlvCntValue" 255 "0x0x0~0xFF:AlvCntValue" ;
VAL_ 1047 HU_GNSS_Fix_status 0 "Doing position fixes" 2 "need time" 3 "PDOP too high" 5 "No usable SVs" 6 "one usable SV" 7 "two usable SVs" 8 "three usable SVs" ;
VAL_ 1047 HU_GNSS_TimeSource 0 "none" 1 "RTC" 2 "GPS(<10ms)" 3 "GPS(<1ms)" ;
VAL_ 1047 HU_GNSS_search 0 "none" 1 "blind" 2 "anywhere" ;
VAL_ 1047 HU_GNSS_DST 0 "DST OFF" 1 "DST ON" 2 "RESERVED" 3 "Invalid" ;
VAL_ 811 SBCM_AST_FD_Crc1Val 0 "0x0x0~0xFFFF:CRCValue" 65535 "0x0x0~0xFFFF:CRCValue" ;
VAL_ 811 USM_AstGhostDoorSta 0 "Default" 1 "Off" 2 "On" 3 "RESERVED" ;
VAL_ 811 AST_SWFailAlarm 0 "Off" 1 "On" 2 "RESERVED" 3 "Error Indicator" ;
VAL_ 811 DoorLock_PDSLkSwSta_AST 0 "Lock" 1 "Unlock" 2 "RESERVED" 3 "Error Indicator" ;
VAL_ 811 PDS_TypeOption_AST 0 "Off" 1 "On" 2 "RESERVED" 3 "Error Indicator" ;
VAL_ 811 AFCU_AutoWashModeSta_SBCM_AST 0 "Default" 1 "AFCU Auto Wash Mode Off (Ready)" 2 "AFCU Auto Wash Mode Off (Error)" 3 "AFCU Auto Wash Mode On" 4 "RESERVED" 5 "RESERVED" 6 "RESERVED" 7 "Invalid" ;
VAL_ 811 CDM_AutoWashModeSta_SBCM_AST 0 "Default" 1 "CDM Auto Wash Mode Off (Ready)" 2 "CDM Auto Wash Mode Off (Error)" 3 "CDM Auto Wash Mode On" 4 "RESERVED" 5 "RESERVED" 6 "RESERVED" 7 "Invalid" ;
VAL_ 811 AFH_AST_FldUnFldSta 0 "Invalid" 1 "Fold" 2 "Unfold" 3 "Inprogress" ;
VAL_ 811 SBCM_AST_DiagSta 0 "Default" 1 "Normal Operation" 2 "AST Indicator Circuit Failure" 3 "RESERVED" ;
VAL_ 811 CDM_TypeOption_AST 0 "Off" 1 "On" 2 "Error Indicator" 3 "RESERVED" ;
VAL_ 811 CDM_ImmeChgSw_AST 0 "Default" 1 "Off" 2 "On" 3 "RESERVED" ;
VAL_ 811 CDM_ChgDrSwFrt_AST 0 "Default" 1 "Close" 2 "Open" 3 "RESERVED" ;
VAL_ 811 CDM_OpnClsState_AST 0 "Default" 1 "Open" 2 "Close" 3 "RESERVED" ;
VAL_ 811 CDM_WarnMsg_AST 0 "Default" 1 "Normal" 2 "ChargeDoorErrorState" 3 "RESERVED" ;
VAL_ 811 Mirror_RH_FoldingSta 0 "Off" 1 "Folding" 2 "RESERVED" 3 "Error Indicator" ;
VAL_ 811 Mirror_RH_UnfoldingSta 0 "Off" 1 "Unfolding" 2 "RESERVED" 3 "Error Indicator" ;
VAL_ 811 CDM_CmdStatus_AST 0 "Open (AVN)" 1 "Open (SMK)" 2 "Open (Sensor Switch)" 3 "Open (Command Hard Switch)" 4 "Open (Anti - Pinch)" 5 "Close (AVN)" 6 "Close (SMK)" 7 "Close (Assist Mode)" 8 "Close (Command Hard Switch)" 9 "Close (Connector)" 10 "Close (Gear Position)" 11 "Close (Time Over)" 12 "Close (Anti - Pinch)" 13 "Close (Sensor Switch)" 14 "Stall (Stop)" 15 "Invalid" ;
VAL_ 811 SBCM_AST_FD_AlvCnt1Val 0 "0x0x0~0xFF:AlvCntValue" 255 "0x0x0~0xFF:AlvCntValue" ;
VAL_ 811 AST_CrashMRActAlarm 0 "Off" 1 "On" 2 "RESERVED" 3 "Error Indicator" ;
VAL_ 811 PwrDRBuzzerOut_AST 0 "OFF" 1 "Open" 2 "Close" 3 "Warning" ;
VAL_ 811 IMS_OSMirPlayBackSta_RH 0 "Stop" 1 "Play 1" 2 "Play 2" 3 "Play 3" 4 "Smart IMS" 5 "Profile 1" 6 "Profile 2" 7 "Guest" 8 "RESERVED" 9 "RESERVED" 10 "RESERVED" 11 "RESERVED" 12 "RESERVED" 13 "RESERVED" 14 "RESERVED" 15 "Error Indicator" ;
VAL_ 811 PwrDRClosingASTDrSta 0 "Default" 1 "Close" 2 "Open" 3 "Stop(during Close)" 4 "Stop(during Open)" 5 "RESERVED" 6 "RESERVED" 7 "Invalid" ;
VAL_ 811 CDM_OutsideOpnSwSta_AST 0 "Default" 1 "Push" 2 "RESERVED" 3 "Invalid" ;
VAL_ 811 SBCM_Longkey_ASTDrAtClsSwSta 0 "Default" 1 "Off" 2 "On" 3 "Error Indicator" ;
VAL_ 811 Hood_TypeOption_AST 0 "Off (Mechanical hood latch is applied)" 1 "On (E-Hood latch is applied)" 2 "RESERVED" 3 "Error Indicator" ;
VAL_ 811 Warn_HoodSwSta_AST 0 "Off" 1 "On" 2 "RESERVED" 3 "Error Indicator" ;
VAL_ 811 FrunkWarning_AST 0 "Off" 1 "On" 2 "RESERVED" 3 "Error Indicator" ;
VAL_ 811 SBCM_FrunkSta_AST 0 "Default" 1 "Valid" 2 "RESERVED" 3 "Error Indicator" ;
VAL_ 811 IMS_OSMirPlayBackSta_RH_New 0 "Stop" 1 "Play 1" 2 "Play 2" 3 "Play 3" 4 "Smart IMS" 5 "Profile 1" 6 "Profile 2" 7 "Profile 3" 8 "Profile 4" 9 "Profile 5" 10 "Profile 6" 11 "Profile 7" 12 "Profile 8" 13 "Profile 9" 14 "Guest" 15 "Error Indicator" ;
VAL_ 811 Ast_DrLkRetryFail_SBCM 0 "Normal" 1 "Fail" 2 "RESERVED" 3 "RESERVED" ;
VAL_ 811 DoorLock_AstLkOutSta_SBCM 0 "Off" 1 "On" 2 "Not Used" 3 "Error Indicator" ;
VAL_ 811 FrunkReleaseSwSta_SBCM_AST 0 "Off" 1 "HalfRelease" 2 "FullRelease" 3 "SwitchError" ;
VAL_ 811 FrunkInsideRelSwSta_SBCM_AST 0 "Off" 1 "On" 2 "Not Used" 3 "Error Indicator" ;
VAL_ 811 FrunkEmergencySwSta_SBCM_AST 0 "Off" 1 "On" 2 "Not Used" 3 "Error Indicator" ;
VAL_ 811 PwrDrSta_Ast 0 "Unavailable" 1 "Available" 2 "RESERVED" 3 "Error Indicator" ;
VAL_ 811 PwrDrSta_AstSd 0 "Unavailable" 1 "Available" 2 "RESERVED" 3 "Error Indicator" ;
VAL_ 811 AST_DetectObj_warn_LH 0 "Detect Left Warning OFF" 1 "Detect Left Warning ON" 2 "RESERVED" 3 "RESERVED" ;
VAL_ 811 PwrDROpenClosingAstSdDRSta 0 "Default" 1 "Close" 2 "Open" 3 "Stop(during Close)" 4 "Stop(during Open)" 5 "RESERVED" 6 "RESERVED" 7 "Invalid" ;
VAL_ 811 PwrDRBuzzerOut_AST_New 0 "OFF" 1 "Open" 2 "Close" 3 "Warning1" 4 "Warning2" ;
VAL_ 811 SBCM_FR_DoorAngle 0 "0° - 90°" 1 "0° - 90°" 2 "0° - 90°" 3 "0° - 90°" 4 "0° - 90°" 5 "0° - 90°" 6 "0° - 90°" 7 "0° - 90°" 8 "0° - 90°" 9 "0° - 90°" 10 "0° - 90°" 11 "0° - 90°" 12 "0° - 90°" 13 "0° - 90°" 14 "0° - 90°" 15 "0° - 90°" 16 "0° - 90°" 17 "0° - 90°" 18 "0° - 90°" 19 "0° - 90°" 20 "0° - 90°" 21 "0° - 90°" 22 "0° - 90°" 23 "0° - 90°" 24 "0° - 90°" 25 "0° - 90°" 26 "0° - 90°" 27 "0° - 90°" 28 "0° - 90°" 29 "0° - 90°" 30 "0° - 90°" 31 "0° - 90°" 32 "0° - 90°" 33 "0° - 90°" 34 "0° - 90°" 35 "0° - 90°" 36 "0° - 90°" 37 "0° - 90°" 38 "0° - 90°" 39 "0° - 90°" 40 "0° - 90°" 41 "0° - 90°" 42 "0° - 90°" 43 "0° - 90°" 44 "0° - 90°" 45 "0° - 90°" 46 "0° - 90°" 47 "0° - 90°" 48 "0° - 90°" 49 "0° - 90°" 50 "0° - 90°" 51 "0° - 90°" 52 "0° - 90°" 53 "0° - 90°" 54 "0° - 90°" 55 "0° - 90°" 56 "0° - 90°" 57 "0° - 90°" 58 "0° - 90°" 59 "0° - 90°" 60 "0° - 90°" 61 "0° - 90°" 62 "0° - 90°" 63 "0° - 90°" 64 "0° - 90°" 65 "0° - 90°" 66 "0° - 90°" 67 "0° - 90°" 68 "0° - 90°" 69 "0° - 90°" 70 "0° - 90°" 71 "0° - 90°" 72 "0° - 90°" 73 "0° - 90°" 74 "0° - 90°" 75 "0° - 90°" 76 "0° - 90°" 77 "0° - 90°" 78 "0° - 90°" 79 "0° - 90°" 80 "0° - 90°" 81 "0° - 90°" 82 "0° - 90°" 83 "0° - 90°" 84 "0° - 90°" 85 "0° - 90°" 86 "0° - 90°" 87 "0° - 90°" 88 "0° - 90°" 89 "0° - 90°" 90 "0° - 90°" 91 "Invalid" 92 "Invalid" 93 "Invalid" 94 "Invalid" 95 "Invalid" 96 "Invalid" 97 "Invalid" 98 "Invalid" 99 "Invalid" 100 "Unknown" 101 "Invalid" 102 "Invalid" 103 "Invalid" 104 "Invalid" 105 "Invalid" 106 "Invalid" 107 "Invalid" 108 "Invalid" 109 "Invalid" 110 "Invalid" 111 "Invalid" 112 "Invalid" 113 "Invalid" 114 "Invalid" 115 "Invalid" 116 "Invalid" 117 "Invalid" 118 "Invalid" 119 "Invalid" 120 "Invalid" 121 "Invalid" 122 "Invalid" 123 "Invalid" 124 "Invalid" 125 "Invalid" 126 "Invalid" 127 "Invalid" ;
VAL_ 811 EHL_TxInfo_SBCM_AST 0 "Default" 1 "EHL_R_Close" 2 "EHL_R_Half" 3 "EHL_R_Open" 4 "EHL_R_RetryFlag" 5 "EHL_R_ErrorIndicator" 6 "RESERVED" 7 "Invalid" ;
VAL_ 811 ASTDoorPushAlarm 0 "Off" 1 "On" 2 "RESERVED" 3 "Error Indicator" ;
VAL_ 811 AST_CrashUnlockCmd 0 "Off" 1 "Unlock (Crash)" ;
VAL_ 811 DoorLock_CtrlDrLkSwSta_SBCM 0 "Off" 1 "On (Lock On)" 2 "RESERVED" 3 "Error Indicator" ;
VAL_ 811 DoorLock_CtrlDrUnLkSwSta_SBCM 0 "Off" 1 "On (Unlock On)" 2 "RESERVED" 3 "Error Indicator" ;
VAL_ 811 Warn_AsstDrSwSta_SBCM 0 "Close" 1 "Open" 2 "RESERVED" 3 "Error Indicator" ;
VAL_ 811 DoorLock_AsstDrUnLkSta_SBCM 0 "Lock" 1 "Unlock" 2 "RESERVED" 3 "Error Indicator" ;
VAL_ 811 AST_SEAWarn_RH 0 "SEA Right Warning OFF" 1 "SEA Right Warning ON" 2 "RESERVED" 3 "RESERVED" ;
VAL_ 811 AST_SEAWarn_LH 0 "SEA Left Warning OFF" 1 "SEA Left Warning ON" 2 "RESERVED" 3 "RESERVED" ;
VAL_ 811 AST_SEWWarn_LH 0 "SEW Left Warning OFF" 1 "SEW Left Warning ON" 2 "RESERVED" 3 "RESERVED" ;
VAL_ 811 AST_SEWWarn_RH 0 "SEW Right Warning OFF" 1 "SEW Right Warning ON" 2 "RESERVED" 3 "RESERVED" ;
VAL_ 811 AST_MRActivationAlarm 0 "Off" 1 "On" 2 "RESERVED" 3 "Error Indicator" ;
VAL_ 811 AST_ReleaseWarn 0 "Release Warning OFF" 1 "Release Warning ON" 2 "RESERVED" 3 "RESERVED" ;
VAL_ 849 IAU_FD_Crc4Val 0 "0x0x0~0xFFFF:CRCValue" 65535 "0x0x0~0xFFFF:CRCValue" ;
VAL_ 849 IAU_DISPWrng 0 "None" 1 "Auth_Fail2 (DigitalKey)" 2 "ReAuth_Warning" 3 "IAU Error" 4 "DigitalKey Saved" 5 "Auth_Fail2 (FP)" 6 "Auth_Fail2 (DigitalKey or FP)" 7 "BiometricKey Saved" 8 "DigitalKey and BiometricKey Saved" 9 "WPCNFC_PreStartAuth_Success" 10 "Reserved" 11 "Reserved" 12 "Reserved" 13 "Reserved" 14 "ReAuth_forRSPA" 15 "Invalid" ;
VAL_ 849 IAU_DigitalKey2Opt 0 "Default (Not applied)" 1 "Digital Key Light (NFC)" 2 "Digital Key Medium (NFC/BLE)" 3 "Digital Key Full (NFC/BLE/UWB)" 4 "Reserved" 5 "Reserved" 6 "Reserved" 7 "invalid" ;
VAL_ 849 IAUwFRULearnState 0 "Default (Normal)" 1 "Learning" 2 "Neutralizing" 3 "Invalid" ;
VAL_ 849 IAUwFPMLearnState 0 "Default(Normal)" 1 "Learning" 2 "Neutralizing" 3 "Invalid" ;
VAL_ 849 IAU_ValetDigitalkey 0 "Default" 1 "Valet Digitalkey" 2 "Resereved" 3 "invalid" ;
VAL_ 849 IAU_DigitalKeyNumberOpt 0 "Max8" 1 "Max16" 2 "Max16 with Grouping" 3 "RESERVED" 4 "RESERVED" 5 "RESERVED" 6 "RESERVED" 7 "Invalid" ;
VAL_ 849 IAU_eSEReprogramSta 0 "Default" 1 "Updating" 2 "RESERVED" 3 "Invalid" ;
VAL_ 849 IAU_DKOwnerSwapOption 0 "Default" 1 "Not applied" 2 "Applied" 3 "Invalid" ;
VAL_ 849 IAU_DgtKeyGrpPrflRval2 0 "Default" 1 "Group index 0x0" 2 "Group index 0x1" 3 "Group index 0x2" 4 "Group index 0x3" 5 "Group index 0x4" 6 "Group index 0x5" 7 "Group index 0x6" 8 "Group index 0x7" 9 "Group index 0x8" 10 "Group index 0x9" 11 "Group index 0xA" 12 "Group index 0xB" 13 "Group index 0xC" 14 "Group index 0xD" 15 "Group index 0xE" 16 "Group index 0xF" 17 "RESERVED" 18 "RESERVED" 19 "RESERVED" 20 "RESERVED" 21 "RESERVED" 22 "RESERVED" 23 "RESERVED" 24 "RESERVED" 25 "RESERVED" 26 "RESERVED" 27 "RESERVED" 28 "RESERVED" 29 "RESERVED" 30 "RESERVED" 31 "Invalid" ;
VAL_ 849 IAU_StartIdentifiedProfile 0 "Default" 1 "Profile 1" 2 "Profile 2" 3 "Reserved" 4 "Reserved" 5 "Reserved" 6 "Reserved" 7 "Invalid" ;
VAL_ 849 IAU_DigitalKeyProfileRval2 0 "Default" 1 "1st digital key (owner)" 2 "2nd digital key" 3 "3rd digital key" 4 "4th digital key" 5 "5th digital key" 6 "6th digital key" 7 "7th digital key" 8 "8th digital key" 9 "9th digital key" 10 "10th digital key" 11 "11th digital key" 12 "12th digital key" 13 "13th digital key" 14 "14th digital key" 15 "15th digital key" 16 "16th digital key" 17 "reserved" 18 "reserved" 19 "reserved" 20 "reserved" 21 "reserved" 22 "reserved" 23 "reserved" 24 "reserved" 25 "reserved" 26 "reserved" 27 "reserved" 28 "reserved" 29 "reserved" 30 "reserved" 31 "Invalid" ;
VAL_ 849 IAU_NFCCard1SN 0 "0x0x00000000~0xFFFFFFFF:" 2147483647 "0x0x00000000~0xFFFFFFFF:" ;
VAL_ 849 IAU_FD_AlvCnt4Val 0 "0x0x0~0xFF:AlvCntValue" 255 "0x0x0~0xFF:AlvCntValue" ;
VAL_ 849 IAU_StartIdentifiedProfile_Ext 0 "Default" 1 "Profile1" 2 "Profile2" 3 "Profile3" 4 "Profile4" 5 "Profile5" 6 "Profile6" 7 "Profile7" 8 "Profile8" 9 "Profile9" 10 "RESERVED" 11 "RESERVED" 12 "RESERVED" 13 "RESERVED" 14 "RESERVED" 15 "INVALID" ;
VAL_ 849 RSPA_UWBRspaExtRngSta 0 "Initial" 1 "Out of range of RSPA remote control Region" 2 "In the range of RSPA remote control region" 3 "Reserved" ;
VAL_ 849 RSPA_CanFltSta 0 "Default" 1 "RSPA CAN Error" 2 "Not Used" 3 "Error Indicator" ;
VAL_ 849 RSPA_BLESigErrSta 0 "Default" 1 "Signal Invalid" 2 "In Progress" 3 "Error Indicator" ;
VAL_ 849 RSPA_ConStat 0 "Normal Status" 1 "Fail Status" 2 "Reserved" 3 "Reserved" ;
VAL_ 849 IAU_ProfileIDRVal 0 "Default" 1 "Guest" 2 "Profile1" 3 "Profile2" 4 "Profile3" 5 "Profile4" 6 "Profile5" 7 "Profile6" 8 "Profile7" 9 "Profile8" 10 "Profile9" 11 "RESERVED" 12 "RESERVED" 13 "RESERVED" 14 "RESERVED" 15 "INVALID" ;
VAL_ 849 IAU_DigitalKeyProcessingSta 0 "None" 1 "DeviceOnWPC" 2 "DeviceRegistering" 3 "PhoneRegistered" 4 "All Phone Key Deleted" 5 "NFCCard1Registered" 6 "Server Registering" 7 "NFCCard1Deleted" 8 "BLE Searching" 9 "Owner Phone key Deleted" 10 "Valet Off Searching" 11 "Server Registering Fail" 12 "All Digital Keys in group Deleted" 15 "Invalid" ;
VAL_ 849 IAU_DigitalKeyExit 0 "Normal" 1 "Check System" 2 "NFC Not Detected" 3 "Fob Not Detected" 4 "Canceled by User (Timeout)" 5 "Device not Available" 6 "ProcessFail" 7 "Check Card Save" 8 "Certificate Update" 9 "Valet Off Fail" 10 "CardNotAvailable" 11 "DigitalKeyDisabled" 12 "Retry After Parking" 13 "Check Password" 14 "P position fail (not P)" 15 "Invalid" ;
VAL_ 849 IAU_DigitalKeyEnblRVal 0 "Default" 1 "Disable" 2 "Enable" 3 "Invalid" ;
VAL_ 849 IAU_OwnerPhnRegRVal 0 "Default" 1 "Disable" 2 "Enable" 3 "Invalid" ;
VAL_ 849 IAU_NFCCard1RegRVal 0 "Default" 1 "Disable" 2 "Enable" 3 "Invalid" ;
VAL_ 849 IAU_NFCCard2RegRVal 0 "Default" 1 "Disable" 2 "Enable" 3 "Invalid" ;
VAL_ 518 GNSS_Crc7Val 0 "0x0x0~0xFFFF:CRCValue" 65535 "0x0x0~0xFFFF:CRCValue" ;
VAL_ 518 GNSS_AlvCnt7Val 0 "0x0x0~0xFF:AlvCntValue" 255 "0x0x0~0xFF:AlvCntValue" ;
VAL_ 518 HU_DR_Position_Status 1 "Valid" ;
VAL_ 518 HU_DR_Altitude_Status 1 "valid" ;
VAL_ 518 HU_DR_Heading_Status 1 "Valid" ;
VAL_ 518 HU_DR_Speed_Status 1 "Valid" ;
VAL_ 518 HU_DR_DirectionSwitch_Sta 1 "Valid" ;
VAL_ 518 HU_DR_Direction 1 "Backward" ;
VAL_ 518 HU_DR_GyroCalib_Sta 1 "Calibrated" ;
VAL_ 518 HU_DR_TachoCalib_Sta 1 "Calibrated" ;
VAL_ 518 HU_DR_Solution_Sta 0 "invalid" 1 "DR valid" ;
VAL_ 518 HU_DR_GNSS_Fix_Age 1 "0x0x1~0xFE:time since last GNSS fix" 254 "0x0x1~0xFE:time since last GNSS fix" 255 "No GNSS fix yet" ;
VAL_ 101 IEB_Crc1Val 0 "0x0x0~0xFFFF:CRCValue" 65535 "0x0x0~0xFFFF:CRCValue" ;
VAL_ 101 IEB_AbsNGearReq 0 "Inactive" 1 "N Gear position Request Active" 2 "Not used" 3 "Error Indicator" ;
VAL_ 101 IEB_EstBrkPdlValVldSta 0 "Invalid" 1 "Valid" 2 "Not used" 3 "Error Indicator" ;
VAL_ 101 IEB_FRAmode_Req 0 "No Request" 1 "Inhibit Transition To 4WD" 2 "Request FRA mode" 3 "Not used" ;
VAL_ 101 IEB_DriftEscModSta_VDC 0 "Default" 1 "Beginner" 2 "Intermediate" 3 "Expert" ;
VAL_ 101 IEB_DrvWhlSlipFlg_Frnt 0 "No slip occurred at the driving wheels" 1 "Slip occurred at the driving wheels" ;
VAL_ 101 IEB_IndDriftMode 0 "Default" 1 "off" 2 "on" 3 "RESERVED" 4 "RESERVED" 5 "RESERVED" 6 "RESERVED" 7 "Invaild" ;
VAL_ 101 IEB_IndDriftEcsModSta 0 "Default" 1 "N-Mode" 2 "Drift Mode" 3 "Reserved" ;
VAL_ 101 IEB_IndDriftElsdModSta 0 "Default" 1 "Drift 1.5 way" 2 "Drift 2.0 way" 3 "Reserved" ;
VAL_ 101 IEB_TCS_Req 0 "TCS control is not active" 1 "TCS control is active by requested TORQUE based" 2 "TCS control is active by requested RPM based" 3 "Not used" ;
VAL_ 101 IEB_RSC_Req 0 "RSC is not active" 1 "RSC is active" 2 "RESERVED" 3 "RESERVED" ;
VAL_ 101 TCS_TqFlag_Frnt 0 "Positive" 1 "Negative" ;
VAL_ 101 TCS_TqFlag_Rear 0 "Positive" 1 "Negative" ;
VAL_ 101 RSC_TqFlag_Frnt 0 "Positive" 1 "Negative" ;
VAL_ 101 RSC_TqFlag_Rear 0 "Positive" 1 "Negative" ;
VAL_ 101 IEB_AlvCnt1Val 0 "0x0x0~0xFF:AlvCntValue" 255 "0x0x0~0xFF:AlvCntValue" ;
VAL_ 101 TCS_MtrTrgtRpm_Flag_Frnt 0 "Positive" 1 "Negative" ;
VAL_ 101 TCS_MtrTrgtRpm_Flag_Rear 0 "Positive" 1 "Negative" ;
VAL_ 101 IEB_DriftElsdModSta 0 "Default" 1 "N-Mode" 2 "Drift Mode" 3 "Reserved" ;
VAL_ 101 IEB_DriftEcsModSta 0 "Default" 1 "N-Mode" 2 "Drift Mode" 3 "Reserved" ;
VAL_ 101 IEB_DriftMdpsModSta 0 "Default" 1 "N-Mode" 2 "Drift Mode" 3 "Reserved" ;
VAL_ 101 TCS_MtrTrgtRpm_Frnt 0 "0x0x000~0xFFE:Motor RPM Target" 4094 "0x0x000~0xFFE:Motor RPM Target" 4095 "Error Value" ;
VAL_ 101 TCS_MtrTrgtRpm_Rear 0 "0x0x000~0xFFE:Motor RPM Target" 4094 "0x0x000~0xFFE:Motor RPM Target" 4095 "Error Value" ;
VAL_ 101 IEB_DriftModeSta 0 "Default" 1 "Drift Mode Activate (ON)" 2 "Drift Mode Deactivate (OFF)" 3 "Defective" ;
VAL_ 101 IEB_DriftModeActSta 0 "Default" 1 "Drift Mode ON" 2 "Drift Mode OFF" 3 "Reserved" ;
VAL_ 101 MCU_AntiJerk_Inhbtsta 0 "Allow Anti Jerk Control" 1 "Inhibit Anti Jerk control" ;
VAL_ 101 IEB_Motor_ProtectModSta 0 "default" 1 "Protection mode operation" ;
VAL_ 101 IEB_EstBrkSacFrcNmVal 0 "0x0x0~0xFFFF:friction brake torque for stop assist control" 65535 "0x0x0~0xFFFF:friction brake torque for stop assist control" ;
VAL_ 101 IEB_SrvLmpDis 0 "AHB Service Lamp is Off" 1 "AHB Service Lamp is On" 2 "AHB Service Lamp is BLINKING(2HZ)" 3 "Error Indicator" ;
VAL_ 101 IEB_IndDriftEscModSta_TCS 0 "Default" 1 "Slip level_01" 2 "Slip level_02" 3 "Slip level_03" 4 "Slip level_04" 5 "Slip level_05" 6 "Slip level_06" 7 "Slip level_07" 8 "Slip level_08" 9 "Slip level_09" 10 "Slip level_10" 11 "Reserved" 12 "Reserved" 13 "Reserved" 14 "Reserved" 15 "Reserved" ;
VAL_ 101 IEB_IndDriftEscModSta_VDC 0 "Default" 1 "Beginner" 2 "Intermediate" 3 "Expert" ;
VAL_ 101 IEB_IndDriftMdpsModSta 0 "Default" 1 "N-Mode" 2 "Drift Mode" 3 "Reserved" ;
VAL_ 101 IEB_DfctvSta 0 "AHB is normal mode" 1 "AHB is degraded mode" 2 "AHB is defective mode" 3 "Error Indicator" ;
VAL_ 101 IEB_ActvSta 0 "All Control Inactive" 1 "Charging Active" 2 "AHB Control Active" 3 "Chaging Active + AHB Control Active" ;
VAL_ 101 IEB_DiagSta 0 "AHB is not diagnostic mode" 1 "AHB is diagnostic mode" 2 "Not used" 3 "Error Indicator" ;
VAL_ 101 IEB_WrngLmpDis 0 "AHB Warning Lamp is Off" 1 "AHB Warning Lamp is On" 2 "Not used" 3 "Error Indicator" ;
VAL_ 101 IEB_MILReq 0 "No Request" 1 "MIL On Request" 2 "Reserved" 3 "Reserved" ;
VAL_ 101 IEB_DriftModeStaDis 0 "Default" 1 "Restriction state of Drift" 2 "RESERVED" 3 "RESERVED" 4 "RESERVED" 5 "RESERVED" 6 "RESERVED" 7 "RESERVED" ;
VAL_ 101 RSC_Sta 0 "RSC is ready" 1 "RSC is not ready" ;
VAL_ 101 IEB_BrkActvSta 0 "ECU does not support this function." 1 "Brake switch is not pressed (OFF)" 2 "Brake switch is pressed (ON)" 3 "Brake switch failure" ;
VAL_ 101 IEB_PdlTrvlSnsrFailSta 0 "Normal" 1 "Fail" 2 "Not used" 3 "Error Indicator" ;
VAL_ 101 IEB_PdlCalibSta 0 "Not complete" 1 "Complete" 2 "Not used" 3 "Error Indicator" ;
VAL_ 101 IEB_BzrSta 0 "Buzzer is Off" 1 "Buzzer is On" 2 "Not used" 3 "Error Indicator" ;
VAL_ 101 IEB_Sta 0 "Not Ready" 1 "Ready" 2 "Ready (Front only) & Not Ready(Rear)" 3 "Ready (Rear only) & Not Ready(Front)" ;
VAL_ 101 IEB_SnsrFailSta 0 "Normal" 1 "Fail" 2 "Not used" 3 "Error Indicator" ;
VAL_ 101 IEB_RbsWrngLmpSta 0 "RBS Warning Lamp OFF" 1 "RBS Warning Lamp ON" 2 "Not used" 3 "Error Indicator" ;
VAL_ 101 IEB_VacSysDfctvSta 0 "Vacuum pump NOT defective" 1 "Vacuum pump defective (failed)" 2 "Not used" 3 "Error Indicator" ;
VAL_ 309 BAT_Crc1Val 0 "0x0x0~0xFFFF:CRCValue" 65535 "0x0x0~0xFFFF:CRCValue" ;
VAL_ 309 BAT_AlvCnt1Val 0 "0x0x0~0xFF:AlvCntValue" 255 "0x0x0~0xFF:AlvCntValue" ;
VAL_ 309 BAT_CurrVal 65535 "Error indicator" ;
VAL_ 309 BAT_SocVal 255 "Error indicator" ;
VAL_ 309 BAT_VoltVal 16383 "Error indicator" ;
VAL_ 309 BAT_AuxBattOpt 0 "Not used" 1 "12V LFP Battery is applied" 2 "12V LFP Battery is not applied" 3 "Error indicator" ;
VAL_ 309 BAT_TempVal 511 "Error indicator" ;
VAL_ 309 BAT_SocErrSta 0 "Nomal State" 1 "Implausible State" 2 "Not used" 3 "Error indicator" ;
VAL_ 309 BAT_SohVal 127 "Error indicator" ;
VAL_ 309 BAT_SnsrInvldSta 0 "Valid Condition" 1 "Invalid Condition" 2 "Not used" 3 "Error indicator" ;
VAL_ 309 BAT_SofVal 127 "Error indicator" ;
VAL_ 309 BAT_RspErrSta 0 "Operating correctly" 1 "Response error" 2 "Not used" 3 "Error indicator" ;
VAL_ 309 BAT_CapacityVal 255 "Error" ;
VAL_ 920 CTM_FD_Crc2Val 0 "0x0x0~0xFFFF:CRCValue" 65535 "0x0x0~0xFFFF:CRCValue" ;
VAL_ 920 CTM_FD_AlvCnt2Val 0 "0x0x0~0xFF:AlvCntValue" 255 "0x0x0~0xFF:AlvCntValue" ;
VAL_ 920 USM_TrailerTypSta 0 "off" 1 "Electric Light" 2 "Electric Heavy" 3 "EOH Light" 4 "EOH Heavy" 5 "Invalid" ;
VAL_ 920 ITBC_TrailerDisplayAppliedSta 0 "Default" 1 "ITBC Applied" 2 "RESERVED" 3 "Invalid" ;
VAL_ 920 ITBC_TrailerBrkOut 0 "0x0x0~0x64:0 ~ 100%" 100 "0x0x0~0x64:0 ~ 100%" 100 "RESERVED" 101 "RESERVED" 102 "RESERVED" 103 "RESERVED" 104 "RESERVED" 105 "RESERVED" 106 "RESERVED" 107 "RESERVED" 108 "RESERVED" 109 "RESERVED" 110 "RESERVED" 111 "RESERVED" 112 "RESERVED" 113 "RESERVED" 114 "RESERVED" 115 "RESERVED" 116 "RESERVED" 117 "RESERVED" 118 "RESERVED" 119 "RESERVED" 120 "RESERVED" 121 "RESERVED" 122 "RESERVED" 123 "RESERVED" 124 "RESERVED" 125 "RESERVED" 126 "RESERVED" 127 "Invalid" ;
VAL_ 920 ITBC_TrailerBrkGainVal 0 "0 ~20" 1 "0 ~20" 2 "0 ~20" 3 "0 ~20" 4 "0 ~20" 5 "0 ~20" 6 "0 ~20" 7 "0 ~20" 8 "0 ~20" 9 "0 ~20" 10 "0 ~20" 11 "0 ~20" 12 "0 ~20" 13 "0 ~20" 14 "0 ~20" 15 "0 ~20" 16 "0 ~20" 17 "0 ~20" 18 "0 ~20" 19 "0 ~20" 20 "0 ~20" 31 "Invalid" ;
VAL_ 920 ITBC_SysWarn 0 "Default" 1 "ITBC_ERROR" 2 "RESERVE" 3 "RESERVE" 4 "RESERVE" 5 "RESERVE" 6 "RESERVE" 7 "RESERVE" ;
VAL_ 920 CTM_TrailerAct 0 "Not Connected" 1 "Connected" 2 "RESERVED" 3 "Invaild" ;
VAL_ 920 CTM_RearfogAct 0 "Off" 1 "On" 2 "RESERVED" 3 "Invaild" ;
VAL_ 920 CTM_StpLmpOpnSta 0 "Normal" 1 "Open Status" 2 "Not Used" 3 "Error Indicator" ;
VAL_ 920 CTM_TrnSigLmpLftOpnSta 0 "Normal" 1 "Open Status" 2 "Not Used" 3 "Error Indicator" ;
VAL_ 920 CTM_TrnSigLmpRtOpnSta 0 "Normal" 1 "Open Status" 2 "Not Used" 3 "Error Indicator" ;
VAL_ 920 CTM_ExtTailLmpLftOpnSta 0 "Normal" 1 "Open Status" 2 "Not Used" 3 "Error Indicator" ;
VAL_ 920 CTM_ExtTailLmpRtOpnSta 0 "Normal" 1 "Open Status" 2 "Not Used" 3 "Error Indicator" ;
VAL_ 920 CTM_Exra_EbrakSta 0 "Off" 1 "On" 2 "Not Used" 3 "Error Indicator" ;
VAL_ 920 CTM_TrlAngl_200ms 65535 "Error Indicator" ;
VAL_ 1059 HU_GW_Crc4Val 0 "0x0x0~0xFFFF:CRCValue" 65535 "0x0x0~0xFFFF:CRCValue" ;
VAL_ 1059 CF_AVN_AutoWashModeSta 0 "Default" 1 "Not Wash Mode" 2 "Auto Wash Mode" 3 "Self Wash Mode" 4 "RESERVED" 5 "RESERVED" 6 "RESERVED" 7 "Invalid" ;
VAL_ 1059 OMUOSMirCtrl_Vr 0 "Off" 1 "Fold" 2 "Unfold" 3 "invalid" ;
VAL_ 1059 HU_GW_AlvCnt4Val 0 "0x0x0~0xFF:AlvCntValue" 255 "0x0x0~0xFF:AlvCntValue" ;
VAL_ 1059 HU_IG3_Request 0 "Off" 1 "On" 2 "RESERVED" 3 "Invalid" ;
VAL_ 1059 HU_DigitalKeyGroupingSupport 0 "Default" 1 "Not supported" 2 "Support" 3 "RESERVED" ;
VAL_ 1059 HU_Background 0 "Default" 1 "Day" 2 "Night" 3 "RESERVED" 4 "RESERVED" 5 "RESERVED" 6 "RESERVED" 7 "Invalid" ;
VAL_ 1059 HU_BackgroundFadeInOut 0 "0x0x0~0x3E8:0.0~100.0%" 1000 "0x0x0~0x3E8:0.0~100.0%" 1001 "RESERVED" 1002 "RESERVED" 1003 "RESERVED" 1004 "RESERVED" 1005 "RESERVED" 1006 "RESERVED" 1007 "RESERVED" 1008 "RESERVED" 1009 "RESERVED" 1010 "RESERVED" 1011 "RESERVED" 1012 "RESERVED" 1013 "RESERVED" 1014 "RESERVED" 1015 "RESERVED" 1016 "RESERVED" 1017 "RESERVED" 1018 "RESERVED" 1019 "RESERVED" 1020 "RESERVED" 1021 "RESERVED" 1022 "Default" 1023 "Invalid" ;
VAL_ 979 BDC_FD_Crc4Val 0 "0x0x0~0xFFFF:CRCValue" 65535 "0x0x0~0xFFFF:CRCValue" ;
VAL_ 979 BDC_FD_AlvCnt4Val 0 "0x0x0~0xFF:AlvCntValue" 255 "0x0x0~0xFF:AlvCntValue" ;
VAL_ 979 BAlarm_BglrAlrm_CurrentSta 0 "Off" 1 "DisArm" 2 "Arm" 3 "PreArm" 4 "ArmWait" 5 "ArmHold" 6 "ReArm" 7 "AutoLockTimer (AutoLockTimer1)" 8 "RESERVED" 9 "Alarm" 10 "Default" 11 "TrunkTgTimer (AutoLockTimer3)" 12 "RESERVED" 13 "RESERVED" 14 "Not Used" 15 "Error Indicator" ;
VAL_ 979 BAlarm_BglrAlrm_Sta 0 "DIS-, PRE-, AUTOLOCKTIMER (AutoLockTimer1), TrunkTgTimer (AutoLockTimer3)" 1 "ARM, -WAIT, RE-, ALARM, -HD(Trunk)" 2 "Not Used" 3 "Error Indicator" ;
VAL_ 979 BAlarm_PncAlrmSta 0 "Off" 1 "On (Panic Alarm ON)" 2 "Not Used" 3 "Error Indicator" ;
VAL_ 979 SBR_StBltStpWrngBzrSta 0 "Warning Off" 1 "Buzzer Hold" 2 "1st Warning" 3 "2nd Warning" 4 "3rd Warning" 5 "Reserved" 6 "Pre Warning" 7 "Error Indicator" ;
VAL_ 979 SBR_StBltWrngBzrSta 0 "Warning Off" 1 "Buzzer Hold" 2 "Buzzer On" 3 "Reserved" 4 "Reserved" 5 "Reseved" 6 "Not Used" 7 "Error Indicator" ;
VAL_ 979 BAlarm_BrglrHrnRlySta 0 "Off" 1 "On" 2 "Not Used" 3 "Error Indicator" ;
VAL_ 979 SBR_DrvStBltIndSta 0 "Off" 1 "On" 2 "Not Used" 3 "Error Indicator" ;
VAL_ 979 SBR_RrLftStBltWrngIndSta 0 "Off" 1 "On" 2 "Belted" 3 "Error Indicator" ;
VAL_ 979 SBR_RrRtStBltWrngIndSta 0 "Off" 1 "On" 2 "Belted" 3 "Error Indicator" ;
VAL_ 979 SBR_RrCtrStBltIndSta 0 "Off" 1 "On" 2 "Belted" 3 "Error Indicator" ;
VAL_ 979 SBR_3rdLftStBltWrngIndSta 0 "Off" 1 "On" 2 "Belted" 3 "Error Indicator" ;
VAL_ 979 SBR_3rdRtStBltWrngIndSta 0 "Off" 1 "On" 2 "Belted" 3 "Error Indicator" ;
VAL_ 979 SBR_3rdCtrStBltWrngIndSta 0 "Off" 1 "On" 2 "Belted" 3 "Error Indicator" ;
VAL_ 979 Warn_BzrWrngSta 0 "Off" 1 "SeatBelt Warning" 2 "Key Operated Warning" 3 "Parking Brake Warning" 4 "Sun Roof Open Warning" 5 "Key Learning Sound(NoSMKOption" 6 "ICE Warning" 7 "Rear Fog Warning" 8 "Reserved" 9 "Reserved" 10 "Reserved" 11 "Reserved" 12 "Reserved" 13 "Reserved" 14 "Not Used" 15 "Error Indicator" ;
VAL_ 979 Warn_BCMWrngSta 0 "Off" 1 "Power off request warning" 2 "Shift P request Warning" 3 "Shift P Warning 2 (Pwr Off, Shift Enable)" 4 "Shift P Warning 2 (Pwr Off, Shift Disable)" 5 "Shift P Warning 2 (Pwr On, Shift Enable)" 6 "Shift P Warning 2 (Pwr On, Shift Disable)" 7 "RESERVED" 8 "RESERVED" 9 "RESERVED" 10 "RESERVED" 11 "RESERVED" 12 "RESERVED" 13 "RESERVED" 14 "Not Used" 15 "Error Indicator" ;
VAL_ 979 ROA_RrBlwAutoOffReq 0 "default" 1 "Request of Rear Blow Off (auto Cut)" 2 "Not Used" 3 "Error Indciator" ;
VAL_ 979 ROA_RegionOpt 0 "Non Euro NCAP CPD" 1 "Euro NCAP CPD" 2 "Reserved" 3 "Error Indicator" ;
VAL_ 979 Warn_RrStRmndOpt 0 "Not apply RrSeatRemind" 1 "Apply RrSeatRemind" 2 "Apply Radar ROA sensor" 3 "Error Indicator" ;
VAL_ 979 Warn_RrStRmndAlrmOnReq 0 "Off" 1 "On(Alarm)" 2 "Not Used" 3 "Error Indicator" ;
VAL_ 979 Warn_RrStRmndSysSta 0 "Default" 1 "System ON" 2 "System OFF" 3 "Error Indicator" ;
VAL_ 979 Warn_RrStRmndAlrmInfo 0 "Off" 1 "Rear Seat Reminder" 2 "Rear Seat Reminder 1st Only" 3 "Delayed ROA" 4 "Reserved" 5 "Reseved" 6 "Not Used" 7 "Error Indicator" ;
VAL_ 979 Warn_RoaErr 0 "Off" 1 "SensorError( Malfunction)" 2 "Reserved" 3 "Reserved" 4 "Reserved" 5 "Reseved" 6 "Not Used" 7 "Error Indicator" ;
VAL_ 979 Warn_RrStRmndDelay 0 "Off" 1 "Delayed ROA" 2 "Not Used" 3 "Error Indicator" ;
VAL_ 979 Warn_RrStRmndSysAct 0 "Default" 1 "Deactivation" 2 "Off" 3 "Error Indicator" ;
VAL_ 979 WAL_FobSearching 0 "Not Fob Exist" 1 "Fob Exist" 2 "Reserved" 3 "Error Indicator" ;
VAL_ 979 Warn_RrStRmndSysOffIND 0 "Indicator Off" 1 "Indicator On" 2 "Not Used" 3 "Error Indicator" ;
VAL_ 979 Warn_VehNotPWrngSta 0 "Off" 1 "Not P Warning (Pwr Off, Shift Enable)" 2 "Not P Warning (Pwr Off, Shift Disable)" 3 "Not P Warning (Pwr On, Shift Enable)" 4 "Not P Warning (Pwr On, Shift Disable)" 5 "RESERVED" 6 "RESERVED" 7 "Error Indicator" ;
VAL_ 983 BDC_FD_Crc8Val 0 "0x0x0~0xFFFF:CRCValue" 65535 "0x0x0~0xFFFF:CRCValue" ;
VAL_ 983 Mirror_MnlFldModSta 0 "None" 1 "ManualFold" 2 "RESERVED" 3 "Error Indicator" ;
VAL_ 983 Mirror_SelSwSta 0 "Off" 1 "Left" 2 "Neutral" 3 "Right" 4 "Not Used" 5 "Not Used" 6 "Not Used" 7 "Error Indicator" ;
VAL_ 983 Mirror_LHPosMnlReq 0 "Off" 1 "Up" 2 "Down" 3 "Left" 4 "Right" 5 "Not Used" 6 "Not Used" 7 "Error Indicator" ;
VAL_ 983 Mirror_AutoWashModeSta_TypeC 0 "Not Completed" 1 "Completed" 2 "RESERVED" 3 "Error Indicator" ;
VAL_ 983 Mirror_RHPosMnlReq 0 "Off" 1 "Up" 2 "Down" 3 "Left" 4 "Right" 5 "Not Used" 6 "Not Used" 7 "Error Indicator" ;
VAL_ 983 Mirror_LHPosMnlCmd 0 "Off" 1 "Up" 2 "Down" 3 "Left" 4 "Right" 5 "Not Used" 6 "Not Used" 7 "Error Indicator" ;
VAL_ 983 Mirror_RHPosMnlCmd 0 "Off" 1 "Up" 2 "Down" 3 "Left" 4 "Right" 5 "Not Used" 6 "Not Used" 7 "Error Indicator" ;
VAL_ 983 Wiper_FrWiperLowAct 0 "Off" 1 "On" 2 "Not Used" 3 "Error Indicator" ;
VAL_ 983 Wiper_FrWiperHighAct 0 "Off" 1 "On" 2 "Not Used" 3 "Error Indicator" ;
VAL_ 983 Wiper_FrtWiperLowCmd 0 "Off" 1 "On" 2 "Not Used" 3 "Error Indicator" ;
VAL_ 983 Wiper_FrtWiperHighCmd 0 "Off" 1 "On" 2 "Not Used" 3 "Error Indicator" ;
VAL_ 983 Wiper_RrWiperCmd 0 "Off" 1 "On" 2 "Not Used" 3 "Error Indicator" ;
VAL_ 983 Wiper_PowerEnableCmd 0 "Off" 1 "On" 2 "Not Used" 3 "Error Indicator" ;
VAL_ 983 Wiper_FrtWasherCmd 0 "Off" 1 "On" 2 "Not Used" 3 "Error Indicator" ;
VAL_ 983 Wiper_RrWasherCmd 0 "Off" 1 "On" 2 "Not Used" 3 "Error Indicator" ;
VAL_ 983 Wiper_HeadLampWasherCmd 0 "Off" 1 "On" 2 "Not Used" 3 "Error Indicator" ;
VAL_ 983 Wiper_AutoWashModeSta_TypeC 0 "Not Completed" 1 "Completed" 2 "RESERVED" 3 "Error Indicator" ;
VAL_ 983 Mirror_LHPosMnlPlyCmd 0 "Off" 1 "Up" 2 "Down" 3 "Left" 4 "Right" 5 "RESERVED" 6 "RESERVED" 7 "Error Indicator" ;
VAL_ 983 Mirror_RHPosMnlPlyCmd 0 "Off" 1 "Up" 2 "Down" 3 "Left" 4 "Right" 5 "RESERVED" 6 "RESERVED" 7 "Error Indicator" ;
VAL_ 983 BDC_FD_AlvCnt8Val 0 "0x0x0~0xFF:AlvCntValue" 255 "0x0x0~0xFF:AlvCntValue" ;
VAL_ 983 Mirror_LHPosAutoPlyCmd 0 "Off" 1 "IMS1" 2 "IMS2" 3 "IMS3" 4 "IMS Stop" 5 "SmartIMS" 6 "SmartIMS Stop" 7 "Personal Service(Profile)" 8 "Default Auto Reverse" 9 "IMS1 Auto Reverse" 10 "IMS2 Auto Reverse" 11 "IMS3 Auto Reverse" 12 "Self Return" 13 "RESERVED" 14 "RESERVED" 15 "Error Indicator" ;
VAL_ 983 Mirror_RHPosAutoPlyCmd 0 "Off" 1 "IMS1" 2 "IMS2" 3 "IMS3" 4 "IMS Stop" 5 "SmartIMS" 6 "SmartIMS Stop" 7 "Personal Service(Profile)" 8 "Default Auto Reverse" 9 "IMS1 Auto Reverse" 10 "IMS2 Auto Reverse" 11 "IMS3 Auto Reverse" 12 "Self Return" 13 "RESERVED" 14 "RESERVED" 15 "Error Indicator" ;
VAL_ 983 Mirror_IMSMemoryCmd 0 "Off" 1 "IMS1" 2 "IMS2" 3 "IMS3" 4 "RESERVED" 5 "RESERVED" 6 "RESERVED" 7 "Error Indicator" ;
VAL_ 983 Wiper_RainAmount 0 "0x0x0~0x96:PH=0.1*HEX(mm/Hr)" 150 "0x0x0~0x96:PH=0.1*HEX(mm/Hr)" 151 "0x97~0xFE:RESERVED" 254 "0x97~0xFE:RESERVED" 255 "Invalid" ;
VAL_ 983 Wiper_AutoWashModeSta 0 "Auto Wash Mode Off" 1 "Auto Wash Mode On" 2 "Not Used" 3 "Error Indicator" ;
VAL_ 983 Wiper_PrkngPosSta 0 "else" 1 "Parking Position" 2 "Not Used" 3 "Error Indicator" ;
VAL_ 983 Wiper_RainSnsrOptionTyp 0 "Non Rain Sensor Option" 1 "Rain Sensor Option" 2 "Not Used" 3 "Error Indicator" ;
VAL_ 983 Wiper_HtWshNzzlCmd 0 "Off" 1 "On" 2 "Not Used" 3 "Error Indicator" ;
VAL_ 983 Wiper_RainSnsrSta 0 "OFF" 1 "Rain Detected" 2 "Low" 3 "High" 4 "Fault 1" 5 "RESERVED" 6 "RESERVED" 7 "RESERVED" 8 "RESERVED" 9 "RESERVED" 10 "RESERVED" 11 "RESERVED" 12 "RESERVED" 13 "RESERVED" 14 "Not Used" 15 "Error Indicator" ;
VAL_ 983 Wiper_RainSnsrPartNum 0 "T6000,NI000" 1 "EV000,DV000" 2 "CU000,XA000" 3 "CV000" 4 "KL000" 5 "DO000" 6 "CU500" 7 "RESERVED" 8 "RESERVED" 9 "RESERVED" 10 "RESERVED" 11 "RESERVED" 12 "RESERVED" 13 "RESERVED" 14 "RESERVED" 15 "L1000,N9000" ;
VAL_ 983 ECW_Fault 0 "Else" 1 "Detected" 2 "Not used" 3 "Error Indicator" ;
VAL_ 983 ECW_FaultActv 0 "Else" 1 "Valid" 2 "Not used" 3 "Error Indicator" ;
VAL_ 983 ECW_HiVolt 0 "Else" 1 "Detected" 2 "Not used" 3 "Error Indicator" ;
VAL_ 983 ECW_HiVoltActv 0 "Else" 1 "Valid" 2 "Not used" 3 "Error Indicator" ;
VAL_ 983 ECW_LoVolt 0 "Else" 1 "Detected" 2 "Not used" 3 "Error Indicator" ;
VAL_ 983 ECW_LoVoltActv 0 "Else" 1 "Valid" 2 "Not used" 3 "Error Indicator" ;
VAL_ 983 ECW_Overload 0 "Else" 1 "Detected" 2 "Not used" 3 "Error Indicator" ;
VAL_ 983 ECW_OverloadActv 0 "Else" 1 "Valid" 2 "Not used" 3 "Error Indicator" ;
VAL_ 983 ECW_CommErr 0 "No error" 1 "Error" 2 "Not used" 3 "Error Indicator" ;
VAL_ 983 Mirror_MirFldOpt 0 "Not Applied" 1 "Applied" 2 "Not Used" 3 "Error Indicator" ;
VAL_ 983 Mirror_FldUnfldCmd 0 "Off" 1 "Fold" 2 "Unfold" 3 "Error Indicator" ;
VAL_ 983 Mirror_FldCtrlSta 0 "Off" 1 "Fldng" 2 "Fld" 3 "Error Indicator" ;
VAL_ 983 Mirror_UnFldCtrlSta 0 "Off" 1 "UnFldng" 2 "UnFld" 3 "Error Indicator" ;
VAL_ 983 Mirror_PosMnlCmd 0 "Off" 1 "Up" 2 "Down" 3 "Left" 4 "Right" 5 "Not Used" 6 "Not Used" 7 "Error Indicator" ;
VAL_ 983 Mirror_SelSwIndCmd 0 "Off" 1 "Left" 2 "Neutral" 3 "Right" 4 "Not Used" 5 "Not Used" 6 "Not Used" 7 "Error Indicator" ;
