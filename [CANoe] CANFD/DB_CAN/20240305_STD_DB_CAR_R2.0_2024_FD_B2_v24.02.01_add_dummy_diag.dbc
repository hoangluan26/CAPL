VERSION ""

NS_ :

BS_:

BU_: ARS_FD WPC_FD WPC2_FD SCM_FD SHVU_FRNT_FD GW_SAU_DRV_FD GW_PSU_AST_FD GW_PSU_3RD_FD RCS_FD GW_PSU_RL_FD RCM_FD SHVU_3RD_FD SHVU_RR_FD PSB_FD ATS_FD GW_PSU_RR_FD SHVU_RL_FD RWPC_FD CGW_CCU OHCL_FD SHVU_REAR_FD BLTN_CAM_FD SGU_FD GW_PSU_DRV_FD FCS_FD

BO_ 870 HU_GW_03_200ms: 24 CGW_CCU
 SG_ HU_GW_Crc3Val : 0|16@1+ (1,0) [0|0] "" Vector__XXX
 SG_ AVN_RSPA_Disp_Rdy : 102|2@1+ (1,0) [0|0] "" Vector__XXX
 SG_ CF_AVN_ProfileIDRValue : 104|4@1+ (1,0) [0|0] ""  BLTN_CAM_FD,GW_PSU_DRV_FD,GW_SAU_DRV_FD,RCM_FD,RWPC_FD,SGU_FD,WPC2_FD,WPC_FD
 SG_ HazardFromHUSVM : 108|2@1+ (1,0) [0|0] "" Vector__XXX
 SG_ OMUOSMirCtrl : 110|2@1+ (1,0) [0|0] "" Vector__XXX
 SG_ OTAUIStatus : 120|2@1+ (1,0) [0|0] "" Vector__XXX
 SG_ C_TeleActiveStatus : 122|2@1+ (1,0) [0|0] "" Vector__XXX
 SG_ HU_RTCCheck : 126|2@1+ (1,0) [0|0] ""  GW_PSU_AST_FD
 SG_ AVN_AccelTimerStat : 128|3@1+ (1,0) [0|0] "" Vector__XXX
 SG_ AVN_AccelTimer_MilliSecond : 144|10@1+ (1,0) [0|0] "" Vector__XXX
 SG_ AVN_AccelTimer_Second : 154|10@1+ (1,0) [0|0] "" Vector__XXX
 SG_ HU_GW_AlvCnt3Val : 16|8@1+ (1,0) [0|0] "" Vector__XXX
 SG_ AVN_AccelSpdTimerStartVal : 164|5@1+ (1,0) [0|0] "" Vector__XXX
 SG_ AVN_AccelSpdTimerEndVal : 169|5@1+ (1,0) [0|0] "" Vector__XXX
 SG_ AVN_AccelTimerUnitSta : 174|2@1+ (1,0) [0|0] "" Vector__XXX
 SG_ AVN_AccelDistTimerVal : 176|4@1+ (1,0) [0|0] "" Vector__XXX
 SG_ AVN_AccelTimerErrSta : 180|2@1+ (1,0) [0|0] "" Vector__XXX
 SG_ HU_SWRCWarmerSet : 182|2@1+ (1,0) [0|0] "" Vector__XXX
 SG_ AVN_MRA_Disp_Rdy : 56|2@1+ (1,0) [0|0] "" Vector__XXX
 SG_ AVN_PRK_Func_Selected : 58|4@1+ (1,0) [0|0] "" Vector__XXX
 SG_ AVN_MRA_CancelInput : 62|2@1+ (1,0) [0|0] "" Vector__XXX
 SG_ HU_DistanceUnit : 64|2@1+ (1,0) [0|0] "" Vector__XXX
 SG_ HU_Scheduled_Setting : 66|4@1+ (1,0) [0|0] "" Vector__XXX
 SG_ HU_AliveStatus : 70|2@1+ (1,0) [0|0] "" Vector__XXX
 SG_ HU_ThemeType : 74|6@1+ (1,0) [0|0] ""  ATS_FD,BLTN_CAM_FD
 SG_ HU_MicActivity : 81|2@1+ (1,0) [0|0] "" Vector__XXX
 SG_ AVN_RSPA_ModeSelect : 84|4@1+ (1,0) [0|0] "" Vector__XXX
 SG_ CF_HU_GPSFlt : 88|2@1+ (1,0) [0|0] "" Vector__XXX
 SG_ AVN_RSPA_CancelInput : 90|2@1+ (1,0) [0|3] "" Vector__XXX

BO_ 261 EMS_07_10ms: 32 CGW_CCU
 SG_ EMS_Crc7Val : 0|16@1+ (1,0) [0|0] "" Vector__XXX
 SG_ HEV_AccelPdlVal : 103|10@1+ (0.09784,0) [0|0] "%"  BLTN_CAM_FD
 SG_ HEV_IndTqTar : 113|8@1+ (0.3906,0) [0|0] "%" Vector__XXX
 SG_ HEV_IndTqVal_Extd : 128|14@1+ (0.1,0) [0|0] "Nm" Vector__XXX
 SG_ EMS_AlvCnt7Val : 16|8@1+ (1,0) [0|0] "" Vector__XXX
 SG_ HEV_IndTqVal : 24|12@1+ (0.1,0) [0|0] "Nm" Vector__XXX
 SG_ HEV_DrvTqVal : 36|12@1+ (0.390625,0) [0|0] "%" Vector__XXX
 SG_ HEV_TqStndVal : 48|6@1+ (10,0) [0|0] "Nm" Vector__XXX
 SG_ HEV_OilDilution_IncICELoad : 54|1@1+ (1,0) [0|0] "" Vector__XXX
 SG_ HEV_OilDilution_ServMode : 56|2@1+ (1,0) [0|0] "" Vector__XXX
 SG_ EMS_TqLmtSta : 58|3@1+ (1,0) [0|0] "" Vector__XXX
 SG_ EMS_EU7 : 61|1@1+ (1,0) [0|0] "" Vector__XXX
 SG_ HEV_FrctTqVal : 64|12@1+ (0.1,0) [0|0] "Nm" Vector__XXX
 SG_ HEV_EngSpdVal : 76|16@1+ (0.25,0) [0|0] "rpm" Vector__XXX
 SG_ HEV_EngOpSta : 92|3@1+ (1,0) [0|0] ""  GW_PSU_3RD_FD,RWPC_FD,WPC2_FD,WPC_FD
 SG_ HEV_IntakeAirTempVal : 95|8@1+ (0.75,-48) [0|0] "℃" Vector__XXX

BO_ 993 PDC_FD_02_200ms: 24 CGW_CCU
 SG_ PDC_FD_Crc2Val : 0|16@1+ (1,0) [0|0] "" Vector__XXX
 SG_ Lamp_StpLmpLftOpnSta : 100|2@1+ (1,0) [0|0] "" Vector__XXX
 SG_ Lamp_StpLmpRtOpnSta : 102|2@1+ (1,0) [0|0] "" Vector__XXX
 SG_ Lamp_HmslLmpOpnSta : 104|2@1+ (1,0) [0|0] "" Vector__XXX
 SG_ Lamp_DrlLmpLftOpnSta : 106|2@1+ (1,0) [0|0] "" Vector__XXX
 SG_ Lamp_DrlLmpRtOpnSta : 108|2@1+ (1,0) [0|0] "" Vector__XXX
 SG_ Lamp_FrFgLmpLftOpnSta : 110|2@1+ (1,0) [0|0] "" Vector__XXX
 SG_ Lamp_FrFgLmpRtOpnSta : 112|2@1+ (1,0) [0|0] "" Vector__XXX
 SG_ Lamp_CorneringLmpLftOpnSta : 114|2@1+ (1,0) [0|0] "" Vector__XXX
 SG_ Lamp_CorneringLmpRtOpnSta : 116|2@1+ (1,0) [0|0] "" Vector__XXX
 SG_ Lamp_StcBendingLmpLftOpnSta : 118|2@1+ (1,0) [0|0] "" Vector__XXX
 SG_ Lamp_StcBendingLmpRtOpnSta : 120|2@1+ (1,0) [0|0] "" Vector__XXX
 SG_ Lamp_FrTurnSigLmpLftPCLSta : 122|2@1+ (1,0) [0|0] "" Vector__XXX
 SG_ Lamp_FrTurnSigLmpRtPCLSta : 124|2@1+ (1,0) [0|0] "" Vector__XXX
 SG_ Lamp_RrTurnSigLmpLftPCLSta : 126|2@1+ (1,0) [0|0] "" Vector__XXX
 SG_ Lamp_RrTurnSigLmpRtPCLSta : 128|2@1+ (1,0) [0|0] "" Vector__XXX
 SG_ HzrdSwPushSta : 130|2@1+ (1,0) [0|0] "" Vector__XXX
 SG_ Lamp_LftTrnFaultSta : 132|2@1+ (1,0) [0|0] "" Vector__XXX
 SG_ Lamp_RtTrnFaultSta : 134|2@1+ (1,0) [0|0] "" Vector__XXX
 SG_ FrtTurnLampOptSta : 136|2@1+ (1,0) [0|0] "" Vector__XXX
 SG_ RrTurnLampOptSta : 138|2@1+ (1,0) [0|0] "" Vector__XXX
 SG_ PDC_FD_AlvCnt2Val : 16|8@1+ (1,0) [0|0] "" Vector__XXX
 SG_ IntLamp_InlTailLmpSta : 64|2@1+ (1,0) [0|0] ""  BLTN_CAM_FD,GW_PSU_3RD_FD,GW_PSU_AST_FD,GW_PSU_DRV_FD,GW_PSU_RL_FD,GW_PSU_RR_FD,WPC2_FD
 SG_ Lamp_FootLampOnReq : 66|2@1+ (1,0) [0|0] "" Vector__XXX
 SG_ Lamp_MoodLampOnReq : 68|3@1+ (1,0) [0|0] "" Vector__XXX
 SG_ USM_FuncForMdLmpBrgtSta : 71|3@1+ (1,0) [0|0] "" Vector__XXX
 SG_ Lamp_HdLmpLoLftOpnSta : 74|2@1+ (1,0) [0|0] "" Vector__XXX
 SG_ Lamp_HdLmpLoRtOpnSta : 76|2@1+ (1,0) [0|0] "" Vector__XXX
 SG_ Lamp_HdLmpBiFuncLftOpnSta : 78|2@1+ (1,0) [0|0] "" Vector__XXX
 SG_ Lamp_HdLmpBiFuncRtOpnSta : 80|2@1+ (1,0) [0|0] "" Vector__XXX
 SG_ Lamp_HdLmpHiLftOpnSta : 82|2@1+ (1,0) [0|0] "" Vector__XXX
 SG_ Lamp_HdLmpHiRtOpnSta : 84|2@1+ (1,0) [0|0] "" Vector__XXX
 SG_ ExtLamp_HzrdSwSta : 86|2@1+ (1,0) [0|0] "" Vector__XXX
 SG_ Lamp_FrTrnSigLmpLftOpnSta : 88|2@1+ (1,0) [0|0] "" Vector__XXX
 SG_ Lamp_FrTrnSigLmpRtOpnSta : 90|2@1+ (1,0) [0|0] "" Vector__XXX
 SG_ Lamp_RrTrnSigLmpLftOpnSta : 92|2@1+ (1,0) [0|0] "" Vector__XXX
 SG_ Lamp_RrTrnSigLmpRtOpnSta : 94|2@1+ (1,0) [0|0] "" Vector__XXX
 SG_ Brake_SwSta_ICU : 96|2@1+ (1,0) [0|0] "" Vector__XXX
 SG_ BrkLmpCmd : 98|2@1+ (1,0) [0|0] "" Vector__XXX

BO_ 813 SBCM_DRV_FD_01_200ms: 32 CGW_CCU
 SG_ SBCM_DRV_FD_Crc1Val : 0|16@1+ (1,0) [0|0] "" Vector__XXX
 SG_ Latch_TypeOption_DRV : 100|2@1+ (1,0) [0|0] ""  RWPC_FD,WPC2_FD,WPC_FD
 SG_ DRV_SWFailAlarm : 102|2@1+ (1,0) [0|0] "" Vector__XXX
 SG_ USM_PwrDRApprOpnSetSta : 104|2@1+ (1,0) [0|0] "" Vector__XXX
 SG_ USM_PwrDRApprOpnSetOpt : 106|2@1+ (1,0) [0|0] "" Vector__XXX
 SG_ USM_PwrDRCloseByRKELockSta : 108|2@1+ (1,0) [0|0] "" Vector__XXX
 SG_ USM_PwrDRCloseByRKELockOpt : 110|2@1+ (1,0) [0|0] "" Vector__XXX
 SG_ USM_PwrDRCloseByBrakeSta : 112|2@1+ (1,0) [0|0] "" Vector__XXX
 SG_ USM_PwrDRCloseByBrakeOpt : 114|2@1+ (1,0) [0|0] "" Vector__XXX
 SG_ USM_PwrDRBuzzerSta : 116|2@1+ (1,0) [0|0] "" Vector__XXX
 SG_ USM_PwrDRBuzzerOpt : 118|2@1+ (1,0) [0|0] "" Vector__XXX
 SG_ PDS_TypeOption_DRV : 120|2@1+ (1,0) [0|0] "" Vector__XXX
 SG_ C_DrvDoorApproachOpen : 122|2@1+ (1,0) [0|0] "" Vector__XXX
 SG_ C_DrvDoorApproachClose : 124|2@1+ (1,0) [0|0] "" Vector__XXX
 SG_ DoorLock_PDSLkSwSta_DRV : 126|2@1+ (1,0) [0|0] "" Vector__XXX
 SG_ SBCM_DRV_DiagSta : 136|2@1+ (1,0) [0|0] "" Vector__XXX
 SG_ DoorLock_CtrlDrLkUnLkSwSta_SBCM : 138|2@1+ (1,0) [0|0] "" Vector__XXX
 SG_ SBCM_PsvDrLkReq : 144|2@1+ (1,0) [0|0] "" Vector__XXX
 SG_ CDMAutoWashModeSet_SBCM : 146|3@1+ (1,0) [0|0] "" Vector__XXX
 SG_ USM_DrvGhostDoorSta : 150|2@1+ (1,0) [0|0] "" Vector__XXX
 SG_ Mirror_LH_FoldingSta : 152|2@1+ (1,0) [0|0] "" Vector__XXX
 SG_ Mirror_LH_UnfoldingSta : 154|2@1+ (1,0) [0|0] "" Vector__XXX
 SG_ DRV_CrashMRActAlarm : 156|2@1+ (1,0) [0|0] "" Vector__XXX
 SG_ AFH_DRV_FldUnFldSta : 158|2@1+ (1,0) [0|0] "" Vector__XXX
 SG_ SBCM_DRV_FD_AlvCnt1Val : 16|8@1+ (1,0) [0|0] "" Vector__XXX
 SG_ MirrorFldReq : 160|2@1+ (1,0) [0|0] "" Vector__XXX
 SG_ OMU_TypeOption_DRV : 162|2@1+ (1,0) [0|0] "" Vector__XXX
 SG_ IMS_OSMirPlayBackSta_LH : 164|4@1+ (1,0) [0|0] ""  GW_PSU_DRV_FD
 SG_ ECMMRR_PLUS : 168|8@1+ (1,0) [0|0] "" Vector__XXX
 SG_ EHL_TxInfo_SBCM_DRV : 176|3@1+ (1,0) [0|0] "" Vector__XXX
 SG_ IMS_OSMirPlayBackSta_LH_New : 184|4@1+ (1,0) [0|0] ""  GW_PSU_DRV_FD
 SG_ CDM_InsideOpnSwSta : 200|2@1+ (1,0) [0|0] "" Vector__XXX
 SG_ CDM_TypeOption : 202|2@1+ (1,0) [0|0] "" Vector__XXX
 SG_ CDM_ImmeChgSw_SBCM : 208|2@1+ (1,0) [0|0] "" Vector__XXX
 SG_ CDM_ChgDrSwFrt_SBCM : 210|2@1+ (1,0) [0|0] "" Vector__XXX
 SG_ CDM_OpnClsState_SBCM : 212|2@1+ (1,0) [0|0] "" Vector__XXX
 SG_ CDM_WarnMsg_SBCM : 214|2@1+ (1,0) [0|0] "" Vector__XXX
 SG_ CDM_AutoWashModeSta : 216|3@1+ (1,0) [0|0] "" Vector__XXX
 SG_ CDM_CmdStatus_SBCM : 220|4@1+ (1,0) [0|0] "" Vector__XXX
 SG_ CDM_OutsideOpnSwSta : 224|2@1+ (1,0) [0|0] "" Vector__XXX
 SG_ PwrDRBuzzerOut_DRV : 226|2@1+ (1,0) [0|0] "" Vector__XXX
 SG_ Warn_HoodSwSta_SBCM : 228|2@1+ (1,0) [0|0] ""  BLTN_CAM_FD
 SG_ Hood_TypeOption : 230|2@1+ (1,0) [0|0] ""  BLTN_CAM_FD
 SG_ SBCM_FrunkSta : 232|2@1+ (1,0) [0|0] "" Vector__XXX
 SG_ Warn_HoodSwFullSta_SBCM : 234|2@1+ (1,0) [0|0] "" Vector__XXX
 SG_ FrunkWarning_SBCM : 236|2@1+ (1,0) [0|0] "" Vector__XXX
 SG_ SBCM_Longkey_DRVDrAtClsSwSta : 238|2@1+ (1,0) [0|0] "" Vector__XXX
 SG_ FrunkReleaseSwSta_SBCM : 24|2@1+ (1,0) [0|0] "" Vector__XXX
 SG_ PwrDRClosingDRVDrSta : 240|3@1+ (1,0) [0|0] ""  ATS_FD
 SG_ Drv_DrLkRetryFail_SBCM : 243|2@1+ (1,0) [0|0] "" Vector__XXX
 SG_ CDM_GbtImmeChgSw_SBCM : 246|2@1+ (1,0) [0|0] "" Vector__XXX
 SG_ CDM_GbtOpnClsState_SBCM : 248|2@1+ (1,0) [0|0] "" Vector__XXX
 SG_ CDM_GbtWarnMsg_SBCM : 250|2@1+ (1,0) [0|0] "" Vector__XXX
 SG_ CDM_GbtOutsideOpnSwSta : 252|2@1+ (1,0) [0|0] "" Vector__XXX
 SG_ DoorLock_DrvLkOutSta_SBCM : 254|2@1+ (1,0) [0|0] "" Vector__XXX
 SG_ FrunkEmergencySwSta_SBCM : 28|2@1+ (1,0) [0|0] "" Vector__XXX
 SG_ DRV_DetectObj_warn_LH : 30|2@1+ (1,0) [0|0] ""  ATS_FD
 SG_ PwrDROpenClosingDdvSdDRSta : 32|3@1+ (1,0) [0|0] ""  ATS_FD
 SG_ PwrDRBuzzerOut_DRV_New : 35|3@1+ (1,0) [0|0] "" Vector__XXX
 SG_ Coach_TypeOption_DRV : 38|2@1+ (1,0) [0|0] ""  ATS_FD,GW_PSU_RL_FD,GW_PSU_RR_FD
 SG_ PwrDrSta_Drv : 40|2@1+ (1,0) [0|0] "" Vector__XXX
 SG_ PwrDrSta_DrvSd : 42|2@1+ (1,0) [0|0] "" Vector__XXX
 SG_ USM_PwrDrOpnTypSta : 44|2@1+ (1,0) [0|0] "" Vector__XXX
 SG_ DischrgDr_OpnClsState_SBCM : 46|2@1+ (1,0) [0|0] "" Vector__XXX
 SG_ SBCM_FL_DoorAngle : 48|7@1+ (1,0) [0|0] "˚" Vector__XXX
 SG_ SBCM_DoorType_DRV : 60|2@1+ (1,0) [0|0] "" Vector__XXX
 SG_ DRVDoorPushAlarm : 72|2@1+ (1,0) [0|0] "" Vector__XXX
 SG_ DRV_CrashUnlockCmd : 74|1@1+ (1,0) [0|0] ""  BLTN_CAM_FD
 SG_ C_ApprOpenStatus : 75|1@1+ (1,0) [0|0] "" Vector__XXX
 SG_ DoorLock_DrvKeyLkSwSta_SBCM : 80|2@1+ (1,0) [0|0] "" Vector__XXX
 SG_ DoorLock_DrvKeyUnLkSwSta_SBCM : 82|2@1+ (1,0) [0|0] "" Vector__XXX
 SG_ Warn_DrvDrSwSta_SBCM : 84|2@1+ (1,0) [0|0] ""  ATS_FD,BLTN_CAM_FD,GW_PSU_DRV_FD,PSB_FD,RWPC_FD,WPC2_FD,WPC_FD
 SG_ DoorLock_DrvDrUnLkSta_SBCM : 86|2@1+ (1,0) [0|0] ""  ATS_FD,GW_PSU_DRV_FD
 SG_ DRV_SEAWarn_LH : 88|2@1+ (1,0) [0|0] "" Vector__XXX
 SG_ DRV_SEAWarn_RH : 90|2@1+ (1,0) [0|0] "" Vector__XXX
 SG_ DRV_SEWWarn_LH : 92|2@1+ (1,0) [0|0] "" Vector__XXX
 SG_ DRV_SEWWarn_RH : 94|2@1+ (1,0) [0|0] "" Vector__XXX
 SG_ DRV_MRActivationAlarm : 96|2@1+ (1,0) [0|0] "" Vector__XXX
 SG_ DRV_ReleaseWarn : 98|2@1+ (1,0) [0|0] "" Vector__XXX

BO_ 992 PDC_FD_01_200ms: 24 CGW_CCU
 SG_ PDC_FD_Crc1Val : 0|16@1+ (1,0) [0|0] "" Vector__XXX
 SG_ C_3rdRCSeatBeltSW : 100|1@1+ (1,0) [0|0] ""  ARS_FD,GW_PSU_RL_FD,GW_PSU_RR_FD,WPC2_FD
 SG_ C_3rdRRSeatBeltSW : 101|1@1+ (1,0) [0|0] ""  ARS_FD,GW_PSU_RR_FD,WPC2_FD
 SG_ C_1stCTRSeatBeltSW : 102|1@1+ (1,0) [0|0] "" Vector__XXX
 SG_ Warn_DrvStOccSta : 103|3@1+ (1,0) [0|0] "" Vector__XXX
 SG_ DPDMat_HDPSpprtSWVer : 106|5@1+ (1,0) [0|0] "" Vector__XXX
 SG_ Warn_PassStOccSta : 111|2@1+ (1,0) [0|0] ""  GW_PSU_AST_FD
 SG_ Warn_RrLftSBRMATSwSta : 113|2@1+ (1,0) [0|0] ""  GW_PSU_DRV_FD
 SG_ Warn_RrRhtSBRMATSwSta : 115|2@1+ (1,0) [0|0] ""  GW_PSU_DRV_FD
 SG_ C_3rdRLSBRMatSw : 117|1@1+ (1,0) [0|0] ""  ARS_FD,GW_PSU_RL_FD,WPC2_FD
 SG_ C_3rdRRSBRMatSw : 118|1@1+ (1,0) [0|0] ""  ARS_FD,GW_PSU_RR_FD,WPC2_FD
 SG_ C_1stCTRSBRMatSw : 119|1@1+ (1,0) [0|0] "" Vector__XXX
 SG_ StrWhlWrmrSwState : 120|2@1+ (1,0) [0|0] "" Vector__XXX
 SG_ StrWhlWrmrFlModDetail : 122|3@1+ (1,0) [0|0] "" Vector__XXX
 SG_ FrHtdGlsSwState : 125|2@1+ (1,0) [0|0] "" Vector__XXX
 SG_ RrGlsHtSwState : 127|2@1+ (1,0) [0|0] "" Vector__XXX
 SG_ RLChldLkLatchSwState : 129|2@1+ (1,0) [0|0] "" Vector__XXX
 SG_ RRChldLkLatchSwState : 131|2@1+ (1,0) [0|0] "" Vector__XXX
 SG_ ChildLock_ActnFlSta : 133|2@1+ (1,0) [0|0] "" Vector__XXX
 SG_ DoorLock_LkOutSta : 135|2@1+ (1,0) [0|0] "" Vector__XXX
 SG_ VSAutoDrLkRetryFailSta : 137|2@1+ (1,0) [0|0] "" Vector__XXX
 SG_ Trunk_TrnkTlgtOutReleaseSwSta : 139|2@1+ (1,0) [0|0] "" Vector__XXX
 SG_ Trunk_TrnkInReleaseSwSta : 141|2@1+ (1,0) [0|0] "" Vector__XXX
 SG_ Trunk_GlvBxTrnkLkSwSta : 143|2@1+ (1,0) [0|0] "" Vector__XXX
 SG_ Trunk_TrnkTlgtSwSta : 145|2@1+ (1,0) [0|0] ""  BLTN_CAM_FD,GW_PSU_3RD_FD,GW_PSU_AST_FD,GW_PSU_RL_FD,GW_PSU_RR_FD,SHVU_RL_FD,SHVU_RR_FD
 SG_ Trunk_TlgtFullOpnSwSta : 147|2@1+ (1,0) [0|0] "" Vector__XXX
 SG_ Trunk_TrnkTlgtReleaseRlySta : 149|2@1+ (1,0) [0|0] "" Vector__XXX
 SG_ FrtWiper_ParkingSwState : 151|2@1+ (1,0) [0|0] "" Vector__XXX
 SG_ PDC_TlgtUnLkSta : 153|2@1+ (1,0) [0|0] "" Vector__XXX
 SG_ PDC_PSDPwrModeOffSwSta : 155|2@1+ (1,0) [0|0] "" Vector__XXX
 SG_ PDC_FD_AlvCnt1Val : 16|8@1+ (1,0) [0|0] "" Vector__XXX
 SG_ OBCWakeupDrLock : 161|2@1+ (1,0) [0|0] "" Vector__XXX
 SG_ OBCWakeupDrUnlock : 163|2@1+ (1,0) [0|0] "%" Vector__XXX
 SG_ Trunk_BgtOpnHzrdReq : 165|2@1+ (1,0) [0|0] "" Vector__XXX
 SG_ Trunk_BgtOpnBzrReq : 167|2@1+ (1,0) [0|0] "" Vector__XXX
 SG_ IGN3State : 169|2@1+ (1,0) [0|0] ""  GW_PSU_3RD_FD,GW_PSU_AST_FD,GW_PSU_DRV_FD,GW_PSU_RL_FD,GW_PSU_RR_FD,SHVU_3RD_FD,SHVU_FRNT_FD,SHVU_REAR_FD,SHVU_RL_FD,SHVU_RR_FD
 SG_ IGN3State_By_BMS : 171|2@1+ (1,0) [0|0] "" Vector__XXX
 SG_ IGN3State_By_VCMS_HMU : 173|2@1+ (1,0) [0|0] "" Vector__XXX
 SG_ IGN3State_By_AfterBlow : 175|2@1+ (1,0) [0|0] "" Vector__XXX
 SG_ IGN3State_By_Bat : 177|2@1+ (1,0) [0|0] "" Vector__XXX
 SG_ IGN3State_By_VCU_HCU_FCU : 179|2@1+ (1,0) [0|0] "" Vector__XXX
 SG_ IGN3State_By_HU : 181|2@1+ (1,0) [0|0] "" Vector__XXX
 SG_ SeatBeltSwSta_Drv : 24|2@1+ (1,0) [0|0] "" Vector__XXX
 SG_ SeatBeltSwSta_1stCtr : 26|2@1+ (1,0) [0|0] "" Vector__XXX
 SG_ SeatBeltSwSta_Asst : 28|2@1+ (1,0) [0|0] ""  GW_SAU_DRV_FD
 SG_ SeatBeltSwSta_2ndLft : 30|2@1+ (1,0) [0|0] "" Vector__XXX
 SG_ SeatBeltSwSta_2ndCtr : 32|2@1+ (1,0) [0|0] "" Vector__XXX
 SG_ SeatBeltSwSta_2ndRt : 34|2@1+ (1,0) [0|0] "" Vector__XXX
 SG_ SeatBeltSwSta_3rdLft : 36|2@1+ (1,0) [0|0] "" Vector__XXX
 SG_ SeatBeltSwSta_3rdCtr : 38|2@1+ (1,0) [0|0] "" Vector__XXX
 SG_ SeatBeltSwSta_3rdRt : 40|2@1+ (1,0) [0|0] "" Vector__XXX
 SG_ SeatBelt4th_InstallInfo : 42|3@1+ (1,0) [0|0] "" Vector__XXX
 SG_ PDCex_CurtainOpt : 45|2@1+ (1,0) [0|0] ""  ATS_FD
 SG_ DriveTypeOption : 64|2@1+ (1,0) [0|0] ""  ATS_FD,BLTN_CAM_FD,GW_PSU_AST_FD,GW_PSU_DRV_FD,GW_PSU_RL_FD,GW_PSU_RR_FD,GW_SAU_DRV_FD,SHVU_3RD_FD,SHVU_FRNT_FD,SHVU_REAR_FD
 SG_ AutoLtOpt : 66|2@1+ (1,0) [0|0] "" Vector__XXX
 SG_ HLmpLoHiOptLtSrcTyp : 68|3@1+ (1,0) [0|0] "" Vector__XXX
 SG_ C_StrgWhlHeatingOpt : 71|2@1+ (1,0) [0|0] "" Vector__XXX
 SG_ C_StrgWhlHeatingSWInf : 73|2@1+ (1,0) [0|0] "" Vector__XXX
 SG_ ICU_MtGearPosRSta : 75|2@1+ (1,0) [0|0] ""  BLTN_CAM_FD
 SG_ C_AutoLeverManualSW : 77|2@1+ (1,0) [0|0] "" Vector__XXX
 SG_ Warn_HoodSwMemorySta : 79|2@1+ (1,0) [0|0] "" Vector__XXX
 SG_ Warn_PrkngBrkSwSta : 81|2@1+ (1,0) [0|0] ""  GW_PSU_3RD_FD,GW_PSU_AST_FD,GW_PSU_RL_FD,GW_PSU_RR_FD,SHVU_RL_FD,SHVU_RR_FD
 SG_ PrkngBrkNotchSwState : 83|2@1+ (1,0) [0|0] "" Vector__XXX
 SG_ Warn_BrkFldSwSta : 85|2@1+ (1,0) [0|0] "" Vector__XXX
 SG_ Warn_WshrFldSwSta : 87|2@1+ (1,0) [0|0] "" Vector__XXX
 SG_ Warn_DrvStBltSwSta : 89|2@1+ (1,0) [0|0] ""  ATS_FD,GW_PSU_DRV_FD,GW_SAU_DRV_FD,PSB_FD
 SG_ Warn_AsstStBltSwSta : 91|2@1+ (1,0) [0|0] ""  GW_PSU_AST_FD,GW_PSU_RL_FD,GW_SAU_DRV_FD,PSB_FD
 SG_ Warn_RrLftStBltSwSta : 93|2@1+ (1,0) [0|0] ""  GW_PSU_AST_FD,GW_PSU_DRV_FD,PSB_FD
 SG_ Warn_RrCtrStBltSwSta : 95|2@1+ (1,0) [0|0] ""  PSB_FD
 SG_ Warn_RrRtStBltSwSta : 97|2@1+ (1,0) [0|0] ""  GW_PSU_AST_FD,GW_PSU_DRV_FD,PSB_FD
 SG_ C_3rdRLSeatBeltSW : 99|1@1+ (1,0) [0|0] ""  ARS_FD,GW_PSU_RL_FD,WPC2_FD

BO_ 995 PDC_FD_04_200ms: 16 CGW_CCU
 SG_ PDC_FD_Crc4Val : 0|16@1+ (1,0) [0|0] "" Vector__XXX
 SG_ PDC_FD_AlvCnt4Val : 16|8@1+ (1,0) [0|0] "" Vector__XXX
 SG_ ICU_Haptic_OPT : 64|2@1+ (1,0) [0|0] "" Vector__XXX
 SG_ HSWS_SysWrngSta_ICU : 66|2@1+ (1,0) [0|0] "" Vector__XXX
 SG_ ICU_PwrWdwMvInhbtSta : 68|1@1+ (1,0) [0|0] "" Vector__XXX
 SG_ Warn_OSMirrFoldSwState : 69|2@1+ (1,0) [0|0] "" Vector__XXX
 SG_ USM_OneTouchTrnSigFuncSta : 71|3@1+ (1,0) [0|0] "" Vector__XXX
 SG_ ExtLamp_TrnSigLmpLftSwSta : 74|2@1+ (1,0) [0|0] "" Vector__XXX
 SG_ ExtLamp_TrnSigLmpRtSwSta : 76|2@1+ (1,0) [0|0] "" Vector__XXX
 SG_ Lamp_LaneChgTrnSigLftSwSta_ICU : 78|2@1+ (1,0) [0|0] "" Vector__XXX
 SG_ Lamp_LaneChgTrnSigRtSwSta_ICU : 80|2@1+ (1,0) [0|0] "" Vector__XXX
 SG_ ICU_HDPSpprtRdy : 82|2@1+ (1,0) [0|0] "" Vector__XXX
 SG_ HzrdLmp_HDPSpprtSWVer : 84|5@1+ (1,0) [0|0] "" Vector__XXX
 SG_ Lamp_TrnSigLmpLftOnReq : 89|2@1+ (1,0) [0|0] ""  BLTN_CAM_FD
 SG_ Lamp_TrnSigLmpRtOnReq : 91|2@1+ (1,0) [0|0] ""  BLTN_CAM_FD
 SG_ Lamp_TrnSigLmpLftActiveSt : 93|2@1+ (1,0) [0|0] "" Vector__XXX
 SG_ Lamp_TrnSigLmpRtActiveSt : 95|2@1+ (1,0) [0|0] "" Vector__XXX
 SG_ TrnLmpSeqEnblCmd : 97|2@1+ (1,0) [0|0] "" Vector__XXX

BO_ 994 PDC_FD_03_200ms: 16 CGW_CCU
 SG_ PDC_FD_Crc3Val : 0|16@1+ (1,0) [0|0] "" Vector__XXX
 SG_ PDC_FD_AlvCnt3Val : 16|8@1+ (1,0) [0|0] "" Vector__XXX
 SG_ Warn_DrvDrSwSta : 64|2@1+ (1,0) [0|0] ""  BLTN_CAM_FD,GW_PSU_DRV_FD,PSB_FD,RWPC_FD,WPC2_FD,WPC_FD
 SG_ Warn_AsstDrSwSta : 66|2@1+ (1,0) [0|0] ""  BLTN_CAM_FD,GW_PSU_AST_FD,GW_PSU_RL_FD,GW_SAU_DRV_FD,PSB_FD,RWPC_FD,WPC2_FD,WPC_FD
 SG_ Warn_RrLftDrSwSta : 68|2@1+ (1,0) [0|0] ""  BLTN_CAM_FD,GW_PSU_AST_FD,GW_PSU_RL_FD,GW_PSU_RR_FD,RWPC_FD,SHVU_RL_FD,WPC2_FD,WPC_FD
 SG_ Warn_RrRtDrSwSta : 70|2@1+ (1,0) [0|0] ""  BLTN_CAM_FD,GW_PSU_AST_FD,GW_PSU_RL_FD,GW_PSU_RR_FD,RWPC_FD,SHVU_RR_FD,WPC2_FD,WPC_FD
 SG_ Warn_HoodSwSta : 72|2@1+ (1,0) [0|0] ""  BLTN_CAM_FD
 SG_ DoorLock_DrvDrUnLkSta : 74|2@1+ (1,0) [0|0] ""  GW_PSU_DRV_FD
 SG_ DoorLock_AsstDrUnLkSta : 76|2@1+ (1,0) [0|0] "" Vector__XXX
 SG_ DoorLock_RrLftDrUnLkSta : 78|2@1+ (1,0) [0|0] "" Vector__XXX
 SG_ DoorLock_RrRtDrUnLkSta : 80|2@1+ (1,0) [0|0] "" Vector__XXX
 SG_ DoorLock_DrvKeyLkSwSta : 82|2@1+ (1,0) [0|0] "" Vector__XXX
 SG_ DoorLock_DrvKeyUnLkSwSta : 84|2@1+ (1,0) [0|0] "" Vector__XXX
 SG_ DoorLock_CtrlDrLkSwSta_ICU : 86|2@1+ (1,0) [0|0] "" Vector__XXX
 SG_ DoorLock_CtrlDrUnLkSwSta_ICU : 88|2@1+ (1,0) [0|0] "" Vector__XXX
 SG_ DoorLock_CtrlDrLkUnLkSwSta_ICU : 90|2@1+ (1,0) [0|0] "" Vector__XXX
 SG_ C_CrashUnlockState : 92|2@1+ (1,0) [0|0] ""  BLTN_CAM_FD
 SG_ Lamp_LedHdLmpSta : 94|2@1+ (1,0) [0|0] "" Vector__XXX
 SG_ Warn_ChaDrSwFrtSta : 96|2@1+ (1,0) [0|0] "" Vector__XXX
 SG_ Warn_ChaDrSwRrSta : 98|2@1+ (1,0) [0|0] "" Vector__XXX

BO_ 997 PDC_FD_11_200ms: 24 CGW_CCU
 SG_ PDC_FD_Crc11Val : 0|16@1+ (1,0) [0|0] "" Vector__XXX
 SG_ ICU_BS1ValFlagSta : 105|2@1+ (1,0) [0|0] "" Vector__XXX
 SG_ ICU_BS1ErrRes : 107|2@1+ (1,0) [0|0] "" Vector__XXX
 SG_ ICU_BS2SoC : 109|8@1+ (1,0) [0|0] ""  BLTN_CAM_FD
 SG_ ICU_BS2NCap : 117|8@1+ (1,0) [0|0] "" Vector__XXX
 SG_ ICU_BS2OpnCirVol : 125|12@1+ (0.001,10) [0|0] "" Vector__XXX
 SG_ ICU_BS2_FSOC : 137|1@1+ (1,0) [0|0] "" Vector__XXX
 SG_ ICU_BS2_FSOH : 138|1@1+ (1,0) [0|0] "" Vector__XXX
 SG_ ICU_BS2_FSOF : 139|1@1+ (1,0) [0|0] "" Vector__XXX
 SG_ ICU_BS2_FQSTAT : 140|1@1+ (1,0) [0|0] "" Vector__XXX
 SG_ ICU_BS2SoH : 141|8@1+ (1,0) [0|0] "" Vector__XXX
 SG_ ICU_BS2SoF : 149|8@1+ (0.05,0) [0|0] "" Vector__XXX
 SG_ PDC_FD_AlvCnt11Val : 16|8@1+ (1,0) [0|0] "" Vector__XXX
 SG_ ICU_BS1IBAT_Conversion : 64|18@1+ (10,-1200000) [-1200000|1200000] "mA" Vector__XXX
 SG_ ICU_BS1BatVol : 82|14@1+ (0.001,6) [0|0] "" Vector__XXX
 SG_ ICU_BS1BatTemp : 96|9@1+ (0.5,-40) [0|0] "" Vector__XXX

CM_ BO_ 870 "[PE] Periodic and On Event";
CM_ SG_ 870 HU_GW_Crc3Val "HU_GW_CyclicRedundancyCheck3Value";
CM_ SG_ 870 AVN_RSPA_Disp_Rdy "Signal to inform RSPA of AVN's display ready status
(RSPA 화면 표시 가능/불가능 상태를 알리기 위한 신호)";
CM_ SG_ 870 CF_AVN_ProfileIDRValue "This signal is User ID value in H/Unit.";
CM_ SG_ 870 HazardFromHUSVM "This signal is for Hazard control";
CM_ SG_ 870 OMUOSMirCtrl "This signal is for the OutSide Mirror Control (Fold or Unfold)";
CM_ SG_ 870 OTAUIStatus "Information of the status of Head Unit";
CM_ SG_ 870 C_TeleActiveStatus "This signal is for check TMS active status";
CM_ SG_ 870 HU_RTCCheck "Checking whether RTC of AVN and HCU is operationg normally.";
CM_ SG_ 870 HU_GW_AlvCnt3Val "HU_GW_AliveCounter3Value";
CM_ SG_ 870 HU_SWRCWarmerSet "HU SW button touch command for SWRC Warmer";
CM_ SG_ 870 HU_DistanceUnit "Request to set CLU Distance Unit";
CM_ SG_ 870 HU_AliveStatus "Information of the status of Head Unit
0x00 : Headunit is booting so, Headunit cant display any state
0x01 : Headunit is normal state, Headunit could display according to MM CAN  command.
0x02 : Headunit is doing their internal process, so Headunit cant communicate with other node.
For CLU/SCC/eCall
-AVN System transmission signal";
CM_ SG_ 870 HU_MicActivity "HU send this signal to eCall for MIC using status.
eCall unit stop the diagonosis when received 0x1:Activated from HU
Otherwise, eCall unit keep diagnosis every 1 sec. and HU can not use MIC";
CM_ SG_ 870 CF_HU_GPSFlt "Information of GPS Fault 

0x0: Normal
0x1 : Fault operation
0x2 : RESERVED
0x3:Invalid";
CM_ SG_ 870 AVN_RSPA_CancelInput "Request Signal to cancel RSPA function";
CM_ BO_ 261 "[P] Periodic";
CM_ SG_ 261 EMS_Crc7Val "EMS_CyclicRedundancyCheck7Value";
CM_ SG_ 261 HEV_AccelPdlVal "HEV_AcceleratorPedalValue";
CM_ SG_ 261 HEV_IndTqTar "HEV_IndicatedTorqueTarget";
CM_ SG_ 261 HEV_IndTqVal_Extd "HEV_IndicatedTorqueValue_Extended";
CM_ SG_ 261 EMS_AlvCnt7Val "EMS_AliveCounter7Value";
CM_ SG_ 261 HEV_IndTqVal "HEV_IndicatedTorqueValue";
CM_ SG_ 261 HEV_DrvTqVal "HEV_DriverTorqueValue";
CM_ SG_ 261 HEV_TqStndVal "HEV_TorqueStandardValue";
CM_ SG_ 261 HEV_OilDilution_IncICELoad "HEV Oil Dilution Increase ICE Load";
CM_ SG_ 261 HEV_OilDilution_ServMode "HEV Oil Dilution Service Mode";
CM_ SG_ 261 EMS_TqLmtSta "Status of Torque Limit. Reference for TMS Cooperative control and Cluster notification";
CM_ SG_ 261 EMS_EU7 "Whether the vehicle is EU7 or not";
CM_ SG_ 261 HEV_FrctTqVal "HEV_FrictionTorqueValue";
CM_ SG_ 261 HEV_EngSpdVal "HEV_EngineSpeedValue";
CM_ SG_ 261 HEV_EngOpSta "HEV_EngineOperatingStatus";
CM_ SG_ 261 HEV_IntakeAirTempVal "HEV_IntakeAirTemperatureValue";
CM_ BO_ 993 "[PE] Periodic and On Event";
CM_ SG_ 993 PDC_FD_Crc2Val "PDC_FD_CyclicRedundancyCheck2Value";
CM_ SG_ 993 Lamp_StpLmpLftOpnSta "Lamp_StopLampLeftOpenStatus ##2G## -  - C_StopLampLhOpenSts";
CM_ SG_ 993 Lamp_StpLmpRtOpnSta "Lamp_StopLampRightOpenStatus ##2G## -  - C_StopLampRhOpenSts";
CM_ SG_ 993 Lamp_HmslLmpOpnSta "HMSL_OpenStatus ##2G## -  - C_HMSLOpenSts";
CM_ SG_ 993 Lamp_DrlLmpLftOpnSta "Lamp_DrlLampLeftOpenStatus ##2G## -  - C_DRLLampLhOpenSts";
CM_ SG_ 993 Lamp_DrlLmpRtOpnSta "Lamp_DrlLampRightOpenStatus ##2G## -  - C_DRLLampRhOpenSts";
CM_ SG_ 993 Lamp_FrFgLmpLftOpnSta "Lamp_FrontFogLampLeftOpenStatus ##2G## -  - C_FrontFOGLhOpenSts";
CM_ SG_ 993 Lamp_FrFgLmpRtOpnSta "Lamp_FrontFogLampRightOpenStatus ##2G## -  - C_FrontFOGRhOpenSts";
CM_ SG_ 993 Lamp_CorneringLmpLftOpnSta "ExtLamp_CorneringLampLeftOpenStatus ##2G## -  - C_CorneringLpLhOpenState";
CM_ SG_ 993 Lamp_CorneringLmpRtOpnSta "ExtLamp_CorneringLampRightOpenStatus ##2G## -  - C_CorneringLpRhOpenState";
CM_ SG_ 993 Lamp_StcBendingLmpLftOpnSta "Lamp_StaticBendingLampLeftOpenStatus ##2G## -  - C_SBendingLhOpenSts";
CM_ SG_ 993 Lamp_StcBendingLmpRtOpnSta "Lamp_StaticBendingLampRightOpenStatus ##2G## -  - C_SBendingRhOpenSts";
CM_ SG_ 993 Lamp_FrTurnSigLmpLftPCLSta "T/SIG Lamp Front Left PCL Status";
CM_ SG_ 993 Lamp_FrTurnSigLmpRtPCLSta "T/SIG Lamp Front Right PCL Status";
CM_ SG_ 993 Lamp_RrTurnSigLmpLftPCLSta "T/SIG Lamp Rear Left PCL Status";
CM_ SG_ 993 Lamp_RrTurnSigLmpRtPCLSta "T/SIG Lamp Rear Right PCL Status";
CM_ SG_ 993 HzrdSwPushSta "Hazard Switch(self return type) Push State";
CM_ SG_ 993 Lamp_LftTrnFaultSta "Left Turn Lamp Fault Status";
CM_ SG_ 993 Lamp_RtTrnFaultSta "Right Turn Lamp Fault Status";
CM_ SG_ 993 FrtTurnLampOptSta "Front Turn Signal Lamp EOL Option State";
CM_ SG_ 993 RrTurnLampOptSta "Rear Turn Signal Lamp EOL Option State";
CM_ SG_ 993 PDC_FD_AlvCnt2Val "PDC_FD_AliveCounter2Value";
CM_ SG_ 993 IntLamp_InlTailLmpSta "IntLamp_InternalTailLampStatus ##2G## -  - C_IntTailAct,CF_Gway_IntTailAct";
CM_ SG_ 993 Lamp_FootLampOnReq "##2G## -  - C_FootLpOn";
CM_ SG_ 993 Lamp_MoodLampOnReq "##2G## -  - C_MoodLpOn";
CM_ SG_ 993 USM_FuncForMdLmpBrgtSta "USM_FunctionForMoodLampBrightStatus ##2G## -  - CF_Gway_MoodLpBrightRValue";
CM_ SG_ 993 Lamp_HdLmpLoLftOpnSta "Lamp_HeadLampLowLeftOpenStatus ##2G## -  - C_HLampLowLhOpenSts";
CM_ SG_ 993 Lamp_HdLmpLoRtOpnSta "Lamp_HeadLampLowRightOpenStatus ##2G## -  - C_HLampLowRhOpenSts";
CM_ SG_ 993 Lamp_HdLmpBiFuncLftOpnSta "Lamp_HeadLampBiFunctionLeftOpenStatus ##2G## -  - C_HLampBifuncLhOpenSts";
CM_ SG_ 993 Lamp_HdLmpBiFuncRtOpnSta "Lamp_HeadLampBiFunctionRightOpenStatus ##2G## -  - C_HLampBifuncRhOpenSts";
CM_ SG_ 993 Lamp_HdLmpHiLftOpnSta "Lamp_HeadLampHighLeftOpenStatus ##2G## -  - C_HLampHighLhOpenSts";
CM_ SG_ 993 Lamp_HdLmpHiRtOpnSta "Lamp_HeadLampHighRightOpenStatus ##2G## -  - C_HLampHighRhOpenSts";
CM_ SG_ 993 ExtLamp_HzrdSwSta "ExtLamp_HazardSwitchStatus ##2G## -  - C_HazardSw,CF_Gway_HazardSw";
CM_ SG_ 993 Lamp_FrTrnSigLmpLftOpnSta "Lamp_FrontTurnSignalLampLeftOpenStatus ##2G## -  - C_FrontTSIGLhOpenSts";
CM_ SG_ 993 Lamp_FrTrnSigLmpRtOpnSta "Lamp_FrontTurnSignalLampRightOpenStatus ##2G## -  - C_FrontTSIGRhOpenSts";
CM_ SG_ 993 Lamp_RrTrnSigLmpLftOpnSta "Lamp_RearTurnSignalLampLeftOpenStatus ##2G## -  - C_RearTSIGLhOpenSts";
CM_ SG_ 993 Lamp_RrTrnSigLmpRtOpnSta "Lamp_RearTurnSignalLampRightOpenStatus ##2G## -  - C_RearTSIGRhOpenSts";
CM_ SG_ 993 Brake_SwSta_ICU "Brake Switch Status ##2G## -  - C_BrakeSw";
CM_ BO_ 813 "[PE] Periodic and On Event";
CM_ SG_ 813 SBCM_DRV_FD_Crc1Val "SBCM_DRV_FD_CyclicRedundancyCheck1Value";
CM_ SG_ 813 C_DrvDoorApproachOpen "Approach open";
CM_ SG_ 813 DoorLock_CtrlDrLkUnLkSwSta_SBCM "Central Door Lock/Unlock Switch State";
CM_ SG_ 813 CDMAutoWashModeSet_SBCM "Auto wash mode set signal for CDM from SBCM_DRV";
CM_ SG_ 813 SBCM_DRV_FD_AlvCnt1Val "SBCM_DRV_FD_AliveCounter1Value";
CM_ SG_ 813 ECMMRR_PLUS "ECM Voltage value";
CM_ SG_ 813 EHL_TxInfo_SBCM_DRV "Electronic hood latch status signal transfer for dual hood latch type (Copy to CANFD)";
CM_ SG_ 813 CDM_TypeOption "CDM_HS_OptionType";
CM_ SG_ 813 CDM_ImmeChgSw_SBCM "State of Immediate Charging Switch";
CM_ SG_ 813 CDM_OpnClsState_SBCM "CDM_HS_ OpenCloseState";
CM_ SG_ 813 CDM_WarnMsg_SBCM "CDM_HS_WarningMessage";
CM_ SG_ 813 CDM_CmdStatus_SBCM "CDM_HS_CommandStatus";
CM_ SG_ 813 Hood_TypeOption "E-Hood_Option Type";
CM_ SG_ 813 FrunkReleaseSwSta_SBCM "FrunkReleaseState";
CM_ SG_ 813 CDM_GbtImmeChgSw_SBCM "State of Immediate Charging Switch";
CM_ SG_ 813 CDM_GbtOpnClsState_SBCM "CDM_HS_ OpenCloseState";
CM_ SG_ 813 CDM_GbtWarnMsg_SBCM "CDM_HS_WarningMessage";
CM_ SG_ 813 FrunkEmergencySwSta_SBCM "FrunkEmergencySwState";
CM_ SG_ 813 C_ApprOpenStatus "Stop fob searching signal";
CM_ SG_ 813 DoorLock_DrvKeyLkSwSta_SBCM "DoorLock_DriverKeyLockSwitchStatus ##2G## -  - C_DrvKeyLockSw";
CM_ SG_ 813 DoorLock_DrvKeyUnLkSwSta_SBCM "DoorLock_DriverKeyUnLockSwitchStatus ##2G## -  - C_DrvKeyUnlockSw";
CM_ SG_ 813 Warn_DrvDrSwSta_SBCM "DoorLock_DriverDoorSwitchStatus ##2G## -  - C_DrvDrSw,CF_Gway_DrvDrSw,Warn_DrvDrSwSta";
CM_ SG_ 813 DoorLock_DrvDrUnLkSta_SBCM "DoorLock_DriverDoorUnLockStatus ##2G## -  - C_DrvUnlockState,CF_Gway_DrvUnlockState";
CM_ BO_ 992 "[PE] Periodic and On Event";
CM_ SG_ 992 PDC_FD_Crc1Val "PDC_FD_CyclicRedundancyCheck1Value";
CM_ SG_ 992 C_3rdRRSeatBeltSW "3rd Rear Right Seat Belt Switch Status";
CM_ SG_ 992 DPDMat_HDPSpprtSWVer "HDP-DPD Mat signal processing Requirement Spec Version";
CM_ SG_ 992 Warn_PassStOccSta "Warn_PassengerSeatOccupyStatus ##2G## -  - C_SBRMatSw";
CM_ SG_ 992 Warn_RrLftSBRMATSwSta "##2G## -  - C_RLSBRMatSw";
CM_ SG_ 992 Warn_RrRhtSBRMATSwSta "##2G## -  - C_RRSBRMatSw";
CM_ SG_ 992 ChildLock_ActnFlSta "ChildLock_ActuationFailedStatus ##2G## -  - C_ChildLockFail";
CM_ SG_ 992 DoorLock_LkOutSta "DoorLock_LockOutputStatus ##2G## -  - C_LockUnlockOutState";
CM_ SG_ 992 VSAutoDrLkRetryFailSta "Door lock fail status after vehicle speed auto door lock retry 3 times";
CM_ SG_ 992 Trunk_TrnkTlgtOutReleaseSwSta "Trunk_TrunkTailgateOutReleaseSwitchStatus ##2G## -  - C_TrunkTgOtrReleaseSW";
CM_ SG_ 992 Trunk_TrnkInReleaseSwSta "Trunk_TrunkInnerReleaseSwitchStatus ##2G## -  - C_TrunkInnerReleaseSw";
CM_ SG_ 992 Trunk_GlvBxTrnkLkSwSta "Trunk_GloveBoxTrunkLockSwitchStatus ##2G## -  - C_GloveBoxTrunkLockSw";
CM_ SG_ 992 Trunk_TrnkTlgtSwSta "Trunk_TrunkTailgateSwitchStatus ##2G## -  - C_TrunkTgSw,CF_Gway_TrunkTgSw,Trunk_TrnkTlgtSwSta";
CM_ SG_ 992 Trunk_TlgtFullOpnSwSta "Trunk_TailGateFullOpenSwitchStatus ##2G## -  - C_TgFullOpenSW";
CM_ SG_ 992 Trunk_TrnkTlgtReleaseRlySta "Trunk_TrunkTailgateReleaseRelayStatus ##2G## -  - C_TrunkTgReleaseRlyAct";
CM_ SG_ 992 FrtWiper_ParkingSwState "Front wiper parking switch state";
CM_ SG_ 992 PDC_FD_AlvCnt1Val "PDC_FD_AliveCounter1Value";
CM_ SG_ 992 OBCWakeupDrLock "This signal is for OBC wake-up";
CM_ SG_ 992 OBCWakeupDrUnlock "This signal is for OBC wake-up";
CM_ SG_ 992 Trunk_BgtOpnHzrdReq "Hazzard Request by Bedgate Open";
CM_ SG_ 992 Trunk_BgtOpnBzrReq "Buzzer Request by Bedgate Open";
CM_ SG_ 992 IGN3State "Output status of ignition 3";
CM_ SG_ 992 IGN3State_By_BMS "Output status of ignition 3 by BMS request";
CM_ SG_ 992 IGN3State_By_VCMS_HMU "Output status of ignition 3 by VCMS(PHEV/EV) or HMU(FCEV) request";
CM_ SG_ 992 IGN3State_By_AfterBlow "Output status of ignition 3 by DATC(FATC/MTC) request for after blow";
CM_ SG_ 992 IGN3State_By_Bat "Output status of ignition 3 by IBS or BMS request for HEV 12V auxiliary battery charging";
CM_ SG_ 992 IGN3State_By_VCU_HCU_FCU "Output status of ignition 3 by VCU(EV) or HCU(HEV/PHEV) or FCU(FCEV) request";
CM_ SG_ 992 IGN3State_By_HU "Output status of ignition 3 by HU(AVNT) or CCU request for CCS";
CM_ SG_ 992 DriveTypeOption "##2G## -  - C_DriveTypeOption,CF_Gway_DriveTypeOption";
CM_ SG_ 992 AutoLtOpt "Auto Light 사양 적용 여부 및 적용 옵션 정보 출력 (미적용/적용)";
CM_ SG_ 992 HLmpLoHiOptLtSrcTyp "Head Low&High Lamp 사양 적용 여부 및 Light Source Type, 옵션 정보 출력";
CM_ SG_ 992 ICU_MtGearPosRSta "##2G## -  - C_InhibitRMT,CF_Gway_InhibitRMT";
CM_ SG_ 992 C_AutoLeverManualSW "Auto Lever Manual Switch Status Information";
CM_ SG_ 992 Warn_HoodSwMemorySta "Warn_HoodSwitchMemoryStatus ##2G## -  - CF_Hoodsw_memory,C_HoodSwMemory";
CM_ SG_ 992 Warn_PrkngBrkSwSta "Warn_ParkingBrakeSwitchStatus ##2G## -  - C_ParkBrakeSw";
CM_ SG_ 992 Warn_BrkFldSwSta "Warn_BrakeFluidSwitchStatus ##2G## -  - C_BrakeFluidSw,CF_Gway_BrakeFluidSw";
CM_ SG_ 992 Warn_WshrFldSwSta "Washer Fluid Switch Signal ##2G## -  - CF_Gway_WasherFluidSw";
CM_ SG_ 992 Warn_DrvStBltSwSta "Warn_DriverSeatbeltSwitchStatus ##2G## -  - C_DrvSeatBeltSw,CF_Gway_DrvSeatBeltSw";
CM_ SG_ 992 Warn_AsstStBltSwSta "Warn_AssistSeatBeltSwitchStatus ##2G## -  - C_AstSeatBeltSw,CF_Gway_AstSeatBeltSw";
CM_ SG_ 992 Warn_RrLftStBltSwSta "Warn_RearLeftSeatBeltSwitchStatus ##2G## -  - C_RLSeatBeltSw";
CM_ SG_ 992 Warn_RrCtrStBltSwSta "Warn_RearCenterSeatBeltSwitchStatus ##2G## -  - C_RCSeatBeltSw";
CM_ SG_ 992 Warn_RrRtStBltSwSta "Warn_RearRightSeatBeltSwitchStatus ##2G## -  - C_RRSeatBeltSw";
CM_ SG_ 992 C_3rdRLSeatBeltSW "3rd Rear Left Seat Belt Switch Status";
CM_ BO_ 995 "[PE] Periodic and On Event";
CM_ SG_ 995 PDC_FD_Crc4Val "PDC_FD_CyclicRedundancyCheck4Value";
CM_ SG_ 995 PDC_FD_AlvCnt4Val "PDC_FD_AliveCounter4Value";
CM_ SG_ 995 ICU_Haptic_OPT "Steering Wheel Haptic Warning Option Infomation ##2G## -  - C_ICU_Haptic_OPT";
CM_ SG_ 995 HSWS_SysWrngSta_ICU "HSWS Status ##2G## -  - C_HSWSSysStat";
CM_ SG_ 995 ICU_PwrWdwMvInhbtSta "ICU_PowerWindowMoveInhibitStatus ##2G##DDM -  - C_PwdwInhibit";
CM_ SG_ 995 Warn_OSMirrFoldSwState "Outside Mirror Folding Swtich Status";
CM_ SG_ 995 USM_OneTouchTrnSigFuncSta "USM_OneTouchTurnSignalFunctionStatus ##2G## -  - CF_Gway_OTTurnRValue,C_OTTurnRValue";
CM_ SG_ 995 ExtLamp_TrnSigLmpLftSwSta "ExtLamp_TurnSignalLampLeftSwitchStatus ##2G## -  - C_TsigLhSw";
CM_ SG_ 995 ExtLamp_TrnSigLmpRtSwSta "ExtLamp_TurnSignalLampRightSwitchStatus ##2G## -  - C_TsigRhSw";
CM_ SG_ 995 Lamp_LaneChgTrnSigLftSwSta_ICU "Lamp_LaneChangeTurnSignalLeftSwitchStatus##2G##CGW -CGW8 - 
CF_Gway_HDAIILaneChangeLh";
CM_ SG_ 995 Lamp_LaneChgTrnSigRtSwSta_ICU "Lamp_LaneChangeTurnSignalRightSwitchStatus##2G##CGW -CGW8 - 
CF_Gway_HDAIILaneChangeRh";
CM_ SG_ 995 ICU_HDPSpprtRdy "This signal is the received state information signal of the ADAS message.";
CM_ SG_ 995 HzrdLmp_HDPSpprtSWVer "HDP-HAZARD Lamp control Requirement Spec Version";
CM_ SG_ 995 Lamp_TrnSigLmpLftOnReq "Lamp_TurnSignalLampLeftOnRequest ##2G## -  - Lamp_TsigLmpFrtLftOnReq";
CM_ SG_ 995 Lamp_TrnSigLmpRtOnReq "Lamp_TurnSignalLampRightOnRequest ##2G## -  - Lamp_TSigLmpRtLftOnReq";
CM_ SG_ 995 Lamp_TrnSigLmpLftActiveSt "Lamp_TurnSignalLampLeftActiveState";
CM_ SG_ 995 Lamp_TrnSigLmpRtActiveSt "Lamp_TurnSignalLampRightActiveState";
CM_ BO_ 994 "[PE] Periodic and On Event";
CM_ SG_ 994 PDC_FD_Crc3Val "PDC_FD_CyclicRedundancyCheck3Value";
CM_ SG_ 994 PDC_FD_AlvCnt3Val "PDC_FD_AliveCounter3Value";
CM_ SG_ 994 Warn_DrvDrSwSta "DoorLock_DriverDoorSwitchStatus ##2G## -  - C_DrvDrSw,CF_Gway_DrvDrSw,Warn_DrvDrSwSta";
CM_ SG_ 994 Warn_AsstDrSwSta "Warn_AssistDoorSwitchStatus ##2G## -  - C_AstDrSw,CF_Gway_AstDrSw,Warn_AsstDrSwSta";
CM_ SG_ 994 Warn_RrLftDrSwSta "Warn_RearLeftDoorSwitchStatus ##2G## -  - C_RLDrSw,CF_Gway_RLDrSw,Warn_RrLftDrSwSta";
CM_ SG_ 994 Warn_RrRtDrSwSta "Warn_RearRightDoorSwitchStatus ##2G## -  - C_RRDrSw,CF_Gway_RRDrSw,Warn_RrRtDrSwSta";
CM_ SG_ 994 Warn_HoodSwSta "Warn_HoodSwitchStatus ##2G## -  - C_HoodSw,CF_Gway_HoodSw";
CM_ SG_ 994 DoorLock_DrvDrUnLkSta "DoorLock_DriverDoorUnLockStatus ##2G## -  - C_DrvUnlockState,CF_Gway_DrvUnlockState";
CM_ SG_ 994 DoorLock_AsstDrUnLkSta "DoorLock_AssistDoorUnLockStatus ##2G## -  - C_AstUnlockState,DoorLock_AsstDrUnLkSta";
CM_ SG_ 994 DoorLock_RrLftDrUnLkSta "DoorLock_RearLeftDoorUnLockStatus ##2G## -  - C_RLUnlockState,DoorLock_RrLftDrUnLkSta";
CM_ SG_ 994 DoorLock_RrRtDrUnLkSta "DoorLock_RearRightDoorUnLockStatus ##2G## -  - C_RRUnlockState,DoorLock_RrRtDrUnLkSta";
CM_ SG_ 994 DoorLock_DrvKeyLkSwSta "DoorLock_DriverKeyLockSwitchStatus ##2G## -  - C_DrvKeyLockSw";
CM_ SG_ 994 DoorLock_DrvKeyUnLkSwSta "DoorLock_DriverKeyUnLockSwitchStatus ##2G## -  - C_DrvKeyUnlockSw";
CM_ SG_ 994 DoorLock_CtrlDrLkSwSta_ICU "Central Door Lock Switch State(DRV or AST or RL or RR Door trim)";
CM_ SG_ 994 DoorLock_CtrlDrUnLkSwSta_ICU "Central Door Unlock Switch State(DRV or AST or RL or RR Door trim)";
CM_ SG_ 994 DoorLock_CtrlDrLkUnLkSwSta_ICU "Central Door Lock/Unlock Switch State(C/PAD, Integrated & self return type)";
CM_ SG_ 994 C_CrashUnlockState "Crash Unlock Active State";
CM_ SG_ 994 Lamp_LedHdLmpSta "Lamp_LedHeadLampStatus ##2G## -  - CF_Afs_LedHLStat";
CM_ SG_ 994 Warn_ChaDrSwFrtSta "##2G## - -  CF_Gway_ChaDrSwFrt";
CM_ SG_ 994 Warn_ChaDrSwRrSta "##2G## -  - CF_Gway_ChaDrSwRr";
CM_ BO_ 997 "[PE] Periodic and On Event";
CM_ SG_ 997 PDC_FD_Crc11Val "PDC_FD_CyclicRedundancyCheck11Value";
CM_ SG_ 997 ICU_BS1ValFlagSta "setting condition is depending on battery sensor self diagnosis information ##2G## -  - BS1_BSInvalidFlag";
CM_ SG_ 997 ICU_BS1ErrRes "Response_Error shall be set whenever a frame received by the node or a frame transmitted by the node contains an error in the response field. ##2G## -  - BS1_ErrorResp";
CM_ SG_ 997 ICU_BS2SoC "This signal is battery State of Charge as calculated by battery sensor. ##2G## -  - BS2_SOC,Batt_SoC";
CM_ SG_ 997 ICU_BS2NCap "Nominal capacity ##2G## -  - BS2_CNOM";
CM_ SG_ 997 ICU_BS2OpnCirVol "Last open circuit voltage ##2G## -  - BS2_OCV";
CM_ SG_ 997 ICU_BS2_FSOC "Fault State of SOC";
CM_ SG_ 997 ICU_BS2_FSOH "Fault State of SOH";
CM_ SG_ 997 ICU_BS2_FSOF "Fault State of SOF";
CM_ SG_ 997 ICU_BS2_FQSTAT "State of quiescent current";
CM_ SG_ 997 ICU_BS2SoH "This signal is battery State of Health(SOH) as calculated by battery sensor. ##2G## -  - BAT_SOH";
CM_ SG_ 997 ICU_BS2SoF "This signal is battery State of Function(SOF) as calculated by battery sensor. ##2G## -  - BAT_SOF";
CM_ SG_ 997 PDC_FD_AlvCnt11Val "PDC_FD_AliveCounter11Value";
CM_ SG_ 997 ICU_BS1IBAT_Conversion "Actual battery current (resolution: 10mA)";
CM_ SG_ 997 ICU_BS1BatVol "This is the actual battery voltage as measured on the battery pole by battery sensor. ##2G## -  - BS1_VBAT";
CM_ SG_ 997 ICU_BS1BatTemp "This is actual battery electrolyte temperature value by battery sensor. ##2G## -  - BS1_TBAT";
BA_DEF_ BO_  "CANFD_BRS" ENUM  "0","1";
BA_DEF_ BO_  "GenMsgEVName" STRING ;
BA_DEF_ BO_  "NmAsrMessage" ENUM  "No","Yes";
BA_DEF_ BO_  "DiagState" ENUM  "No","Yes";
BA_DEF_ BO_  "DiagResponse" ENUM  "No","Yes";
BA_DEF_ BO_  "DiagRequest" ENUM  "No","Yes";
BA_DEF_ BO_  "TpMessage" ENUM  "No","Yes";
BA_DEF_ BO_  "UsrMsgIDSforwardDeviation" INT 0 100;
BA_DEF_ BO_  "UsrMsgIDSbackwardDeviation" INT 50 1000;
BA_DEF_ BO_  "GenMsgCycleTime" INT 0 2000;
BA_DEF_ BO_  "GenMsgStartDelayTime" INT 0 2000;
BA_DEF_ BO_  "GenMsgSendType" ENUM  "Cyclic","NoMsgSendType";
BA_DEF_ BO_  "GenMsgCycleTimeFast" INT 0 500;
BA_DEF_ BO_  "GenMsgDelayTime" INT 0 20;
BA_DEF_ BO_  "GenMsgILSupport" ENUM  "No","Yes";
BA_DEF_ BO_  "GenMsgNrOfRepetition" INT 0 3;
BA_DEF_ BO_  "VFrameFormat" ENUM  "StandardCAN","ExtendedCAN","reserved","reserved","reserved","reserved","reserved","reserved","reserved","reserved","reserved","reserved","reserved","reserved","StandardCAN_FD","ExtendedCAN_FD";
BA_DEF_ SG_  "UserSigValidity" ENUM  "B+","ACC","IG","IG1","IG2","IG3","IG1 or IG2","IG1 or IG3","Undef";
BA_DEF_ SG_  "TimeoutValue" STRING ;
BA_DEF_ SG_  "UsrSigPurpose" ENUM  "Undef","FN","DIAG","DIAG(Req)","DIAG(Res)","DIAG(Func)","DEV","CCP","NM","TP";
BA_DEF_ SG_  "GenSigStartValue" INT 0 1215752192;
BA_DEF_ SG_  "NetworkRequest" ENUM  "Yes","No";
BA_DEF_ SG_  "NetworkRequestHoldingTime" INT 0 65535;
BA_DEF_ SG_  "Description" STRING ;
BA_DEF_ SG_  "Version" STRING ;
BA_DEF_ SG_  "GenSigEnvVarType" ENUM  "Int","Float","Undef";
BA_DEF_ SG_  "GenSigSendType" ENUM  "Cyclic","OnWrite","OnWriteWithRepetition","OnChange","OnChangeWithRepetition","IfActive","IfActiveWithRepetition","NoSigSendType","OnChangeAndIfActive","OnChangeAndIfActiveWithRepetition";
BA_DEF_ SG_  "GwSigLatencyTime" INT 0 65536;
BA_DEF_ SG_  "GwSigMissingSourceType" ENUM  "Undef","OldValue","DefaultValue","InitialValue";
BA_DEF_ SG_  "NWM-WakeupAllowed" ENUM  "<n.a.>";
BA_DEF_ SG_  "RoutingFactor" INT 1 1215752192;
BA_DEF_ SG_  "SystemSignalLongSymbol" STRING ;
BA_DEF_REL_ BU_SG_REL_  "GenSigTimeoutTime" INT 0 7000;
BA_DEF_DEF_  "CANFD_BRS" "1";
BA_DEF_DEF_  "GenMsgEVName" "@Signame";
BA_DEF_DEF_  "NmAsrMessage" "No";
BA_DEF_DEF_  "DiagState" "No";
BA_DEF_DEF_  "DiagResponse" "No";
BA_DEF_DEF_  "DiagRequest" "No";
BA_DEF_DEF_  "TpMessage" "No";
BA_DEF_DEF_  "UsrMsgIDSforwardDeviation" 10;
BA_DEF_DEF_  "UsrMsgIDSbackwardDeviation" 100;
BA_DEF_DEF_  "GenMsgCycleTime" 200;
BA_DEF_DEF_  "GenMsgStartDelayTime" 0;
BA_DEF_DEF_  "GenMsgSendType" "NoMsgSendType";
BA_DEF_DEF_  "GenMsgCycleTimeFast" 40;
BA_DEF_DEF_  "GenMsgDelayTime" 20;
BA_DEF_DEF_  "GenMsgILSupport" "Yes";
BA_DEF_DEF_  "GenMsgNrOfRepetition" 3;
BA_DEF_DEF_  "VFrameFormat" "StandardCAN";
BA_DEF_DEF_  "UserSigValidity" "IG";
BA_DEF_DEF_  "TimeoutValue" "";
BA_DEF_DEF_  "UsrSigPurpose" "FN";
BA_DEF_DEF_  "GenSigStartValue" 0;
BA_DEF_DEF_  "NetworkRequest" "No";
BA_DEF_DEF_  "NetworkRequestHoldingTime" 0;
BA_DEF_DEF_  "Description" "";
BA_DEF_DEF_  "Version" "";
BA_DEF_DEF_  "GenSigEnvVarType" "Undef";
BA_DEF_DEF_  "GenSigSendType" "NoSigSendType";
BA_DEF_DEF_  "GwSigLatencyTime" 40;
BA_DEF_DEF_  "GwSigMissingSourceType" "Undef";
BA_DEF_DEF_  "NWM-WakeupAllowed" "<n.a.>";
BA_DEF_DEF_  "RoutingFactor" 1;
BA_DEF_DEF_REL_ "GenSigTimeoutTime" 500;
BA_DEF_DEF_  "SystemSignalLongSymbol" "";
BA_ "GenMsgSendType" BO_ 870 0;
BA_ "GenMsgStartDelayTime" BO_ 870 50;
BA_ "VFrameFormat" BO_ 870 14;
BA_ "GenMsgSendType" BO_ 261 0;
BA_ "GenMsgCycleTime" BO_ 261 50;
BA_ "GenMsgCycleTimeFast" BO_ 261 0;
BA_ "GenMsgNrOfRepetition" BO_ 261 0;
BA_ "VFrameFormat" BO_ 261 14;
BA_ "GenMsgSendType" BO_ 993 0;
BA_ "VFrameFormat" BO_ 993 14;
BA_ "GenMsgSendType" BO_ 813 0;
BA_ "VFrameFormat" BO_ 813 14;
BA_ "GenMsgSendType" BO_ 992 0;
BA_ "VFrameFormat" BO_ 992 14;
BA_ "GenMsgSendType" BO_ 995 0;
BA_ "VFrameFormat" BO_ 995 14;
BA_ "GenMsgSendType" BO_ 994 0;
BA_ "VFrameFormat" BO_ 994 14;
BA_ "GenMsgSendType" BO_ 997 0;
BA_ "GenMsgStartDelayTime" BO_ 997 10;
BA_ "VFrameFormat" BO_ 997 14;
BA_ "Description" SG_ 870 HU_GW_Crc3Val "The data area for CRC calculation is based on the data length (DLC) of the message DB.

The CRC shall be calculated over the entire data block (excluding the CRC bytes) including the user data, alive counter and Data ID



- CRC Polynomial (0x1021) , Ini";
BA_ "GenSigSendType" SG_ 870 HU_GW_Crc3Val 4;
BA_ "GenSigStartValue" SG_ 870 HU_GW_Crc3Val 65535;
BA_ "UserSigValidity" SG_ 870 HU_GW_Crc3Val 3;
BA_ "Version" SG_ 870 HU_GW_Crc3Val "22.10.20";
BA_ "GenSigSendType" SG_ 870 AVN_RSPA_Disp_Rdy 4;
BA_ "GenSigStartValue" SG_ 870 AVN_RSPA_Disp_Rdy 3;
BA_ "UserSigValidity" SG_ 870 AVN_RSPA_Disp_Rdy 0;
BA_ "Version" SG_ 870 AVN_RSPA_Disp_Rdy "22.06.01";
BA_ "Description" SG_ 870 CF_AVN_ProfileIDRValue "Profile 3~Profile9 value is only used from Vehicle Architecture 2.0 (STD_DB_CAR_R2, SV 24.6~) vehicle models

Vehicle Architecture 1.0 (STD_DB_CAR) vehicle models can use Guest, Profile1, Profile 2 only.";
BA_ "GenSigSendType" SG_ 870 CF_AVN_ProfileIDRValue 4;
BA_ "GenSigStartValue" SG_ 870 CF_AVN_ProfileIDRValue 15;
BA_ "UserSigValidity" SG_ 870 CF_AVN_ProfileIDRValue 0;
BA_ "Version" SG_ 870 CF_AVN_ProfileIDRValue "22.11.24";
BA_ "GenSigSendType" SG_ 870 HazardFromHUSVM 4;
BA_ "GenSigStartValue" SG_ 870 HazardFromHUSVM 3;
BA_ "UserSigValidity" SG_ 870 HazardFromHUSVM 0;
BA_ "Version" SG_ 870 HazardFromHUSVM "22.06.01";
BA_ "GenSigSendType" SG_ 870 OMUOSMirCtrl 4;
BA_ "GenSigStartValue" SG_ 870 OMUOSMirCtrl 3;
BA_ "UserSigValidity" SG_ 870 OMUOSMirCtrl 0;
BA_ "Version" SG_ 870 OMUOSMirCtrl "22.06.01";
BA_ "Description" SG_ 870 OTAUIStatus "0x00 : Headunit is booting so, Headunit can't display any state

0x01 : Headunit is normal state, Headunit could display according to CCU command.";
BA_ "GenSigSendType" SG_ 870 OTAUIStatus 4;
BA_ "UserSigValidity" SG_ 870 OTAUIStatus 0;
BA_ "Version" SG_ 870 OTAUIStatus "22.06.01";
BA_ "GenSigSendType" SG_ 870 C_TeleActiveStatus 4;
BA_ "GenSigStartValue" SG_ 870 C_TeleActiveStatus 3;
BA_ "UserSigValidity" SG_ 870 C_TeleActiveStatus 0;
BA_ "Version" SG_ 870 C_TeleActiveStatus "22.06.01";
BA_ "GenSigSendType" SG_ 870 HU_RTCCheck 4;
BA_ "GenSigStartValue" SG_ 870 HU_RTCCheck 3;
BA_ "TimeoutValue" SG_ 870 HU_RTCCheck "0x3";
BA_ "UserSigValidity" SG_ 870 HU_RTCCheck 3;
BA_ "Version" SG_ 870 HU_RTCCheck "22.06.01";
BA_ "Description" SG_ 870 AVN_AccelTimerStat "AVNT Timer Status signal";
BA_ "GenSigSendType" SG_ 870 AVN_AccelTimerStat 4;
BA_ "UserSigValidity" SG_ 870 AVN_AccelTimerStat 3;
BA_ "Version" SG_ 870 AVN_AccelTimerStat "23.02.02";
BA_ "Description" SG_ 870 AVN_AccelTimer_MilliSecond "AVNT timer measurement result for millisecond";
BA_ "GenSigSendType" SG_ 870 AVN_AccelTimer_MilliSecond 4;
BA_ "UserSigValidity" SG_ 870 AVN_AccelTimer_MilliSecond 3;
BA_ "Version" SG_ 870 AVN_AccelTimer_MilliSecond "23.02.02";
BA_ "Description" SG_ 870 AVN_AccelTimer_Second "AVNT timer measurement result for second";
BA_ "GenSigSendType" SG_ 870 AVN_AccelTimer_Second 4;
BA_ "UserSigValidity" SG_ 870 AVN_AccelTimer_Second 3;
BA_ "Version" SG_ 870 AVN_AccelTimer_Second "23.02.02";
BA_ "Description" SG_ 870 HU_GW_AlvCnt3Val "For the first transmission request for a data element the counter shall be initialized with 0 and shall be incremented by 1 for every subsequent send request. 

When the counter reaches the maximum value(0xFF), then it shall restart with 0 for the next s";
BA_ "GenSigSendType" SG_ 870 HU_GW_AlvCnt3Val 4;
BA_ "UserSigValidity" SG_ 870 HU_GW_AlvCnt3Val 3;
BA_ "Version" SG_ 870 HU_GW_AlvCnt3Val "22.10.20";
BA_ "Description" SG_ 870 AVN_AccelSpdTimerStartVal "AVNT Start value signal for timer";
BA_ "GenSigSendType" SG_ 870 AVN_AccelSpdTimerStartVal 4;
BA_ "UserSigValidity" SG_ 870 AVN_AccelSpdTimerStartVal 3;
BA_ "Version" SG_ 870 AVN_AccelSpdTimerStartVal "23.02.02";
BA_ "Description" SG_ 870 AVN_AccelSpdTimerEndVal "AVNT End Value signal for timer";
BA_ "GenSigSendType" SG_ 870 AVN_AccelSpdTimerEndVal 4;
BA_ "UserSigValidity" SG_ 870 AVN_AccelSpdTimerEndVal 3;
BA_ "Version" SG_ 870 AVN_AccelSpdTimerEndVal "23.02.02";
BA_ "Description" SG_ 870 AVN_AccelTimerUnitSta "AVNT menu select of drag timer & acceleration timer signal";
BA_ "GenSigSendType" SG_ 870 AVN_AccelTimerUnitSta 4;
BA_ "UserSigValidity" SG_ 870 AVN_AccelTimerUnitSta 3;
BA_ "Version" SG_ 870 AVN_AccelTimerUnitSta "23.02.02";
BA_ "Description" SG_ 870 AVN_AccelDistTimerVal "AVNT Distance End signal for timer";
BA_ "GenSigSendType" SG_ 870 AVN_AccelDistTimerVal 4;
BA_ "UserSigValidity" SG_ 870 AVN_AccelDistTimerVal 3;
BA_ "Version" SG_ 870 AVN_AccelDistTimerVal "23.02.02";
BA_ "Description" SG_ 870 AVN_AccelTimerErrSta "AVNT Timer(Drag & Acceleration) status False signal";
BA_ "GenSigSendType" SG_ 870 AVN_AccelTimerErrSta 4;
BA_ "UserSigValidity" SG_ 870 AVN_AccelTimerErrSta 3;
BA_ "Version" SG_ 870 AVN_AccelTimerErrSta "23.02.02";
BA_ "Description" SG_ 870 HU_SWRCWarmerSet "send 0x1(On) value while button press to ICU";
BA_ "GenSigSendType" SG_ 870 HU_SWRCWarmerSet 4;
BA_ "UserSigValidity" SG_ 870 HU_SWRCWarmerSet 3;
BA_ "Version" SG_ 870 HU_SWRCWarmerSet "22.06.01";
BA_ "Description" SG_ 870 AVN_MRA_Disp_Rdy "AVN status notification for ADAS_PRK

- status notification whether AVN can display on the navigation screen";
BA_ "GenSigSendType" SG_ 870 AVN_MRA_Disp_Rdy 4;
BA_ "UserSigValidity" SG_ 870 AVN_MRA_Disp_Rdy 0;
BA_ "Version" SG_ 870 AVN_MRA_Disp_Rdy "24.01.04";
BA_ "Description" SG_ 870 AVN_PRK_Func_Selected "MRA function activation button selection result feedback";
BA_ "GenSigSendType" SG_ 870 AVN_PRK_Func_Selected 4;
BA_ "UserSigValidity" SG_ 870 AVN_PRK_Func_Selected 0;
BA_ "Version" SG_ 870 AVN_PRK_Func_Selected "24.01.04";
BA_ "Description" SG_ 870 AVN_MRA_CancelInput "Information of exit button input on the navigation screen from MRA activation to control stage";
BA_ "GenSigSendType" SG_ 870 AVN_MRA_CancelInput 4;
BA_ "UserSigValidity" SG_ 870 AVN_MRA_CancelInput 0;
BA_ "Version" SG_ 870 AVN_MRA_CancelInput "24.01.04";
BA_ "GenSigSendType" SG_ 870 HU_DistanceUnit 4;
BA_ "GenSigStartValue" SG_ 870 HU_DistanceUnit 3;
BA_ "UserSigValidity" SG_ 870 HU_DistanceUnit 1;
BA_ "NetworkRequest" SG_ 870 HU_DistanceUnit 0;
BA_ "Version" SG_ 870 HU_DistanceUnit "22.06.01";
BA_ "Description" SG_ 870 HU_Scheduled_Setting "Information of scheduled update charge setting

The signal means that scheduled update charaging information send to BMS for BMS SOC control";
BA_ "GenSigSendType" SG_ 870 HU_Scheduled_Setting 4;
BA_ "UserSigValidity" SG_ 870 HU_Scheduled_Setting 3;
BA_ "Version" SG_ 870 HU_Scheduled_Setting "22.06.01";
BA_ "GenSigSendType" SG_ 870 HU_AliveStatus 4;
BA_ "GenSigStartValue" SG_ 870 HU_AliveStatus 3;
BA_ "UserSigValidity" SG_ 870 HU_AliveStatus 0;
BA_ "NetworkRequest" SG_ 870 HU_AliveStatus 0;
BA_ "Version" SG_ 870 HU_AliveStatus "22.06.01";
BA_ "Description" SG_ 870 HU_ThemeType "This signal indicates current H/Unit GUI theme value. 

 

Detail value -GUI Theme matching table, refer to attachement and ES SPEC";
BA_ "GenSigSendType" SG_ 870 HU_ThemeType 4;
BA_ "GenSigStartValue" SG_ 870 HU_ThemeType 15;
BA_ "UserSigValidity" SG_ 870 HU_ThemeType 0;
BA_ "Version" SG_ 870 HU_ThemeType "22.06.01";
BA_ "GenSigSendType" SG_ 870 HU_MicActivity 4;
BA_ "GenSigStartValue" SG_ 870 HU_MicActivity 3;
BA_ "UserSigValidity" SG_ 870 HU_MicActivity 0;
BA_ "Version" SG_ 870 HU_MicActivity "22.06.01";
BA_ "Description" SG_ 870 AVN_RSPA_ModeSelect "Signal for User's RSPAⅡ mode setting

RSPAⅡ 모드 선택 메뉴 CCP Focus 및 CCP Confirm or Touch 결과";
BA_ "GenSigSendType" SG_ 870 AVN_RSPA_ModeSelect 4;
BA_ "GenSigStartValue" SG_ 870 AVN_RSPA_ModeSelect 15;
BA_ "UserSigValidity" SG_ 870 AVN_RSPA_ModeSelect 0;
BA_ "Version" SG_ 870 AVN_RSPA_ModeSelect "23.10.01";
BA_ "GenSigSendType" SG_ 870 CF_HU_GPSFlt 4;
BA_ "GenSigStartValue" SG_ 870 CF_HU_GPSFlt 2;
BA_ "TimeoutValue" SG_ 870 CF_HU_GPSFlt "0x2";
BA_ "UserSigValidity" SG_ 870 CF_HU_GPSFlt 0;
BA_ "Version" SG_ 870 CF_HU_GPSFlt "22.06.01";
BA_ "GenSigSendType" SG_ 870 AVN_RSPA_CancelInput 4;
BA_ "UserSigValidity" SG_ 870 AVN_RSPA_CancelInput 0;
BA_ "Version" SG_ 870 AVN_RSPA_CancelInput "22.06.01";
BA_ "Description" SG_ 261 EMS_Crc7Val "The data area for CRC calculation is based on the data length (DLC) of the message DB.

The CRC shall be calculated over the entire data block (excluding the CRC bytes) including the user data, alive counter and Data ID



- CRC Polynomial (0x1021) , Ini";
BA_ "GenSigStartValue" SG_ 261 EMS_Crc7Val 65535;
BA_ "UserSigValidity" SG_ 261 EMS_Crc7Val 3;
BA_ "RoutingFactor" SG_ 261 EMS_Crc7Val 5;
BA_ "Version" SG_ 261 EMS_Crc7Val "21.09.03";
BA_ "Description" SG_ 261 HEV_AccelPdlVal "The signal is a measure of the Accelerator Pedal value.

The accelerator pedal value is determined via 2 pedal sensors, which are connected mechanically to the accelerator pedal. If the EMS-ECU recognizes that the accelerator pedal is not activated, then";
BA_ "UserSigValidity" SG_ 261 HEV_AccelPdlVal 3;
BA_ "RoutingFactor" SG_ 261 HEV_AccelPdlVal 5;
BA_ "Version" SG_ 261 HEV_AccelPdlVal "19.11.11";
BA_ "Description" SG_ 261 HEV_IndTqTar "Indicated Engine (Desired) Torque";
BA_ "UserSigValidity" SG_ 261 HEV_IndTqTar 3;
BA_ "RoutingFactor" SG_ 261 HEV_IndTqTar 5;
BA_ "Version" SG_ 261 HEV_IndTqTar "18.05.04";
BA_ "Description" SG_ 261 HEV_IndTqVal_Extd "Indicated engine torque after torque coordination(intervention)



0x0000 ~ 0x3FFF : Physical Value (0~1638.3Nm)



Depending on the engine specifications, the signals are separated as follows.

HEV Engine Only.

- HEV_IndTqVal : Kappa, Gamma, Nu Engine

";
BA_ "UserSigValidity" SG_ 261 HEV_IndTqVal_Extd 3;
BA_ "RoutingFactor" SG_ 261 HEV_IndTqVal_Extd 5;
BA_ "Version" SG_ 261 HEV_IndTqVal_Extd "23.08.03";
BA_ "Description" SG_ 261 EMS_AlvCnt7Val "For the first transmission request for a data element the counter shall be initialized with 0 and shall be incremented by 1 for every subsequent send request. 

When the counter reaches the maximum value(0xFF), then it shall restart with 0 for the next s";
BA_ "UserSigValidity" SG_ 261 EMS_AlvCnt7Val 3;
BA_ "RoutingFactor" SG_ 261 EMS_AlvCnt7Val 5;
BA_ "Version" SG_ 261 EMS_AlvCnt7Val "21.09.03";
BA_ "Description" SG_ 261 HEV_IndTqVal "Indicated engine torque after torque coordination(intervention)";
BA_ "UserSigValidity" SG_ 261 HEV_IndTqVal 3;
BA_ "RoutingFactor" SG_ 261 HEV_IndTqVal 5;
BA_ "Version" SG_ 261 HEV_IndTqVal "18.10.07";
BA_ "Description" SG_ 261 HEV_DrvTqVal "Driver's demand torque";
BA_ "UserSigValidity" SG_ 261 HEV_DrvTqVal 3;
BA_ "RoutingFactor" SG_ 261 HEV_DrvTqVal 5;
BA_ "Version" SG_ 261 HEV_DrvTqVal "18.05.04";
BA_ "Description" SG_ 261 HEV_TqStndVal "Standard value for torque scaling in torque interface";
BA_ "UserSigValidity" SG_ 261 HEV_TqStndVal 3;
BA_ "RoutingFactor" SG_ 261 HEV_TqStndVal 5;
BA_ "Version" SG_ 261 HEV_TqStndVal "18.05.04";
BA_ "Description" SG_ 261 HEV_OilDilution_IncICELoad "This signal indicates oil dilution ICE load increase mode.";
BA_ "UserSigValidity" SG_ 261 HEV_OilDilution_IncICELoad 3;
BA_ "RoutingFactor" SG_ 261 HEV_OilDilution_IncICELoad 5;
BA_ "Version" SG_ 261 HEV_OilDilution_IncICELoad "22.05.04";
BA_ "Description" SG_ 261 HEV_OilDilution_ServMode "This signal indicates oil dilution service mode.";
BA_ "UserSigValidity" SG_ 261 HEV_OilDilution_ServMode 3;
BA_ "RoutingFactor" SG_ 261 HEV_OilDilution_ServMode 5;
BA_ "Version" SG_ 261 HEV_OilDilution_ServMode "22.05.04";
BA_ "Description" SG_ 261 EMS_TqLmtSta "Status of Torque Limit.";
BA_ "UserSigValidity" SG_ 261 EMS_TqLmtSta 3;
BA_ "RoutingFactor" SG_ 261 EMS_TqLmtSta 5;
BA_ "Version" SG_ 261 EMS_TqLmtSta "23.04.02";
BA_ "Description" SG_ 261 EMS_EU7 "This signal defines if the vehicle is EU7 vehicle.";
BA_ "UserSigValidity" SG_ 261 EMS_EU7 3;
BA_ "RoutingFactor" SG_ 261 EMS_EU7 5;
BA_ "Version" SG_ 261 EMS_EU7 "23.04.02";
BA_ "Description" SG_ 261 HEV_FrctTqVal "Friction Loss Torque";
BA_ "UserSigValidity" SG_ 261 HEV_FrctTqVal 3;
BA_ "RoutingFactor" SG_ 261 HEV_FrctTqVal 5;
BA_ "Version" SG_ 261 HEV_FrctTqVal "18.10.07";
BA_ "Description" SG_ 261 HEV_EngSpdVal "Engine Speed";
BA_ "UserSigValidity" SG_ 261 HEV_EngSpdVal 3;
BA_ "RoutingFactor" SG_ 261 HEV_EngSpdVal 5;
BA_ "Version" SG_ 261 HEV_EngSpdVal "18.05.04";
BA_ "Description" SG_ 261 HEV_EngOpSta "Engine Operating State";
BA_ "UserSigValidity" SG_ 261 HEV_EngOpSta 3;
BA_ "RoutingFactor" SG_ 261 HEV_EngOpSta 5;
BA_ "Version" SG_ 261 HEV_EngOpSta "18.05.04";
BA_ "Description" SG_ 261 HEV_IntakeAirTempVal "Intake air temperature";
BA_ "UserSigValidity" SG_ 261 HEV_IntakeAirTempVal 3;
BA_ "RoutingFactor" SG_ 261 HEV_IntakeAirTempVal 5;
BA_ "Version" SG_ 261 HEV_IntakeAirTempVal "18.05.04";
BA_ "Description" SG_ 993 PDC_FD_Crc2Val "The data area for CRC calculation is based on the data length (DLC) of the message DB.

The CRC shall be calculated over the entire data block (excluding the CRC bytes) including the user data, alive counter and Data ID



- CRC Polynomial (0x1021) , Ini";
BA_ "GenSigSendType" SG_ 993 PDC_FD_Crc2Val 4;
BA_ "GenSigStartValue" SG_ 993 PDC_FD_Crc2Val 65535;
BA_ "UserSigValidity" SG_ 993 PDC_FD_Crc2Val 3;
BA_ "Version" SG_ 993 PDC_FD_Crc2Val "22.10.20";
BA_ "Description" SG_ 993 Lamp_StpLmpLftOpnSta "Stop Lamp



Left Open Status";
BA_ "GenSigSendType" SG_ 993 Lamp_StpLmpLftOpnSta 4;
BA_ "UserSigValidity" SG_ 993 Lamp_StpLmpLftOpnSta 0;
BA_ "NetworkRequest" SG_ 993 Lamp_StpLmpLftOpnSta 0;
BA_ "NetworkRequestHoldingTime" SG_ 993 Lamp_StpLmpLftOpnSta 5000;
BA_ "Version" SG_ 993 Lamp_StpLmpLftOpnSta "17.12.00";
BA_ "Description" SG_ 993 Lamp_StpLmpRtOpnSta "Stop Lamp



Right Open Status";
BA_ "GenSigSendType" SG_ 993 Lamp_StpLmpRtOpnSta 4;
BA_ "UserSigValidity" SG_ 993 Lamp_StpLmpRtOpnSta 0;
BA_ "NetworkRequest" SG_ 993 Lamp_StpLmpRtOpnSta 0;
BA_ "NetworkRequestHoldingTime" SG_ 993 Lamp_StpLmpRtOpnSta 5000;
BA_ "Version" SG_ 993 Lamp_StpLmpRtOpnSta "17.12.00";
BA_ "Description" SG_ 993 Lamp_HmslLmpOpnSta "HMSL OpenStatus";
BA_ "GenSigSendType" SG_ 993 Lamp_HmslLmpOpnSta 4;
BA_ "UserSigValidity" SG_ 993 Lamp_HmslLmpOpnSta 0;
BA_ "NetworkRequest" SG_ 993 Lamp_HmslLmpOpnSta 0;
BA_ "NetworkRequestHoldingTime" SG_ 993 Lamp_HmslLmpOpnSta 5000;
BA_ "Version" SG_ 993 Lamp_HmslLmpOpnSta "19.11.09";
BA_ "Description" SG_ 993 Lamp_DrlLmpLftOpnSta "DRL Lamp



Left OpenStatus";
BA_ "GenSigSendType" SG_ 993 Lamp_DrlLmpLftOpnSta 4;
BA_ "UserSigValidity" SG_ 993 Lamp_DrlLmpLftOpnSta 0;
BA_ "NetworkRequest" SG_ 993 Lamp_DrlLmpLftOpnSta 0;
BA_ "NetworkRequestHoldingTime" SG_ 993 Lamp_DrlLmpLftOpnSta 5000;
BA_ "Version" SG_ 993 Lamp_DrlLmpLftOpnSta "17.12.00";
BA_ "Description" SG_ 993 Lamp_DrlLmpRtOpnSta "DRL Lamp



Right OpenStatus";
BA_ "GenSigSendType" SG_ 993 Lamp_DrlLmpRtOpnSta 4;
BA_ "UserSigValidity" SG_ 993 Lamp_DrlLmpRtOpnSta 0;
BA_ "NetworkRequest" SG_ 993 Lamp_DrlLmpRtOpnSta 0;
BA_ "NetworkRequestHoldingTime" SG_ 993 Lamp_DrlLmpRtOpnSta 5000;
BA_ "Version" SG_ 993 Lamp_DrlLmpRtOpnSta "17.12.00";
BA_ "Description" SG_ 993 Lamp_FrFgLmpLftOpnSta "Front FOG Lamp



Left OpenStatus";
BA_ "GenSigSendType" SG_ 993 Lamp_FrFgLmpLftOpnSta 4;
BA_ "UserSigValidity" SG_ 993 Lamp_FrFgLmpLftOpnSta 0;
BA_ "NetworkRequest" SG_ 993 Lamp_FrFgLmpLftOpnSta 0;
BA_ "NetworkRequestHoldingTime" SG_ 993 Lamp_FrFgLmpLftOpnSta 5000;
BA_ "Version" SG_ 993 Lamp_FrFgLmpLftOpnSta "17.12.00";
BA_ "Description" SG_ 993 Lamp_FrFgLmpRtOpnSta "Front FOG Lamp



Right OpenStatus";
BA_ "GenSigSendType" SG_ 993 Lamp_FrFgLmpRtOpnSta 4;
BA_ "UserSigValidity" SG_ 993 Lamp_FrFgLmpRtOpnSta 0;
BA_ "NetworkRequest" SG_ 993 Lamp_FrFgLmpRtOpnSta 0;
BA_ "NetworkRequestHoldingTime" SG_ 993 Lamp_FrFgLmpRtOpnSta 5000;
BA_ "Version" SG_ 993 Lamp_FrFgLmpRtOpnSta "17.12.00";
BA_ "Description" SG_ 993 Lamp_CorneringLmpLftOpnSta "Cornering Lamp Left Open Status";
BA_ "GenSigSendType" SG_ 993 Lamp_CorneringLmpLftOpnSta 4;
BA_ "UserSigValidity" SG_ 993 Lamp_CorneringLmpLftOpnSta 0;
BA_ "NetworkRequest" SG_ 993 Lamp_CorneringLmpLftOpnSta 0;
BA_ "NetworkRequestHoldingTime" SG_ 993 Lamp_CorneringLmpLftOpnSta 5000;
BA_ "Version" SG_ 993 Lamp_CorneringLmpLftOpnSta "19.11.11";
BA_ "Description" SG_ 993 Lamp_CorneringLmpRtOpnSta "Cornering Lamp Right Open Status";
BA_ "GenSigSendType" SG_ 993 Lamp_CorneringLmpRtOpnSta 4;
BA_ "UserSigValidity" SG_ 993 Lamp_CorneringLmpRtOpnSta 0;
BA_ "NetworkRequest" SG_ 993 Lamp_CorneringLmpRtOpnSta 0;
BA_ "NetworkRequestHoldingTime" SG_ 993 Lamp_CorneringLmpRtOpnSta 5000;
BA_ "Version" SG_ 993 Lamp_CorneringLmpRtOpnSta "19.11.11";
BA_ "Description" SG_ 993 Lamp_StcBendingLmpLftOpnSta "Static Bending Lamp



Left OpenStatus";
BA_ "GenSigSendType" SG_ 993 Lamp_StcBendingLmpLftOpnSta 4;
BA_ "UserSigValidity" SG_ 993 Lamp_StcBendingLmpLftOpnSta 0;
BA_ "NetworkRequest" SG_ 993 Lamp_StcBendingLmpLftOpnSta 0;
BA_ "NetworkRequestHoldingTime" SG_ 993 Lamp_StcBendingLmpLftOpnSta 5000;
BA_ "Version" SG_ 993 Lamp_StcBendingLmpLftOpnSta "17.12.00";
BA_ "Description" SG_ 993 Lamp_StcBendingLmpRtOpnSta "Static Bending Lamp



Right OpenStatus";
BA_ "GenSigSendType" SG_ 993 Lamp_StcBendingLmpRtOpnSta 4;
BA_ "UserSigValidity" SG_ 993 Lamp_StcBendingLmpRtOpnSta 0;
BA_ "NetworkRequest" SG_ 993 Lamp_StcBendingLmpRtOpnSta 0;
BA_ "NetworkRequestHoldingTime" SG_ 993 Lamp_StcBendingLmpRtOpnSta 5000;
BA_ "Version" SG_ 993 Lamp_StcBendingLmpRtOpnSta "17.12.00";
BA_ "Description" SG_ 993 Lamp_FrTurnSigLmpLftPCLSta "T/SIG Lamp Front Left PCL Status";
BA_ "GenSigSendType" SG_ 993 Lamp_FrTurnSigLmpLftPCLSta 4;
BA_ "UserSigValidity" SG_ 993 Lamp_FrTurnSigLmpLftPCLSta 0;
BA_ "NetworkRequest" SG_ 993 Lamp_FrTurnSigLmpLftPCLSta 0;
BA_ "NetworkRequestHoldingTime" SG_ 993 Lamp_FrTurnSigLmpLftPCLSta 5000;
BA_ "Version" SG_ 993 Lamp_FrTurnSigLmpLftPCLSta "22.07.05";
BA_ "Description" SG_ 993 Lamp_FrTurnSigLmpRtPCLSta "T/SIG Lamp Front Right PCL Status";
BA_ "GenSigSendType" SG_ 993 Lamp_FrTurnSigLmpRtPCLSta 4;
BA_ "UserSigValidity" SG_ 993 Lamp_FrTurnSigLmpRtPCLSta 0;
BA_ "NetworkRequest" SG_ 993 Lamp_FrTurnSigLmpRtPCLSta 0;
BA_ "NetworkRequestHoldingTime" SG_ 993 Lamp_FrTurnSigLmpRtPCLSta 5000;
BA_ "Version" SG_ 993 Lamp_FrTurnSigLmpRtPCLSta "22.07.05";
BA_ "Description" SG_ 993 Lamp_RrTurnSigLmpLftPCLSta "T/SIG Lamp Rear Left PCL Status";
BA_ "GenSigSendType" SG_ 993 Lamp_RrTurnSigLmpLftPCLSta 4;
BA_ "UserSigValidity" SG_ 993 Lamp_RrTurnSigLmpLftPCLSta 0;
BA_ "NetworkRequest" SG_ 993 Lamp_RrTurnSigLmpLftPCLSta 0;
BA_ "NetworkRequestHoldingTime" SG_ 993 Lamp_RrTurnSigLmpLftPCLSta 5000;
BA_ "Version" SG_ 993 Lamp_RrTurnSigLmpLftPCLSta "22.07.05";
BA_ "Description" SG_ 993 Lamp_RrTurnSigLmpRtPCLSta "T/SIG Lamp Rear Right PCL Status";
BA_ "GenSigSendType" SG_ 993 Lamp_RrTurnSigLmpRtPCLSta 4;
BA_ "UserSigValidity" SG_ 993 Lamp_RrTurnSigLmpRtPCLSta 0;
BA_ "NetworkRequest" SG_ 993 Lamp_RrTurnSigLmpRtPCLSta 0;
BA_ "NetworkRequestHoldingTime" SG_ 993 Lamp_RrTurnSigLmpRtPCLSta 5000;
BA_ "Version" SG_ 993 Lamp_RrTurnSigLmpRtPCLSta "22.07.05";
BA_ "Description" SG_ 993 HzrdSwPushSta "Hazard Switch(self return type) Push State";
BA_ "GenSigSendType" SG_ 993 HzrdSwPushSta 4;
BA_ "UserSigValidity" SG_ 993 HzrdSwPushSta 0;
BA_ "NetworkRequest" SG_ 993 HzrdSwPushSta 0;
BA_ "NetworkRequestHoldingTime" SG_ 993 HzrdSwPushSta 5000;
BA_ "Version" SG_ 993 HzrdSwPushSta "23.02.13";
BA_ "Description" SG_ 993 Lamp_LftTrnFaultSta "Left Turn Lamp Fault Status";
BA_ "GenSigSendType" SG_ 993 Lamp_LftTrnFaultSta 4;
BA_ "UserSigValidity" SG_ 993 Lamp_LftTrnFaultSta 0;
BA_ "NetworkRequest" SG_ 993 Lamp_LftTrnFaultSta 0;
BA_ "NetworkRequestHoldingTime" SG_ 993 Lamp_LftTrnFaultSta 5000;
BA_ "Version" SG_ 993 Lamp_LftTrnFaultSta "23.02.13";
BA_ "Description" SG_ 993 Lamp_RtTrnFaultSta "Right Turn Lamp Fault Status";
BA_ "GenSigSendType" SG_ 993 Lamp_RtTrnFaultSta 4;
BA_ "UserSigValidity" SG_ 993 Lamp_RtTrnFaultSta 0;
BA_ "NetworkRequest" SG_ 993 Lamp_RtTrnFaultSta 0;
BA_ "NetworkRequestHoldingTime" SG_ 993 Lamp_RtTrnFaultSta 5000;
BA_ "Version" SG_ 993 Lamp_RtTrnFaultSta "23.02.13";
BA_ "Description" SG_ 993 FrtTurnLampOptSta "Front Turn Signal Lamp EOL Option State";
BA_ "GenSigSendType" SG_ 993 FrtTurnLampOptSta 4;
BA_ "UserSigValidity" SG_ 993 FrtTurnLampOptSta 0;
BA_ "NetworkRequest" SG_ 993 FrtTurnLampOptSta 0;
BA_ "NetworkRequestHoldingTime" SG_ 993 FrtTurnLampOptSta 5000;
BA_ "Version" SG_ 993 FrtTurnLampOptSta "23.04.00";
BA_ "Description" SG_ 993 RrTurnLampOptSta "Rear Turn Signal Lamp EOL Option State";
BA_ "GenSigSendType" SG_ 993 RrTurnLampOptSta 4;
BA_ "UserSigValidity" SG_ 993 RrTurnLampOptSta 0;
BA_ "NetworkRequest" SG_ 993 RrTurnLampOptSta 0;
BA_ "NetworkRequestHoldingTime" SG_ 993 RrTurnLampOptSta 5000;
BA_ "Version" SG_ 993 RrTurnLampOptSta "23.04.00";
BA_ "Description" SG_ 993 PDC_FD_AlvCnt2Val "For the first transmission request for a data element the counter shall be initialized with 0 and shall be incremented by 1 for every subsequent send request. 

When the counter reaches the maximum value(0xFF), then it shall restart with 0 for the next s";
BA_ "GenSigSendType" SG_ 993 PDC_FD_AlvCnt2Val 4;
BA_ "UserSigValidity" SG_ 993 PDC_FD_AlvCnt2Val 3;
BA_ "Version" SG_ 993 PDC_FD_AlvCnt2Val "22.10.20";
BA_ "Description" SG_ 993 IntLamp_InlTailLmpSta "-(Old)C_INTTail_Act";
BA_ "GenSigSendType" SG_ 993 IntLamp_InlTailLmpSta 4;
BA_ "UserSigValidity" SG_ 993 IntLamp_InlTailLmpSta 0;
BA_ "NetworkRequest" SG_ 993 IntLamp_InlTailLmpSta 0;
BA_ "NetworkRequestHoldingTime" SG_ 993 IntLamp_InlTailLmpSta 5000;
BA_ "Version" SG_ 993 IntLamp_InlTailLmpSta "17.12.00";
BA_ "Description" SG_ 993 Lamp_FootLampOnReq "Foot Lamp Command";
BA_ "GenSigSendType" SG_ 993 Lamp_FootLampOnReq 4;
BA_ "UserSigValidity" SG_ 993 Lamp_FootLampOnReq 0;
BA_ "NetworkRequest" SG_ 993 Lamp_FootLampOnReq 0;
BA_ "NetworkRequestHoldingTime" SG_ 993 Lamp_FootLampOnReq 5000;
BA_ "Version" SG_ 993 Lamp_FootLampOnReq "17.12.00";
BA_ "Description" SG_ 993 Lamp_MoodLampOnReq "Mood lamp command";
BA_ "GenSigSendType" SG_ 993 Lamp_MoodLampOnReq 4;
BA_ "UserSigValidity" SG_ 993 Lamp_MoodLampOnReq 0;
BA_ "NetworkRequest" SG_ 993 Lamp_MoodLampOnReq 0;
BA_ "NetworkRequestHoldingTime" SG_ 993 Lamp_MoodLampOnReq 5000;
BA_ "Version" SG_ 993 Lamp_MoodLampOnReq "21.07.05";
BA_ "Description" SG_ 993 USM_FuncForMdLmpBrgtSta "USM Function for Mood Lamp bright";
BA_ "GenSigSendType" SG_ 993 USM_FuncForMdLmpBrgtSta 4;
BA_ "UserSigValidity" SG_ 993 USM_FuncForMdLmpBrgtSta 3;
BA_ "NetworkRequest" SG_ 993 USM_FuncForMdLmpBrgtSta 0;
BA_ "NetworkRequestHoldingTime" SG_ 993 USM_FuncForMdLmpBrgtSta 5000;
BA_ "Version" SG_ 993 USM_FuncForMdLmpBrgtSta "21.11.00";
BA_ "Description" SG_ 993 Lamp_HdLmpLoLftOpnSta "Head Lamp Low



Left OpenStatus";
BA_ "GenSigSendType" SG_ 993 Lamp_HdLmpLoLftOpnSta 4;
BA_ "UserSigValidity" SG_ 993 Lamp_HdLmpLoLftOpnSta 0;
BA_ "NetworkRequest" SG_ 993 Lamp_HdLmpLoLftOpnSta 0;
BA_ "NetworkRequestHoldingTime" SG_ 993 Lamp_HdLmpLoLftOpnSta 5000;
BA_ "Version" SG_ 993 Lamp_HdLmpLoLftOpnSta "17.12.00";
BA_ "Description" SG_ 993 Lamp_HdLmpLoRtOpnSta "Head Lamp Low Right OpenStatus";
BA_ "GenSigSendType" SG_ 993 Lamp_HdLmpLoRtOpnSta 4;
BA_ "UserSigValidity" SG_ 993 Lamp_HdLmpLoRtOpnSta 0;
BA_ "NetworkRequest" SG_ 993 Lamp_HdLmpLoRtOpnSta 0;
BA_ "NetworkRequestHoldingTime" SG_ 993 Lamp_HdLmpLoRtOpnSta 5000;
BA_ "Version" SG_ 993 Lamp_HdLmpLoRtOpnSta "17.12.00";
BA_ "Description" SG_ 993 Lamp_HdLmpBiFuncLftOpnSta "Bi Function Head Lamp Left Open Status";
BA_ "GenSigSendType" SG_ 993 Lamp_HdLmpBiFuncLftOpnSta 4;
BA_ "UserSigValidity" SG_ 993 Lamp_HdLmpBiFuncLftOpnSta 0;
BA_ "NetworkRequest" SG_ 993 Lamp_HdLmpBiFuncLftOpnSta 0;
BA_ "NetworkRequestHoldingTime" SG_ 993 Lamp_HdLmpBiFuncLftOpnSta 5000;
BA_ "Version" SG_ 993 Lamp_HdLmpBiFuncLftOpnSta "19.11.10";
BA_ "Description" SG_ 993 Lamp_HdLmpBiFuncRtOpnSta "Bi Function Head Lamp Right Open Status";
BA_ "GenSigSendType" SG_ 993 Lamp_HdLmpBiFuncRtOpnSta 4;
BA_ "UserSigValidity" SG_ 993 Lamp_HdLmpBiFuncRtOpnSta 0;
BA_ "NetworkRequest" SG_ 993 Lamp_HdLmpBiFuncRtOpnSta 0;
BA_ "NetworkRequestHoldingTime" SG_ 993 Lamp_HdLmpBiFuncRtOpnSta 5000;
BA_ "Version" SG_ 993 Lamp_HdLmpBiFuncRtOpnSta "19.11.10";
BA_ "Description" SG_ 993 Lamp_HdLmpHiLftOpnSta "Head Lamp High



Left OpenStatus";
BA_ "GenSigSendType" SG_ 993 Lamp_HdLmpHiLftOpnSta 4;
BA_ "UserSigValidity" SG_ 993 Lamp_HdLmpHiLftOpnSta 0;
BA_ "NetworkRequest" SG_ 993 Lamp_HdLmpHiLftOpnSta 0;
BA_ "NetworkRequestHoldingTime" SG_ 993 Lamp_HdLmpHiLftOpnSta 5000;
BA_ "Version" SG_ 993 Lamp_HdLmpHiLftOpnSta "17.12.00";
BA_ "Description" SG_ 993 Lamp_HdLmpHiRtOpnSta "Head Lamp High Right OpenStatus";
BA_ "GenSigSendType" SG_ 993 Lamp_HdLmpHiRtOpnSta 4;
BA_ "UserSigValidity" SG_ 993 Lamp_HdLmpHiRtOpnSta 0;
BA_ "NetworkRequest" SG_ 993 Lamp_HdLmpHiRtOpnSta 0;
BA_ "NetworkRequestHoldingTime" SG_ 993 Lamp_HdLmpHiRtOpnSta 5000;
BA_ "Version" SG_ 993 Lamp_HdLmpHiRtOpnSta "17.12.00";
BA_ "GenSigSendType" SG_ 993 ExtLamp_HzrdSwSta 4;
BA_ "UserSigValidity" SG_ 993 ExtLamp_HzrdSwSta 0;
BA_ "NetworkRequest" SG_ 993 ExtLamp_HzrdSwSta 0;
BA_ "NetworkRequestHoldingTime" SG_ 993 ExtLamp_HzrdSwSta 5000;
BA_ "Version" SG_ 993 ExtLamp_HzrdSwSta "17.12.00";
BA_ "Description" SG_ 993 Lamp_FrTrnSigLmpLftOpnSta "Front T/SIG Lamp



Left OpenStatus";
BA_ "GenSigSendType" SG_ 993 Lamp_FrTrnSigLmpLftOpnSta 4;
BA_ "UserSigValidity" SG_ 993 Lamp_FrTrnSigLmpLftOpnSta 0;
BA_ "NetworkRequest" SG_ 993 Lamp_FrTrnSigLmpLftOpnSta 0;
BA_ "NetworkRequestHoldingTime" SG_ 993 Lamp_FrTrnSigLmpLftOpnSta 5000;
BA_ "Version" SG_ 993 Lamp_FrTrnSigLmpLftOpnSta "17.12.00";
BA_ "Description" SG_ 993 Lamp_FrTrnSigLmpRtOpnSta "Front T/SIG Lamp



Right OpenStatus";
BA_ "GenSigSendType" SG_ 993 Lamp_FrTrnSigLmpRtOpnSta 4;
BA_ "UserSigValidity" SG_ 993 Lamp_FrTrnSigLmpRtOpnSta 0;
BA_ "NetworkRequest" SG_ 993 Lamp_FrTrnSigLmpRtOpnSta 0;
BA_ "NetworkRequestHoldingTime" SG_ 993 Lamp_FrTrnSigLmpRtOpnSta 5000;
BA_ "Version" SG_ 993 Lamp_FrTrnSigLmpRtOpnSta "17.12.00";
BA_ "Description" SG_ 993 Lamp_RrTrnSigLmpLftOpnSta "Rear T/SIG Lamp



Left OpenStatus";
BA_ "GenSigSendType" SG_ 993 Lamp_RrTrnSigLmpLftOpnSta 4;
BA_ "UserSigValidity" SG_ 993 Lamp_RrTrnSigLmpLftOpnSta 0;
BA_ "NetworkRequest" SG_ 993 Lamp_RrTrnSigLmpLftOpnSta 0;
BA_ "NetworkRequestHoldingTime" SG_ 993 Lamp_RrTrnSigLmpLftOpnSta 5000;
BA_ "Version" SG_ 993 Lamp_RrTrnSigLmpLftOpnSta "17.12.00";
BA_ "Description" SG_ 993 Lamp_RrTrnSigLmpRtOpnSta "Rear T/SIG Lamp



Right OpenStatus";
BA_ "GenSigSendType" SG_ 993 Lamp_RrTrnSigLmpRtOpnSta 4;
BA_ "UserSigValidity" SG_ 993 Lamp_RrTrnSigLmpRtOpnSta 0;
BA_ "NetworkRequest" SG_ 993 Lamp_RrTrnSigLmpRtOpnSta 0;
BA_ "NetworkRequestHoldingTime" SG_ 993 Lamp_RrTrnSigLmpRtOpnSta 5000;
BA_ "Version" SG_ 993 Lamp_RrTrnSigLmpRtOpnSta "17.12.00";
BA_ "Description" SG_ 993 Brake_SwSta_ICU "Brake Switch Status";
BA_ "GenSigSendType" SG_ 993 Brake_SwSta_ICU 4;
BA_ "UserSigValidity" SG_ 993 Brake_SwSta_ICU 0;
BA_ "NetworkRequest" SG_ 993 Brake_SwSta_ICU 0;
BA_ "NetworkRequestHoldingTime" SG_ 993 Brake_SwSta_ICU 5000;
BA_ "Version" SG_ 993 Brake_SwSta_ICU "21.07.05";
BA_ "Description" SG_ 993 BrkLmpCmd "Brake Lamp Control Command";
BA_ "GenSigSendType" SG_ 993 BrkLmpCmd 4;
BA_ "UserSigValidity" SG_ 993 BrkLmpCmd 0;
BA_ "NetworkRequest" SG_ 993 BrkLmpCmd 0;
BA_ "NetworkRequestHoldingTime" SG_ 993 BrkLmpCmd 5000;
BA_ "Version" SG_ 993 BrkLmpCmd "20.08.07";
BA_ "Description" SG_ 813 SBCM_DRV_FD_Crc1Val "The data area for CRC calculation is based on the data length (DLC) of the message DB.

The CRC shall be calculated over the entire data block (excluding the CRC bytes) including the user data, alive counter and Data ID



- CRC Polynomial (0x1021) , Ini";
BA_ "GenSigSendType" SG_ 813 SBCM_DRV_FD_Crc1Val 4;
BA_ "GenSigStartValue" SG_ 813 SBCM_DRV_FD_Crc1Val 65535;
BA_ "UserSigValidity" SG_ 813 SBCM_DRV_FD_Crc1Val 3;
BA_ "Version" SG_ 813 SBCM_DRV_FD_Crc1Val "22.10.20";
BA_ "Description" SG_ 813 Latch_TypeOption_DRV "If the E-Lacth is applied, the signal will be send for identify the door lock/unlock function and option.";
BA_ "GenSigSendType" SG_ 813 Latch_TypeOption_DRV 4;
BA_ "UserSigValidity" SG_ 813 Latch_TypeOption_DRV 0;
BA_ "NetworkRequest" SG_ 813 Latch_TypeOption_DRV 0;
BA_ "Version" SG_ 813 Latch_TypeOption_DRV "21.07.07";
BA_ "GenSigSendType" SG_ 813 DRV_SWFailAlarm 4;
BA_ "UserSigValidity" SG_ 813 DRV_SWFailAlarm 0;
BA_ "NetworkRequest" SG_ 813 DRV_SWFailAlarm 0;
BA_ "NetworkRequestHoldingTime" SG_ 813 DRV_SWFailAlarm 5000;
BA_ "Version" SG_ 813 DRV_SWFailAlarm "21.07.07";
BA_ "GenSigSendType" SG_ 813 USM_PwrDRApprOpnSetSta 4;
BA_ "UserSigValidity" SG_ 813 USM_PwrDRApprOpnSetSta 0;
BA_ "NetworkRequest" SG_ 813 USM_PwrDRApprOpnSetSta 0;
BA_ "NetworkRequestHoldingTime" SG_ 813 USM_PwrDRApprOpnSetSta 5000;
BA_ "Version" SG_ 813 USM_PwrDRApprOpnSetSta "21.07.07";
BA_ "GenSigSendType" SG_ 813 USM_PwrDRApprOpnSetOpt 4;
BA_ "UserSigValidity" SG_ 813 USM_PwrDRApprOpnSetOpt 0;
BA_ "NetworkRequest" SG_ 813 USM_PwrDRApprOpnSetOpt 0;
BA_ "NetworkRequestHoldingTime" SG_ 813 USM_PwrDRApprOpnSetOpt 5000;
BA_ "Version" SG_ 813 USM_PwrDRApprOpnSetOpt "21.07.07";
BA_ "GenSigSendType" SG_ 813 USM_PwrDRCloseByRKELockSta 4;
BA_ "UserSigValidity" SG_ 813 USM_PwrDRCloseByRKELockSta 0;
BA_ "NetworkRequest" SG_ 813 USM_PwrDRCloseByRKELockSta 0;
BA_ "NetworkRequestHoldingTime" SG_ 813 USM_PwrDRCloseByRKELockSta 5000;
BA_ "Version" SG_ 813 USM_PwrDRCloseByRKELockSta "22.10.01";
BA_ "GenSigSendType" SG_ 813 USM_PwrDRCloseByRKELockOpt 4;
BA_ "UserSigValidity" SG_ 813 USM_PwrDRCloseByRKELockOpt 0;
BA_ "NetworkRequest" SG_ 813 USM_PwrDRCloseByRKELockOpt 0;
BA_ "NetworkRequestHoldingTime" SG_ 813 USM_PwrDRCloseByRKELockOpt 5000;
BA_ "Version" SG_ 813 USM_PwrDRCloseByRKELockOpt "22.10.01";
BA_ "GenSigSendType" SG_ 813 USM_PwrDRCloseByBrakeSta 4;
BA_ "UserSigValidity" SG_ 813 USM_PwrDRCloseByBrakeSta 0;
BA_ "NetworkRequest" SG_ 813 USM_PwrDRCloseByBrakeSta 0;
BA_ "NetworkRequestHoldingTime" SG_ 813 USM_PwrDRCloseByBrakeSta 5000;
BA_ "Version" SG_ 813 USM_PwrDRCloseByBrakeSta "21.07.07";
BA_ "GenSigSendType" SG_ 813 USM_PwrDRCloseByBrakeOpt 4;
BA_ "UserSigValidity" SG_ 813 USM_PwrDRCloseByBrakeOpt 0;
BA_ "NetworkRequest" SG_ 813 USM_PwrDRCloseByBrakeOpt 0;
BA_ "NetworkRequestHoldingTime" SG_ 813 USM_PwrDRCloseByBrakeOpt 5000;
BA_ "Version" SG_ 813 USM_PwrDRCloseByBrakeOpt "21.07.07";
BA_ "GenSigSendType" SG_ 813 USM_PwrDRBuzzerSta 4;
BA_ "UserSigValidity" SG_ 813 USM_PwrDRBuzzerSta 0;
BA_ "NetworkRequest" SG_ 813 USM_PwrDRBuzzerSta 0;
BA_ "NetworkRequestHoldingTime" SG_ 813 USM_PwrDRBuzzerSta 5000;
BA_ "Version" SG_ 813 USM_PwrDRBuzzerSta "21.07.07";
BA_ "GenSigSendType" SG_ 813 USM_PwrDRBuzzerOpt 4;
BA_ "UserSigValidity" SG_ 813 USM_PwrDRBuzzerOpt 0;
BA_ "NetworkRequest" SG_ 813 USM_PwrDRBuzzerOpt 0;
BA_ "NetworkRequestHoldingTime" SG_ 813 USM_PwrDRBuzzerOpt 5000;
BA_ "Version" SG_ 813 USM_PwrDRBuzzerOpt "21.07.07";
BA_ "GenSigSendType" SG_ 813 PDS_TypeOption_DRV 4;
BA_ "UserSigValidity" SG_ 813 PDS_TypeOption_DRV 0;
BA_ "NetworkRequest" SG_ 813 PDS_TypeOption_DRV 0;
BA_ "Version" SG_ 813 PDS_TypeOption_DRV "23.04.02";
BA_ "Description" SG_ 813 C_DrvDoorApproachOpen "Fob searching start and stop signal for PDS.";
BA_ "GenSigSendType" SG_ 813 C_DrvDoorApproachOpen 4;
BA_ "UserSigValidity" SG_ 813 C_DrvDoorApproachOpen 0;
BA_ "Version" SG_ 813 C_DrvDoorApproachOpen "21.07.07";
BA_ "Description" SG_ 813 C_DrvDoorApproachClose "To close the door automatically, request the fob searching signal";
BA_ "GenSigSendType" SG_ 813 C_DrvDoorApproachClose 4;
BA_ "UserSigValidity" SG_ 813 C_DrvDoorApproachClose 0;
BA_ "Version" SG_ 813 C_DrvDoorApproachClose "21.07.07";
BA_ "GenSigSendType" SG_ 813 DoorLock_PDSLkSwSta_DRV 4;
BA_ "UserSigValidity" SG_ 813 DoorLock_PDSLkSwSta_DRV 0;
BA_ "NetworkRequest" SG_ 813 DoorLock_PDSLkSwSta_DRV 0;
BA_ "Version" SG_ 813 DoorLock_PDSLkSwSta_DRV "21.07.07";
BA_ "GenSigSendType" SG_ 813 SBCM_DRV_DiagSta 4;
BA_ "UserSigValidity" SG_ 813 SBCM_DRV_DiagSta 0;
BA_ "NetworkRequest" SG_ 813 SBCM_DRV_DiagSta 0;
BA_ "NetworkRequestHoldingTime" SG_ 813 SBCM_DRV_DiagSta 5000;
BA_ "Version" SG_ 813 SBCM_DRV_DiagSta "21.07.07";
BA_ "Description" SG_ 813 DoorLock_CtrlDrLkUnLkSwSta_SBCM "Central Door Lock/Unlock Switch State";
BA_ "GenSigSendType" SG_ 813 DoorLock_CtrlDrLkUnLkSwSta_SBCM 4;
BA_ "UserSigValidity" SG_ 813 DoorLock_CtrlDrLkUnLkSwSta_SBCM 0;
BA_ "NetworkRequest" SG_ 813 DoorLock_CtrlDrLkUnLkSwSta_SBCM 0;
BA_ "NetworkRequestHoldingTime" SG_ 813 DoorLock_CtrlDrLkUnLkSwSta_SBCM 5000;
BA_ "Version" SG_ 813 DoorLock_CtrlDrLkUnLkSwSta_SBCM "21.07.07";
BA_ "GenSigSendType" SG_ 813 SBCM_PsvDrLkReq 4;
BA_ "UserSigValidity" SG_ 813 SBCM_PsvDrLkReq 0;
BA_ "NetworkRequest" SG_ 813 SBCM_PsvDrLkReq 0;
BA_ "Version" SG_ 813 SBCM_PsvDrLkReq "21.07.07";
BA_ "GenSigSendType" SG_ 813 CDMAutoWashModeSet_SBCM 4;
BA_ "UserSigValidity" SG_ 813 CDMAutoWashModeSet_SBCM 3;
BA_ "Version" SG_ 813 CDMAutoWashModeSet_SBCM "22.07.00";
BA_ "GenSigSendType" SG_ 813 USM_DrvGhostDoorSta 4;
BA_ "UserSigValidity" SG_ 813 USM_DrvGhostDoorSta 0;
BA_ "NetworkRequest" SG_ 813 USM_DrvGhostDoorSta 0;
BA_ "NetworkRequestHoldingTime" SG_ 813 USM_DrvGhostDoorSta 5000;
BA_ "Version" SG_ 813 USM_DrvGhostDoorSta "21.07.07";
BA_ "GenSigSendType" SG_ 813 Mirror_LH_FoldingSta 4;
BA_ "UserSigValidity" SG_ 813 Mirror_LH_FoldingSta 0;
BA_ "NetworkRequest" SG_ 813 Mirror_LH_FoldingSta 0;
BA_ "NetworkRequestHoldingTime" SG_ 813 Mirror_LH_FoldingSta 5000;
BA_ "Version" SG_ 813 Mirror_LH_FoldingSta "21.07.07";
BA_ "GenSigSendType" SG_ 813 Mirror_LH_UnfoldingSta 4;
BA_ "UserSigValidity" SG_ 813 Mirror_LH_UnfoldingSta 0;
BA_ "NetworkRequest" SG_ 813 Mirror_LH_UnfoldingSta 0;
BA_ "NetworkRequestHoldingTime" SG_ 813 Mirror_LH_UnfoldingSta 5000;
BA_ "Version" SG_ 813 Mirror_LH_UnfoldingSta "21.07.07";
BA_ "GenSigSendType" SG_ 813 DRV_CrashMRActAlarm 4;
BA_ "UserSigValidity" SG_ 813 DRV_CrashMRActAlarm 0;
BA_ "NetworkRequest" SG_ 813 DRV_CrashMRActAlarm 0;
BA_ "NetworkRequestHoldingTime" SG_ 813 DRV_CrashMRActAlarm 5000;
BA_ "Version" SG_ 813 DRV_CrashMRActAlarm "21.07.07";
BA_ "GenSigSendType" SG_ 813 AFH_DRV_FldUnFldSta 4;
BA_ "UserSigValidity" SG_ 813 AFH_DRV_FldUnFldSta 0;
BA_ "NetworkRequest" SG_ 813 AFH_DRV_FldUnFldSta 0;
BA_ "NetworkRequestHoldingTime" SG_ 813 AFH_DRV_FldUnFldSta 5000;
BA_ "Version" SG_ 813 AFH_DRV_FldUnFldSta "23.01.01";
BA_ "Description" SG_ 813 SBCM_DRV_FD_AlvCnt1Val "For the first transmission request for a data element the counter shall be initialized with 0 and shall be incremented by 1 for every subsequent send request. 

When the counter reaches the maximum value(0xFF), then it shall restart with 0 for the next s";
BA_ "GenSigSendType" SG_ 813 SBCM_DRV_FD_AlvCnt1Val 4;
BA_ "UserSigValidity" SG_ 813 SBCM_DRV_FD_AlvCnt1Val 3;
BA_ "Version" SG_ 813 SBCM_DRV_FD_AlvCnt1Val "22.10.20";
BA_ "GenSigSendType" SG_ 813 MirrorFldReq 4;
BA_ "UserSigValidity" SG_ 813 MirrorFldReq 0;
BA_ "NetworkRequest" SG_ 813 MirrorFldReq 0;
BA_ "NetworkRequestHoldingTime" SG_ 813 MirrorFldReq 5000;
BA_ "Version" SG_ 813 MirrorFldReq "21.07.07";
BA_ "GenSigSendType" SG_ 813 OMU_TypeOption_DRV 4;
BA_ "UserSigValidity" SG_ 813 OMU_TypeOption_DRV 0;
BA_ "NetworkRequest" SG_ 813 OMU_TypeOption_DRV 0;
BA_ "NetworkRequestHoldingTime" SG_ 813 OMU_TypeOption_DRV 5000;
BA_ "Version" SG_ 813 OMU_TypeOption_DRV "21.07.07";
BA_ "GenSigSendType" SG_ 813 IMS_OSMirPlayBackSta_LH 4;
BA_ "UserSigValidity" SG_ 813 IMS_OSMirPlayBackSta_LH 0;
BA_ "NetworkRequest" SG_ 813 IMS_OSMirPlayBackSta_LH 0;
BA_ "NetworkRequestHoldingTime" SG_ 813 IMS_OSMirPlayBackSta_LH 5000;
BA_ "Version" SG_ 813 IMS_OSMirPlayBackSta_LH "21.07.07";
BA_ "Description" SG_ 813 ECMMRR_PLUS "This signal for passenger outside mirror OEC function(or ECM)

SBCM_DRV receive the ECM voltage value via H/wiring and then send this signal to SBCM_AST";
BA_ "GenSigSendType" SG_ 813 ECMMRR_PLUS 4;
BA_ "UserSigValidity" SG_ 813 ECMMRR_PLUS 0;
BA_ "NetworkRequest" SG_ 813 ECMMRR_PLUS 0;
BA_ "NetworkRequestHoldingTime" SG_ 813 ECMMRR_PLUS 5000;
BA_ "Version" SG_ 813 ECMMRR_PLUS "21.07.07";
BA_ "Description" SG_ 813 EHL_TxInfo_SBCM_DRV "Electronic hood latch status signal transfer for dual hood latch type

(Copy to CANFD)";
BA_ "GenSigSendType" SG_ 813 EHL_TxInfo_SBCM_DRV 4;
BA_ "UserSigValidity" SG_ 813 EHL_TxInfo_SBCM_DRV 0;
BA_ "NetworkRequest" SG_ 813 EHL_TxInfo_SBCM_DRV 0;
BA_ "NetworkRequestHoldingTime" SG_ 813 EHL_TxInfo_SBCM_DRV 5000;
BA_ "Version" SG_ 813 EHL_TxInfo_SBCM_DRV "24.01.04";
BA_ "Description" SG_ 813 IMS_OSMirPlayBackSta_LH_New "Applied from standard DB 2.0";
BA_ "GenSigSendType" SG_ 813 IMS_OSMirPlayBackSta_LH_New 4;
BA_ "UserSigValidity" SG_ 813 IMS_OSMirPlayBackSta_LH_New 0;
BA_ "NetworkRequest" SG_ 813 IMS_OSMirPlayBackSta_LH_New 0;
BA_ "NetworkRequestHoldingTime" SG_ 813 IMS_OSMirPlayBackSta_LH_New 5000;
BA_ "Version" SG_ 813 IMS_OSMirPlayBackSta_LH_New "23.01.03";
BA_ "GenSigSendType" SG_ 813 CDM_InsideOpnSwSta 4;
BA_ "UserSigValidity" SG_ 813 CDM_InsideOpnSwSta 0;
BA_ "NetworkRequest" SG_ 813 CDM_InsideOpnSwSta 0;
BA_ "NetworkRequestHoldingTime" SG_ 813 CDM_InsideOpnSwSta 5000;
BA_ "Version" SG_ 813 CDM_InsideOpnSwSta "23.04.05";
BA_ "Description" SG_ 813 CDM_TypeOption "0x1 : On (CDM is applied)

0x2 : On_2EA (CDM 2EA are applied)";
BA_ "GenSigSendType" SG_ 813 CDM_TypeOption 4;
BA_ "UserSigValidity" SG_ 813 CDM_TypeOption 0;
BA_ "NetworkRequest" SG_ 813 CDM_TypeOption 0;
BA_ "NetworkRequestHoldingTime" SG_ 813 CDM_TypeOption 5000;
BA_ "Version" SG_ 813 CDM_TypeOption "23.04.02";
BA_ "Description" SG_ 813 CDM_ImmeChgSw_SBCM "State of Immediate Charging Switch";
BA_ "GenSigSendType" SG_ 813 CDM_ImmeChgSw_SBCM 4;
BA_ "UserSigValidity" SG_ 813 CDM_ImmeChgSw_SBCM 0;
BA_ "Version" SG_ 813 CDM_ImmeChgSw_SBCM "23.04.05";
BA_ "Description" SG_ 813 CDM_ChgDrSwFrt_SBCM "State of Front Charging Door Open Switch";
BA_ "GenSigSendType" SG_ 813 CDM_ChgDrSwFrt_SBCM 4;
BA_ "UserSigValidity" SG_ 813 CDM_ChgDrSwFrt_SBCM 0;
BA_ "Version" SG_ 813 CDM_ChgDrSwFrt_SBCM "23.04.05";
BA_ "Description" SG_ 813 CDM_OpnClsState_SBCM "This signal indicates CDM Open/Close Status";
BA_ "GenSigSendType" SG_ 813 CDM_OpnClsState_SBCM 4;
BA_ "UserSigValidity" SG_ 813 CDM_OpnClsState_SBCM 0;
BA_ "Version" SG_ 813 CDM_OpnClsState_SBCM "23.04.05";
BA_ "Description" SG_ 813 CDM_WarnMsg_SBCM "Command for CDM Warning on cluster";
BA_ "GenSigSendType" SG_ 813 CDM_WarnMsg_SBCM 4;
BA_ "UserSigValidity" SG_ 813 CDM_WarnMsg_SBCM 0;
BA_ "Version" SG_ 813 CDM_WarnMsg_SBCM "23.04.05";
BA_ "GenSigSendType" SG_ 813 CDM_AutoWashModeSta 4;
BA_ "UserSigValidity" SG_ 813 CDM_AutoWashModeSta 0;
BA_ "NetworkRequest" SG_ 813 CDM_AutoWashModeSta 0;
BA_ "NetworkRequestHoldingTime" SG_ 813 CDM_AutoWashModeSta 5000;
BA_ "Version" SG_ 813 CDM_AutoWashModeSta "22.02.00";
BA_ "Description" SG_ 813 CDM_CmdStatus_SBCM "User Condition Check For CDM Operation";
BA_ "GenSigSendType" SG_ 813 CDM_CmdStatus_SBCM 4;
BA_ "GenSigStartValue" SG_ 813 CDM_CmdStatus_SBCM 15;
BA_ "UserSigValidity" SG_ 813 CDM_CmdStatus_SBCM 0;
BA_ "Version" SG_ 813 CDM_CmdStatus_SBCM "23.04.05";
BA_ "Description" SG_ 813 CDM_OutsideOpnSwSta "Charing Dorr O/S SW State";
BA_ "GenSigSendType" SG_ 813 CDM_OutsideOpnSwSta 4;
BA_ "UserSigValidity" SG_ 813 CDM_OutsideOpnSwSta 0;
BA_ "NetworkRequest" SG_ 813 CDM_OutsideOpnSwSta 0;
BA_ "NetworkRequestHoldingTime" SG_ 813 CDM_OutsideOpnSwSta 5000;
BA_ "Version" SG_ 813 CDM_OutsideOpnSwSta "23.04.05";
BA_ "GenSigSendType" SG_ 813 PwrDRBuzzerOut_DRV 4;
BA_ "UserSigValidity" SG_ 813 PwrDRBuzzerOut_DRV 0;
BA_ "NetworkRequest" SG_ 813 PwrDRBuzzerOut_DRV 0;
BA_ "NetworkRequestHoldingTime" SG_ 813 PwrDRBuzzerOut_DRV 5000;
BA_ "Version" SG_ 813 PwrDRBuzzerOut_DRV "21.07.07";
BA_ "GenSigSendType" SG_ 813 Warn_HoodSwSta_SBCM 4;
BA_ "UserSigValidity" SG_ 813 Warn_HoodSwSta_SBCM 0;
BA_ "NetworkRequest" SG_ 813 Warn_HoodSwSta_SBCM 0;
BA_ "NetworkRequestHoldingTime" SG_ 813 Warn_HoodSwSta_SBCM 5000;
BA_ "Version" SG_ 813 Warn_HoodSwSta_SBCM "21.09.08";
BA_ "Description" SG_ 813 Hood_TypeOption "If the E-Hood is applied, the signal will be send.";
BA_ "GenSigSendType" SG_ 813 Hood_TypeOption 4;
BA_ "UserSigValidity" SG_ 813 Hood_TypeOption 0;
BA_ "NetworkRequest" SG_ 813 Hood_TypeOption 0;
BA_ "NetworkRequestHoldingTime" SG_ 813 Hood_TypeOption 5000;
BA_ "Version" SG_ 813 Hood_TypeOption "22.03.01";
BA_ "GenSigSendType" SG_ 813 SBCM_FrunkSta 4;
BA_ "UserSigValidity" SG_ 813 SBCM_FrunkSta 0;
BA_ "NetworkRequest" SG_ 813 SBCM_FrunkSta 0;
BA_ "NetworkRequestHoldingTime" SG_ 813 SBCM_FrunkSta 5000;
BA_ "Version" SG_ 813 SBCM_FrunkSta "22.01.06";
BA_ "GenSigSendType" SG_ 813 Warn_HoodSwFullSta_SBCM 4;
BA_ "UserSigValidity" SG_ 813 Warn_HoodSwFullSta_SBCM 0;
BA_ "NetworkRequest" SG_ 813 Warn_HoodSwFullSta_SBCM 0;
BA_ "NetworkRequestHoldingTime" SG_ 813 Warn_HoodSwFullSta_SBCM 5000;
BA_ "Version" SG_ 813 Warn_HoodSwFullSta_SBCM "22.01.06";
BA_ "GenSigSendType" SG_ 813 FrunkWarning_SBCM 4;
BA_ "UserSigValidity" SG_ 813 FrunkWarning_SBCM 0;
BA_ "NetworkRequest" SG_ 813 FrunkWarning_SBCM 0;
BA_ "NetworkRequestHoldingTime" SG_ 813 FrunkWarning_SBCM 5000;
BA_ "Version" SG_ 813 FrunkWarning_SBCM "22.03.01";
BA_ "Description" SG_ 813 SBCM_Longkey_DRVDrAtClsSwSta "FCS Power Door Long key Status";
BA_ "GenSigSendType" SG_ 813 SBCM_Longkey_DRVDrAtClsSwSta 4;
BA_ "UserSigValidity" SG_ 813 SBCM_Longkey_DRVDrAtClsSwSta 0;
BA_ "NetworkRequest" SG_ 813 SBCM_Longkey_DRVDrAtClsSwSta 0;
BA_ "NetworkRequestHoldingTime" SG_ 813 SBCM_Longkey_DRVDrAtClsSwSta 5000;
BA_ "Version" SG_ 813 SBCM_Longkey_DRVDrAtClsSwSta "22.04.02";
BA_ "Description" SG_ 813 FrunkReleaseSwSta_SBCM "FrunkReleaseState";
BA_ "GenSigSendType" SG_ 813 FrunkReleaseSwSta_SBCM 4;
BA_ "UserSigValidity" SG_ 813 FrunkReleaseSwSta_SBCM 0;
BA_ "NetworkRequest" SG_ 813 FrunkReleaseSwSta_SBCM 0;
BA_ "NetworkRequestHoldingTime" SG_ 813 FrunkReleaseSwSta_SBCM 50000;
BA_ "Version" SG_ 813 FrunkReleaseSwSta_SBCM "23.04.04";
BA_ "GenSigSendType" SG_ 813 PwrDRClosingDRVDrSta 4;
BA_ "UserSigValidity" SG_ 813 PwrDRClosingDRVDrSta 0;
BA_ "NetworkRequest" SG_ 813 PwrDRClosingDRVDrSta 0;
BA_ "NetworkRequestHoldingTime" SG_ 813 PwrDRClosingDRVDrSta 5000;
BA_ "Version" SG_ 813 PwrDRClosingDRVDrSta "23.10.11";
BA_ "GenSigSendType" SG_ 813 Drv_DrLkRetryFail_SBCM 4;
BA_ "TimeoutValue" SG_ 813 Drv_DrLkRetryFail_SBCM "0x0";
BA_ "UserSigValidity" SG_ 813 Drv_DrLkRetryFail_SBCM 0;
BA_ "NetworkRequest" SG_ 813 Drv_DrLkRetryFail_SBCM 0;
BA_ "NetworkRequestHoldingTime" SG_ 813 Drv_DrLkRetryFail_SBCM 5000;
BA_ "Version" SG_ 813 Drv_DrLkRetryFail_SBCM "23.03.00";
BA_ "Description" SG_ 813 CDM_GbtImmeChgSw_SBCM "State of Immediate Charging Switch";
BA_ "GenSigSendType" SG_ 813 CDM_GbtImmeChgSw_SBCM 4;
BA_ "UserSigValidity" SG_ 813 CDM_GbtImmeChgSw_SBCM 0;
BA_ "Version" SG_ 813 CDM_GbtImmeChgSw_SBCM "23.04.02";
BA_ "Description" SG_ 813 CDM_GbtOpnClsState_SBCM "This signal indicates CDM Open/Close Status(Gbt)";
BA_ "GenSigSendType" SG_ 813 CDM_GbtOpnClsState_SBCM 4;
BA_ "UserSigValidity" SG_ 813 CDM_GbtOpnClsState_SBCM 0;
BA_ "Version" SG_ 813 CDM_GbtOpnClsState_SBCM "23.04.02";
BA_ "Description" SG_ 813 CDM_GbtWarnMsg_SBCM "Command for CDM Warning on cluster(Gbt)";
BA_ "GenSigSendType" SG_ 813 CDM_GbtWarnMsg_SBCM 4;
BA_ "UserSigValidity" SG_ 813 CDM_GbtWarnMsg_SBCM 0;
BA_ "Version" SG_ 813 CDM_GbtWarnMsg_SBCM "23.04.02";
BA_ "GenSigSendType" SG_ 813 CDM_GbtOutsideOpnSwSta 4;
BA_ "UserSigValidity" SG_ 813 CDM_GbtOutsideOpnSwSta 0;
BA_ "NetworkRequest" SG_ 813 CDM_GbtOutsideOpnSwSta 0;
BA_ "NetworkRequestHoldingTime" SG_ 813 CDM_GbtOutsideOpnSwSta 5000;
BA_ "Version" SG_ 813 CDM_GbtOutsideOpnSwSta "24.01.03";
BA_ "Description" SG_ 813 DoorLock_DrvLkOutSta_SBCM "- Door Lock or Unlock Output State 

0x0 : Off (Door lock/unlock output Off state)

0x1 : On (Door lock/unlock output On state)";
BA_ "GenSigSendType" SG_ 813 DoorLock_DrvLkOutSta_SBCM 4;
BA_ "UserSigValidity" SG_ 813 DoorLock_DrvLkOutSta_SBCM 0;
BA_ "NetworkRequest" SG_ 813 DoorLock_DrvLkOutSta_SBCM 0;
BA_ "NetworkRequestHoldingTime" SG_ 813 DoorLock_DrvLkOutSta_SBCM 5000;
BA_ "Version" SG_ 813 DoorLock_DrvLkOutSta_SBCM "23.02.09";
BA_ "Description" SG_ 813 FrunkEmergencySwSta_SBCM "FrunkEmergencySwState";
BA_ "GenSigSendType" SG_ 813 FrunkEmergencySwSta_SBCM 4;
BA_ "UserSigValidity" SG_ 813 FrunkEmergencySwSta_SBCM 0;
BA_ "NetworkRequest" SG_ 813 FrunkEmergencySwSta_SBCM 0;
BA_ "NetworkRequestHoldingTime" SG_ 813 FrunkEmergencySwSta_SBCM 5000;
BA_ "Version" SG_ 813 FrunkEmergencySwSta_SBCM "23.04.04";
BA_ "GenSigSendType" SG_ 813 DRV_DetectObj_warn_LH 4;
BA_ "UserSigValidity" SG_ 813 DRV_DetectObj_warn_LH 0;
BA_ "NetworkRequest" SG_ 813 DRV_DetectObj_warn_LH 0;
BA_ "NetworkRequestHoldingTime" SG_ 813 DRV_DetectObj_warn_LH 5000;
BA_ "Version" SG_ 813 DRV_DetectObj_warn_LH "23.10.11";
BA_ "GenSigSendType" SG_ 813 PwrDROpenClosingDdvSdDRSta 4;
BA_ "UserSigValidity" SG_ 813 PwrDROpenClosingDdvSdDRSta 0;
BA_ "NetworkRequest" SG_ 813 PwrDROpenClosingDdvSdDRSta 0;
BA_ "NetworkRequestHoldingTime" SG_ 813 PwrDROpenClosingDdvSdDRSta 5000;
BA_ "Version" SG_ 813 PwrDROpenClosingDdvSdDRSta "23.10.11";
BA_ "Description" SG_ 813 PwrDRBuzzerOut_DRV_New "JG~ 적용";
BA_ "GenSigSendType" SG_ 813 PwrDRBuzzerOut_DRV_New 4;
BA_ "UserSigValidity" SG_ 813 PwrDRBuzzerOut_DRV_New 0;
BA_ "NetworkRequest" SG_ 813 PwrDRBuzzerOut_DRV_New 0;
BA_ "NetworkRequestHoldingTime" SG_ 813 PwrDRBuzzerOut_DRV_New 5000;
BA_ "Version" SG_ 813 PwrDRBuzzerOut_DRV_New "24.01.05";
BA_ "GenSigSendType" SG_ 813 Coach_TypeOption_DRV 4;
BA_ "GenSigStartValue" SG_ 813 Coach_TypeOption_DRV 3;
BA_ "UserSigValidity" SG_ 813 Coach_TypeOption_DRV 0;
BA_ "NetworkRequest" SG_ 813 Coach_TypeOption_DRV 0;
BA_ "NetworkRequestHoldingTime" SG_ 813 Coach_TypeOption_DRV 5000;
BA_ "Version" SG_ 813 Coach_TypeOption_DRV "24.01.07";
BA_ "GenSigSendType" SG_ 813 PwrDrSta_Drv 4;
BA_ "UserSigValidity" SG_ 813 PwrDrSta_Drv 0;
BA_ "NetworkRequest" SG_ 813 PwrDrSta_Drv 0;
BA_ "NetworkRequestHoldingTime" SG_ 813 PwrDrSta_Drv 5000;
BA_ "Version" SG_ 813 PwrDrSta_Drv "24.01.05";
BA_ "GenSigSendType" SG_ 813 PwrDrSta_DrvSd 4;
BA_ "UserSigValidity" SG_ 813 PwrDrSta_DrvSd 0;
BA_ "NetworkRequest" SG_ 813 PwrDrSta_DrvSd 0;
BA_ "NetworkRequestHoldingTime" SG_ 813 PwrDrSta_DrvSd 5000;
BA_ "Version" SG_ 813 PwrDrSta_DrvSd "24.01.05";
BA_ "GenSigSendType" SG_ 813 USM_PwrDrOpnTypSta 4;
BA_ "UserSigValidity" SG_ 813 USM_PwrDrOpnTypSta 0;
BA_ "NetworkRequest" SG_ 813 USM_PwrDrOpnTypSta 0;
BA_ "NetworkRequestHoldingTime" SG_ 813 USM_PwrDrOpnTypSta 5000;
BA_ "Version" SG_ 813 USM_PwrDrOpnTypSta "24.01.05";
BA_ "GenSigSendType" SG_ 813 DischrgDr_OpnClsState_SBCM 4;
BA_ "UserSigValidity" SG_ 813 DischrgDr_OpnClsState_SBCM 0;
BA_ "NetworkRequest" SG_ 813 DischrgDr_OpnClsState_SBCM 0;
BA_ "NetworkRequestHoldingTime" SG_ 813 DischrgDr_OpnClsState_SBCM 5000;
BA_ "Version" SG_ 813 DischrgDr_OpnClsState_SBCM "24.01.04";
BA_ "Description" SG_ 813 SBCM_FL_DoorAngle "PDSM_FL_DoorAngle";
BA_ "GenSigSendType" SG_ 813 SBCM_FL_DoorAngle 4;
BA_ "GenSigStartValue" SG_ 813 SBCM_FL_DoorAngle 100;
BA_ "UserSigValidity" SG_ 813 SBCM_FL_DoorAngle 0;
BA_ "NetworkRequest" SG_ 813 SBCM_FL_DoorAngle 0;
BA_ "NetworkRequestHoldingTime" SG_ 813 SBCM_FL_DoorAngle 5000;
BA_ "Version" SG_ 813 SBCM_FL_DoorAngle "24.01.05";
BA_ "Description" SG_ 813 SBCM_DoorType_DRV "SBCM Applied Type";
BA_ "GenSigSendType" SG_ 813 SBCM_DoorType_DRV 4;
BA_ "GenSigStartValue" SG_ 813 SBCM_DoorType_DRV 2;
BA_ "UserSigValidity" SG_ 813 SBCM_DoorType_DRV 0;
BA_ "NetworkRequest" SG_ 813 SBCM_DoorType_DRV 0;
BA_ "NetworkRequestHoldingTime" SG_ 813 SBCM_DoorType_DRV 5000;
BA_ "Version" SG_ 813 SBCM_DoorType_DRV "24.01.07";
BA_ "GenSigSendType" SG_ 813 DRVDoorPushAlarm 4;
BA_ "UserSigValidity" SG_ 813 DRVDoorPushAlarm 0;
BA_ "NetworkRequest" SG_ 813 DRVDoorPushAlarm 0;
BA_ "NetworkRequestHoldingTime" SG_ 813 DRVDoorPushAlarm 5000;
BA_ "Version" SG_ 813 DRVDoorPushAlarm "21.07.07";
BA_ "Description" SG_ 813 DRV_CrashUnlockCmd "Drive Crash Unlock Command";
BA_ "GenSigSendType" SG_ 813 DRV_CrashUnlockCmd 4;
BA_ "UserSigValidity" SG_ 813 DRV_CrashUnlockCmd 0;
BA_ "NetworkRequest" SG_ 813 DRV_CrashUnlockCmd 0;
BA_ "Version" SG_ 813 DRV_CrashUnlockCmd "21.07.07";
BA_ "Description" SG_ 813 C_ApprOpenStatus "This is for Power Door System enable/disable signal.";
BA_ "GenSigSendType" SG_ 813 C_ApprOpenStatus 4;
BA_ "UserSigValidity" SG_ 813 C_ApprOpenStatus 0;
BA_ "Version" SG_ 813 C_ApprOpenStatus "21.07.07";
BA_ "Description" SG_ 813 DoorLock_DrvKeyLkSwSta_SBCM "Door Lock Driver Mechanical Key Input Signal";
BA_ "GenSigSendType" SG_ 813 DoorLock_DrvKeyLkSwSta_SBCM 4;
BA_ "UserSigValidity" SG_ 813 DoorLock_DrvKeyLkSwSta_SBCM 0;
BA_ "NetworkRequest" SG_ 813 DoorLock_DrvKeyLkSwSta_SBCM 0;
BA_ "Version" SG_ 813 DoorLock_DrvKeyLkSwSta_SBCM "21.07.07";
BA_ "Description" SG_ 813 DoorLock_DrvKeyUnLkSwSta_SBCM "Door Drive Mechanical Key Unlock Switch State";
BA_ "GenSigSendType" SG_ 813 DoorLock_DrvKeyUnLkSwSta_SBCM 4;
BA_ "UserSigValidity" SG_ 813 DoorLock_DrvKeyUnLkSwSta_SBCM 0;
BA_ "NetworkRequest" SG_ 813 DoorLock_DrvKeyUnLkSwSta_SBCM 0;
BA_ "Version" SG_ 813 DoorLock_DrvKeyUnLkSwSta_SBCM "21.07.07";
BA_ "Description" SG_ 813 Warn_DrvDrSwSta_SBCM "Warning Drive Door Switch State";
BA_ "GenSigSendType" SG_ 813 Warn_DrvDrSwSta_SBCM 4;
BA_ "UserSigValidity" SG_ 813 Warn_DrvDrSwSta_SBCM 0;
BA_ "NetworkRequest" SG_ 813 Warn_DrvDrSwSta_SBCM 0;
BA_ "Version" SG_ 813 Warn_DrvDrSwSta_SBCM "21.09.05";
BA_ "Description" SG_ 813 DoorLock_DrvDrUnLkSta_SBCM "Drive Door Lock Unlock Status";
BA_ "GenSigSendType" SG_ 813 DoorLock_DrvDrUnLkSta_SBCM 4;
BA_ "UserSigValidity" SG_ 813 DoorLock_DrvDrUnLkSta_SBCM 0;
BA_ "NetworkRequest" SG_ 813 DoorLock_DrvDrUnLkSta_SBCM 0;
BA_ "Version" SG_ 813 DoorLock_DrvDrUnLkSta_SBCM "21.09.05";
BA_ "Description" SG_ 813 DRV_SEAWarn_LH "Drive (FLH) Door SEA Warning";
BA_ "GenSigSendType" SG_ 813 DRV_SEAWarn_LH 4;
BA_ "UserSigValidity" SG_ 813 DRV_SEAWarn_LH 0;
BA_ "NetworkRequest" SG_ 813 DRV_SEAWarn_LH 0;
BA_ "Version" SG_ 813 DRV_SEAWarn_LH "21.07.07";
BA_ "Description" SG_ 813 DRV_SEAWarn_RH "Drive (FRH) Door SEA Warning";
BA_ "GenSigSendType" SG_ 813 DRV_SEAWarn_RH 4;
BA_ "UserSigValidity" SG_ 813 DRV_SEAWarn_RH 0;
BA_ "NetworkRequest" SG_ 813 DRV_SEAWarn_RH 0;
BA_ "Version" SG_ 813 DRV_SEAWarn_RH "21.07.07";
BA_ "Description" SG_ 813 DRV_SEWWarn_LH "Drive (FLH) Door Safety Exit Warning";
BA_ "GenSigSendType" SG_ 813 DRV_SEWWarn_LH 4;
BA_ "UserSigValidity" SG_ 813 DRV_SEWWarn_LH 0;
BA_ "NetworkRequest" SG_ 813 DRV_SEWWarn_LH 0;
BA_ "Version" SG_ 813 DRV_SEWWarn_LH "21.07.07";
BA_ "Description" SG_ 813 DRV_SEWWarn_RH "Drive (FRH) Door Safety Exit Warning";
BA_ "GenSigSendType" SG_ 813 DRV_SEWWarn_RH 4;
BA_ "UserSigValidity" SG_ 813 DRV_SEWWarn_RH 0;
BA_ "NetworkRequest" SG_ 813 DRV_SEWWarn_RH 0;
BA_ "Version" SG_ 813 DRV_SEWWarn_RH "21.07.07";
BA_ "GenSigSendType" SG_ 813 DRV_MRActivationAlarm 4;
BA_ "UserSigValidity" SG_ 813 DRV_MRActivationAlarm 0;
BA_ "NetworkRequest" SG_ 813 DRV_MRActivationAlarm 0;
BA_ "NetworkRequestHoldingTime" SG_ 813 DRV_MRActivationAlarm 5000;
BA_ "Version" SG_ 813 DRV_MRActivationAlarm "21.07.07";
BA_ "GenSigSendType" SG_ 813 DRV_ReleaseWarn 4;
BA_ "UserSigValidity" SG_ 813 DRV_ReleaseWarn 0;
BA_ "NetworkRequest" SG_ 813 DRV_ReleaseWarn 0;
BA_ "NetworkRequestHoldingTime" SG_ 813 DRV_ReleaseWarn 5000;
BA_ "Version" SG_ 813 DRV_ReleaseWarn "21.09.05";
BA_ "Description" SG_ 992 PDC_FD_Crc1Val "The data area for CRC calculation is based on the data length (DLC) of the message DB.

The CRC shall be calculated over the entire data block (excluding the CRC bytes) including the user data, alive counter and Data ID



- CRC Polynomial (0x1021) , Ini";
BA_ "GenSigSendType" SG_ 992 PDC_FD_Crc1Val 4;
BA_ "GenSigStartValue" SG_ 992 PDC_FD_Crc1Val 65535;
BA_ "UserSigValidity" SG_ 992 PDC_FD_Crc1Val 3;
BA_ "Version" SG_ 992 PDC_FD_Crc1Val "22.10.20";
BA_ "Description" SG_ 992 C_3rdRCSeatBeltSW "3rd Rear Center Seat Belt Switch Status";
BA_ "GenSigSendType" SG_ 992 C_3rdRCSeatBeltSW 4;
BA_ "UserSigValidity" SG_ 992 C_3rdRCSeatBeltSW 0;
BA_ "NetworkRequest" SG_ 992 C_3rdRCSeatBeltSW 0;
BA_ "NetworkRequestHoldingTime" SG_ 992 C_3rdRCSeatBeltSW 5000;
BA_ "Version" SG_ 992 C_3rdRCSeatBeltSW "18.03.04";
BA_ "Description" SG_ 992 C_3rdRRSeatBeltSW "3rd Rear Right Seat Belt Switch Status";
BA_ "GenSigSendType" SG_ 992 C_3rdRRSeatBeltSW 4;
BA_ "UserSigValidity" SG_ 992 C_3rdRRSeatBeltSW 0;
BA_ "NetworkRequest" SG_ 992 C_3rdRRSeatBeltSW 0;
BA_ "NetworkRequestHoldingTime" SG_ 992 C_3rdRRSeatBeltSW 5000;
BA_ "Version" SG_ 992 C_3rdRRSeatBeltSW "18.03.04";
BA_ "Description" SG_ 992 C_1stCTRSeatBeltSW "1st Center Seat Belt Switch Status";
BA_ "GenSigSendType" SG_ 992 C_1stCTRSeatBeltSW 4;
BA_ "UserSigValidity" SG_ 992 C_1stCTRSeatBeltSW 0;
BA_ "NetworkRequest" SG_ 992 C_1stCTRSeatBeltSW 0;
BA_ "NetworkRequestHoldingTime" SG_ 992 C_1stCTRSeatBeltSW 5000;
BA_ "Version" SG_ 992 C_1stCTRSeatBeltSW "19.04.06";
BA_ "Description" SG_ 992 Warn_DrvStOccSta "Driver Presence Detection MAT Switch Status";
BA_ "GenSigSendType" SG_ 992 Warn_DrvStOccSta 4;
BA_ "UserSigValidity" SG_ 992 Warn_DrvStOccSta 0;
BA_ "NetworkRequest" SG_ 992 Warn_DrvStOccSta 0;
BA_ "NetworkRequestHoldingTime" SG_ 992 Warn_DrvStOccSta 5000;
BA_ "Version" SG_ 992 Warn_DrvStOccSta "22.05.04";
BA_ "Description" SG_ 992 DPDMat_HDPSpprtSWVer "This signal indicates HDP-DPD Mat signal processing Requirement Spec Version";
BA_ "GenSigSendType" SG_ 992 DPDMat_HDPSpprtSWVer 4;
BA_ "UserSigValidity" SG_ 992 DPDMat_HDPSpprtSWVer 3;
BA_ "Version" SG_ 992 DPDMat_HDPSpprtSWVer "21.12.04";
BA_ "Description" SG_ 992 Warn_PassStOccSta "Passenger Seated State







-Default value: 0x0 (미탑승)



-Initial value: 0x0 (미탑승)



-Timeout value: 0x0 (미탑승)";
BA_ "GenSigSendType" SG_ 992 Warn_PassStOccSta 4;
BA_ "UserSigValidity" SG_ 992 Warn_PassStOccSta 0;
BA_ "NetworkRequest" SG_ 992 Warn_PassStOccSta 0;
BA_ "NetworkRequestHoldingTime" SG_ 992 Warn_PassStOccSta 5000;
BA_ "Version" SG_ 992 Warn_PassStOccSta "17.12.00";
BA_ "Description" SG_ 992 Warn_RrLftSBRMATSwSta "Rear Left Seated State";
BA_ "GenSigSendType" SG_ 992 Warn_RrLftSBRMATSwSta 4;
BA_ "UserSigValidity" SG_ 992 Warn_RrLftSBRMATSwSta 0;
BA_ "NetworkRequest" SG_ 992 Warn_RrLftSBRMATSwSta 0;
BA_ "NetworkRequestHoldingTime" SG_ 992 Warn_RrLftSBRMATSwSta 5000;
BA_ "Version" SG_ 992 Warn_RrLftSBRMATSwSta "21.11.00";
BA_ "Description" SG_ 992 Warn_RrRhtSBRMATSwSta "Rear Right Seated State";
BA_ "GenSigSendType" SG_ 992 Warn_RrRhtSBRMATSwSta 4;
BA_ "UserSigValidity" SG_ 992 Warn_RrRhtSBRMATSwSta 0;
BA_ "NetworkRequest" SG_ 992 Warn_RrRhtSBRMATSwSta 0;
BA_ "NetworkRequestHoldingTime" SG_ 992 Warn_RrRhtSBRMATSwSta 5000;
BA_ "Version" SG_ 992 Warn_RrRhtSBRMATSwSta "21.11.00";
BA_ "Description" SG_ 992 C_3rdRLSBRMatSw "3rd Rear Left Seated State



-Default value: 0x0 (미탑승)

-Initial value: 0x0 (미탑승)

-Timeout value: 0x0 (미탑승)";
BA_ "GenSigSendType" SG_ 992 C_3rdRLSBRMatSw 4;
BA_ "UserSigValidity" SG_ 992 C_3rdRLSBRMatSw 0;
BA_ "NetworkRequest" SG_ 992 C_3rdRLSBRMatSw 0;
BA_ "NetworkRequestHoldingTime" SG_ 992 C_3rdRLSBRMatSw 5000;
BA_ "Version" SG_ 992 C_3rdRLSBRMatSw "18.03.04";
BA_ "Description" SG_ 992 C_3rdRRSBRMatSw "3rd Rear Right Seated State



-Default value: 0x0 (미탑승)

-Initial value: 0x0 (미탑승)

-Timeout value: 0x0 (미탑승)";
BA_ "GenSigSendType" SG_ 992 C_3rdRRSBRMatSw 4;
BA_ "UserSigValidity" SG_ 992 C_3rdRRSBRMatSw 0;
BA_ "NetworkRequest" SG_ 992 C_3rdRRSBRMatSw 0;
BA_ "NetworkRequestHoldingTime" SG_ 992 C_3rdRRSBRMatSw 5000;
BA_ "Version" SG_ 992 C_3rdRRSBRMatSw "18.03.04";
BA_ "Description" SG_ 992 C_1stCTRSBRMatSw "1st Center Seated State



-Default value: 0x0 (미탑승)

-Initial value: 0x0 (미탑승)

-Timeout value: 0x0 (미탑승)";
BA_ "GenSigSendType" SG_ 992 C_1stCTRSBRMatSw 4;
BA_ "UserSigValidity" SG_ 992 C_1stCTRSBRMatSw 0;
BA_ "NetworkRequest" SG_ 992 C_1stCTRSBRMatSw 0;
BA_ "NetworkRequestHoldingTime" SG_ 992 C_1stCTRSBRMatSw 5000;
BA_ "Version" SG_ 992 C_1stCTRSBRMatSw "19.04.06";
BA_ "Description" SG_ 992 StrWhlWrmrSwState "PDC Steering Wheel Warmer Self Return Type Manual Switch State";
BA_ "GenSigSendType" SG_ 992 StrWhlWrmrSwState 4;
BA_ "UserSigValidity" SG_ 992 StrWhlWrmrSwState 4;
BA_ "Version" SG_ 992 StrWhlWrmrSwState "20.08.07";
BA_ "Description" SG_ 992 StrWhlWrmrFlModDetail "Steering Wheel Warmer Fail Mode Detail Information";
BA_ "GenSigSendType" SG_ 992 StrWhlWrmrFlModDetail 4;
BA_ "UserSigValidity" SG_ 992 StrWhlWrmrFlModDetail 4;
BA_ "Version" SG_ 992 StrWhlWrmrFlModDetail "20.08.07";
BA_ "Description" SG_ 992 FrHtdGlsSwState "Front Heated Glass Switch State";
BA_ "GenSigSendType" SG_ 992 FrHtdGlsSwState 4;
BA_ "UserSigValidity" SG_ 992 FrHtdGlsSwState 4;
BA_ "Version" SG_ 992 FrHtdGlsSwState "20.08.07";
BA_ "Description" SG_ 992 RrGlsHtSwState "Rear Glass Heated Switch State";
BA_ "GenSigSendType" SG_ 992 RrGlsHtSwState 4;
BA_ "UserSigValidity" SG_ 992 RrGlsHtSwState 4;
BA_ "Version" SG_ 992 RrGlsHtSwState "21.01.06";
BA_ "Description" SG_ 992 RLChldLkLatchSwState "Rear Left Electric Child Lock Latch Lock Unlock State";
BA_ "GenSigSendType" SG_ 992 RLChldLkLatchSwState 4;
BA_ "UserSigValidity" SG_ 992 RLChldLkLatchSwState 0;
BA_ "NetworkRequest" SG_ 992 RLChldLkLatchSwState 0;
BA_ "NetworkRequestHoldingTime" SG_ 992 RLChldLkLatchSwState 5000;
BA_ "Version" SG_ 992 RLChldLkLatchSwState "20.08.07";
BA_ "Description" SG_ 992 RRChldLkLatchSwState "Rear Right Electric Child Lock Latch Lock Unlock State";
BA_ "GenSigSendType" SG_ 992 RRChldLkLatchSwState 4;
BA_ "UserSigValidity" SG_ 992 RRChldLkLatchSwState 0;
BA_ "NetworkRequest" SG_ 992 RRChldLkLatchSwState 0;
BA_ "NetworkRequestHoldingTime" SG_ 992 RRChldLkLatchSwState 5000;
BA_ "Version" SG_ 992 RRChldLkLatchSwState "20.08.07";
BA_ "Description" SG_ 992 ChildLock_ActnFlSta "Child Lock actuation failed";
BA_ "GenSigSendType" SG_ 992 ChildLock_ActnFlSta 4;
BA_ "UserSigValidity" SG_ 992 ChildLock_ActnFlSta 0;
BA_ "NetworkRequest" SG_ 992 ChildLock_ActnFlSta 0;
BA_ "NetworkRequestHoldingTime" SG_ 992 ChildLock_ActnFlSta 5000;
BA_ "Version" SG_ 992 ChildLock_ActnFlSta "17.12.00";
BA_ "Description" SG_ 992 DoorLock_LkOutSta "- Door Lock or Unlock Output State 



0x0 : Off (Door lock/unlock output Off state)



0x1 : On (Door lock/unlock output On state)";
BA_ "GenSigSendType" SG_ 992 DoorLock_LkOutSta 4;
BA_ "UserSigValidity" SG_ 992 DoorLock_LkOutSta 0;
BA_ "NetworkRequest" SG_ 992 DoorLock_LkOutSta 0;
BA_ "NetworkRequestHoldingTime" SG_ 992 DoorLock_LkOutSta 5000;
BA_ "Version" SG_ 992 DoorLock_LkOutSta "17.12.00";
BA_ "Description" SG_ 992 VSAutoDrLkRetryFailSta "Door lock fail status after vehicle speed auto door lock retry 3 times";
BA_ "GenSigSendType" SG_ 992 VSAutoDrLkRetryFailSta 4;
BA_ "TimeoutValue" SG_ 992 VSAutoDrLkRetryFailSta "0x0";
BA_ "UserSigValidity" SG_ 992 VSAutoDrLkRetryFailSta 6;
BA_ "NetworkRequest" SG_ 992 VSAutoDrLkRetryFailSta 0;
BA_ "NetworkRequestHoldingTime" SG_ 992 VSAutoDrLkRetryFailSta 5000;
BA_ "Version" SG_ 992 VSAutoDrLkRetryFailSta "21.11.00";
BA_ "Description" SG_ 992 Trunk_TrnkTlgtOutReleaseSwSta "-(Old)C_TRUNK_LID

-Trunk/Tailgate Outter Release SW";
BA_ "GenSigSendType" SG_ 992 Trunk_TrnkTlgtOutReleaseSwSta 4;
BA_ "UserSigValidity" SG_ 992 Trunk_TrnkTlgtOutReleaseSwSta 0;
BA_ "NetworkRequest" SG_ 992 Trunk_TrnkTlgtOutReleaseSwSta 0;
BA_ "NetworkRequestHoldingTime" SG_ 992 Trunk_TrnkTlgtOutReleaseSwSta 5000;
BA_ "Version" SG_ 992 Trunk_TrnkTlgtOutReleaseSwSta "23.04.02";
BA_ "Description" SG_ 992 Trunk_TrnkInReleaseSwSta "-Trunk Inner Release SW";
BA_ "GenSigSendType" SG_ 992 Trunk_TrnkInReleaseSwSta 4;
BA_ "UserSigValidity" SG_ 992 Trunk_TrnkInReleaseSwSta 0;
BA_ "NetworkRequest" SG_ 992 Trunk_TrnkInReleaseSwSta 0;
BA_ "NetworkRequestHoldingTime" SG_ 992 Trunk_TrnkInReleaseSwSta 5000;
BA_ "Version" SG_ 992 Trunk_TrnkInReleaseSwSta "23.04.02";
BA_ "Description" SG_ 992 Trunk_GlvBxTrnkLkSwSta "- Glove Box Trunk Lock SW";
BA_ "GenSigSendType" SG_ 992 Trunk_GlvBxTrnkLkSwSta 4;
BA_ "UserSigValidity" SG_ 992 Trunk_GlvBxTrnkLkSwSta 0;
BA_ "NetworkRequest" SG_ 992 Trunk_GlvBxTrnkLkSwSta 0;
BA_ "NetworkRequestHoldingTime" SG_ 992 Trunk_GlvBxTrnkLkSwSta 5000;
BA_ "Version" SG_ 992 Trunk_GlvBxTrnkLkSwSta "17.12.00";
BA_ "Description" SG_ 992 Trunk_TrnkTlgtSwSta "Full Lock SW Status Signal



(TailGate/TrunkLid Tpye all)



1. Luggage or Trunkroom Lamp On/Off



2. TailGate/TrunkLid Open Ind in cluster



3. Normal Open SW



  - SW Off: Full Lock(Full Close state)



  - SW On: ^Full Lock";
BA_ "GenSigSendType" SG_ 992 Trunk_TrnkTlgtSwSta 4;
BA_ "UserSigValidity" SG_ 992 Trunk_TrnkTlgtSwSta 0;
BA_ "NetworkRequest" SG_ 992 Trunk_TrnkTlgtSwSta 0;
BA_ "NetworkRequestHoldingTime" SG_ 992 Trunk_TrnkTlgtSwSta 5000;
BA_ "Version" SG_ 992 Trunk_TrnkTlgtSwSta "17.12.00";
BA_ "Description" SG_ 992 Trunk_TlgtFullOpnSwSta "Full Open SW Status Signal



(Power TailGate/TrunkLid Tpye or tailgate latch 2sw type)



* Normal Open SW



  - SW Off: ^Full Open



  - SW On: Full Open(Full Open state)";
BA_ "GenSigSendType" SG_ 992 Trunk_TlgtFullOpnSwSta 4;
BA_ "UserSigValidity" SG_ 992 Trunk_TlgtFullOpnSwSta 0;
BA_ "NetworkRequest" SG_ 992 Trunk_TlgtFullOpnSwSta 0;
BA_ "NetworkRequestHoldingTime" SG_ 992 Trunk_TlgtFullOpnSwSta 5000;
BA_ "Version" SG_ 992 Trunk_TlgtFullOpnSwSta "17.12.00";
BA_ "GenSigSendType" SG_ 992 Trunk_TrnkTlgtReleaseRlySta 4;
BA_ "UserSigValidity" SG_ 992 Trunk_TrnkTlgtReleaseRlySta 0;
BA_ "NetworkRequest" SG_ 992 Trunk_TrnkTlgtReleaseRlySta 0;
BA_ "NetworkRequestHoldingTime" SG_ 992 Trunk_TrnkTlgtReleaseRlySta 5000;
BA_ "Version" SG_ 992 Trunk_TrnkTlgtReleaseRlySta "17.12.00";
BA_ "Description" SG_ 992 FrtWiper_ParkingSwState "Front wiper parking switch state";
BA_ "GenSigSendType" SG_ 992 FrtWiper_ParkingSwState 4;
BA_ "TimeoutValue" SG_ 992 FrtWiper_ParkingSwState "0x0";
BA_ "UserSigValidity" SG_ 992 FrtWiper_ParkingSwState 0;
BA_ "Version" SG_ 992 FrtWiper_ParkingSwState "23.04.06";
BA_ "Description" SG_ 992 PDC_TlgtUnLkSta "Tailgate unlocked status of MPV vehicle with twin swing tailgate";
BA_ "GenSigSendType" SG_ 992 PDC_TlgtUnLkSta 4;
BA_ "UserSigValidity" SG_ 992 PDC_TlgtUnLkSta 0;
BA_ "NetworkRequest" SG_ 992 PDC_TlgtUnLkSta 0;
BA_ "NetworkRequestHoldingTime" SG_ 992 PDC_TlgtUnLkSta 5000;
BA_ "Version" SG_ 992 PDC_TlgtUnLkSta "24.01.00";
BA_ "Description" SG_ 992 PDC_PSDPwrModeOffSwSta "PSD power mode off switch state(Self-return type)

-'On' value is output only during the time the switch is pressed";
BA_ "GenSigSendType" SG_ 992 PDC_PSDPwrModeOffSwSta 4;
BA_ "UserSigValidity" SG_ 992 PDC_PSDPwrModeOffSwSta 0;
BA_ "NetworkRequest" SG_ 992 PDC_PSDPwrModeOffSwSta 0;
BA_ "NetworkRequestHoldingTime" SG_ 992 PDC_PSDPwrModeOffSwSta 5000;
BA_ "Version" SG_ 992 PDC_PSDPwrModeOffSwSta "24.01.00";
BA_ "Description" SG_ 992 PDC_FD_AlvCnt1Val "For the first transmission request for a data element the counter shall be initialized with 0 and shall be incremented by 1 for every subsequent send request. 

When the counter reaches the maximum value(0xFF), then it shall restart with 0 for the next s";
BA_ "GenSigSendType" SG_ 992 PDC_FD_AlvCnt1Val 4;
BA_ "UserSigValidity" SG_ 992 PDC_FD_AlvCnt1Val 3;
BA_ "Version" SG_ 992 PDC_FD_AlvCnt1Val "22.10.20";
BA_ "Description" SG_ 992 OBCWakeupDrLock "This signal is for OBC wake-up, When ICU Lock event";
BA_ "GenSigSendType" SG_ 992 OBCWakeupDrLock 4;
BA_ "UserSigValidity" SG_ 992 OBCWakeupDrLock 0;
BA_ "Version" SG_ 992 OBCWakeupDrLock "19.04.06";
BA_ "Description" SG_ 992 OBCWakeupDrUnlock "This signal is for OBC wake-up, When ICU Unlock event";
BA_ "GenSigSendType" SG_ 992 OBCWakeupDrUnlock 4;
BA_ "UserSigValidity" SG_ 992 OBCWakeupDrUnlock 0;
BA_ "Version" SG_ 992 OBCWakeupDrUnlock "19.04.06";
BA_ "Description" SG_ 992 Trunk_BgtOpnHzrdReq "Hazzard Request by Bedgate Open";
BA_ "GenSigSendType" SG_ 992 Trunk_BgtOpnHzrdReq 4;
BA_ "UserSigValidity" SG_ 992 Trunk_BgtOpnHzrdReq 0;
BA_ "NetworkRequest" SG_ 992 Trunk_BgtOpnHzrdReq 0;
BA_ "NetworkRequestHoldingTime" SG_ 992 Trunk_BgtOpnHzrdReq 5000;
BA_ "Version" SG_ 992 Trunk_BgtOpnHzrdReq "22.07.06";
BA_ "Description" SG_ 992 Trunk_BgtOpnBzrReq "Buzzer Request by Bedgate Open";
BA_ "GenSigSendType" SG_ 992 Trunk_BgtOpnBzrReq 4;
BA_ "UserSigValidity" SG_ 992 Trunk_BgtOpnBzrReq 0;
BA_ "NetworkRequest" SG_ 992 Trunk_BgtOpnBzrReq 0;
BA_ "NetworkRequestHoldingTime" SG_ 992 Trunk_BgtOpnBzrReq 5000;
BA_ "Version" SG_ 992 Trunk_BgtOpnBzrReq "22.07.06";
BA_ "Description" SG_ 992 IGN3State "Output status of ignition 3";
BA_ "GenSigSendType" SG_ 992 IGN3State 4;
BA_ "TimeoutValue" SG_ 992 IGN3State "0x0";
BA_ "UserSigValidity" SG_ 992 IGN3State 7;
BA_ "Version" SG_ 992 IGN3State "23.09.00";
BA_ "Description" SG_ 992 IGN3State_By_BMS "Output status of ignition 3 by BMS request";
BA_ "GenSigSendType" SG_ 992 IGN3State_By_BMS 4;
BA_ "TimeoutValue" SG_ 992 IGN3State_By_BMS "0x0";
BA_ "UserSigValidity" SG_ 992 IGN3State_By_BMS 7;
BA_ "Version" SG_ 992 IGN3State_By_BMS "23.02.02";
BA_ "Description" SG_ 992 IGN3State_By_VCMS_HMU "Output status of ignition 3 by VCMS(PHEV/EV) or HMU(FCEV) request";
BA_ "GenSigSendType" SG_ 992 IGN3State_By_VCMS_HMU 4;
BA_ "TimeoutValue" SG_ 992 IGN3State_By_VCMS_HMU "0x0";
BA_ "UserSigValidity" SG_ 992 IGN3State_By_VCMS_HMU 7;
BA_ "Version" SG_ 992 IGN3State_By_VCMS_HMU "23.02.02";
BA_ "Description" SG_ 992 IGN3State_By_AfterBlow "Output status of ignition 3 by DATC(FATC/MTC) request for after blow";
BA_ "GenSigSendType" SG_ 992 IGN3State_By_AfterBlow 4;
BA_ "TimeoutValue" SG_ 992 IGN3State_By_AfterBlow "0x0";
BA_ "UserSigValidity" SG_ 992 IGN3State_By_AfterBlow 7;
BA_ "Version" SG_ 992 IGN3State_By_AfterBlow "23.02.02";
BA_ "Description" SG_ 992 IGN3State_By_Bat "Output status of ignition 3 by IBS or BMS request for HEV 12V auxiliary battery charging";
BA_ "GenSigSendType" SG_ 992 IGN3State_By_Bat 4;
BA_ "TimeoutValue" SG_ 992 IGN3State_By_Bat "0x0";
BA_ "UserSigValidity" SG_ 992 IGN3State_By_Bat 7;
BA_ "Version" SG_ 992 IGN3State_By_Bat "23.02.01";
BA_ "Description" SG_ 992 IGN3State_By_VCU_HCU_FCU "Output status of ignition 3 by VCU(EV) or HCU(HEV/PHEV) or FCU(FCEV) request";
BA_ "GenSigSendType" SG_ 992 IGN3State_By_VCU_HCU_FCU 4;
BA_ "TimeoutValue" SG_ 992 IGN3State_By_VCU_HCU_FCU "0x0";
BA_ "UserSigValidity" SG_ 992 IGN3State_By_VCU_HCU_FCU 7;
BA_ "Version" SG_ 992 IGN3State_By_VCU_HCU_FCU "23.02.02";
BA_ "Description" SG_ 992 IGN3State_By_HU "Output status of ignition 3 by HU(AVNT) or CCU request for CCS";
BA_ "GenSigSendType" SG_ 992 IGN3State_By_HU 4;
BA_ "TimeoutValue" SG_ 992 IGN3State_By_HU "0x0";
BA_ "UserSigValidity" SG_ 992 IGN3State_By_HU 7;
BA_ "Version" SG_ 992 IGN3State_By_HU "23.02.02";
BA_ "Description" SG_ 992 SeatBeltSwSta_Drv "Driver Seat Belt Switch Status.

This signal is set as 'Not Supported' if the seat belt is not installed for EDR law(UN ECE R160.01) and EURO NCAP";
BA_ "GenSigSendType" SG_ 992 SeatBeltSwSta_Drv 4;
BA_ "UserSigValidity" SG_ 992 SeatBeltSwSta_Drv 0;
BA_ "NetworkRequest" SG_ 992 SeatBeltSwSta_Drv 0;
BA_ "NetworkRequestHoldingTime" SG_ 992 SeatBeltSwSta_Drv 5000;
BA_ "Version" SG_ 992 SeatBeltSwSta_Drv "23.07.03";
BA_ "Description" SG_ 992 SeatBeltSwSta_1stCtr "1st Center Seat Belt Switch Status

This signal is set as 'Not Supported' if the seat belt is not installed for EDR law(UN ECE R160.01) and EURO NCAP";
BA_ "GenSigSendType" SG_ 992 SeatBeltSwSta_1stCtr 4;
BA_ "UserSigValidity" SG_ 992 SeatBeltSwSta_1stCtr 0;
BA_ "NetworkRequest" SG_ 992 SeatBeltSwSta_1stCtr 0;
BA_ "NetworkRequestHoldingTime" SG_ 992 SeatBeltSwSta_1stCtr 5000;
BA_ "Version" SG_ 992 SeatBeltSwSta_1stCtr "23.07.03";
BA_ "Description" SG_ 992 SeatBeltSwSta_Asst "Assistance Seat Belt Switch Status

This signal is set as 'Not Supported' if the seat belt is not installed for EDR law(UN ECE R160.01) and EURO NCAP";
BA_ "GenSigSendType" SG_ 992 SeatBeltSwSta_Asst 4;
BA_ "UserSigValidity" SG_ 992 SeatBeltSwSta_Asst 0;
BA_ "NetworkRequest" SG_ 992 SeatBeltSwSta_Asst 0;
BA_ "NetworkRequestHoldingTime" SG_ 992 SeatBeltSwSta_Asst 5000;
BA_ "Version" SG_ 992 SeatBeltSwSta_Asst "23.07.03";
BA_ "Description" SG_ 992 SeatBeltSwSta_2ndLft "2nd Left Seat Belt Switch Status

This signal is set as 'Not Supported' if the seat belt is not installed for EDR law(UN ECE R160.01) and EURO NCAP";
BA_ "GenSigSendType" SG_ 992 SeatBeltSwSta_2ndLft 4;
BA_ "UserSigValidity" SG_ 992 SeatBeltSwSta_2ndLft 0;
BA_ "NetworkRequest" SG_ 992 SeatBeltSwSta_2ndLft 0;
BA_ "NetworkRequestHoldingTime" SG_ 992 SeatBeltSwSta_2ndLft 5000;
BA_ "Version" SG_ 992 SeatBeltSwSta_2ndLft "23.07.03";
BA_ "Description" SG_ 992 SeatBeltSwSta_2ndCtr "2nd Center Seat Belt Switch Status

This signal is set as 'Not Supported' if the seat belt is not installed for EDR law(UN ECE R160.01) and EURO NCAP";
BA_ "GenSigSendType" SG_ 992 SeatBeltSwSta_2ndCtr 4;
BA_ "UserSigValidity" SG_ 992 SeatBeltSwSta_2ndCtr 0;
BA_ "NetworkRequest" SG_ 992 SeatBeltSwSta_2ndCtr 0;
BA_ "NetworkRequestHoldingTime" SG_ 992 SeatBeltSwSta_2ndCtr 5000;
BA_ "Version" SG_ 992 SeatBeltSwSta_2ndCtr "23.07.03";
BA_ "Description" SG_ 992 SeatBeltSwSta_2ndRt "2nd Right Seat Belt Switch Status

This signal is set as 'Not Supported' if the seat belt is not installed for EDR law(UN ECE R160.01) and EURO NCAP";
BA_ "GenSigSendType" SG_ 992 SeatBeltSwSta_2ndRt 4;
BA_ "UserSigValidity" SG_ 992 SeatBeltSwSta_2ndRt 0;
BA_ "NetworkRequest" SG_ 992 SeatBeltSwSta_2ndRt 0;
BA_ "NetworkRequestHoldingTime" SG_ 992 SeatBeltSwSta_2ndRt 5000;
BA_ "Version" SG_ 992 SeatBeltSwSta_2ndRt "23.07.03";
BA_ "Description" SG_ 992 SeatBeltSwSta_3rdLft "3rd Left Seat Belt Switch Status

This signal is set as 'Not Supported' if the seat belt is not installed for EDR law(UN ECE R160.01) and EURO NCAP";
BA_ "GenSigSendType" SG_ 992 SeatBeltSwSta_3rdLft 4;
BA_ "UserSigValidity" SG_ 992 SeatBeltSwSta_3rdLft 0;
BA_ "NetworkRequest" SG_ 992 SeatBeltSwSta_3rdLft 0;
BA_ "NetworkRequestHoldingTime" SG_ 992 SeatBeltSwSta_3rdLft 5000;
BA_ "Version" SG_ 992 SeatBeltSwSta_3rdLft "23.07.03";
BA_ "Description" SG_ 992 SeatBeltSwSta_3rdCtr "3rd Center Seat Belt Switch Status

This signal is set as 'Not Supported' if the seat belt is not installed for EDR law(UN ECE R160.01) and EURO NCAP";
BA_ "GenSigSendType" SG_ 992 SeatBeltSwSta_3rdCtr 4;
BA_ "UserSigValidity" SG_ 992 SeatBeltSwSta_3rdCtr 0;
BA_ "NetworkRequest" SG_ 992 SeatBeltSwSta_3rdCtr 0;
BA_ "NetworkRequestHoldingTime" SG_ 992 SeatBeltSwSta_3rdCtr 5000;
BA_ "Version" SG_ 992 SeatBeltSwSta_3rdCtr "23.07.03";
BA_ "Description" SG_ 992 SeatBeltSwSta_3rdRt "3rd Right Seat Belt Switch Status

This signal is set as 'Not Supported' if the seat belt is not installed for EDR law(UN ECE R160.01) and EURO NCAP";
BA_ "GenSigSendType" SG_ 992 SeatBeltSwSta_3rdRt 4;
BA_ "UserSigValidity" SG_ 992 SeatBeltSwSta_3rdRt 0;
BA_ "NetworkRequest" SG_ 992 SeatBeltSwSta_3rdRt 0;
BA_ "NetworkRequestHoldingTime" SG_ 992 SeatBeltSwSta_3rdRt 5000;
BA_ "Version" SG_ 992 SeatBeltSwSta_3rdRt "23.07.03";
BA_ "Description" SG_ 992 SeatBelt4th_InstallInfo "4th Seat Belt installation Information";
BA_ "GenSigSendType" SG_ 992 SeatBelt4th_InstallInfo 4;
BA_ "UserSigValidity" SG_ 992 SeatBelt4th_InstallInfo 0;
BA_ "NetworkRequest" SG_ 992 SeatBelt4th_InstallInfo 0;
BA_ "NetworkRequestHoldingTime" SG_ 992 SeatBelt4th_InstallInfo 5000;
BA_ "Version" SG_ 992 SeatBelt4th_InstallInfo "23.07.05";
BA_ "Description" SG_ 992 PDCex_CurtainOpt "PDCex Curtain Option Information

0x0 : No Curtain

0x1 : Rear Curtain Only

0x2 : Quarter Glass Curtain Only

0x3 : All Curtain(Rear+Quarter Glass Curtain)";
BA_ "GenSigSendType" SG_ 992 PDCex_CurtainOpt 4;
BA_ "UserSigValidity" SG_ 992 PDCex_CurtainOpt 0;
BA_ "Version" SG_ 992 PDCex_CurtainOpt "23.07.04";
BA_ "Description" SG_ 992 DriveTypeOption "Drive Type Option

This signal is used to determine driver's seat position('Drive Type') about this vehicle.";
BA_ "GenSigSendType" SG_ 992 DriveTypeOption 4;
BA_ "UserSigValidity" SG_ 992 DriveTypeOption 0;
BA_ "NetworkRequest" SG_ 992 DriveTypeOption 0;
BA_ "NetworkRequestHoldingTime" SG_ 992 DriveTypeOption 5000;
BA_ "Version" SG_ 992 DriveTypeOption "21.11.00";
BA_ "Description" SG_ 992 AutoLtOpt "Auto Light 사양 적용 여부 및 적용 옵션 정보 출력 (미적용/적용)";
BA_ "GenSigSendType" SG_ 992 AutoLtOpt 4;
BA_ "UserSigValidity" SG_ 992 AutoLtOpt 0;
BA_ "Version" SG_ 992 AutoLtOpt "20.09.00";
BA_ "Description" SG_ 992 HLmpLoHiOptLtSrcTyp "Head Low and High Lamp Option and Light Source Type";
BA_ "GenSigSendType" SG_ 992 HLmpLoHiOptLtSrcTyp 4;
BA_ "UserSigValidity" SG_ 992 HLmpLoHiOptLtSrcTyp 0;
BA_ "Version" SG_ 992 HLmpLoHiOptLtSrcTyp "20.09.00";
BA_ "Description" SG_ 992 C_StrgWhlHeatingOpt "Steering wheel heating option signal";
BA_ "GenSigSendType" SG_ 992 C_StrgWhlHeatingOpt 4;
BA_ "UserSigValidity" SG_ 992 C_StrgWhlHeatingOpt 0;
BA_ "Version" SG_ 992 C_StrgWhlHeatingOpt "23.02.02";
BA_ "Description" SG_ 992 C_StrgWhlHeatingSWInf "Steering wheel heating Step information signal";
BA_ "GenSigSendType" SG_ 992 C_StrgWhlHeatingSWInf 4;
BA_ "UserSigValidity" SG_ 992 C_StrgWhlHeatingSWInf 3;
BA_ "Version" SG_ 992 C_StrgWhlHeatingSWInf "19.11.11";
BA_ "Description" SG_ 992 ICU_MtGearPosRSta "Manual Shift Lever R Switch Status 0x0:Off/0x1:On";
BA_ "GenSigSendType" SG_ 992 ICU_MtGearPosRSta 4;
BA_ "UserSigValidity" SG_ 992 ICU_MtGearPosRSta 3;
BA_ "Version" SG_ 992 ICU_MtGearPosRSta "21.07.05";
BA_ "Description" SG_ 992 C_AutoLeverManualSW "This signal represents operating status of AT/CVT/DCT Lever Manual Switch";
BA_ "GenSigSendType" SG_ 992 C_AutoLeverManualSW 4;
BA_ "UserSigValidity" SG_ 992 C_AutoLeverManualSW 3;
BA_ "Version" SG_ 992 C_AutoLeverManualSW "19.09.06";
BA_ "Description" SG_ 992 Warn_HoodSwMemorySta "Hood swtich open->close information(memory)



This signal is for oil level warning lamp reset In case hood open->close when IG-OFF, 0x01 sent for 5 sec at next IG-ON";
BA_ "GenSigSendType" SG_ 992 Warn_HoodSwMemorySta 4;
BA_ "UserSigValidity" SG_ 992 Warn_HoodSwMemorySta 3;
BA_ "NetworkRequest" SG_ 992 Warn_HoodSwMemorySta 0;
BA_ "NetworkRequestHoldingTime" SG_ 992 Warn_HoodSwMemorySta 5000;
BA_ "Version" SG_ 992 Warn_HoodSwMemorySta "21.11.00";
BA_ "GenSigSendType" SG_ 992 Warn_PrkngBrkSwSta 4;
BA_ "UserSigValidity" SG_ 992 Warn_PrkngBrkSwSta 0;
BA_ "NetworkRequest" SG_ 992 Warn_PrkngBrkSwSta 0;
BA_ "NetworkRequestHoldingTime" SG_ 992 Warn_PrkngBrkSwSta 5000;
BA_ "Version" SG_ 992 Warn_PrkngBrkSwSta "17.12.00";
BA_ "Description" SG_ 992 PrkngBrkNotchSwState "Parking Brake High Notch Switch State";
BA_ "GenSigSendType" SG_ 992 PrkngBrkNotchSwState 4;
BA_ "UserSigValidity" SG_ 992 PrkngBrkNotchSwState 0;
BA_ "NetworkRequest" SG_ 992 PrkngBrkNotchSwState 0;
BA_ "NetworkRequestHoldingTime" SG_ 992 PrkngBrkNotchSwState 5000;
BA_ "Version" SG_ 992 PrkngBrkNotchSwState "20.08.07";
BA_ "GenSigSendType" SG_ 992 Warn_BrkFldSwSta 4;
BA_ "UserSigValidity" SG_ 992 Warn_BrkFldSwSta 0;
BA_ "NetworkRequest" SG_ 992 Warn_BrkFldSwSta 0;
BA_ "NetworkRequestHoldingTime" SG_ 992 Warn_BrkFldSwSta 5000;
BA_ "Version" SG_ 992 Warn_BrkFldSwSta "17.12.00";
BA_ "Description" SG_ 992 Warn_WshrFldSwSta "Washer Fluid Switch Signal

This signal indicates Washer Fluid Switch Signal

0x0:Off/0x1:On";
BA_ "GenSigSendType" SG_ 992 Warn_WshrFldSwSta 4;
BA_ "UserSigValidity" SG_ 992 Warn_WshrFldSwSta 3;
BA_ "NetworkRequest" SG_ 992 Warn_WshrFldSwSta 0;
BA_ "NetworkRequestHoldingTime" SG_ 992 Warn_WshrFldSwSta 5000;
BA_ "Version" SG_ 992 Warn_WshrFldSwSta "21.07.05";
BA_ "GenSigSendType" SG_ 992 Warn_DrvStBltSwSta 4;
BA_ "UserSigValidity" SG_ 992 Warn_DrvStBltSwSta 0;
BA_ "NetworkRequest" SG_ 992 Warn_DrvStBltSwSta 0;
BA_ "NetworkRequestHoldingTime" SG_ 992 Warn_DrvStBltSwSta 5000;
BA_ "Version" SG_ 992 Warn_DrvStBltSwSta "17.12.00";
BA_ "Description" SG_ 992 Warn_AsstStBltSwSta "-Default value: 0x1 (Belt)



-Initial value: 0x1 (Belt)



-Timeout value: 0x1 (Belt)";
BA_ "GenSigSendType" SG_ 992 Warn_AsstStBltSwSta 4;
BA_ "GenSigStartValue" SG_ 992 Warn_AsstStBltSwSta 1;
BA_ "UserSigValidity" SG_ 992 Warn_AsstStBltSwSta 0;
BA_ "NetworkRequest" SG_ 992 Warn_AsstStBltSwSta 0;
BA_ "NetworkRequestHoldingTime" SG_ 992 Warn_AsstStBltSwSta 5000;
BA_ "Version" SG_ 992 Warn_AsstStBltSwSta "17.12.00";
BA_ "GenSigSendType" SG_ 992 Warn_RrLftStBltSwSta 4;
BA_ "UserSigValidity" SG_ 992 Warn_RrLftStBltSwSta 0;
BA_ "NetworkRequest" SG_ 992 Warn_RrLftStBltSwSta 0;
BA_ "NetworkRequestHoldingTime" SG_ 992 Warn_RrLftStBltSwSta 5000;
BA_ "Version" SG_ 992 Warn_RrLftStBltSwSta "17.12.00";
BA_ "GenSigSendType" SG_ 992 Warn_RrCtrStBltSwSta 4;
BA_ "UserSigValidity" SG_ 992 Warn_RrCtrStBltSwSta 0;
BA_ "NetworkRequest" SG_ 992 Warn_RrCtrStBltSwSta 0;
BA_ "NetworkRequestHoldingTime" SG_ 992 Warn_RrCtrStBltSwSta 5000;
BA_ "Version" SG_ 992 Warn_RrCtrStBltSwSta "17.12.00";
BA_ "GenSigSendType" SG_ 992 Warn_RrRtStBltSwSta 4;
BA_ "UserSigValidity" SG_ 992 Warn_RrRtStBltSwSta 0;
BA_ "NetworkRequest" SG_ 992 Warn_RrRtStBltSwSta 0;
BA_ "NetworkRequestHoldingTime" SG_ 992 Warn_RrRtStBltSwSta 5000;
BA_ "Version" SG_ 992 Warn_RrRtStBltSwSta "17.12.00";
BA_ "Description" SG_ 992 C_3rdRLSeatBeltSW "3rd Rear Left Seat Belt Switch Status";
BA_ "GenSigSendType" SG_ 992 C_3rdRLSeatBeltSW 4;
BA_ "UserSigValidity" SG_ 992 C_3rdRLSeatBeltSW 0;
BA_ "NetworkRequest" SG_ 992 C_3rdRLSeatBeltSW 0;
BA_ "NetworkRequestHoldingTime" SG_ 992 C_3rdRLSeatBeltSW 5000;
BA_ "Version" SG_ 992 C_3rdRLSeatBeltSW "18.03.04";
BA_ "Description" SG_ 995 PDC_FD_Crc4Val "The data area for CRC calculation is based on the data length (DLC) of the message DB.

The CRC shall be calculated over the entire data block (excluding the CRC bytes) including the user data, alive counter and Data ID



- CRC Polynomial (0x1021) , Ini";
BA_ "GenSigSendType" SG_ 995 PDC_FD_Crc4Val 4;
BA_ "GenSigStartValue" SG_ 995 PDC_FD_Crc4Val 65535;
BA_ "UserSigValidity" SG_ 995 PDC_FD_Crc4Val 3;
BA_ "Version" SG_ 995 PDC_FD_Crc4Val "22.10.20";
BA_ "Description" SG_ 995 PDC_FD_AlvCnt4Val "For the first transmission request for a data element the counter shall be initialized with 0 and shall be incremented by 1 for every subsequent send request. 

When the counter reaches the maximum value(0xFF), then it shall restart with 0 for the next s";
BA_ "GenSigSendType" SG_ 995 PDC_FD_AlvCnt4Val 4;
BA_ "UserSigValidity" SG_ 995 PDC_FD_AlvCnt4Val 3;
BA_ "Version" SG_ 995 PDC_FD_AlvCnt4Val "22.10.20";
BA_ "Description" SG_ 995 ICU_Haptic_OPT "Steering Wheel Haptic Warning Option Infomation (From ICU)";
BA_ "GenSigSendType" SG_ 995 ICU_Haptic_OPT 4;
BA_ "UserSigValidity" SG_ 995 ICU_Haptic_OPT 0;
BA_ "NetworkRequest" SG_ 995 ICU_Haptic_OPT 0;
BA_ "NetworkRequestHoldingTime" SG_ 995 ICU_Haptic_OPT 5000;
BA_ "Version" SG_ 995 ICU_Haptic_OPT "18.07.07";
BA_ "Description" SG_ 995 HSWS_SysWrngSta_ICU "0x0 : Normal

0x1 : System Fail

0x2 : Reserved

0x3 : Invalid";
BA_ "GenSigSendType" SG_ 995 HSWS_SysWrngSta_ICU 4;
BA_ "UserSigValidity" SG_ 995 HSWS_SysWrngSta_ICU 4;
BA_ "Version" SG_ 995 HSWS_SysWrngSta_ICU "21.11.00";
BA_ "GenSigSendType" SG_ 995 ICU_PwrWdwMvInhbtSta 4;
BA_ "UserSigValidity" SG_ 995 ICU_PwrWdwMvInhbtSta 0;
BA_ "NetworkRequest" SG_ 995 ICU_PwrWdwMvInhbtSta 0;
BA_ "NetworkRequestHoldingTime" SG_ 995 ICU_PwrWdwMvInhbtSta 5000;
BA_ "Version" SG_ 995 ICU_PwrWdwMvInhbtSta "19.02.05";
BA_ "Description" SG_ 995 Warn_OSMirrFoldSwState "Outside Mirror folding Sw input signal. It has two type .

1) 0x0 : FOLD , 0x1: UNFOLD or Auto (Seasaw type folding SW)

2) 0x0 :OFF , 0x1 : ON (Self Return Type Folding SW)";
BA_ "GenSigSendType" SG_ 995 Warn_OSMirrFoldSwState 4;
BA_ "UserSigValidity" SG_ 995 Warn_OSMirrFoldSwState 0;
BA_ "NetworkRequest" SG_ 995 Warn_OSMirrFoldSwState 0;
BA_ "NetworkRequestHoldingTime" SG_ 995 Warn_OSMirrFoldSwState 5000;
BA_ "Version" SG_ 995 Warn_OSMirrFoldSwState "18.12.01";
BA_ "Description" SG_ 995 USM_OneTouchTrnSigFuncSta "This signal is 



- For One Touch Turn Signal Function,



 the advanced version of One Touch triple turn signal



- Communicated with Cluster for setting USM



- Periodic Event Signal to notice current staus to USM of Cluster";
BA_ "GenSigSendType" SG_ 995 USM_OneTouchTrnSigFuncSta 4;
BA_ "UserSigValidity" SG_ 995 USM_OneTouchTrnSigFuncSta 0;
BA_ "NetworkRequest" SG_ 995 USM_OneTouchTrnSigFuncSta 0;
BA_ "NetworkRequestHoldingTime" SG_ 995 USM_OneTouchTrnSigFuncSta 5000;
BA_ "Version" SG_ 995 USM_OneTouchTrnSigFuncSta "21.07.05";
BA_ "GenSigSendType" SG_ 995 ExtLamp_TrnSigLmpLftSwSta 4;
BA_ "UserSigValidity" SG_ 995 ExtLamp_TrnSigLmpLftSwSta 0;
BA_ "NetworkRequest" SG_ 995 ExtLamp_TrnSigLmpLftSwSta 0;
BA_ "NetworkRequestHoldingTime" SG_ 995 ExtLamp_TrnSigLmpLftSwSta 5000;
BA_ "Version" SG_ 995 ExtLamp_TrnSigLmpLftSwSta "18.08.07";
BA_ "GenSigSendType" SG_ 995 ExtLamp_TrnSigLmpRtSwSta 4;
BA_ "UserSigValidity" SG_ 995 ExtLamp_TrnSigLmpRtSwSta 0;
BA_ "NetworkRequest" SG_ 995 ExtLamp_TrnSigLmpRtSwSta 0;
BA_ "NetworkRequestHoldingTime" SG_ 995 ExtLamp_TrnSigLmpRtSwSta 5000;
BA_ "Version" SG_ 995 ExtLamp_TrnSigLmpRtSwSta "18.08.07";
BA_ "Description" SG_ 995 Lamp_LaneChgTrnSigLftSwSta_ICU "LANE CHANGE TURN SIGNAL FOR LH";
BA_ "GenSigSendType" SG_ 995 Lamp_LaneChgTrnSigLftSwSta_ICU 4;
BA_ "UserSigValidity" SG_ 995 Lamp_LaneChgTrnSigLftSwSta_ICU 0;
BA_ "NetworkRequest" SG_ 995 Lamp_LaneChgTrnSigLftSwSta_ICU 0;
BA_ "NetworkRequestHoldingTime" SG_ 995 Lamp_LaneChgTrnSigLftSwSta_ICU 5000;
BA_ "Version" SG_ 995 Lamp_LaneChgTrnSigLftSwSta_ICU "18.09.05";
BA_ "Description" SG_ 995 Lamp_LaneChgTrnSigRtSwSta_ICU "LANE CHANGE TURN SIGNAL FOR RH";
BA_ "GenSigSendType" SG_ 995 Lamp_LaneChgTrnSigRtSwSta_ICU 4;
BA_ "UserSigValidity" SG_ 995 Lamp_LaneChgTrnSigRtSwSta_ICU 0;
BA_ "NetworkRequest" SG_ 995 Lamp_LaneChgTrnSigRtSwSta_ICU 0;
BA_ "NetworkRequestHoldingTime" SG_ 995 Lamp_LaneChgTrnSigRtSwSta_ICU 5000;
BA_ "Version" SG_ 995 Lamp_LaneChgTrnSigRtSwSta_ICU "18.09.05";
BA_ "Description" SG_ 995 ICU_HDPSpprtRdy "This signal is the received state information signal of the ADAS message.";
BA_ "GenSigSendType" SG_ 995 ICU_HDPSpprtRdy 4;
BA_ "UserSigValidity" SG_ 995 ICU_HDPSpprtRdy 3;
BA_ "Version" SG_ 995 ICU_HDPSpprtRdy "22.03.02";
BA_ "Description" SG_ 995 HzrdLmp_HDPSpprtSWVer "This signal indicates HDP-HAZARD Lamp control Requirement Spec Version";
BA_ "GenSigSendType" SG_ 995 HzrdLmp_HDPSpprtSWVer 4;
BA_ "UserSigValidity" SG_ 995 HzrdLmp_HDPSpprtSWVer 3;
BA_ "Version" SG_ 995 HzrdLmp_HDPSpprtSWVer "21.12.04";
BA_ "GenSigSendType" SG_ 995 Lamp_TrnSigLmpLftOnReq 4;
BA_ "UserSigValidity" SG_ 995 Lamp_TrnSigLmpLftOnReq 0;
BA_ "NetworkRequest" SG_ 995 Lamp_TrnSigLmpLftOnReq 0;
BA_ "NetworkRequestHoldingTime" SG_ 995 Lamp_TrnSigLmpLftOnReq 5000;
BA_ "Version" SG_ 995 Lamp_TrnSigLmpLftOnReq "22.05.04";
BA_ "GenSigSendType" SG_ 995 Lamp_TrnSigLmpRtOnReq 4;
BA_ "UserSigValidity" SG_ 995 Lamp_TrnSigLmpRtOnReq 0;
BA_ "NetworkRequest" SG_ 995 Lamp_TrnSigLmpRtOnReq 0;
BA_ "NetworkRequestHoldingTime" SG_ 995 Lamp_TrnSigLmpRtOnReq 5000;
BA_ "Version" SG_ 995 Lamp_TrnSigLmpRtOnReq "22.05.04";
BA_ "Description" SG_ 995 Lamp_TrnSigLmpLftActiveSt "Turn Signal Lmap Blink Info";
BA_ "GenSigSendType" SG_ 995 Lamp_TrnSigLmpLftActiveSt 4;
BA_ "UserSigValidity" SG_ 995 Lamp_TrnSigLmpLftActiveSt 0;
BA_ "NetworkRequest" SG_ 995 Lamp_TrnSigLmpLftActiveSt 0;
BA_ "NetworkRequestHoldingTime" SG_ 995 Lamp_TrnSigLmpLftActiveSt 5000;
BA_ "Version" SG_ 995 Lamp_TrnSigLmpLftActiveSt "21.11.00";
BA_ "Description" SG_ 995 Lamp_TrnSigLmpRtActiveSt "Turn Signal Lamp Blink Info";
BA_ "GenSigSendType" SG_ 995 Lamp_TrnSigLmpRtActiveSt 4;
BA_ "UserSigValidity" SG_ 995 Lamp_TrnSigLmpRtActiveSt 0;
BA_ "NetworkRequest" SG_ 995 Lamp_TrnSigLmpRtActiveSt 0;
BA_ "NetworkRequestHoldingTime" SG_ 995 Lamp_TrnSigLmpRtActiveSt 5000;
BA_ "Version" SG_ 995 Lamp_TrnSigLmpRtActiveSt "21.11.00";
BA_ "Description" SG_ 995 TrnLmpSeqEnblCmd "Turn Signal Sequential Enable CAN Command";
BA_ "GenSigSendType" SG_ 995 TrnLmpSeqEnblCmd 4;
BA_ "UserSigValidity" SG_ 995 TrnLmpSeqEnblCmd 0;
BA_ "NetworkRequest" SG_ 995 TrnLmpSeqEnblCmd 0;
BA_ "NetworkRequestHoldingTime" SG_ 995 TrnLmpSeqEnblCmd 5000;
BA_ "Version" SG_ 995 TrnLmpSeqEnblCmd "20.08.07";
BA_ "Description" SG_ 994 PDC_FD_Crc3Val "The data area for CRC calculation is based on the data length (DLC) of the message DB.

The CRC shall be calculated over the entire data block (excluding the CRC bytes) including the user data, alive counter and Data ID



- CRC Polynomial (0x1021) , Ini";
BA_ "GenSigSendType" SG_ 994 PDC_FD_Crc3Val 4;
BA_ "GenSigStartValue" SG_ 994 PDC_FD_Crc3Val 65535;
BA_ "UserSigValidity" SG_ 994 PDC_FD_Crc3Val 3;
BA_ "Version" SG_ 994 PDC_FD_Crc3Val "22.10.20";
BA_ "Description" SG_ 994 PDC_FD_AlvCnt3Val "For the first transmission request for a data element the counter shall be initialized with 0 and shall be incremented by 1 for every subsequent send request. 

When the counter reaches the maximum value(0xFF), then it shall restart with 0 for the next s";
BA_ "GenSigSendType" SG_ 994 PDC_FD_AlvCnt3Val 4;
BA_ "UserSigValidity" SG_ 994 PDC_FD_AlvCnt3Val 3;
BA_ "Version" SG_ 994 PDC_FD_AlvCnt3Val "22.10.20";
BA_ "GenSigSendType" SG_ 994 Warn_DrvDrSwSta 4;
BA_ "UserSigValidity" SG_ 994 Warn_DrvDrSwSta 0;
BA_ "NetworkRequest" SG_ 994 Warn_DrvDrSwSta 0;
BA_ "NetworkRequestHoldingTime" SG_ 994 Warn_DrvDrSwSta 5000;
BA_ "Version" SG_ 994 Warn_DrvDrSwSta "17.12.00";
BA_ "GenSigSendType" SG_ 994 Warn_AsstDrSwSta 4;
BA_ "UserSigValidity" SG_ 994 Warn_AsstDrSwSta 0;
BA_ "NetworkRequest" SG_ 994 Warn_AsstDrSwSta 0;
BA_ "NetworkRequestHoldingTime" SG_ 994 Warn_AsstDrSwSta 5000;
BA_ "Version" SG_ 994 Warn_AsstDrSwSta "17.12.00";
BA_ "GenSigSendType" SG_ 994 Warn_RrLftDrSwSta 4;
BA_ "UserSigValidity" SG_ 994 Warn_RrLftDrSwSta 0;
BA_ "NetworkRequest" SG_ 994 Warn_RrLftDrSwSta 0;
BA_ "NetworkRequestHoldingTime" SG_ 994 Warn_RrLftDrSwSta 5000;
BA_ "Version" SG_ 994 Warn_RrLftDrSwSta "17.12.00";
BA_ "GenSigSendType" SG_ 994 Warn_RrRtDrSwSta 4;
BA_ "UserSigValidity" SG_ 994 Warn_RrRtDrSwSta 0;
BA_ "NetworkRequest" SG_ 994 Warn_RrRtDrSwSta 0;
BA_ "NetworkRequestHoldingTime" SG_ 994 Warn_RrRtDrSwSta 5000;
BA_ "Version" SG_ 994 Warn_RrRtDrSwSta "17.12.00";
BA_ "GenSigSendType" SG_ 994 Warn_HoodSwSta 4;
BA_ "UserSigValidity" SG_ 994 Warn_HoodSwSta 0;
BA_ "NetworkRequest" SG_ 994 Warn_HoodSwSta 0;
BA_ "NetworkRequestHoldingTime" SG_ 994 Warn_HoodSwSta 5000;
BA_ "Version" SG_ 994 Warn_HoodSwSta "17.12.00";
BA_ "GenSigSendType" SG_ 994 DoorLock_DrvDrUnLkSta 4;
BA_ "UserSigValidity" SG_ 994 DoorLock_DrvDrUnLkSta 0;
BA_ "NetworkRequest" SG_ 994 DoorLock_DrvDrUnLkSta 0;
BA_ "NetworkRequestHoldingTime" SG_ 994 DoorLock_DrvDrUnLkSta 5000;
BA_ "Version" SG_ 994 DoorLock_DrvDrUnLkSta "21.09.05";
BA_ "GenSigSendType" SG_ 994 DoorLock_AsstDrUnLkSta 4;
BA_ "UserSigValidity" SG_ 994 DoorLock_AsstDrUnLkSta 0;
BA_ "NetworkRequest" SG_ 994 DoorLock_AsstDrUnLkSta 0;
BA_ "NetworkRequestHoldingTime" SG_ 994 DoorLock_AsstDrUnLkSta 5000;
BA_ "Version" SG_ 994 DoorLock_AsstDrUnLkSta "17.12.00";
BA_ "GenSigSendType" SG_ 994 DoorLock_RrLftDrUnLkSta 4;
BA_ "UserSigValidity" SG_ 994 DoorLock_RrLftDrUnLkSta 0;
BA_ "NetworkRequest" SG_ 994 DoorLock_RrLftDrUnLkSta 0;
BA_ "NetworkRequestHoldingTime" SG_ 994 DoorLock_RrLftDrUnLkSta 5000;
BA_ "Version" SG_ 994 DoorLock_RrLftDrUnLkSta "17.12.00";
BA_ "GenSigSendType" SG_ 994 DoorLock_RrRtDrUnLkSta 4;
BA_ "UserSigValidity" SG_ 994 DoorLock_RrRtDrUnLkSta 0;
BA_ "NetworkRequest" SG_ 994 DoorLock_RrRtDrUnLkSta 0;
BA_ "NetworkRequestHoldingTime" SG_ 994 DoorLock_RrRtDrUnLkSta 5000;
BA_ "Version" SG_ 994 DoorLock_RrRtDrUnLkSta "17.12.00";
BA_ "GenSigSendType" SG_ 994 DoorLock_DrvKeyLkSwSta 4;
BA_ "UserSigValidity" SG_ 994 DoorLock_DrvKeyLkSwSta 0;
BA_ "NetworkRequest" SG_ 994 DoorLock_DrvKeyLkSwSta 0;
BA_ "NetworkRequestHoldingTime" SG_ 994 DoorLock_DrvKeyLkSwSta 5000;
BA_ "Version" SG_ 994 DoorLock_DrvKeyLkSwSta "17.12.00";
BA_ "GenSigSendType" SG_ 994 DoorLock_DrvKeyUnLkSwSta 4;
BA_ "UserSigValidity" SG_ 994 DoorLock_DrvKeyUnLkSwSta 0;
BA_ "NetworkRequest" SG_ 994 DoorLock_DrvKeyUnLkSwSta 0;
BA_ "NetworkRequestHoldingTime" SG_ 994 DoorLock_DrvKeyUnLkSwSta 5000;
BA_ "Version" SG_ 994 DoorLock_DrvKeyUnLkSwSta "17.12.00";
BA_ "Description" SG_ 994 DoorLock_CtrlDrLkSwSta_ICU "Central Door Lock Switch State

(DRV or AST or RL or RR Door trim)";
BA_ "GenSigSendType" SG_ 994 DoorLock_CtrlDrLkSwSta_ICU 4;
BA_ "UserSigValidity" SG_ 994 DoorLock_CtrlDrLkSwSta_ICU 0;
BA_ "NetworkRequest" SG_ 994 DoorLock_CtrlDrLkSwSta_ICU 0;
BA_ "NetworkRequestHoldingTime" SG_ 994 DoorLock_CtrlDrLkSwSta_ICU 5000;
BA_ "Version" SG_ 994 DoorLock_CtrlDrLkSwSta_ICU "19.07.01";
BA_ "Description" SG_ 994 DoorLock_CtrlDrUnLkSwSta_ICU "Central Door Unlock Switch State

(DRV or AST or RL or RR Door trim)";
BA_ "GenSigSendType" SG_ 994 DoorLock_CtrlDrUnLkSwSta_ICU 4;
BA_ "UserSigValidity" SG_ 994 DoorLock_CtrlDrUnLkSwSta_ICU 0;
BA_ "NetworkRequest" SG_ 994 DoorLock_CtrlDrUnLkSwSta_ICU 0;
BA_ "NetworkRequestHoldingTime" SG_ 994 DoorLock_CtrlDrUnLkSwSta_ICU 5000;
BA_ "Version" SG_ 994 DoorLock_CtrlDrUnLkSwSta_ICU "19.07.01";
BA_ "Description" SG_ 994 DoorLock_CtrlDrLkUnLkSwSta_ICU "Central Door Lock/Unlock Switch State

(C/PAD, Integrated & self return type)";
BA_ "GenSigSendType" SG_ 994 DoorLock_CtrlDrLkUnLkSwSta_ICU 4;
BA_ "UserSigValidity" SG_ 994 DoorLock_CtrlDrLkUnLkSwSta_ICU 0;
BA_ "NetworkRequest" SG_ 994 DoorLock_CtrlDrLkUnLkSwSta_ICU 0;
BA_ "NetworkRequestHoldingTime" SG_ 994 DoorLock_CtrlDrLkUnLkSwSta_ICU 5000;
BA_ "Version" SG_ 994 DoorLock_CtrlDrLkUnLkSwSta_ICU "19.07.01";
BA_ "Description" SG_ 994 C_CrashUnlockState "Crash Unlock Active State

-0x0:Off

-0x1:Unlock(crash)";
BA_ "GenSigSendType" SG_ 994 C_CrashUnlockState 4;
BA_ "UserSigValidity" SG_ 994 C_CrashUnlockState 0;
BA_ "NetworkRequest" SG_ 994 C_CrashUnlockState 0;
BA_ "Version" SG_ 994 C_CrashUnlockState "21.07.05";
BA_ "Description" SG_ 994 Lamp_LedHdLmpSta "This signal is LED headlamp status inform whether LED fail or not which is regulation of ECE, Domestic.



If LED H/Lamp detects LED failure then a cluster shall be turn on to 'LED' indicator in the display panel and It should be to display the words 'Ch";
BA_ "GenSigSendType" SG_ 994 Lamp_LedHdLmpSta 4;
BA_ "UserSigValidity" SG_ 994 Lamp_LedHdLmpSta 3;
BA_ "NetworkRequest" SG_ 994 Lamp_LedHdLmpSta 0;
BA_ "NetworkRequestHoldingTime" SG_ 994 Lamp_LedHdLmpSta 5000;
BA_ "Version" SG_ 994 Lamp_LedHdLmpSta "21.11.00";
BA_ "Description" SG_ 994 Warn_ChaDrSwFrtSta "Front Charging Door Open Switch";
BA_ "GenSigSendType" SG_ 994 Warn_ChaDrSwFrtSta 4;
BA_ "UserSigValidity" SG_ 994 Warn_ChaDrSwFrtSta 7;
BA_ "Version" SG_ 994 Warn_ChaDrSwFrtSta "18.08.12";
BA_ "Description" SG_ 994 Warn_ChaDrSwRrSta "Rear Charging Door Open Switch";
BA_ "GenSigSendType" SG_ 994 Warn_ChaDrSwRrSta 4;
BA_ "UserSigValidity" SG_ 994 Warn_ChaDrSwRrSta 7;
BA_ "Version" SG_ 994 Warn_ChaDrSwRrSta "18.08.12";
BA_ "Description" SG_ 997 PDC_FD_Crc11Val "The data area for CRC calculation is based on the data length (DLC) of the message DB.

The CRC shall be calculated over the entire data block (excluding the CRC bytes) including the user data, alive counter and Data ID



- CRC Polynomial (0x1021) , Ini";
BA_ "GenSigSendType" SG_ 997 PDC_FD_Crc11Val 4;
BA_ "GenSigStartValue" SG_ 997 PDC_FD_Crc11Val 65535;
BA_ "UserSigValidity" SG_ 997 PDC_FD_Crc11Val 3;
BA_ "Version" SG_ 997 PDC_FD_Crc11Val "22.10.20";
BA_ "Description" SG_ 997 ICU_BS1ValFlagSta "setting condition is depending on battery sensor self diagnosis information";
BA_ "GenSigSendType" SG_ 997 ICU_BS1ValFlagSta 4;
BA_ "GenSigStartValue" SG_ 997 ICU_BS1ValFlagSta 1;
BA_ "UserSigValidity" SG_ 997 ICU_BS1ValFlagSta 3;
BA_ "Version" SG_ 997 ICU_BS1ValFlagSta "21.11.00";
BA_ "GenSigSendType" SG_ 997 ICU_BS1ErrRes 4;
BA_ "GenSigStartValue" SG_ 997 ICU_BS1ErrRes 1;
BA_ "UserSigValidity" SG_ 997 ICU_BS1ErrRes 3;
BA_ "Version" SG_ 997 ICU_BS1ErrRes "21.11.00";
BA_ "Description" SG_ 997 ICU_BS2SoC "This signal is battery State of Charge as calculated by battery sensor.";
BA_ "GenSigSendType" SG_ 997 ICU_BS2SoC 4;
BA_ "GenSigStartValue" SG_ 997 ICU_BS2SoC 255;
BA_ "UserSigValidity" SG_ 997 ICU_BS2SoC 3;
BA_ "Version" SG_ 997 ICU_BS2SoC "21.09.05";
BA_ "Description" SG_ 997 ICU_BS2NCap "Nominal capacity";
BA_ "GenSigSendType" SG_ 997 ICU_BS2NCap 4;
BA_ "GenSigStartValue" SG_ 997 ICU_BS2NCap 255;
BA_ "UserSigValidity" SG_ 997 ICU_BS2NCap 3;
BA_ "Version" SG_ 997 ICU_BS2NCap "21.07.05";
BA_ "Description" SG_ 997 ICU_BS2OpnCirVol "Last open circuit voltage";
BA_ "GenSigSendType" SG_ 997 ICU_BS2OpnCirVol 4;
BA_ "GenSigStartValue" SG_ 997 ICU_BS2OpnCirVol 4095;
BA_ "UserSigValidity" SG_ 997 ICU_BS2OpnCirVol 3;
BA_ "Version" SG_ 997 ICU_BS2OpnCirVol "21.07.05";
BA_ "Description" SG_ 997 ICU_BS2_FSOC "This signal indicates whether the state of SOC signal is fault or not";
BA_ "GenSigSendType" SG_ 997 ICU_BS2_FSOC 4;
BA_ "GenSigStartValue" SG_ 997 ICU_BS2_FSOC 1;
BA_ "UserSigValidity" SG_ 997 ICU_BS2_FSOC 3;
BA_ "Version" SG_ 997 ICU_BS2_FSOC "18.08.03";
BA_ "Description" SG_ 997 ICU_BS2_FSOH "This signal indicates whether the state of SOH signal is fault or not";
BA_ "GenSigSendType" SG_ 997 ICU_BS2_FSOH 4;
BA_ "GenSigStartValue" SG_ 997 ICU_BS2_FSOH 1;
BA_ "UserSigValidity" SG_ 997 ICU_BS2_FSOH 3;
BA_ "Version" SG_ 997 ICU_BS2_FSOH "18.08.03";
BA_ "Description" SG_ 997 ICU_BS2_FSOF "This signal indicates whether the state of SOF signal is fault or not";
BA_ "GenSigSendType" SG_ 997 ICU_BS2_FSOF 4;
BA_ "GenSigStartValue" SG_ 997 ICU_BS2_FSOF 1;
BA_ "UserSigValidity" SG_ 997 ICU_BS2_FSOF 3;
BA_ "Version" SG_ 997 ICU_BS2_FSOF "18.08.03";
BA_ "Description" SG_ 997 ICU_BS2_FQSTAT "This signal indicates whether quiescent current is high or not compared to pre-defined value";
BA_ "GenSigSendType" SG_ 997 ICU_BS2_FQSTAT 4;
BA_ "GenSigStartValue" SG_ 997 ICU_BS2_FQSTAT 1;
BA_ "UserSigValidity" SG_ 997 ICU_BS2_FQSTAT 3;
BA_ "Version" SG_ 997 ICU_BS2_FQSTAT "18.08.03";
BA_ "Description" SG_ 997 ICU_BS2SoH "This signal is battery State of Health(SOH) as calculated by battery sensor.



This value shows reduction rate of nominal capacity.



This value can be used for diagnosis information of application system.";
BA_ "GenSigSendType" SG_ 997 ICU_BS2SoH 4;
BA_ "GenSigStartValue" SG_ 997 ICU_BS2SoH 255;
BA_ "UserSigValidity" SG_ 997 ICU_BS2SoH 3;
BA_ "Version" SG_ 997 ICU_BS2SoH "21.07.05";
BA_ "Description" SG_ 997 ICU_BS2SoF "This signal is battery State of Function(SOF) as calculated by battery sensor.



This value shows information about the battery ability to crank the engine (both of warm & cold cranking).



This value is prediction value of the minimum voltage for the ";
BA_ "GenSigSendType" SG_ 997 ICU_BS2SoF 4;
BA_ "GenSigStartValue" SG_ 997 ICU_BS2SoF 255;
BA_ "UserSigValidity" SG_ 997 ICU_BS2SoF 3;
BA_ "Version" SG_ 997 ICU_BS2SoF "21.07.05";
BA_ "Description" SG_ 997 PDC_FD_AlvCnt11Val "For the first transmission request for a data element the counter shall be initialized with 0 and shall be incremented by 1 for every subsequent send request. 

When the counter reaches the maximum value(0xFF), then it shall restart with 0 for the next s";
BA_ "GenSigSendType" SG_ 997 PDC_FD_AlvCnt11Val 4;
BA_ "UserSigValidity" SG_ 997 PDC_FD_AlvCnt11Val 3;
BA_ "Version" SG_ 997 PDC_FD_AlvCnt11Val "22.10.20";
BA_ "Description" SG_ 997 ICU_BS1IBAT_Conversion "This is Battery current as measured by battery sensor.

The resolution is 10mA



- 0x3FFFF : 262,143 (Error) , 0x00000 ~ 0x3A980 : 0 ~ 240,000

- Physical value min. : (0 * 10mA) + (-1,200,000) = -1,200 A

- Physical value max. : (240,000 * 10mA) + (-1,";
BA_ "GenSigSendType" SG_ 997 ICU_BS1IBAT_Conversion 4;
BA_ "UserSigValidity" SG_ 997 ICU_BS1IBAT_Conversion 3;
BA_ "Version" SG_ 997 ICU_BS1IBAT_Conversion "22.06.05";
BA_ "Description" SG_ 997 ICU_BS1BatVol "This is the actual battery voltage as measured on the battery pole by battery sensor.



The resolution is 1mV.";
BA_ "GenSigSendType" SG_ 997 ICU_BS1BatVol 4;
BA_ "GenSigStartValue" SG_ 997 ICU_BS1BatVol 16383;
BA_ "UserSigValidity" SG_ 997 ICU_BS1BatVol 3;
BA_ "Version" SG_ 997 ICU_BS1BatVol "21.07.05";
BA_ "Description" SG_ 997 ICU_BS1BatTemp "This is actual battery electrolyte temperature value by battery sensor.



The value is calculated by a Battery Temperature Model, depending on measured temperature of the battery pole.





The resolution is 0.5℃.";
BA_ "GenSigSendType" SG_ 997 ICU_BS1BatTemp 4;
BA_ "GenSigStartValue" SG_ 997 ICU_BS1BatTemp 511;
BA_ "UserSigValidity" SG_ 997 ICU_BS1BatTemp 3;
BA_ "Version" SG_ 997 ICU_BS1BatTemp "21.07.05";
BA_REL_ "GenSigTimeoutTime" BU_SG_REL_ BLTN_CAM_FD SG_ 870 CF_AVN_ProfileIDRValue 1500;
BA_REL_ "GenSigTimeoutTime" BU_SG_REL_ GW_PSU_DRV_FD SG_ 870 CF_AVN_ProfileIDRValue 1500;
BA_REL_ "GenSigTimeoutTime" BU_SG_REL_ GW_SAU_DRV_FD SG_ 870 CF_AVN_ProfileIDRValue 1500;
BA_REL_ "GenSigTimeoutTime" BU_SG_REL_ RCM_FD SG_ 870 CF_AVN_ProfileIDRValue 1500;
BA_REL_ "GenSigTimeoutTime" BU_SG_REL_ RWPC_FD SG_ 870 CF_AVN_ProfileIDRValue 1500;
BA_REL_ "GenSigTimeoutTime" BU_SG_REL_ SGU_FD SG_ 870 CF_AVN_ProfileIDRValue 1500;
BA_REL_ "GenSigTimeoutTime" BU_SG_REL_ WPC2_FD SG_ 870 CF_AVN_ProfileIDRValue 1500;
BA_REL_ "GenSigTimeoutTime" BU_SG_REL_ WPC_FD SG_ 870 CF_AVN_ProfileIDRValue 1500;
BA_REL_ "GenSigTimeoutTime" BU_SG_REL_ GW_PSU_AST_FD SG_ 870 HU_RTCCheck 1500;
BA_REL_ "GenSigTimeoutTime" BU_SG_REL_ ATS_FD SG_ 870 HU_ThemeType 1500;
BA_REL_ "GenSigTimeoutTime" BU_SG_REL_ BLTN_CAM_FD SG_ 870 HU_ThemeType 1500;
BA_REL_ "GenSigTimeoutTime" BU_SG_REL_ BLTN_CAM_FD SG_ 993 IntLamp_InlTailLmpSta 1500;
BA_REL_ "GenSigTimeoutTime" BU_SG_REL_ GW_PSU_3RD_FD SG_ 993 IntLamp_InlTailLmpSta 1500;
BA_REL_ "GenSigTimeoutTime" BU_SG_REL_ GW_PSU_AST_FD SG_ 993 IntLamp_InlTailLmpSta 1500;
BA_REL_ "GenSigTimeoutTime" BU_SG_REL_ GW_PSU_DRV_FD SG_ 993 IntLamp_InlTailLmpSta 1500;
BA_REL_ "GenSigTimeoutTime" BU_SG_REL_ GW_PSU_RL_FD SG_ 993 IntLamp_InlTailLmpSta 1500;
BA_REL_ "GenSigTimeoutTime" BU_SG_REL_ GW_PSU_RR_FD SG_ 993 IntLamp_InlTailLmpSta 1500;
BA_REL_ "GenSigTimeoutTime" BU_SG_REL_ WPC2_FD SG_ 993 IntLamp_InlTailLmpSta 1500;
BA_REL_ "GenSigTimeoutTime" BU_SG_REL_ RWPC_FD SG_ 813 Latch_TypeOption_DRV 1500;
BA_REL_ "GenSigTimeoutTime" BU_SG_REL_ WPC2_FD SG_ 813 Latch_TypeOption_DRV 1500;
BA_REL_ "GenSigTimeoutTime" BU_SG_REL_ WPC_FD SG_ 813 Latch_TypeOption_DRV 1500;
BA_REL_ "GenSigTimeoutTime" BU_SG_REL_ GW_PSU_DRV_FD SG_ 813 IMS_OSMirPlayBackSta_LH 1500;
BA_REL_ "GenSigTimeoutTime" BU_SG_REL_ GW_PSU_DRV_FD SG_ 813 IMS_OSMirPlayBackSta_LH_New 1500;
BA_REL_ "GenSigTimeoutTime" BU_SG_REL_ BLTN_CAM_FD SG_ 813 Warn_HoodSwSta_SBCM 1500;
BA_REL_ "GenSigTimeoutTime" BU_SG_REL_ BLTN_CAM_FD SG_ 813 Hood_TypeOption 1500;
BA_REL_ "GenSigTimeoutTime" BU_SG_REL_ ATS_FD SG_ 813 PwrDRClosingDRVDrSta 1500;
BA_REL_ "GenSigTimeoutTime" BU_SG_REL_ ATS_FD SG_ 813 DRV_DetectObj_warn_LH 1500;
BA_REL_ "GenSigTimeoutTime" BU_SG_REL_ ATS_FD SG_ 813 PwrDROpenClosingDdvSdDRSta 1500;
BA_REL_ "GenSigTimeoutTime" BU_SG_REL_ ATS_FD SG_ 813 Coach_TypeOption_DRV 1500;
BA_REL_ "GenSigTimeoutTime" BU_SG_REL_ GW_PSU_RL_FD SG_ 813 Coach_TypeOption_DRV 1500;
BA_REL_ "GenSigTimeoutTime" BU_SG_REL_ GW_PSU_RR_FD SG_ 813 Coach_TypeOption_DRV 1500;
BA_REL_ "GenSigTimeoutTime" BU_SG_REL_ BLTN_CAM_FD SG_ 813 DRV_CrashUnlockCmd 1500;
BA_REL_ "GenSigTimeoutTime" BU_SG_REL_ ATS_FD SG_ 813 Warn_DrvDrSwSta_SBCM 1500;
BA_REL_ "GenSigTimeoutTime" BU_SG_REL_ BLTN_CAM_FD SG_ 813 Warn_DrvDrSwSta_SBCM 1500;
BA_REL_ "GenSigTimeoutTime" BU_SG_REL_ GW_PSU_DRV_FD SG_ 813 Warn_DrvDrSwSta_SBCM 1500;
BA_REL_ "GenSigTimeoutTime" BU_SG_REL_ PSB_FD SG_ 813 Warn_DrvDrSwSta_SBCM 1500;
BA_REL_ "GenSigTimeoutTime" BU_SG_REL_ RWPC_FD SG_ 813 Warn_DrvDrSwSta_SBCM 1500;
BA_REL_ "GenSigTimeoutTime" BU_SG_REL_ WPC2_FD SG_ 813 Warn_DrvDrSwSta_SBCM 1500;
BA_REL_ "GenSigTimeoutTime" BU_SG_REL_ WPC_FD SG_ 813 Warn_DrvDrSwSta_SBCM 1500;
BA_REL_ "GenSigTimeoutTime" BU_SG_REL_ ATS_FD SG_ 813 DoorLock_DrvDrUnLkSta_SBCM 1500;
BA_REL_ "GenSigTimeoutTime" BU_SG_REL_ GW_PSU_DRV_FD SG_ 813 DoorLock_DrvDrUnLkSta_SBCM 1500;
BA_REL_ "GenSigTimeoutTime" BU_SG_REL_ ARS_FD SG_ 992 C_3rdRCSeatBeltSW 1500;
BA_REL_ "GenSigTimeoutTime" BU_SG_REL_ GW_PSU_RL_FD SG_ 992 C_3rdRCSeatBeltSW 1500;
BA_REL_ "GenSigTimeoutTime" BU_SG_REL_ GW_PSU_RR_FD SG_ 992 C_3rdRCSeatBeltSW 1500;
BA_REL_ "GenSigTimeoutTime" BU_SG_REL_ WPC2_FD SG_ 992 C_3rdRCSeatBeltSW 1500;
BA_REL_ "GenSigTimeoutTime" BU_SG_REL_ ARS_FD SG_ 992 C_3rdRRSeatBeltSW 1500;
BA_REL_ "GenSigTimeoutTime" BU_SG_REL_ GW_PSU_RR_FD SG_ 992 C_3rdRRSeatBeltSW 1500;
BA_REL_ "GenSigTimeoutTime" BU_SG_REL_ WPC2_FD SG_ 992 C_3rdRRSeatBeltSW 1500;
BA_REL_ "GenSigTimeoutTime" BU_SG_REL_ GW_PSU_AST_FD SG_ 992 Warn_PassStOccSta 1500;
BA_REL_ "GenSigTimeoutTime" BU_SG_REL_ GW_PSU_DRV_FD SG_ 992 Warn_RrLftSBRMATSwSta 1500;
BA_REL_ "GenSigTimeoutTime" BU_SG_REL_ GW_PSU_DRV_FD SG_ 992 Warn_RrRhtSBRMATSwSta 1500;
BA_REL_ "GenSigTimeoutTime" BU_SG_REL_ ARS_FD SG_ 992 C_3rdRLSBRMatSw 1500;
BA_REL_ "GenSigTimeoutTime" BU_SG_REL_ GW_PSU_RL_FD SG_ 992 C_3rdRLSBRMatSw 1500;
BA_REL_ "GenSigTimeoutTime" BU_SG_REL_ WPC2_FD SG_ 992 C_3rdRLSBRMatSw 1500;
BA_REL_ "GenSigTimeoutTime" BU_SG_REL_ ARS_FD SG_ 992 C_3rdRRSBRMatSw 1500;
BA_REL_ "GenSigTimeoutTime" BU_SG_REL_ GW_PSU_RR_FD SG_ 992 C_3rdRRSBRMatSw 1500;
BA_REL_ "GenSigTimeoutTime" BU_SG_REL_ WPC2_FD SG_ 992 C_3rdRRSBRMatSw 1500;
BA_REL_ "GenSigTimeoutTime" BU_SG_REL_ BLTN_CAM_FD SG_ 992 Trunk_TrnkTlgtSwSta 1500;
BA_REL_ "GenSigTimeoutTime" BU_SG_REL_ GW_PSU_3RD_FD SG_ 992 Trunk_TrnkTlgtSwSta 1500;
BA_REL_ "GenSigTimeoutTime" BU_SG_REL_ GW_PSU_AST_FD SG_ 992 Trunk_TrnkTlgtSwSta 1500;
BA_REL_ "GenSigTimeoutTime" BU_SG_REL_ GW_PSU_RL_FD SG_ 992 Trunk_TrnkTlgtSwSta 1500;
BA_REL_ "GenSigTimeoutTime" BU_SG_REL_ GW_PSU_RR_FD SG_ 992 Trunk_TrnkTlgtSwSta 1500;
BA_REL_ "GenSigTimeoutTime" BU_SG_REL_ SHVU_RL_FD SG_ 992 Trunk_TrnkTlgtSwSta 1500;
BA_REL_ "GenSigTimeoutTime" BU_SG_REL_ SHVU_RR_FD SG_ 992 Trunk_TrnkTlgtSwSta 1500;
BA_REL_ "GenSigTimeoutTime" BU_SG_REL_ GW_PSU_3RD_FD SG_ 992 IGN3State 1500;
BA_REL_ "GenSigTimeoutTime" BU_SG_REL_ GW_PSU_AST_FD SG_ 992 IGN3State 1500;
BA_REL_ "GenSigTimeoutTime" BU_SG_REL_ GW_PSU_DRV_FD SG_ 992 IGN3State 1500;
BA_REL_ "GenSigTimeoutTime" BU_SG_REL_ GW_PSU_RL_FD SG_ 992 IGN3State 1500;
BA_REL_ "GenSigTimeoutTime" BU_SG_REL_ GW_PSU_RR_FD SG_ 992 IGN3State 1500;
BA_REL_ "GenSigTimeoutTime" BU_SG_REL_ SHVU_3RD_FD SG_ 992 IGN3State 1500;
BA_REL_ "GenSigTimeoutTime" BU_SG_REL_ SHVU_FRNT_FD SG_ 992 IGN3State 1500;
BA_REL_ "GenSigTimeoutTime" BU_SG_REL_ SHVU_REAR_FD SG_ 992 IGN3State 1500;
BA_REL_ "GenSigTimeoutTime" BU_SG_REL_ SHVU_RL_FD SG_ 992 IGN3State 1500;
BA_REL_ "GenSigTimeoutTime" BU_SG_REL_ SHVU_RR_FD SG_ 992 IGN3State 1500;
BA_REL_ "GenSigTimeoutTime" BU_SG_REL_ GW_SAU_DRV_FD SG_ 992 SeatBeltSwSta_Asst 1500;
BA_REL_ "GenSigTimeoutTime" BU_SG_REL_ ATS_FD SG_ 992 PDCex_CurtainOpt 1500;
BA_REL_ "GenSigTimeoutTime" BU_SG_REL_ ATS_FD SG_ 992 DriveTypeOption 1500;
BA_REL_ "GenSigTimeoutTime" BU_SG_REL_ BLTN_CAM_FD SG_ 992 DriveTypeOption 1500;
BA_REL_ "GenSigTimeoutTime" BU_SG_REL_ GW_PSU_AST_FD SG_ 992 DriveTypeOption 1500;
BA_REL_ "GenSigTimeoutTime" BU_SG_REL_ GW_PSU_DRV_FD SG_ 992 DriveTypeOption 1500;
BA_REL_ "GenSigTimeoutTime" BU_SG_REL_ GW_PSU_RL_FD SG_ 992 DriveTypeOption 1500;
BA_REL_ "GenSigTimeoutTime" BU_SG_REL_ GW_PSU_RR_FD SG_ 992 DriveTypeOption 1500;
BA_REL_ "GenSigTimeoutTime" BU_SG_REL_ GW_SAU_DRV_FD SG_ 992 DriveTypeOption 1500;
BA_REL_ "GenSigTimeoutTime" BU_SG_REL_ SHVU_3RD_FD SG_ 992 DriveTypeOption 1500;
BA_REL_ "GenSigTimeoutTime" BU_SG_REL_ SHVU_FRNT_FD SG_ 992 DriveTypeOption 1500;
BA_REL_ "GenSigTimeoutTime" BU_SG_REL_ SHVU_REAR_FD SG_ 992 DriveTypeOption 1500;
BA_REL_ "GenSigTimeoutTime" BU_SG_REL_ BLTN_CAM_FD SG_ 992 ICU_MtGearPosRSta 1500;
BA_REL_ "GenSigTimeoutTime" BU_SG_REL_ GW_PSU_3RD_FD SG_ 992 Warn_PrkngBrkSwSta 1500;
BA_REL_ "GenSigTimeoutTime" BU_SG_REL_ GW_PSU_AST_FD SG_ 992 Warn_PrkngBrkSwSta 1500;
BA_REL_ "GenSigTimeoutTime" BU_SG_REL_ GW_PSU_RL_FD SG_ 992 Warn_PrkngBrkSwSta 1500;
BA_REL_ "GenSigTimeoutTime" BU_SG_REL_ GW_PSU_RR_FD SG_ 992 Warn_PrkngBrkSwSta 1500;
BA_REL_ "GenSigTimeoutTime" BU_SG_REL_ SHVU_RL_FD SG_ 992 Warn_PrkngBrkSwSta 1500;
BA_REL_ "GenSigTimeoutTime" BU_SG_REL_ SHVU_RR_FD SG_ 992 Warn_PrkngBrkSwSta 1500;
BA_REL_ "GenSigTimeoutTime" BU_SG_REL_ ATS_FD SG_ 992 Warn_DrvStBltSwSta 1500;
BA_REL_ "GenSigTimeoutTime" BU_SG_REL_ GW_PSU_DRV_FD SG_ 992 Warn_DrvStBltSwSta 1500;
BA_REL_ "GenSigTimeoutTime" BU_SG_REL_ GW_SAU_DRV_FD SG_ 992 Warn_DrvStBltSwSta 1500;
BA_REL_ "GenSigTimeoutTime" BU_SG_REL_ PSB_FD SG_ 992 Warn_DrvStBltSwSta 1500;
BA_REL_ "GenSigTimeoutTime" BU_SG_REL_ GW_PSU_AST_FD SG_ 992 Warn_AsstStBltSwSta 1500;
BA_REL_ "GenSigTimeoutTime" BU_SG_REL_ GW_PSU_RL_FD SG_ 992 Warn_AsstStBltSwSta 1500;
BA_REL_ "GenSigTimeoutTime" BU_SG_REL_ GW_SAU_DRV_FD SG_ 992 Warn_AsstStBltSwSta 1500;
BA_REL_ "GenSigTimeoutTime" BU_SG_REL_ PSB_FD SG_ 992 Warn_AsstStBltSwSta 1500;
BA_REL_ "GenSigTimeoutTime" BU_SG_REL_ GW_PSU_AST_FD SG_ 992 Warn_RrLftStBltSwSta 1500;
BA_REL_ "GenSigTimeoutTime" BU_SG_REL_ GW_PSU_DRV_FD SG_ 992 Warn_RrLftStBltSwSta 1500;
BA_REL_ "GenSigTimeoutTime" BU_SG_REL_ PSB_FD SG_ 992 Warn_RrLftStBltSwSta 1500;
BA_REL_ "GenSigTimeoutTime" BU_SG_REL_ PSB_FD SG_ 992 Warn_RrCtrStBltSwSta 1500;
BA_REL_ "GenSigTimeoutTime" BU_SG_REL_ GW_PSU_AST_FD SG_ 992 Warn_RrRtStBltSwSta 1500;
BA_REL_ "GenSigTimeoutTime" BU_SG_REL_ GW_PSU_DRV_FD SG_ 992 Warn_RrRtStBltSwSta 1500;
BA_REL_ "GenSigTimeoutTime" BU_SG_REL_ PSB_FD SG_ 992 Warn_RrRtStBltSwSta 1500;
BA_REL_ "GenSigTimeoutTime" BU_SG_REL_ ARS_FD SG_ 992 C_3rdRLSeatBeltSW 1500;
BA_REL_ "GenSigTimeoutTime" BU_SG_REL_ GW_PSU_RL_FD SG_ 992 C_3rdRLSeatBeltSW 1500;
BA_REL_ "GenSigTimeoutTime" BU_SG_REL_ WPC2_FD SG_ 992 C_3rdRLSeatBeltSW 1500;
BA_REL_ "GenSigTimeoutTime" BU_SG_REL_ BLTN_CAM_FD SG_ 995 Lamp_TrnSigLmpLftOnReq 1500;
BA_REL_ "GenSigTimeoutTime" BU_SG_REL_ BLTN_CAM_FD SG_ 995 Lamp_TrnSigLmpRtOnReq 1500;
BA_REL_ "GenSigTimeoutTime" BU_SG_REL_ BLTN_CAM_FD SG_ 994 Warn_DrvDrSwSta 1500;
BA_REL_ "GenSigTimeoutTime" BU_SG_REL_ GW_PSU_DRV_FD SG_ 994 Warn_DrvDrSwSta 1500;
BA_REL_ "GenSigTimeoutTime" BU_SG_REL_ PSB_FD SG_ 994 Warn_DrvDrSwSta 1500;
BA_REL_ "GenSigTimeoutTime" BU_SG_REL_ RWPC_FD SG_ 994 Warn_DrvDrSwSta 1500;
BA_REL_ "GenSigTimeoutTime" BU_SG_REL_ WPC2_FD SG_ 994 Warn_DrvDrSwSta 1500;
BA_REL_ "GenSigTimeoutTime" BU_SG_REL_ WPC_FD SG_ 994 Warn_DrvDrSwSta 1500;
BA_REL_ "GenSigTimeoutTime" BU_SG_REL_ BLTN_CAM_FD SG_ 994 Warn_AsstDrSwSta 1500;
BA_REL_ "GenSigTimeoutTime" BU_SG_REL_ GW_PSU_AST_FD SG_ 994 Warn_AsstDrSwSta 1500;
BA_REL_ "GenSigTimeoutTime" BU_SG_REL_ GW_PSU_RL_FD SG_ 994 Warn_AsstDrSwSta 1500;
BA_REL_ "GenSigTimeoutTime" BU_SG_REL_ GW_SAU_DRV_FD SG_ 994 Warn_AsstDrSwSta 1500;
BA_REL_ "GenSigTimeoutTime" BU_SG_REL_ PSB_FD SG_ 994 Warn_AsstDrSwSta 1500;
BA_REL_ "GenSigTimeoutTime" BU_SG_REL_ RWPC_FD SG_ 994 Warn_AsstDrSwSta 1500;
BA_REL_ "GenSigTimeoutTime" BU_SG_REL_ WPC2_FD SG_ 994 Warn_AsstDrSwSta 1500;
BA_REL_ "GenSigTimeoutTime" BU_SG_REL_ WPC_FD SG_ 994 Warn_AsstDrSwSta 1500;
BA_REL_ "GenSigTimeoutTime" BU_SG_REL_ BLTN_CAM_FD SG_ 994 Warn_RrLftDrSwSta 1500;
BA_REL_ "GenSigTimeoutTime" BU_SG_REL_ GW_PSU_AST_FD SG_ 994 Warn_RrLftDrSwSta 1500;
BA_REL_ "GenSigTimeoutTime" BU_SG_REL_ GW_PSU_RL_FD SG_ 994 Warn_RrLftDrSwSta 1500;
BA_REL_ "GenSigTimeoutTime" BU_SG_REL_ GW_PSU_RR_FD SG_ 994 Warn_RrLftDrSwSta 1500;
BA_REL_ "GenSigTimeoutTime" BU_SG_REL_ RWPC_FD SG_ 994 Warn_RrLftDrSwSta 1500;
BA_REL_ "GenSigTimeoutTime" BU_SG_REL_ SHVU_RL_FD SG_ 994 Warn_RrLftDrSwSta 1500;
BA_REL_ "GenSigTimeoutTime" BU_SG_REL_ WPC2_FD SG_ 994 Warn_RrLftDrSwSta 1500;
BA_REL_ "GenSigTimeoutTime" BU_SG_REL_ WPC_FD SG_ 994 Warn_RrLftDrSwSta 1500;
BA_REL_ "GenSigTimeoutTime" BU_SG_REL_ BLTN_CAM_FD SG_ 994 Warn_RrRtDrSwSta 1500;
BA_REL_ "GenSigTimeoutTime" BU_SG_REL_ GW_PSU_AST_FD SG_ 994 Warn_RrRtDrSwSta 1500;
BA_REL_ "GenSigTimeoutTime" BU_SG_REL_ GW_PSU_RL_FD SG_ 994 Warn_RrRtDrSwSta 1500;
BA_REL_ "GenSigTimeoutTime" BU_SG_REL_ GW_PSU_RR_FD SG_ 994 Warn_RrRtDrSwSta 1500;
BA_REL_ "GenSigTimeoutTime" BU_SG_REL_ RWPC_FD SG_ 994 Warn_RrRtDrSwSta 1500;
BA_REL_ "GenSigTimeoutTime" BU_SG_REL_ SHVU_RR_FD SG_ 994 Warn_RrRtDrSwSta 1500;
BA_REL_ "GenSigTimeoutTime" BU_SG_REL_ WPC2_FD SG_ 994 Warn_RrRtDrSwSta 1500;
BA_REL_ "GenSigTimeoutTime" BU_SG_REL_ WPC_FD SG_ 994 Warn_RrRtDrSwSta 1500;
BA_REL_ "GenSigTimeoutTime" BU_SG_REL_ BLTN_CAM_FD SG_ 994 Warn_HoodSwSta 1500;
BA_REL_ "GenSigTimeoutTime" BU_SG_REL_ GW_PSU_DRV_FD SG_ 994 DoorLock_DrvDrUnLkSta 1500;
BA_REL_ "GenSigTimeoutTime" BU_SG_REL_ BLTN_CAM_FD SG_ 994 C_CrashUnlockState 1500;
BA_REL_ "GenSigTimeoutTime" BU_SG_REL_ BLTN_CAM_FD SG_ 997 ICU_BS2SoC 1500;
VAL_ 870 HU_GW_Crc3Val 0 "0x0x0~0xFFFF:CRCValue" 65535 "0x0x0~0xFFFF:CRCValue" ;
VAL_ 870 AVN_RSPA_Disp_Rdy 0 "Impossible to display" 1 "Possible to display" 2 "RESERVED" 3 "Invalid" ;
VAL_ 870 CF_AVN_ProfileIDRValue 0 "Default" 1 "Guest" 2 "Profile 1" 3 "Profile 2" 4 "Profile 3" 5 "Profile 4" 6 "Profile 5" 7 "Profile 6" 8 "Profile 7" 9 "Profile 8" 10 "Profile 9" 11 "RESERVED" 12 "RESERVED" 13 "RESERVED" 14 "RESERVED" 15 "Invalid" ;
VAL_ 870 HazardFromHUSVM 0 "inactive" 1 "active" 2 "RESERVED" 3 "invalid" ;
VAL_ 870 OMUOSMirCtrl 0 "Off" 1 "Fold" 2 "Unfold" 3 "invalid" ;
VAL_ 870 OTAUIStatus 0 "Not Ready" 1 "Ready" 2 "RESERVED" 3 "Invalid" ;
VAL_ 870 C_TeleActiveStatus 0 "Active" 1 "Deactive" 2 "RESERVED" 3 "Invalid" ;
VAL_ 870 HU_RTCCheck 0 "Ready" 1 "Checking" 2 "RESERVED" 3 "Invalid" ;
VAL_ 870 HU_GW_AlvCnt3Val 0 "0x0x0~0xFF:AlvCntValue" 255 "0x0x0~0xFF:AlvCntValue" ;
VAL_ 870 HU_SWRCWarmerSet 0 "Off (Release)" 1 "On (Press)" 2 "RESERVED" 3 "Invalid" ;
VAL_ 870 AVN_MRA_Disp_Rdy 0 "Impossible to display" 1 "Possible to display" 2 "RESERVED" 3 "Invalid" ;
VAL_ 870 AVN_PRK_Func_Selected 0 "Init" 1 "No input" 2 "RSPA Soft Button input" 3 "MRA Soft Button input" 4 "RESERVED" 5 "RESERVED" 6 "RESERVED" 7 "RESERVED" 8 "RESERVED" 9 "RESERVED" 10 "RESERVED" 11 "RESERVED" 12 "RESERVED" 13 "RESERVED" 14 "RESERVED" 15 "Invalid" ;
VAL_ 870 AVN_MRA_CancelInput 0 "Init" 1 "No input" 2 "Cancel input" 3 "Invalid" ;
VAL_ 870 HU_DistanceUnit 0 "Km" 1 "Mile" 2 "RESERVED" 3 "Invalid" ;
VAL_ 870 HU_Scheduled_Setting 0 "Scheduled not set" 1 "Scheduled set" 2 "RESERVED" 3 "RESERVED" 4 "RESERVED" 5 "RESERVED" 6 "60% SoC Requested" 7 "70% SoC Requested" 8 "80% SoC Requested" 9 "90% SoC Requested" 10 "100% SoC Requested" 11 "RESERVED" 12 "RESERVED" 13 "RESERVED" 14 "RESERVED" 15 "Invalid" ;
VAL_ 870 HU_AliveStatus 0 "Not Ready" 1 "On Mode" 2 "Head Unit Update Mode" 3 "Invalid" ;
VAL_ 870 HU_ThemeType 0 "Default" 1 "Aqua(Hyundai)" 2 "Magenta(Kia)" 3 "Eco White" 4 "Eco Black" 5 "Genesis(IKPE)" 6 "Magenta White" 7 "RESERVED" 8 "RESERVED" 9 "RESERVED" 10 "RESERVED" 11 "RESERVED" 12 "RESERVED" 13 "RESERVED" 14 "RESERVED" 15 "Invalid" 16 "Copper" 17 "Copper Rust" 18 "RESERVED" 19 "RESERVED" 20 "RESERVED" 21 "RESERVED" 22 "RESERVED" 23 "RESERVED" 24 "RESERVED" 25 "RESERVED" 26 "RESERVED" 27 "RESERVED" 28 "RESERVED" 29 "RESERVED" 30 "RESERVED" 31 "RESERVED" 32 "ccIC Light" 33 "ccIC Dark" 34 "RESERVED" 35 "RESERVED" 36 "RESERVED" 37 "RESERVED" 38 "RESERVED" 39 "RESERVED" 40 "RESERVED" 41 "RESERVED" 42 "RESERVED" 43 "RESERVED" 44 "RESERVED" 45 "RESERVED" 46 "RESERVED" 47 "RESERVED" 48 "RESERVED" 49 "RESERVED" 50 "RESERVED" 51 "RESERVED" 52 "RESERVED" 53 "RESERVED" 54 "RESERVED" 55 "RESERVED" 56 "RESERVED" 57 "RESERVED" 58 "RESERVED" 59 "RESERVED" 60 "RESERVED" 61 "RESERVED" 62 "RESERVED" 63 "RESERVED" ;
VAL_ 870 HU_MicActivity 0 "Deactivated" 1 "Activated" 2 "RESERVED" 3 "Invalid" ;
VAL_ 870 AVN_RSPA_ModeSelect 0 "None" 1 "CCP focus (1st menu on the left)" 2 "Touch or CCP confirm (1st menu on the left)" 3 "CCP focus (2nd menu on the left)" 4 "Touch or CCP confirm (2nd menu on the left)" 5 "CCP focus (1st menu on the right)" 6 "Touch or CCP confirm (1st menu on the right)" 7 "CCP focus (2nd menu on the right)" 8 "Touch or CCP confirm (2nd menu on the right)" 9 "Touch or CCP confirm (1st menu Forward perpendicular on the left)" 10 "Touch or CCP confirm (2nd menu Forward perpendicular on the left)" 11 "Touch or CCP confirm (1st menu Forward perpendicular on the right)" 12 "Touch or CCP confirm (2nd menu Forward perpendicular on the right)" 13 "RESERVED" 14 "RESERVED" 15 "Invalid" ;
VAL_ 870 CF_HU_GPSFlt 0 "Normal" 1 "Fault operation" 2 "TimeOut" 3 "Invalid" ;
VAL_ 870 AVN_RSPA_CancelInput 0 "Init" 1 "No Input" 2 "Cancel Input" 3 "Invalid" ;
VAL_ 261 EMS_Crc7Val 0 "0x0x0~0xFFFF:CRCValue" 65535 "0x0x0~0xFFFF:CRCValue" ;
VAL_ 261 HEV_AccelPdlVal 0 "Accelerator Pedal not activated" 1022 "Accelerator Pedal fully activated" 1023 "Accelerator Pedal is defective (fail state) or Non-ETC system (APS is not installed)" ;
VAL_ 261 HEV_IndTqVal_Extd 0 "0x0x0000~0x3FFF:Physical Value (0~1638.3Nm)" 16383 "0x0x0000~0x3FFF:Physical Value (0~1638.3Nm)" ;
VAL_ 261 EMS_AlvCnt7Val 0 "0x0x0~0xFF:AlvCntValue" 255 "0x0x0~0xFF:AlvCntValue" ;
VAL_ 261 HEV_OilDilution_IncICELoad 0 "OFF" 1 "ON" ;
VAL_ 261 HEV_OilDilution_ServMode 0 "OFF" 1 "Healing I" 2 "Healing II" 3 "RESERVED" ;
VAL_ 261 EMS_TqLmtSta 0 "Default/Normal" 1 "O2 Sensor Pre-Heating - To be Started" 2 "O2 Sensor Pre-Heating - Can be Started" 3 "Torque Limit for Low Temperature (Catalyst Heating)" 4 "Torque Ramping" 5 "Warming up" 6 "Torque Limit for High Temperature (Catalyst Overheating Protection)" 7 "Error" ;
VAL_ 261 EMS_EU7 0 "Not EU7 vehicle" 1 "EU7 vehicle" ;
VAL_ 261 HEV_EngOpSta 0 "ES(Engine Stop)" 1 "ST(Start)" 2 "IS(Idle speed)" 3 "PL(Part Load)" 4 "PU(Pull)" 5 "PUC(Fuel Cut off)" ;
VAL_ 993 PDC_FD_Crc2Val 0 "0x0x0~0xFFFF:CRCValue" 65535 "0x0x0~0xFFFF:CRCValue" ;
VAL_ 993 Lamp_StpLmpLftOpnSta 0 "Normal" 1 "Open Status" 2 "Not Used" 3 "Error Indicator" ;
VAL_ 993 Lamp_StpLmpRtOpnSta 0 "Normal" 1 "Open Status" 2 "Not Used" 3 "Error Indicator" ;
VAL_ 993 Lamp_HmslLmpOpnSta 0 "Normal" 1 "Open Status" 2 "Not Used" 3 "Error Indicator" ;
VAL_ 993 Lamp_DrlLmpLftOpnSta 0 "Normal" 1 "Open Status" 2 "Not Used" 3 "Error Indicator" ;
VAL_ 993 Lamp_DrlLmpRtOpnSta 0 "Normal" 1 "Open Status" 2 "Not Used" 3 "Error Indicator" ;
VAL_ 993 Lamp_FrFgLmpLftOpnSta 0 "Normal" 1 "Open Status" 2 "Not Used" 3 "Error Indicator" ;
VAL_ 993 Lamp_FrFgLmpRtOpnSta 0 "Normal" 1 "Open Status" 2 "Not Used" 3 "Error Indicator" ;
VAL_ 993 Lamp_CorneringLmpLftOpnSta 0 "Normal" 1 "Open Status" 2 "Not Used" 3 "Error Indicator" ;
VAL_ 993 Lamp_CorneringLmpRtOpnSta 0 "Normal" 1 "Open Status" 2 "Not Used" 3 "Error Indicator" ;
VAL_ 993 Lamp_StcBendingLmpLftOpnSta 0 "Normal" 1 "Open Status" 2 "Not Used" 3 "Error Indicator" ;
VAL_ 993 Lamp_StcBendingLmpRtOpnSta 0 "Normal" 1 "Open Status" 2 "Not Used" 3 "Error Indicator" ;
VAL_ 993 Lamp_FrTurnSigLmpLftPCLSta 0 "Normal" 1 "PCL Status" 2 "Not Used" 3 "Error Indicator" ;
VAL_ 993 Lamp_FrTurnSigLmpRtPCLSta 0 "Normal" 1 "PCL Status" 2 "Not Used" 3 "Error Indicator" ;
VAL_ 993 Lamp_RrTurnSigLmpLftPCLSta 0 "Normal" 1 "PCL Status" 2 "Not Used" 3 "Error Indicator" ;
VAL_ 993 Lamp_RrTurnSigLmpRtPCLSta 0 "Normal" 1 "PCL Status" 2 "Not Used" 3 "Error Indicator" ;
VAL_ 993 HzrdSwPushSta 0 "Off" 1 "On" 2 "Not Used" 3 "Error Indicator" ;
VAL_ 993 Lamp_LftTrnFaultSta 0 "Off" 1 "On" 2 "Not Used" 3 "Error Indicator" ;
VAL_ 993 Lamp_RtTrnFaultSta 0 "Off" 1 "On" 2 "Not Used" 3 "Error Indicator" ;
VAL_ 993 FrtTurnLampOptSta 0 "Not Applied" 1 "Bulb" 2 "LED" 3 "RESERVED" ;
VAL_ 993 RrTurnLampOptSta 0 "Not Applied" 1 "Bulb" 2 "LED" 3 "2Bulb" ;
VAL_ 993 PDC_FD_AlvCnt2Val 0 "0x0x0~0xFF:AlvCntValue" 255 "0x0x0~0xFF:AlvCntValue" ;
VAL_ 993 IntLamp_InlTailLmpSta 0 "Off" 1 "On" 2 "Not Used" 3 "Error Indicator" ;
VAL_ 993 Lamp_FootLampOnReq 0 "Off" 1 "On" 2 "Dim Out" 3 "Error Indicator" ;
VAL_ 993 Lamp_MoodLampOnReq 0 "0%" 1 "FadeIn" 2 "MoodBrightPercent" 3 "FadeOut" 4 "100%" 5 "RESERVED" 6 "RESERVED" 7 "RESERVED" ;
VAL_ 993 USM_FuncForMdLmpBrgtSta 0 "Default Value" 1 "Off" 2 "step 1" 3 "step 2" 4 "step 3" 5 "step 4" 6 "RESERVED" 7 "Invalid" ;
VAL_ 993 Lamp_HdLmpLoLftOpnSta 0 "Normal" 1 "Open Status" 2 "Not Used" 3 "Error Indicator" ;
VAL_ 993 Lamp_HdLmpLoRtOpnSta 0 "Normal" 1 "Open Status" 2 "Not Used" 3 "Error Indicator" ;
VAL_ 993 Lamp_HdLmpBiFuncLftOpnSta 0 "Normal" 1 "Open Status" 2 "Not Used" 3 "Error Indicator" ;
VAL_ 993 Lamp_HdLmpBiFuncRtOpnSta 0 "Normal" 1 "Open Status" 2 "Not Used" 3 "Error Indicator" ;
VAL_ 993 Lamp_HdLmpHiLftOpnSta 0 "Normal" 1 "Open Status" 2 "Not Used" 3 "Error Indicator" ;
VAL_ 993 Lamp_HdLmpHiRtOpnSta 0 "Normal" 1 "Open Status" 2 "Not Used" 3 "Error Indicator" ;
VAL_ 993 ExtLamp_HzrdSwSta 0 "Off" 1 "On" 2 "Not Used" 3 "Error Indicator" ;
VAL_ 993 Lamp_FrTrnSigLmpLftOpnSta 0 "Normal" 1 "Open Status" 2 "Not Used" 3 "Error Indicator" ;
VAL_ 993 Lamp_FrTrnSigLmpRtOpnSta 0 "Normal" 1 "Open Status" 2 "Not Used" 3 "Error Indicator" ;
VAL_ 993 Lamp_RrTrnSigLmpLftOpnSta 0 "Normal" 1 "Open Status" 2 "Not Used" 3 "Error Indicator" ;
VAL_ 993 Lamp_RrTrnSigLmpRtOpnSta 0 "Normal" 1 "Open Status" 2 "Not Used" 3 "Error Indicator" ;
VAL_ 993 Brake_SwSta_ICU 0 "Off" 1 "On" 2 "RESERVED" 3 "RESERVED" ;
VAL_ 993 BrkLmpCmd 0 "Inactive" 1 "Blink Off" 2 "Blink On" 3 "Steady On" ;
VAL_ 813 SBCM_DRV_FD_Crc1Val 0 "0x0x0~0xFFFF:CRCValue" 65535 "0x0x0~0xFFFF:CRCValue" ;
VAL_ 813 Latch_TypeOption_DRV 0 "Off" 1 "On" 2 "RESERVED" 3 "Error Indicator" ;
VAL_ 813 DRV_SWFailAlarm 0 "Off" 1 "On" 2 "RESERVED" 3 "Error Indicator" ;
VAL_ 813 USM_PwrDRApprOpnSetSta 0 "Default" 1 "Off" 2 "On" 3 "RESERVED" ;
VAL_ 813 USM_PwrDRApprOpnSetOpt 0 "Default" 1 "Off" 2 "On" 3 "RESERVED" ;
VAL_ 813 USM_PwrDRCloseByRKELockSta 0 "Default" 1 "Off" 2 "On" 3 "RESERVED" ;
VAL_ 813 USM_PwrDRCloseByRKELockOpt 0 "Default" 1 "Off" 2 "On" 3 "RESERVED" ;
VAL_ 813 USM_PwrDRCloseByBrakeSta 0 "Default" 1 "Off" 2 "On" 3 "RESERVED" ;
VAL_ 813 USM_PwrDRCloseByBrakeOpt 0 "Default" 1 "Off" 2 "On" 3 "RESERVED" ;
VAL_ 813 USM_PwrDRBuzzerSta 0 "Default" 1 "Off" 2 "On" 3 "RESERVED" ;
VAL_ 813 USM_PwrDRBuzzerOpt 0 "Default" 1 "Off" 2 "On" 3 "RESERVED" ;
VAL_ 813 PDS_TypeOption_DRV 0 "Off" 1 "All Door" 2 "Front Only" 3 "Rear Only" ;
VAL_ 813 C_DrvDoorApproachOpen 0 "Default" 1 "Approach Open Request" 2 "Approach Open Stop" 3 "RESERVED" ;
VAL_ 813 C_DrvDoorApproachClose 0 "Default" 1 "Approach Close Request" 2 "Approach Close Stop" 3 "RESERVED" ;
VAL_ 813 DoorLock_PDSLkSwSta_DRV 0 "Default" 1 "Lock" 2 "RESERVED" 3 "Error Indicator" ;
VAL_ 813 SBCM_DRV_DiagSta 0 "Default" 1 "Normal Operation" 2 "DRV Indicator Circuit Failure" 3 "RESERVED" ;
VAL_ 813 DoorLock_CtrlDrLkUnLkSwSta_SBCM 0 "Off" 1 "On" 2 "RESERVED" 3 "Error Indicator" ;
VAL_ 813 SBCM_PsvDrLkReq 0 "None" 1 "Lock" 2 "Passive Trunk Lock" 3 "RESERVED" ;
VAL_ 813 CDMAutoWashModeSet_SBCM 0 "Default" 1 "CDM Auto Wash Mode Off" 2 "CDM Auto Wash Mode On" 3 "RESERVED" 4 "RESERVED" 5 "RESERVED" 6 "RESERVED" 7 "Invalid" ;
VAL_ 813 USM_DrvGhostDoorSta 0 "Default" 1 "Off" 2 "On" 3 "RESERVED" ;
VAL_ 813 Mirror_LH_FoldingSta 0 "Off" 1 "Folding" 2 "RESERVED" 3 "Error Indicator" ;
VAL_ 813 Mirror_LH_UnfoldingSta 0 "Off" 1 "Unfolding" 2 "RESERVED" 3 "Error Indicator" ;
VAL_ 813 DRV_CrashMRActAlarm 0 "Off" 1 "On" 2 "RESERVED" 3 "Error Indicator" ;
VAL_ 813 AFH_DRV_FldUnFldSta 0 "Invalid" 1 "Fold" 2 "Unfold" 3 "Inprogress" ;
VAL_ 813 SBCM_DRV_FD_AlvCnt1Val 0 "0x0x0~0xFF:AlvCntValue" 255 "0x0x0~0xFF:AlvCntValue" ;
VAL_ 813 MirrorFldReq 0 "Default" 1 "Folding Request" 2 "Unfolding Request" 3 "RESERVED" ;
VAL_ 813 OMU_TypeOption_DRV 0 "Off" 1 "On" 2 "RESERVED" 3 "Error Indicator" ;
VAL_ 813 IMS_OSMirPlayBackSta_LH 0 "Stop" 1 "Play 1" 2 "Play 2" 3 "Play 3" 4 "SmartIMS" 5 "Profile 1" 6 "Profile 2" 7 "Guest" 8 "RESERVED" 9 "RESERVED" 10 "RESERVED" 11 "RESERVED" 12 "RESERVED" 13 "RESERVED" 14 "RESERVED" 15 "Error Indicator" ;
VAL_ 813 ECMMRR_PLUS 0 "0x0x0~0x7D:0~1.25 V" 125 "0x0x0~0x7D:0~1.25 V" 126 "0x7E~0xFE:RESERVED" 254 "0x7E~0xFE:RESERVED" 255 "RESERVED" ;
VAL_ 813 EHL_TxInfo_SBCM_DRV 0 "Default" 1 "EHL_L_Close" 2 "EHL_L_Half" 3 "EHL_L_Open" 4 "EHL_L_RetryFlag" 5 "EHL_L_ErrorIndicator" 6 "RESERVED" 7 "Invalid" ;
VAL_ 813 IMS_OSMirPlayBackSta_LH_New 0 "Stop" 1 "Play 1" 2 "Play 2" 3 "Play 3" 4 "Smart IMS" 5 "Profile 1" 6 "Profile 2" 7 "Profile 3" 8 "Profile 4" 9 "Profile 5" 10 "Profile 6" 11 "Profile 7" 12 "Profile 8" 13 "Profile 9" 14 "Guest" 15 "Error Indicator" ;
VAL_ 813 CDM_InsideOpnSwSta 0 "Off" 1 "On" 2 "RESERVED" 3 "Error Indicator" ;
VAL_ 813 CDM_TypeOption 0 "Off" 1 "On" 2 "On_2EA" 3 "Error Indicator" ;
VAL_ 813 CDM_ImmeChgSw_SBCM 0 "Default" 1 "Off" 2 "On" 3 "RESERVED" ;
VAL_ 813 CDM_ChgDrSwFrt_SBCM 0 "Default" 1 "Close" 2 "Open" 3 "RESERVED" ;
VAL_ 813 CDM_OpnClsState_SBCM 0 "Default" 1 "Open" 2 "Close" 3 "RESERVED" ;
VAL_ 813 CDM_WarnMsg_SBCM 0 "Default" 1 "Normal" 2 "ChargeDoorErrorState" 3 "RESERVED" ;
VAL_ 813 CDM_AutoWashModeSta 0 "Default" 1 "CDM Auto Wash Mode Off (Ready)" 2 "CDM Auto Wash Mode Off (Error)" 3 "CDM Auto Wash Mode On" 4 "RESERVED" 5 "RESERVED" 6 "RESERVED" 7 "Invalid" ;
VAL_ 813 CDM_CmdStatus_SBCM 0 "Open (AVN)" 1 "Open (SMK)" 2 "Open (Sensor Switch)" 3 "Open (Command Hard Switch)" 4 "Open (Anti - Pinch)" 5 "Close (AVN)" 6 "Close (SMK)" 7 "Close (Assist Mode)" 8 "Close (Command Hard Switch)" 9 "Close (Connector)" 10 "Close (Gear Position)" 11 "Close (Time Over)" 12 "Close (Anti - Pinch)" 13 "Close (Sensor Switch)" 14 "Stall (Stop)" 15 "Invalid" ;
VAL_ 813 CDM_OutsideOpnSwSta 0 "Default" 1 "Push" 2 "RESERVED" 3 "Invalid" ;
VAL_ 813 PwrDRBuzzerOut_DRV 0 "OFF" 1 "Open" 2 "Close" 3 "Warning" ;
VAL_ 813 Warn_HoodSwSta_SBCM 0 "Off" 1 "On" 2 "RESERVED" 3 "Error Indicator" ;
VAL_ 813 Hood_TypeOption 0 "Off (Mechanical hood latch is applied)" 1 "On (E-Hood latch is applied)" 2 "RESERVED" 3 "Error Indicator" ;
VAL_ 813 SBCM_FrunkSta 0 "Default" 1 "Valid" 2 "RESERVED" 3 "Error Indicator" ;
VAL_ 813 Warn_HoodSwFullSta_SBCM 0 "Off" 1 "On" 2 "RESERVED" 3 "Error Indicator" ;
VAL_ 813 FrunkWarning_SBCM 0 "Off" 1 "On" 2 "RESERVED" 3 "Error Indicator" ;
VAL_ 813 SBCM_Longkey_DRVDrAtClsSwSta 0 "Default" 1 "Off" 2 "On" 3 "Error Indicator" ;
VAL_ 813 FrunkReleaseSwSta_SBCM 0 "Off" 1 "HalfRelease" 2 "FullRelease" 3 "SwitchError" ;
VAL_ 813 PwrDRClosingDRVDrSta 0 "Default" 1 "Close" 2 "Open" 3 "Stop(during Close)" 4 "Stop(during Open)" 5 "RESERVED" 6 "RESERVED" 7 "Invalid" ;
VAL_ 813 Drv_DrLkRetryFail_SBCM 0 "Normal" 1 "Fail" 2 "RESERVED" 3 "RESERVED" ;
VAL_ 813 CDM_GbtImmeChgSw_SBCM 0 "Default" 1 "Off" 2 "On" 3 "RESERVED" ;
VAL_ 813 CDM_GbtOpnClsState_SBCM 0 "Default" 1 "Open" 2 "Close" 3 "RESERVED" ;
VAL_ 813 CDM_GbtWarnMsg_SBCM 0 "Default" 1 "Normal" 2 "ChargeDoorErrorState" 3 "RESERVED" ;
VAL_ 813 CDM_GbtOutsideOpnSwSta 0 "Default" 1 "Push" 2 "RESERVED" 3 "Invalid" ;
VAL_ 813 DoorLock_DrvLkOutSta_SBCM 0 "Off" 1 "On" 2 "Not Used" 3 "Error Indicator" ;
VAL_ 813 FrunkEmergencySwSta_SBCM 0 "Off" 1 "On" 2 "Not Used" 3 "Error Indicator" ;
VAL_ 813 DRV_DetectObj_warn_LH 0 "Detect Left Warning OFF" 1 "Detect Left Warning ON" 2 "RESERVED" 3 "RESERVED" ;
VAL_ 813 PwrDROpenClosingDdvSdDRSta 0 "Default" 1 "Close" 2 "Open" 3 "Stop(during Close)" 4 "Stop(during Open)" 5 "RESERVED" 6 "RESERVED" 7 "Invalid" ;
VAL_ 813 PwrDRBuzzerOut_DRV_New 0 "OFF" 1 "Open" 2 "Close" 3 "Warning1" 4 "Warning2" ;
VAL_ 813 Coach_TypeOption_DRV 0 "Off" 1 "On" 2 "Not Used" 3 "Error Indicator" ;
VAL_ 813 PwrDrSta_Drv 0 "Unavailable" 1 "Available" 2 "RESERVED" 3 "Error Indicator" ;
VAL_ 813 PwrDrSta_DrvSd 0 "Unavailable" 1 "Available" 2 "RESERVED" 3 "Error Indicator" ;
VAL_ 813 USM_PwrDrOpnTypSta 0 "Default" 1 "Pop-up" 2 "Full Open" 3 "RESERVED" ;
VAL_ 813 DischrgDr_OpnClsState_SBCM 0 "Default" 1 "Open" 2 "Close" 3 "Invalid" ;
VAL_ 813 SBCM_FL_DoorAngle 0 "0° - 90°" 1 "0° - 90°" 2 "0° - 90°" 3 "0° - 90°" 4 "0° - 90°" 5 "0° - 90°" 6 "0° - 90°" 7 "0° - 90°" 8 "0° - 90°" 9 "0° - 90°" 10 "0° - 90°" 11 "0° - 90°" 12 "0° - 90°" 13 "0° - 90°" 14 "0° - 90°" 15 "0° - 90°" 16 "0° - 90°" 17 "0° - 90°" 18 "0° - 90°" 19 "0° - 90°" 20 "0° - 90°" 21 "0° - 90°" 22 "0° - 90°" 23 "0° - 90°" 24 "0° - 90°" 25 "0° - 90°" 26 "0° - 90°" 27 "0° - 90°" 28 "0° - 90°" 29 "0° - 90°" 30 "0° - 90°" 31 "0° - 90°" 32 "0° - 90°" 33 "0° - 90°" 34 "0° - 90°" 35 "0° - 90°" 36 "0° - 90°" 37 "0° - 90°" 38 "0° - 90°" 39 "0° - 90°" 40 "0° - 90°" 41 "0° - 90°" 42 "0° - 90°" 43 "0° - 90°" 44 "0° - 90°" 45 "0° - 90°" 46 "0° - 90°" 47 "0° - 90°" 48 "0° - 90°" 49 "0° - 90°" 50 "0° - 90°" 51 "0° - 90°" 52 "0° - 90°" 53 "0° - 90°" 54 "0° - 90°" 55 "0° - 90°" 56 "0° - 90°" 57 "0° - 90°" 58 "0° - 90°" 59 "0° - 90°" 60 "0° - 90°" 61 "0° - 90°" 62 "0° - 90°" 63 "0° - 90°" 64 "0° - 90°" 65 "0° - 90°" 66 "0° - 90°" 67 "0° - 90°" 68 "0° - 90°" 69 "0° - 90°" 70 "0° - 90°" 71 "0° - 90°" 72 "0° - 90°" 73 "0° - 90°" 74 "0° - 90°" 75 "0° - 90°" 76 "0° - 90°" 77 "0° - 90°" 78 "0° - 90°" 79 "0° - 90°" 80 "0° - 90°" 81 "0° - 90°" 82 "0° - 90°" 83 "0° - 90°" 84 "0° - 90°" 85 "0° - 90°" 86 "0° - 90°" 87 "0° - 90°" 88 "0° - 90°" 89 "0° - 90°" 90 "0° - 90°" 91 "Invalid" 92 "Invalid" 93 "Invalid" 94 "Invalid" 95 "Invalid" 96 "Invalid" 97 "Invalid" 98 "Invalid" 99 "Invalid" 100 "Unknown" 101 "Invalid" 102 "Invalid" 103 "Invalid" 104 "Invalid" 105 "Invalid" 106 "Invalid" 107 "Invalid" 108 "Invalid" 109 "Invalid" 110 "Invalid" 111 "Invalid" 112 "Invalid" 113 "Invalid" 114 "Invalid" 115 "Invalid" 116 "Invalid" 117 "Invalid" 118 "Invalid" 119 "Invalid" 120 "Invalid" 121 "Invalid" 122 "Invalid" 123 "Invalid" 124 "Invalid" 125 "Invalid" 126 "Invalid" 127 "Invalid" ;
VAL_ 813 SBCM_DoorType_DRV 0 "Two Door" 1 "Four Door" 2 "Not Used" 3 "Error Indicator" ;
VAL_ 813 DRVDoorPushAlarm 0 "Off" 1 "On" 2 "RESERVED" 3 "Error Indicator" ;
VAL_ 813 DRV_CrashUnlockCmd 0 "Off" 1 "Unlock(Crash)" ;
VAL_ 813 C_ApprOpenStatus 0 "Approach Open Off" 1 "Approach Open On" ;
VAL_ 813 DoorLock_DrvKeyLkSwSta_SBCM 0 "Off" 1 "Lock" 2 "RESERVED" 3 "Error Indicator" ;
VAL_ 813 DoorLock_DrvKeyUnLkSwSta_SBCM 0 "Off" 1 "Unlock" 2 "RESERVED" 3 "Error Indicator" ;
VAL_ 813 Warn_DrvDrSwSta_SBCM 0 "Close" 1 "Open" 2 "RESERVED" 3 "Error Indicator" ;
VAL_ 813 DoorLock_DrvDrUnLkSta_SBCM 0 "Lock" 1 "Unlock" 2 "RESERVED" 3 "Error Indicator" ;
VAL_ 813 DRV_SEAWarn_LH 0 "SEA Left Warning OFF" 1 "SEA Left Warning ON" 2 "RESERVED" 3 "RESERVED" ;
VAL_ 813 DRV_SEAWarn_RH 0 "SEA Right Warning OFF" 1 "SEA Right  Warning ON" 2 "RESERVED" 3 "RESERVED" ;
VAL_ 813 DRV_SEWWarn_LH 0 "SEW Left Warning OFF" 1 "SEW Left Warning ON" 2 "RESERVED" 3 "RESERVED" ;
VAL_ 813 DRV_SEWWarn_RH 0 "SEW Right Warning OFF" 1 "SEW Right Warning ON" 2 "RESERVED" 3 "RESERVED" ;
VAL_ 813 DRV_MRActivationAlarm 0 "Off" 1 "On" 2 "RESERVED" 3 "Error Indicator" ;
VAL_ 813 DRV_ReleaseWarn 0 "Release Warning OFF" 1 "Release Warning ON" 2 "RESERVED" 3 "RESERVED" ;
VAL_ 992 PDC_FD_Crc1Val 0 "0x0x0~0xFFFF:CRCValue" 65535 "0x0x0~0xFFFF:CRCValue" ;
VAL_ 992 C_3rdRCSeatBeltSW 0 "Unbelted" 1 "Belted" ;
VAL_ 992 C_3rdRRSeatBeltSW 0 "Unbelted" 1 "Belted" ;
VAL_ 992 C_1stCTRSeatBeltSW 0 "Unbelted" 1 "Belted" ;
VAL_ 992 Warn_DrvStOccSta 0 "UnSeated" 1 "Seated" 2 "RESERVED" 3 "RESERVED" 4 "RESERVED" 5 "Fault 1 (Cable Cut-off)" 6 "Fault 2 (Cable Short)" 7 "Error Indicator" ;
VAL_ 992 DPDMat_HDPSpprtSWVer 0 "Requirement Spec Version" 1 "Requirement Spec Version" 2 "Requirement Spec Version" 3 "Requirement Spec Version" 4 "Requirement Spec Version" 5 "Requirement Spec Version" 6 "Requirement Spec Version" 7 "Requirement Spec Version" 8 "Requirement Spec Version" 9 "Requirement Spec Version" 10 "Requirement Spec Version" 11 "Requirement Spec Version" 12 "Requirement Spec Version" 13 "Requirement Spec Version" 14 "Requirement Spec Version" 15 "Requirement Spec Version" 16 "Requirement Spec Version" 17 "Requirement Spec Version" 18 "Requirement Spec Version" 19 "Requirement Spec Version" 20 "Requirement Spec Version" 21 "Requirement Spec Version" 22 "Requirement Spec Version" 23 "Requirement Spec Version" 24 "Requirement Spec Version" 25 "Requirement Spec Version" 26 "Requirement Spec Version" 27 "Requirement Spec Version" 28 "Requirement Spec Version" 29 "Requirement Spec Version" 30 "Requirement Spec Version" 31 "Requirement Spec Version" ;
VAL_ 992 Warn_PassStOccSta 0 "Off (UnSeated)" 1 "On (Seated)" 2 "Not Used" 3 "Error Indicator" ;
VAL_ 992 Warn_RrLftSBRMATSwSta 0 "Off (UnSeated)" 1 "On (Seated)" 2 "RESERVED" 3 "Error Indicator" ;
VAL_ 992 Warn_RrRhtSBRMATSwSta 0 "Off (UnSeated)" 1 "On (Seated)" 2 "RESERVED" 3 "Error Indicator" ;
VAL_ 992 C_3rdRLSBRMatSw 0 "Off (UnSeated)" 1 "On (Seated)" ;
VAL_ 992 C_3rdRRSBRMatSw 0 "Off (UnSeated)" 1 "On (Seated)" ;
VAL_ 992 C_1stCTRSBRMatSw 0 "Off (UnSeated)" 1 "On (Seated)" ;
VAL_ 992 StrWhlWrmrSwState 0 "Off" 1 "On" 2 "Not Used" 3 "Error Indicator" ;
VAL_ 992 StrWhlWrmrFlModDetail 0 "Off" 1 "OverVoltage" 2 "UnderVoltage" 3 "OverCurrent" 4 "CircuitOpen" 5 "OverLimitTemperature" 6 "LowLimitTemperature" 7 "Reserved" ;
VAL_ 992 FrHtdGlsSwState 0 "Off" 1 "On" 2 "Not Used" 3 "Error Indicator" ;
VAL_ 992 RrGlsHtSwState 0 "Off" 1 "On" 2 "Not Used" 3 "Error Indicator" ;
VAL_ 992 RLChldLkLatchSwState 0 "Unlock" 1 "Lock" 2 "Not Used" 3 "Error Indicator" ;
VAL_ 992 RRChldLkLatchSwState 0 "Unlock" 1 "Lock" 2 "Not Used" 3 "Error Indicator" ;
VAL_ 992 ChildLock_ActnFlSta 0 "OK" 1 "Failed" 2 "Not Used" 3 "Error Indicator" ;
VAL_ 992 DoorLock_LkOutSta 0 "Off" 1 "On" 2 "Not Used" 3 "Error Indicator" ;
VAL_ 992 VSAutoDrLkRetryFailSta 0 "Normal" 1 "Fail" 2 "RESERVED" 3 "RESERVED" ;
VAL_ 992 Trunk_TrnkTlgtOutReleaseSwSta 0 "Off" 1 "On" 2 "Stuck" 3 "Error Indicator" ;
VAL_ 992 Trunk_TrnkInReleaseSwSta 0 "Off" 1 "On" 2 "Stuck" 3 "Error Indicator" ;
VAL_ 992 Trunk_GlvBxTrnkLkSwSta 0 "Off" 1 "On" 2 "Not Used" 3 "Error Indicator" ;
VAL_ 992 Trunk_TrnkTlgtSwSta 0 "Close(Full Lock)" 1 "Open(Not Full Lock)" 2 "Not Used" 3 "Error Indicator" ;
VAL_ 992 Trunk_TlgtFullOpnSwSta 0 "Close(Not Full Open)" 1 "Open(Full Open)" 2 "Not Used" 3 "Error Indicator" ;
VAL_ 992 Trunk_TrnkTlgtReleaseRlySta 0 "OFF" 1 "ON" 2 "Not Used" 3 "Error Indicator" ;
VAL_ 992 FrtWiper_ParkingSwState 0 "Off" 1 "On" 2 "RESERVED" 3 "RESERVED" ;
VAL_ 992 PDC_TlgtUnLkSta 0 "Lock" 1 "Unlock" 2 "Not Used" 3 "Error Indicator" ;
VAL_ 992 PDC_PSDPwrModeOffSwSta 0 "Off" 1 "On" 2 "Not Used" 3 "Error Indicator" ;
VAL_ 992 PDC_FD_AlvCnt1Val 0 "0x0x0~0xFF:AlvCntValue" 255 "0x0x0~0xFF:AlvCntValue" ;
VAL_ 992 OBCWakeupDrLock 0 "Default" 1 "Off" 2 "On(DrLock)" 3 "Error Indicator" ;
VAL_ 992 OBCWakeupDrUnlock 0 "Default" 1 "Off" 2 "On(Unlock)" 3 "Error Indicator" ;
VAL_ 992 Trunk_BgtOpnHzrdReq 0 "Off" 1 "On" 2 "Not Used" 3 "Error Indicator" ;
VAL_ 992 Trunk_BgtOpnBzrReq 0 "Off" 1 "On" 2 "Not Used" 3 "Error Indicator" ;
VAL_ 992 IGN3State 0 "Off" 1 "On" 2 "RESERVED" 3 "RESERVED" ;
VAL_ 992 IGN3State_By_BMS 0 "Off" 1 "On" 2 "RESERVED" 3 "RESERVED" ;
VAL_ 992 IGN3State_By_VCMS_HMU 0 "Off" 1 "On" 2 "RESERVED" 3 "RESERVED" ;
VAL_ 992 IGN3State_By_AfterBlow 0 "Off" 1 "On" 2 "RESERVED" 3 "RESERVED" ;
VAL_ 992 IGN3State_By_Bat 0 "Off" 1 "On" 2 "RESERVED" 3 "RESERVED" ;
VAL_ 992 IGN3State_By_VCU_HCU_FCU 0 "Off" 1 "On" 2 "RESERVED" 3 "RESERVED" ;
VAL_ 992 IGN3State_By_HU 0 "Off" 1 "On" 2 "RESERVED" 3 "RESERVED" ;
VAL_ 992 SeatBeltSwSta_Drv 0 "Unbelted" 1 "Belted" 2 "Not Supported" 3 "Virgin Mode" ;
VAL_ 992 SeatBeltSwSta_1stCtr 0 "Unbelted" 1 "Belted" 2 "Not Supported" 3 "Virgin Mode" ;
VAL_ 992 SeatBeltSwSta_Asst 0 "Unbelted" 1 "Belted" 2 "Not Supported" 3 "Virgin Mode" ;
VAL_ 992 SeatBeltSwSta_2ndLft 0 "Unbelted" 1 "Belted" 2 "Not Supported" 3 "Virgin Mode" ;
VAL_ 992 SeatBeltSwSta_2ndCtr 0 "Unbelted" 1 "Belted" 2 "Not Supported" 3 "Virgin Mode" ;
VAL_ 992 SeatBeltSwSta_2ndRt 0 "Unbelted" 1 "Belted" 2 "Not Supported" 3 "Virgin Mode" ;
VAL_ 992 SeatBeltSwSta_3rdLft 0 "Unbelted" 1 "Belted" 2 "Not Supported" 3 "Virgin Mode" ;
VAL_ 992 SeatBeltSwSta_3rdCtr 0 "Unbelted" 1 "Belted" 2 "Not Supported" 3 "Virgin Mode" ;
VAL_ 992 SeatBeltSwSta_3rdRt 0 "Unbelted" 1 "Belted" 2 "Not Supported" 3 "Virgin Mode" ;
VAL_ 992 SeatBelt4th_InstallInfo 0 "Virgin Mode" 1 "No Seat" 2 "All Seat" 3 "Left and Right" 4 "RESERVED" 5 "RESERVED" 6 "RESERVED" 7 "RESERVED" ;
VAL_ 992 PDCex_CurtainOpt 0 "No Curtain" 1 "Rear Curtain" 2 "Quarter Glass Curtain" 3 "All Curtain" ;
VAL_ 992 DriveTypeOption 0 "Left Handle Drive Type" 1 "Right Handle Drive Type" 2 "RESERVED" 3 "Error Indicator" ;
VAL_ 992 AutoLtOpt 0 "Not Applied" 1 "Applied" 2 "Reserved" 3 "Reserved" ;
VAL_ 992 HLmpLoHiOptLtSrcTyp 0 "Not Applied" 1 "2 Light MFR Bulb" 2 "4 Light Bulb" 3 "4 Light Led Ldm" 4 "Bi-Function Bulb" 5 "Bi-Function Led Ldm" 6 "Reserved" 7 "Reserved" ;
VAL_ 992 C_StrgWhlHeatingOpt 0 "Not Applied" 1 "Applied(steering wheel applied)" 2 "RESERVED" 3 "Invalid" ;
VAL_ 992 C_StrgWhlHeatingSWInf 0 "Default" 1 "1step opt(On/Off)" 2 "2step opt(step1,step2,Off)" 3 "Invalid" ;
VAL_ 992 ICU_MtGearPosRSta 0 "Off" 1 "On" 2 "RESERVED" 3 "RESERVED" ;
VAL_ 992 C_AutoLeverManualSW 0 "Not Manual" 1 "Manual" 2 "Manual +" 3 "Manual -" ;
VAL_ 992 Warn_HoodSwMemorySta 0 "No event" 1 "hood_open_close" 2 "RESERVED" 3 "RESERVED" ;
VAL_ 992 Warn_PrkngBrkSwSta 0 "Off" 1 "On" 2 "Not Used" 3 "Error Indicator" ;
VAL_ 992 PrkngBrkNotchSwState 0 "Off" 1 "On" 2 "Reserved" 3 "InvalidState" ;
VAL_ 992 Warn_BrkFldSwSta 0 "Off" 1 "On" 2 "Not Used" 3 "Error Indicator" ;
VAL_ 992 Warn_WshrFldSwSta 0 "Off" 1 "On" 2 "RESERVED" 3 "RESERVED" ;
VAL_ 992 Warn_DrvStBltSwSta 0 "Unbelted" 1 "Belted" 2 "Not Used" 3 "Error Indicator" ;
VAL_ 992 Warn_AsstStBltSwSta 0 "Unbelted" 1 "Belted" 2 "Not Used" 3 "Error Indicator" ;
VAL_ 992 Warn_RrLftStBltSwSta 0 "Unbelted" 1 "Belted" 2 "Not Used" 3 "Error Indicator" ;
VAL_ 992 Warn_RrCtrStBltSwSta 0 "Unbelted" 1 "Belted" 2 "Not Used" 3 "Error Indicator" ;
VAL_ 992 Warn_RrRtStBltSwSta 0 "Unbelted" 1 "Belted" 2 "Not Used" 3 "Error Indicator" ;
VAL_ 992 C_3rdRLSeatBeltSW 0 "Unbelted" 1 "Belted" ;
VAL_ 995 PDC_FD_Crc4Val 0 "0x0x0~0xFFFF:CRCValue" 65535 "0x0x0~0xFFFF:CRCValue" ;
VAL_ 995 PDC_FD_AlvCnt4Val 0 "0x0x0~0xFF:AlvCntValue" 255 "0x0x0~0xFF:AlvCntValue" ;
VAL_ 995 ICU_Haptic_OPT 0 "Default" 1 "No option(None Haptic Option)" 2 "Option" 3 "Invalid" ;
VAL_ 995 HSWS_SysWrngSta_ICU 0 "Normal" 1 "System Fail" 2 "RESERVED" 3 "Invalid" ;
VAL_ 995 ICU_PwrWdwMvInhbtSta 0 "Off" 1 "Inhabit" ;
VAL_ 995 Warn_OSMirrFoldSwState 0 "OFF(Seasaw Type=Fold, Return Type=Off)" 1 "ON(Seasaw Type=Unfold or Auto, Return Type" 2 "Not Used" 3 "Error Indicator" ;
VAL_ 995 USM_OneTouchTrnSigFuncSta 0 "Default" 1 "One Touch Turn Off" 2 "3 Flashing" 3 "5 Flashing" 4 "7 Flashing" 5 "Invalid" 6 "RESERVED" 7 "RESERVED" ;
VAL_ 995 ExtLamp_TrnSigLmpLftSwSta 0 "Off" 1 "On" 2 "Not Used" 3 "Error Indicator" ;
VAL_ 995 ExtLamp_TrnSigLmpRtSwSta 0 "Off" 1 "On" 2 "Not Used" 3 "Error Indicator" ;
VAL_ 995 Lamp_LaneChgTrnSigLftSwSta_ICU 0 "Off" 1 "On" 2 "Not Used" 3 "Error Indicator" ;
VAL_ 995 Lamp_LaneChgTrnSigRtSwSta_ICU 0 "Off" 1 "On" 2 "Not Used" 3 "Error Indicator" ;
VAL_ 995 ICU_HDPSpprtRdy 0 "Normal" 1 "ADAS Message Not Recognized" 2 "RESERVED" 3 "RESERVED" ;
VAL_ 995 HzrdLmp_HDPSpprtSWVer 0 "Requirement Spec Version" 1 "Requirement Spec Version" 2 "Requirement Spec Version" 3 "Requirement Spec Version" 4 "Requirement Spec Version" 5 "Requirement Spec Version" 6 "Requirement Spec Version" 7 "Requirement Spec Version" 8 "Requirement Spec Version" 9 "Requirement Spec Version" 10 "Requirement Spec Version" 11 "Requirement Spec Version" 12 "Requirement Spec Version" 13 "Requirement Spec Version" 14 "Requirement Spec Version" 15 "Requirement Spec Version" 16 "Requirement Spec Version" 17 "Requirement Spec Version" 18 "Requirement Spec Version" 19 "Requirement Spec Version" 20 "Requirement Spec Version" 21 "Requirement Spec Version" 22 "Requirement Spec Version" 23 "Requirement Spec Version" 24 "Requirement Spec Version" 25 "Requirement Spec Version" 26 "Requirement Spec Version" 27 "Requirement Spec Version" 28 "Requirement Spec Version" 29 "Requirement Spec Version" 30 "Requirement Spec Version" 31 "Requirement Spec Version" ;
VAL_ 995 Lamp_TrnSigLmpLftOnReq 0 "Inactive" 1 "Active Off(Flasher Off)" 2 "Active On(Flasher On)" 3 "RESERVED" ;
VAL_ 995 Lamp_TrnSigLmpRtOnReq 0 "Inactive" 1 "Active Off(Flasher Off)" 2 "Active On(Flasher On)" 3 "RESERVED" ;
VAL_ 995 Lamp_TrnSigLmpLftActiveSt 0 "Off (Inactive)" 1 "On (Active)" 2 "RESERVED" 3 "Invalid" ;
VAL_ 995 Lamp_TrnSigLmpRtActiveSt 0 "Off (Inactive)" 1 "On (Active)" 2 "RESERVED" 3 "Invalid" ;
VAL_ 995 TrnLmpSeqEnblCmd 0 "Off" 1 "On" 2 "Reserved" 3 "Reserved" ;
VAL_ 994 PDC_FD_Crc3Val 0 "0x0x0~0xFFFF:CRCValue" 65535 "0x0x0~0xFFFF:CRCValue" ;
VAL_ 994 PDC_FD_AlvCnt3Val 0 "0x0x0~0xFF:AlvCntValue" 255 "0x0x0~0xFF:AlvCntValue" ;
VAL_ 994 Warn_DrvDrSwSta 0 "Close" 1 "Open" 2 "Not Used" 3 "Error Indicator" ;
VAL_ 994 Warn_AsstDrSwSta 0 "Close" 1 "Open" 2 "Not Used" 3 "Error Indicator" ;
VAL_ 994 Warn_RrLftDrSwSta 0 "Close" 1 "Open" 2 "Not Used" 3 "Error Indicator" ;
VAL_ 994 Warn_RrRtDrSwSta 0 "Close" 1 "Open" 2 "Not Used" 3 "Error Indicator" ;
VAL_ 994 Warn_HoodSwSta 0 "Off" 1 "On" 2 "Not Used" 3 "Error Indicator" ;
VAL_ 994 DoorLock_DrvDrUnLkSta 0 "Lock" 1 "Unlock" 2 "Not Used" 3 "Error Indicator" ;
VAL_ 994 DoorLock_AsstDrUnLkSta 0 "Lock" 1 "Unlock" 2 "Not Used" 3 "Error Indicator" ;
VAL_ 994 DoorLock_RrLftDrUnLkSta 0 "Lock" 1 "Unlock" 2 "Not Used" 3 "Error Indicator" ;
VAL_ 994 DoorLock_RrRtDrUnLkSta 0 "Lock" 1 "Unlock" 2 "Not Used" 3 "Error Indicator" ;
VAL_ 994 DoorLock_DrvKeyLkSwSta 0 "Off" 1 "Lock" 2 "Not Used" 3 "Error Indicator" ;
VAL_ 994 DoorLock_DrvKeyUnLkSwSta 0 "Off" 1 "Unlock" 2 "Not Used" 3 "Error Indicator" ;
VAL_ 994 DoorLock_CtrlDrLkSwSta_ICU 0 "Off" 1 "On(Lock On)" 2 "Not Used" 3 "Error Indicator" ;
VAL_ 994 DoorLock_CtrlDrUnLkSwSta_ICU 0 "Off" 1 "On(Unlock On)" 2 "Not Used" 3 "Error Indicator" ;
VAL_ 994 DoorLock_CtrlDrLkUnLkSwSta_ICU 0 "Off" 1 "On" 2 "Not Used" 3 "Error Indicator" ;
VAL_ 994 C_CrashUnlockState 0 "Off" 1 "Unlock(Crash)" 2 "RESERVED" 3 "RESERVED" ;
VAL_ 994 Lamp_LedHdLmpSta 0 "LED Headlamp is in nornal condition" 1 "RESERVED" 2 "LED Fail" 3 "RESERVED" ;
VAL_ 994 Warn_ChaDrSwFrtSta 0 "Default" 1 "Close" 2 "Open" 3 "Error Indicator" ;
VAL_ 994 Warn_ChaDrSwRrSta 0 "Default" 1 "Close" 2 "Open" 3 "Error Indicator" ;
VAL_ 997 PDC_FD_Crc11Val 0 "0x0x0~0xFFFF:CRCValue" 65535 "0x0x0~0xFFFF:CRCValue" ;
VAL_ 997 ICU_BS1ValFlagSta 0 "Valid condition" 1 "Invalid condition" 2 "RESERVED" 3 "RESERVED" ;
VAL_ 997 ICU_BS1ErrRes 0 "opeartion correctly" 1 "response error" 2 "RESERVED" 3 "Error Indicator" ;
VAL_ 997 ICU_BS2SoC 0 "0x0x00~0x64:0% ~ 100 %" 100 "0x0x00~0x64:0% ~ 100 %" 101 "0x65~0xFE:Invalid" 254 "0x65~0xFE:Invalid" 255 "Error" ;
VAL_ 997 ICU_BS2NCap 0 "0x0x00~0xFA:0Ah ~ 250Ah" 250 "0x0x00~0xFA:0Ah ~ 250Ah" 251 "Invalid" 252 "Invalid" 253 "Invalid" 254 "Invalid" 255 "Error" ;
VAL_ 997 ICU_BS2OpnCirVol 0 "0x0x000~0xFA0:10.000V ~ 14.000V" 4000 "0x0x000~0xFA0:10.000V ~ 14.000V" 4001 "Invailid" 4002 "Invailid" 4003 "Invailid" 4004 "Invailid" 4005 "Invailid" 4006 "Invailid" 4007 "Invailid" 4008 "Invailid" 4009 "Invailid" 4010 "Invailid" 4011 "Invailid" 4012 "Invailid" 4013 "Invailid" 4014 "Invailid" 4015 "Invailid" 4016 "Invailid" 4017 "Invailid" 4018 "Invailid" 4019 "Invailid" 4020 "Invailid" 4021 "Invailid" 4022 "Invailid" 4023 "Invailid" 4024 "Invailid" 4025 "Invailid" 4026 "Invailid" 4027 "Invailid" 4028 "Invailid" 4029 "Invailid" 4030 "Invailid" 4031 "Invailid" 4032 "Invailid" 4033 "Invailid" 4034 "Invailid" 4035 "Invailid" 4036 "Invailid" 4037 "Invailid" 4038 "Invailid" 4039 "Invailid" 4040 "Invailid" 4041 "Invailid" 4042 "Invailid" 4043 "Invailid" 4044 "Invailid" 4045 "Invailid" 4046 "Invailid" 4047 "Invailid" 4048 "Invailid" 4049 "Invailid" 4050 "Invailid" 4051 "Invailid" 4052 "Invailid" 4053 "Invailid" 4054 "Invailid" 4055 "Invailid" 4056 "Invailid" 4057 "Invailid" 4058 "Invailid" 4059 "Invailid" 4060 "Invailid" 4061 "Invailid" 4062 "Invailid" 4063 "Invailid" 4064 "Invailid" 4065 "Invailid" 4066 "Invailid" 4067 "Invailid" 4068 "Invailid" 4069 "Invailid" 4070 "Invailid" 4071 "Invailid" 4072 "Invailid" 4073 "Invailid" 4074 "Invailid" 4075 "Invailid" 4076 "Invailid" 4077 "Invailid" 4078 "Invailid" 4079 "Invailid" 4080 "Invailid" 4081 "Invailid" 4082 "Invailid" 4083 "Invailid" 4084 "Invailid" 4085 "Invailid" 4086 "Invailid" 4087 "Invailid" 4088 "Invailid" 4089 "Invailid" 4090 "Invailid" 4091 "Invailid" 4092 "Invailid" 4093 "Invailid" 4094 "Invailid" 4095 "Error" ;
VAL_ 997 ICU_BS2_FSOC 0 "valid" 1 "invalid" ;
VAL_ 997 ICU_BS2_FSOH 0 "valid" 1 "invalid" ;
VAL_ 997 ICU_BS2_FSOF 0 "valid" 1 "invalid" ;
VAL_ 997 ICU_BS2_FQSTAT 0 "valid" 1 "invalid" ;
VAL_ 997 ICU_BS2SoH 0 "0x0x00~0x64:0% ~ 100 %" 100 "0x0x00~0x64:0% ~ 100 %" 101 "0x65~0xFE:Invalid" 254 "0x65~0xFE:Invalid" 255 "Error" ;
VAL_ 997 ICU_BS2SoF 0 "0x0x00~0xF0:0.00V ~ 12.00V" 240 "0x0x00~0xF0:0.00V ~ 12.00V" 241 "Invalid" 242 "Invalid" 243 "Invalid" 244 "Invalid" 245 "Invalid" 246 "Invalid" 247 "Invalid" 248 "Invalid" 249 "Invalid" 250 "Invalid" 251 "Invalid" 252 "Invalid" 253 "Invalid" 254 "Invalid" 255 "Error" ;
VAL_ 997 PDC_FD_AlvCnt11Val 0 "0x0x0~0xFF:AlvCntValue" 255 "0x0x0~0xFF:AlvCntValue" ;
VAL_ 997 ICU_BS1IBAT_Conversion 0 "0x0x00000~0x3A980:-1,200,000mA ~ 1,200,000mA" 240000 "0x0x00000~0x3A980:-1,200,000mA ~ 1,200,000mA" 240001 "0x3A981~0x3FFFE:Invalid" 262142 "0x3A981~0x3FFFE:Invalid" 262143 "Error" ;
VAL_ 997 ICU_BS1BatVol 0 "0x0x0000~0x2EE0:6.000V ~ 18.000V" 12000 "0x0x0000~0x2EE0:6.000V ~ 18.000V" 12001 "0x2EE1~0x3FFE:Invalid" 16382 "0x2EE1~0x3FFE:Invalid" 16383 "Error" ;
VAL_ 997 ICU_BS1BatTemp 0 "0x0x000~0x14A:-40℃ ~ 125℃" 330 "0x0x000~0x14A:-40℃ ~ 125℃" 331 "0x14B~0x1FE:Invalid" 510 "0x14B~0x1FE:Invalid" 511 "Error" ;
