VERSION ""

NS_ :

BS_:

BU_: SHVU_CCS_FD ARS_FD WPC_FD WPC2_FD SCM_FD SHVU_FRNT_FD GW_SAU_DRV_FD ATS_FD PSB_FD GW_PSU_RR_FD SHVU_RL_FD RWPC_FD CGW_CCU SHVU_REAR_FD OHCL_FD BLTN_CAM_FD GW_PSU_DRV_FD FCS_FD GW_PSU_AST_FD GW_PSU_3RD_FD RCS_FD SHVU_3RD_FD GW_PSU_RL_FD SHVU_RR_FD RCM_FD SGU_FD DCM_FD

BO_ 74 IMU_01_10ms: 32 CGW_CCU
 SG_ IMU_Crc1Val : 0|16@1+ (1,0) [0|0] "" Vector__XXX
 SG_ IMU_SnsrTempVal : 112|8@1+ (1,-68) [0|0] "℃" Vector__XXX
 SG_ IMU_SeralNumVal : 128|48@1+ (1,0) [0|0] "" Vector__XXX
 SG_ IMU_AlvCnt1Val : 16|8@1+ (1,0) [0|0] "" Vector__XXX
 SG_ IMU_RollRtVal : 192|16@1+ (0.005,-163.84) [0|0] "˚/s" Vector__XXX
 SG_ IMU_VerAccelVal : 208|16@1+ (0.000127465,-4.17677312) [0|0] "g" Vector__XXX
 SG_ IMU_YawSigSta : 24|4@1+ (1,0) [0|0] ""  PSB_FD
 SG_ IMU_LatAccelSigSta : 28|4@1+ (1,0) [0|0] ""  BLTN_CAM_FD,PSB_FD
 SG_ IMU_LongAccelSigSta : 32|4@1+ (1,0) [0|0] ""  BLTN_CAM_FD,PSB_FD
 SG_ IMU_VerAccelSigSta : 36|4@1+ (1,0) [0|0] "" Vector__XXX
 SG_ IMU_McuVoltSta : 40|4@1+ (1,0) [0|0] "" Vector__XXX
 SG_ IMU_AcuRstSta : 44|4@1+ (1,0) [0|0] "" Vector__XXX
 SG_ IMU_SnsrTyp : 48|4@1+ (1,0) [0|0] "" Vector__XXX
 SG_ IMU_RollSigSta : 56|4@1+ (1,0) [0|0] "" Vector__XXX
 SG_ IMU_YawRtVal : 64|16@1+ (0.005,-163.84) [0|0] "˚/s"  PSB_FD
 SG_ IMU_LatAccelVal : 80|16@1+ (0.000127465,-4.17677312) [0|0] "g"  BLTN_CAM_FD,PSB_FD
 SG_ IMU_LongAccelVal : 96|16@1+ (0.000127465,-4.17677312) [0|0] "g"  BLTN_CAM_FD,PSB_FD

BO_ 345 LBM_FD_02_100ms: 32 CGW_CCU
 SG_ LBM_FD_Crc2Val : 0|16@1+ (1,0) [0|0] "" Vector__XXX
 SG_ LBM_FD_AlvCnt2Val : 16|8@1+ (1,0) [0|0] "" Vector__XXX
 SG_ MainLBM_CurrVal : 24|16@1+ (0.01,-327) [0|0] "A"  BLTN_CAM_FD
 SG_ MainLBM_SocVal : 40|8@1+ (1,0) [0|0] ""  BLTN_CAM_FD
 SG_ MainLBM_VtgVal : 48|14@1+ (0.001,6) [0|0] "V"  BLTN_CAM_FD
 SG_ MainLBM_TempVal : 62|9@1+ (0.5,-40) [0|0] "℃"  BLTN_CAM_FD
 SG_ MainLBM_SocErrSta : 71|2@1+ (1,0) [0|0] ""  BLTN_CAM_FD
 SG_ MainLBM_SohVal : 73|8@1+ (1,0) [0|0] "%"  BLTN_CAM_FD
 SG_ MainLBM_SnsrInvldSta : 81|2@1+ (1,0) [0|0] ""  BLTN_CAM_FD
 SG_ MainLBM_RspErrSta : 83|2@1+ (1,0) [0|0] ""  BLTN_CAM_FD
 SG_ MainLBM_CapacityVal : 85|8@1+ (1,0) [0|0] ""  BLTN_CAM_FD
 SG_ MainLBM_SohErrSta : 93|2@1+ (1,0) [0|0] ""  BLTN_CAM_FD

BO_ 194 BMS_FD_01_00ms: 16 CGW_CCU
 SG_ BMS_FD_Crc1Val : 0|16@1+ (1,0) [0|0] "" Vector__XXX
 SG_ BMS_FD_AlvCnt1Val : 16|8@1+ (1,0) [0|0] "" Vector__XXX
 SG_ xEV_BatEvtAlarm_HS : 64|3@1+ (1,0) [0|0] "" Vector__XXX
 SG_ xEV_BMS_WakeUpReqfor12V : 67|2@1+ (1,0) [0|0] "" Vector__XXX
 SG_ xEV_AuxBattChrgReq_HS : 69|2@1+ (1,0) [0|0] ""  BLTN_CAM_FD
 SG_ xEV_12VBatAlarmReq_HS : 72|2@1+ (1,0) [0|0] ""  BLTN_CAM_FD
 SG_ BMS_ResetWakeup : 74|2@1+ (1,0) [0|0] "" Vector__XXX

BO_ 1048 GNSS_06_1000ms: 32 CGW_CCU
 SG_ GNSS_Crc6Val : 0|16@1+ (1,0) [0|0] "" Vector__XXX
 SG_ HU_MM_Altitude : 128|32@1- (0.01,0) [0|0] "m"  BLTN_CAM_FD
 SG_ GNSS_AlvCnt6Val : 16|8@1+ (1,0) [0|0] "" Vector__XXX
 SG_ HU_MM_Heading : 160|32@1+ (1,0) [0|0] "˚"  BLTN_CAM_FD
 SG_ GNSS_MM_type : 192|4@1+ (1,0) [0|0] ""  BLTN_CAM_FD
 SG_ HU_MM_Latitude : 64|32@1- (1E-006,0) [0|0] "˚"  BLTN_CAM_FD
 SG_ HU_MM_Longitude : 96|32@1- (1E-006,0) [0|0] "˚"  BLTN_CAM_FD

BO_ 1051 HU_CLOCK_01_1000ms: 16 CGW_CCU
 SG_ HU_CLOCK_Crc1Val : 0|16@1+ (1,0) [0|0] "" Vector__XXX
 SG_ HU_DisplayYear1 : 102|2@1+ (1,0) [0|0] ""  ATS_FD,BLTN_CAM_FD
 SG_ HU_DisplayYear2 : 104|8@1+ (1,0) [0|0] ""  ATS_FD,BLTN_CAM_FD
 SG_ HU_DisplayDay : 112|8@1+ (1,0) [0|0] ""  ATS_FD,BLTN_CAM_FD
 SG_ HU_AM_PM_INFO : 120|2@1+ (1,0) [0|0] ""  ATS_FD,BLTN_CAM_FD
 SG_ HU_ComRefresh : 124|2@1+ (1,0) [0|0] ""  ATS_FD,BLTN_CAM_FD
 SG_ HU_ClockInfo : 126|2@1+ (1,0) [0|0] ""  ATS_FD,BLTN_CAM_FD
 SG_ HU_CLOCK_AlvCnt1Val : 16|8@1+ (1,0) [0|0] "" Vector__XXX
 SG_ HU_TimeSetting : 64|2@1+ (1,0) [0|0] ""  ATS_FD,BLTN_CAM_FD
 SG_ HU_Status : 66|4@1+ (1,0) [0|0] ""  ATS_FD,BLTN_CAM_FD
 SG_ HU_TimeFormat : 70|2@1+ (1,0) [0|0] ""  ATS_FD,BLTN_CAM_FD
 SG_ HU_DisplayHour : 72|8@1+ (1,0) [0|0] ""  ATS_FD,BLTN_CAM_FD
 SG_ HU_DisplayMinute : 80|8@1+ (1,0) [0|0] ""  ATS_FD,BLTN_CAM_FD
 SG_ HU_DisplaySecond : 88|8@1+ (1,0) [0|0] ""  ATS_FD,BLTN_CAM_FD
 SG_ HU_DisplayMonth : 98|4@1+ (1,0) [0|0] ""  ATS_FD,BLTN_CAM_FD

BO_ 1052 HU_CLU_02_1000ms: 16 CGW_CCU
 SG_ HU_CLU_Crc2Val : 0|16@1+ (1,0) [0|0] "" Vector__XXX
 SG_ HU_EVSupport : 104|2@1+ (1,0) [0|0] "" Vector__XXX
 SG_ HU_DayNightState : 108|2@1+ (1,0) [0|0] "" Vector__XXX
 SG_ HU_AutoBrightState_New : 118|10@1+ (1,0) [0|0] "" Vector__XXX
 SG_ HU_CLU_AlvCnt2Val : 16|8@1+ (1,0) [0|0] "" Vector__XXX
 SG_ HU_OffloadBtnReq : 24|2@1+ (1,0) [0|0] "" Vector__XXX
 SG_ HU_LanguageInfo : 64|8@1+ (1,0) [0|0] ""  ATS_FD,BLTN_CAM_FD,DCM_FD
 SG_ HU_VolumeStatus : 72|6@1+ (1,0) [0|0] "" Vector__XXX
 SG_ HU_MuteStatus : 78|2@1+ (1,0) [0|0] "" Vector__XXX
 SG_ HU_WelcomeReady : 80|2@1+ (1,0) [0|0] "" Vector__XXX
 SG_ HU_UsmSupport : 82|2@1+ (1,0) [0|0] "" Vector__XXX
 SG_ HU_NaviStatus : 84|2@1+ (1,0) [0|0] "" Vector__XXX
 SG_ HU_NaviDisp : 86|2@1+ (1,0) [0|0] "" Vector__XXX
 SG_ HU_BVM_Display_Message : 88|3@1+ (1,0) [0|0] "" Vector__XXX
 SG_ HU_NaviCamSettingStatus : 96|8@1+ (1,0) [0|0] "" Vector__XXX

BO_ 870 HU_GW_03_200ms: 24 CGW_CCU
 SG_ HU_GW_Crc3Val : 0|16@1+ (1,0) [0|0] ""  GW_PSU_DRV_FD
 SG_ AVN_RSPA_Disp_Rdy : 102|2@1+ (1,0) [0|0] "" Vector__XXX
 SG_ CF_AVN_ProfileIDRValue : 104|4@1+ (1,0) [0|0] ""  BLTN_CAM_FD,GW_PSU_DRV_FD,GW_SAU_DRV_FD,RCM_FD,RWPC_FD,SGU_FD,WPC2_FD,WPC_FD
 SG_ HazardFromHUSVM : 108|2@1+ (1,0) [0|0] "" Vector__XXX
 SG_ OMUOSMirCtrl : 110|2@1+ (1,0) [0|0] "" Vector__XXX
 SG_ OTAUIStatus : 120|2@1+ (1,0) [0|0] "" Vector__XXX
 SG_ C_TeleActiveStatus : 122|2@1+ (1,0) [0|0] "" Vector__XXX
 SG_ HU_RTCCheck : 126|2@1+ (1,0) [0|0] ""  GW_PSU_AST_FD
 SG_ HU_GW_AlvCnt3Val : 16|8@1+ (1,0) [0|0] ""  GW_PSU_DRV_FD
 SG_ HU_SWRCWarmerSet : 182|2@1+ (1,0) [0|0] "" Vector__XXX
 SG_ HU_TrModeReq_PE : 24|3@1+ (1,0) [0|0] "" Vector__XXX
 SG_ HU_TrBrakeTypeReq_PE : 27|3@1+ (1,0) [0|0] "" Vector__XXX
 SG_ AVN_MPA_SelBtnSta : 48|6@1+ (1,0) [0|0] "" Vector__XXX
 SG_ AVN_PRK_Cam_Status : 54|2@1+ (1,0) [0|0] "" Vector__XXX
 SG_ AVN_MRA_Disp_Rdy : 56|2@1+ (1,0) [0|0] "" Vector__XXX
 SG_ AVN_PRK_Func_Selected : 58|4@1+ (1,0) [0|0] "" Vector__XXX
 SG_ AVN_MRA_CancelInput : 62|2@1+ (1,0) [0|0] "" Vector__XXX
 SG_ HU_DistanceUnit : 64|2@1+ (1,0) [0|0] "" Vector__XXX
 SG_ HU_Scheduled_Setting : 66|4@1+ (1,0) [0|0] "" Vector__XXX
 SG_ HU_AliveStatus : 70|2@1+ (1,0) [0|0] "" Vector__XXX
 SG_ HU_ThemeType : 74|6@1+ (1,0) [0|0] ""  ATS_FD,BLTN_CAM_FD
 SG_ HU_MicActivity : 81|2@1+ (1,0) [0|0] "" Vector__XXX
 SG_ AVN_RSPA_ModeSelect : 84|4@1+ (1,0) [0|0] "" Vector__XXX
 SG_ CF_HU_GPSFlt : 88|2@1+ (1,0) [0|0] "" Vector__XXX
 SG_ AVN_RSPA_CancelInput : 90|2@1+ (1,0) [0|3] "" Vector__XXX

BO_ 993 PDC_FD_02_200ms: 24 CGW_CCU
 SG_ PDC_FD_Crc2Val : 0|16@1+ (1,0) [0|0] ""  GW_PSU_DRV_FD
 SG_ Lamp_StpLmpLftOpnSta : 100|2@1+ (1,0) [0|0] "" Vector__XXX
 SG_ Lamp_StpLmpRtOpnSta : 102|2@1+ (1,0) [0|0] "" Vector__XXX
 SG_ Lamp_HmslLmpOpnSta : 104|2@1+ (1,0) [0|0] "" Vector__XXX
 SG_ Lamp_DrlLmpLftOpnSta : 106|2@1+ (1,0) [0|0] "" Vector__XXX
 SG_ Lamp_DrlLmpRtOpnSta : 108|2@1+ (1,0) [0|0] "" Vector__XXX
 SG_ Lamp_FrFgLmpLftOpnSta : 110|2@1+ (1,0) [0|0] "" Vector__XXX
 SG_ Lamp_FrFgLmpRtOpnSta : 112|2@1+ (1,0) [0|0] "" Vector__XXX
 SG_ Lamp_CorneringLmpLftOpnSta : 114|2@1+ (1,0) [0|0] "" Vector__XXX
 SG_ Lamp_CorneringLmpRtOpnSta : 116|2@1+ (1,0) [0|0] "" Vector__XXX
 SG_ Lamp_StcBendingLmpLftOpnSta : 118|2@1+ (1,0) [0|0] "" Vector__XXX
 SG_ Lamp_StcBendingLmpRtOpnSta : 120|2@1+ (1,0) [0|0] "" Vector__XXX
 SG_ Lamp_FrTurnSigLmpLftPCLSta : 122|2@1+ (1,0) [0|0] "" Vector__XXX
 SG_ Lamp_FrTurnSigLmpRtPCLSta : 124|2@1+ (1,0) [0|0] "" Vector__XXX
 SG_ Lamp_RrTurnSigLmpLftPCLSta : 126|2@1+ (1,0) [0|0] "" Vector__XXX
 SG_ Lamp_RrTurnSigLmpRtPCLSta : 128|2@1+ (1,0) [0|0] "" Vector__XXX
 SG_ HzrdSwPushSta : 130|2@1+ (1,0) [0|0] "" Vector__XXX
 SG_ Lamp_LftTrnFaultSta : 132|2@1+ (1,0) [0|0] "" Vector__XXX
 SG_ Lamp_RtTrnFaultSta : 134|2@1+ (1,0) [0|0] "" Vector__XXX
 SG_ FrtTurnLampOptSta : 136|2@1+ (1,0) [0|0] "" Vector__XXX
 SG_ RrTurnLampOptSta : 138|2@1+ (1,0) [0|0] "" Vector__XXX
 SG_ PDC_FD_AlvCnt2Val : 16|8@1+ (1,0) [0|0] ""  GW_PSU_DRV_FD
 SG_ IntLamp_InlTailLmpSta : 64|2@1+ (1,0) [0|0] ""  BLTN_CAM_FD,FCS_FD,GW_PSU_3RD_FD,GW_PSU_AST_FD,GW_PSU_DRV_FD,GW_PSU_RL_FD,GW_PSU_RR_FD,WPC2_FD
 SG_ Lamp_FootLampOnReq : 66|2@1+ (1,0) [0|0] "" Vector__XXX
 SG_ Lamp_MoodLampOnReq : 68|3@1+ (1,0) [0|0] "" Vector__XXX
 SG_ USM_FuncForMdLmpBrgtSta : 71|3@1+ (1,0) [0|0] "" Vector__XXX
 SG_ Lamp_HdLmpLoLftOpnSta : 74|2@1+ (1,0) [0|0] "" Vector__XXX
 SG_ Lamp_HdLmpLoRtOpnSta : 76|2@1+ (1,0) [0|0] "" Vector__XXX
 SG_ Lamp_HdLmpBiFuncLftOpnSta : 78|2@1+ (1,0) [0|0] "" Vector__XXX
 SG_ Lamp_HdLmpBiFuncRtOpnSta : 80|2@1+ (1,0) [0|0] "" Vector__XXX
 SG_ Lamp_HdLmpHiLftOpnSta : 82|2@1+ (1,0) [0|0] "" Vector__XXX
 SG_ Lamp_HdLmpHiRtOpnSta : 84|2@1+ (1,0) [0|0] "" Vector__XXX
 SG_ ExtLamp_HzrdSwSta : 86|2@1+ (1,0) [0|0] "" Vector__XXX
 SG_ Lamp_FrTrnSigLmpLftOpnSta : 88|2@1+ (1,0) [0|0] "" Vector__XXX
 SG_ Lamp_FrTrnSigLmpRtOpnSta : 90|2@1+ (1,0) [0|0] "" Vector__XXX
 SG_ Lamp_RrTrnSigLmpLftOpnSta : 92|2@1+ (1,0) [0|0] "" Vector__XXX
 SG_ Lamp_RrTrnSigLmpRtOpnSta : 94|2@1+ (1,0) [0|0] "" Vector__XXX
 SG_ Brake_SwSta_ICU : 96|2@1+ (1,0) [0|0] "" Vector__XXX
 SG_ BrkLmpCmd : 98|2@1+ (1,0) [0|0] "" Vector__XXX

BO_ 992 PDC_FD_01_200ms: 24 CGW_CCU
 SG_ PDC_FD_Crc1Val : 0|16@1+ (1,0) [0|0] ""  GW_PSU_DRV_FD
 SG_ C_3rdRCSeatBeltSW : 100|1@1+ (1,0) [0|0] ""  ARS_FD,GW_PSU_RL_FD,GW_PSU_RR_FD,PSB_FD,WPC2_FD
 SG_ C_3rdRRSeatBeltSW : 101|1@1+ (1,0) [0|0] ""  ARS_FD,GW_PSU_RR_FD,PSB_FD,WPC2_FD
 SG_ C_1stCTRSeatBeltSW : 102|1@1+ (1,0) [0|0] "" Vector__XXX
 SG_ Warn_DrvStOccSta : 103|3@1+ (1,0) [0|0] "" Vector__XXX
 SG_ DPDMat_HDPSpprtSWVer : 106|5@1+ (1,0) [0|0] "" Vector__XXX
 SG_ Warn_PassStOccSta : 111|2@1+ (1,0) [0|0] ""  GW_PSU_AST_FD,PSB_FD
 SG_ Warn_RrLftSBRMATSwSta : 113|2@1+ (1,0) [0|0] ""  GW_PSU_DRV_FD
 SG_ Warn_RrRhtSBRMATSwSta : 115|2@1+ (1,0) [0|0] ""  GW_PSU_DRV_FD
 SG_ C_3rdRLSBRMatSw : 117|1@1+ (1,0) [0|0] ""  ARS_FD,GW_PSU_RL_FD,WPC2_FD
 SG_ C_3rdRRSBRMatSw : 118|1@1+ (1,0) [0|0] ""  ARS_FD,GW_PSU_RR_FD,WPC2_FD
 SG_ C_1stCTRSBRMatSw : 119|1@1+ (1,0) [0|0] "" Vector__XXX
 SG_ StrWhlWrmrSwState : 120|2@1+ (1,0) [0|0] "" Vector__XXX
 SG_ StrWhlWrmrFlModDetail : 122|3@1+ (1,0) [0|0] "" Vector__XXX
 SG_ FrHtdGlsSwState : 125|2@1+ (1,0) [0|0] "" Vector__XXX
 SG_ RrGlsHtSwState : 127|2@1+ (1,0) [0|0] "" Vector__XXX
 SG_ RLChldLkLatchSwState : 129|2@1+ (1,0) [0|0] "" Vector__XXX
 SG_ RRChldLkLatchSwState : 131|2@1+ (1,0) [0|0] "" Vector__XXX
 SG_ ChildLock_ActnFlSta : 133|2@1+ (1,0) [0|0] "" Vector__XXX
 SG_ DoorLock_LkOutSta : 135|2@1+ (1,0) [0|0] "" Vector__XXX
 SG_ VSAutoDrLkRetryFailSta : 137|2@1+ (1,0) [0|0] "" Vector__XXX
 SG_ Trunk_TrnkTlgtOutReleaseSwSta : 139|2@1+ (1,0) [0|0] "" Vector__XXX
 SG_ Trunk_TrnkInReleaseSwSta : 141|2@1+ (1,0) [0|0] "" Vector__XXX
 SG_ Trunk_GlvBxTrnkLkSwSta : 143|2@1+ (1,0) [0|0] "" Vector__XXX
 SG_ Trunk_TrnkTlgtSwSta : 145|2@1+ (1,0) [0|0] ""  BLTN_CAM_FD,GW_PSU_3RD_FD,GW_PSU_AST_FD,GW_PSU_RL_FD,GW_PSU_RR_FD,SHVU_RL_FD,SHVU_RR_FD
 SG_ Trunk_TlgtFullOpnSwSta : 147|2@1+ (1,0) [0|0] "" Vector__XXX
 SG_ Trunk_TrnkTlgtReleaseRlySta : 149|2@1+ (1,0) [0|0] "" Vector__XXX
 SG_ FrtWiper_ParkingSwState : 151|2@1+ (1,0) [0|0] "" Vector__XXX
 SG_ PDC_TlgtUnLkSta : 153|2@1+ (1,0) [0|0] "" Vector__XXX
 SG_ PDC_PSDPwrModeOffSwSta : 155|2@1+ (1,0) [0|0] "" Vector__XXX
 SG_ PDC_FuelDrOpenSta : 157|2@1+ (1,0) [0|0] "" Vector__XXX
 SG_ PDC_FD_AlvCnt1Val : 16|8@1+ (1,0) [0|0] ""  GW_PSU_DRV_FD
 SG_ OBCWakeupDrLock : 161|2@1+ (1,0) [0|0] "" Vector__XXX
 SG_ OBCWakeupDrUnlock : 163|2@1+ (1,0) [0|0] "%" Vector__XXX
 SG_ Trunk_BgtOpnHzrdReq : 165|2@1+ (1,0) [0|0] "" Vector__XXX
 SG_ Trunk_BgtOpnBzrReq : 167|2@1+ (1,0) [0|0] "" Vector__XXX
 SG_ IGN3State : 169|2@1+ (1,0) [0|0] ""  GW_PSU_3RD_FD,GW_PSU_AST_FD,GW_PSU_DRV_FD,GW_PSU_RL_FD,GW_PSU_RR_FD,GW_SAU_DRV_FD,SHVU_3RD_FD,SHVU_CCS_FD,SHVU_FRNT_FD,SHVU_REAR_FD,SHVU_RL_FD,SHVU_RR_FD
 SG_ IGN3State_By_BMS : 171|2@1+ (1,0) [0|0] "" Vector__XXX
 SG_ IGN3State_By_VCMS_HMU : 173|2@1+ (1,0) [0|0] "" Vector__XXX
 SG_ IGN3State_By_AfterBlow : 175|2@1+ (1,0) [0|0] "" Vector__XXX
 SG_ IGN3State_By_Bat : 177|2@1+ (1,0) [0|0] "" Vector__XXX
 SG_ IGN3State_By_VCU_HCU_FCU : 179|2@1+ (1,0) [0|0] "" Vector__XXX
 SG_ IGN3State_By_HU : 181|2@1+ (1,0) [0|0] "" Vector__XXX
 SG_ IGN3CutOffState : 183|3@1+ (1,0) [0|0] ""  GW_PSU_3RD_FD,GW_PSU_AST_FD,GW_PSU_DRV_FD,GW_PSU_RL_FD,GW_PSU_RR_FD,SHVU_3RD_FD,SHVU_CCS_FD,SHVU_FRNT_FD,SHVU_REAR_FD,SHVU_RL_FD,SHVU_RR_FD
 SG_ SeatBeltSwSta_Drv : 24|2@1+ (1,0) [0|0] "" Vector__XXX
 SG_ SeatBeltSwSta_1stCtr : 26|2@1+ (1,0) [0|0] "" Vector__XXX
 SG_ SeatBeltSwSta_Asst : 28|2@1+ (1,0) [0|0] ""  GW_SAU_DRV_FD
 SG_ SeatBeltSwSta_2ndLft : 30|2@1+ (1,0) [0|0] "" Vector__XXX
 SG_ SeatBeltSwSta_2ndCtr : 32|2@1+ (1,0) [0|0] "" Vector__XXX
 SG_ SeatBeltSwSta_2ndRt : 34|2@1+ (1,0) [0|0] "" Vector__XXX
 SG_ SeatBeltSwSta_3rdLft : 36|2@1+ (1,0) [0|0] "" Vector__XXX
 SG_ SeatBeltSwSta_3rdCtr : 38|2@1+ (1,0) [0|0] "" Vector__XXX
 SG_ SeatBeltSwSta_3rdRt : 40|2@1+ (1,0) [0|0] "" Vector__XXX
 SG_ SeatBelt4th_InstallInfo : 42|3@1+ (1,0) [0|0] "" Vector__XXX
 SG_ PDCex_CurtainOpt : 45|2@1+ (1,0) [0|0] ""  ATS_FD
 SG_ Reprogram_State_PDC2 : 47|2@1+ (1,0) [0|0] "" Vector__XXX
 SG_ Warn_RrCTRSBRMATSwSta : 56|2@1+ (1,0) [0|0] "" Vector__XXX
 SG_ C_3rdRCSBRMatSw : 58|1@1+ (1,0) [0|0] "" Vector__XXX
 SG_ DriveTypeOption : 64|2@1+ (1,0) [0|0] ""  ATS_FD,BLTN_CAM_FD,GW_PSU_AST_FD,GW_PSU_DRV_FD,GW_PSU_RL_FD,GW_PSU_RR_FD,GW_SAU_DRV_FD,PSB_FD,SGU_FD,SHVU_3RD_FD,SHVU_FRNT_FD,SHVU_REAR_FD
 SG_ AutoLtOpt : 66|2@1+ (1,0) [0|0] "" Vector__XXX
 SG_ HLmpLoHiOptLtSrcTyp : 68|3@1+ (1,0) [0|0] "" Vector__XXX
 SG_ C_StrgWhlHeatingOpt : 71|2@1+ (1,0) [0|0] "" Vector__XXX
 SG_ C_StrgWhlHeatingSWInf : 73|2@1+ (1,0) [0|0] "" Vector__XXX
 SG_ ICU_MtGearPosRSta : 75|2@1+ (1,0) [0|0] ""  BLTN_CAM_FD
 SG_ C_AutoLeverManualSW : 77|2@1+ (1,0) [0|0] "" Vector__XXX
 SG_ Warn_HoodSwMemorySta : 79|2@1+ (1,0) [0|0] "" Vector__XXX
 SG_ Warn_PrkngBrkSwSta : 81|2@1+ (1,0) [0|0] ""  GW_PSU_3RD_FD,GW_PSU_AST_FD,GW_PSU_RL_FD,GW_PSU_RR_FD,SHVU_RL_FD,SHVU_RR_FD
 SG_ PrkngBrkNotchSwState : 83|2@1+ (1,0) [0|0] "" Vector__XXX
 SG_ Warn_BrkFldSwSta : 85|2@1+ (1,0) [0|0] "" Vector__XXX
 SG_ Warn_WshrFldSwSta : 87|2@1+ (1,0) [0|0] "" Vector__XXX
 SG_ Warn_DrvStBltSwSta : 89|2@1+ (1,0) [0|0] ""  ATS_FD,GW_PSU_DRV_FD,GW_SAU_DRV_FD,PSB_FD
 SG_ Warn_AsstStBltSwSta : 91|2@1+ (1,0) [0|0] ""  GW_PSU_AST_FD,GW_PSU_RL_FD,GW_SAU_DRV_FD,PSB_FD
 SG_ Warn_RrLftStBltSwSta : 93|2@1+ (1,0) [0|0] ""  GW_PSU_AST_FD,GW_PSU_DRV_FD,PSB_FD
 SG_ Warn_RrCtrStBltSwSta : 95|2@1+ (1,0) [0|0] ""  PSB_FD
 SG_ Warn_RrRtStBltSwSta : 97|2@1+ (1,0) [0|0] ""  GW_PSU_AST_FD,GW_PSU_DRV_FD,PSB_FD
 SG_ C_3rdRLSeatBeltSW : 99|1@1+ (1,0) [0|0] ""  ARS_FD,GW_PSU_RL_FD,PSB_FD,WPC2_FD

BO_ 995 PDC_FD_04_200ms: 16 CGW_CCU
 SG_ PDC_FD_Crc4Val : 0|16@1+ (1,0) [0|0] "" Vector__XXX
 SG_ PDC_FD_AlvCnt4Val : 16|8@1+ (1,0) [0|0] "" Vector__XXX
 SG_ ICU_Haptic_OPT : 64|2@1+ (1,0) [0|0] "" Vector__XXX
 SG_ HSWS_SysWrngSta_ICU : 66|2@1+ (1,0) [0|0] "" Vector__XXX
 SG_ ICU_PwrWdwMvInhbtSta : 68|1@1+ (1,0) [0|0] "" Vector__XXX
 SG_ Warn_OSMirrFoldSwState : 69|2@1+ (1,0) [0|0] "" Vector__XXX
 SG_ USM_OneTouchTrnSigFuncSta : 71|3@1+ (1,0) [0|0] "" Vector__XXX
 SG_ ExtLamp_TrnSigLmpLftSwSta : 74|2@1+ (1,0) [0|0] "" Vector__XXX
 SG_ ExtLamp_TrnSigLmpRtSwSta : 76|2@1+ (1,0) [0|0] "" Vector__XXX
 SG_ Lamp_LaneChgTrnSigLftSwSta_ICU : 78|2@1+ (1,0) [0|0] "" Vector__XXX
 SG_ Lamp_LaneChgTrnSigRtSwSta_ICU : 80|2@1+ (1,0) [0|0] "" Vector__XXX
 SG_ ICU_HDPSpprtRdy : 82|2@1+ (1,0) [0|0] "" Vector__XXX
 SG_ HzrdLmp_HDPSpprtSWVer : 84|5@1+ (1,0) [0|0] "" Vector__XXX
 SG_ Lamp_TrnSigLmpLftOnReq : 89|2@1+ (1,0) [0|0] ""  BLTN_CAM_FD
 SG_ Lamp_TrnSigLmpRtOnReq : 91|2@1+ (1,0) [0|0] ""  BLTN_CAM_FD
 SG_ Lamp_TrnSigLmpLftActiveSt : 93|2@1+ (1,0) [0|0] "" Vector__XXX
 SG_ Lamp_TrnSigLmpRtActiveSt : 95|2@1+ (1,0) [0|0] "" Vector__XXX
 SG_ TrnLmpSeqEnblCmd : 97|2@1+ (1,0) [0|0] "" Vector__XXX
 SG_ CrashHazardLampOnReq : 99|2@1+ (1,0) [0|0] "" Vector__XXX

BO_ 994 PDC_FD_03_200ms: 16 CGW_CCU
 SG_ PDC_FD_Crc3Val : 0|16@1+ (1,0) [0|0] ""  GW_PSU_DRV_FD
 SG_ PDC_FD_AlvCnt3Val : 16|8@1+ (1,0) [0|0] ""  GW_PSU_DRV_FD
 SG_ Warn_DrvDrSwSta : 64|2@1+ (1,0) [0|0] ""  BLTN_CAM_FD,DCM_FD,GW_PSU_DRV_FD,PSB_FD,RWPC_FD,WPC2_FD,WPC_FD
 SG_ Warn_AsstDrSwSta : 66|2@1+ (1,0) [0|0] ""  BLTN_CAM_FD,DCM_FD,GW_PSU_AST_FD,GW_PSU_RL_FD,GW_SAU_DRV_FD,PSB_FD,RWPC_FD,WPC2_FD,WPC_FD
 SG_ Warn_RrLftDrSwSta : 68|2@1+ (1,0) [0|0] ""  BLTN_CAM_FD,DCM_FD,GW_PSU_AST_FD,GW_PSU_RL_FD,GW_PSU_RR_FD,PSB_FD,RWPC_FD,SHVU_RL_FD,WPC2_FD,WPC_FD
 SG_ Warn_RrRtDrSwSta : 70|2@1+ (1,0) [0|0] ""  BLTN_CAM_FD,DCM_FD,GW_PSU_AST_FD,GW_PSU_RL_FD,GW_PSU_RR_FD,PSB_FD,RWPC_FD,SHVU_RR_FD,WPC2_FD,WPC_FD
 SG_ Warn_HoodSwSta : 72|2@1+ (1,0) [0|0] ""  BLTN_CAM_FD
 SG_ DoorLock_DrvDrUnLkSta : 74|2@1+ (1,0) [0|0] ""  GW_PSU_DRV_FD
 SG_ DoorLock_AsstDrUnLkSta : 76|2@1+ (1,0) [0|0] "" Vector__XXX
 SG_ DoorLock_RrLftDrUnLkSta : 78|2@1+ (1,0) [0|0] "" Vector__XXX
 SG_ DoorLock_RrRtDrUnLkSta : 80|2@1+ (1,0) [0|0] "" Vector__XXX
 SG_ DoorLock_DrvKeyLkSwSta : 82|2@1+ (1,0) [0|0] "" Vector__XXX
 SG_ DoorLock_DrvKeyUnLkSwSta : 84|2@1+ (1,0) [0|0] "" Vector__XXX
 SG_ DoorLock_CtrlDrLkSwSta_ICU : 86|2@1+ (1,0) [0|0] "" Vector__XXX
 SG_ DoorLock_CtrlDrUnLkSwSta_ICU : 88|2@1+ (1,0) [0|0] "" Vector__XXX
 SG_ DoorLock_CtrlDrLkUnLkSwSta_ICU : 90|2@1+ (1,0) [0|0] "" Vector__XXX
 SG_ C_CrashUnlockState : 92|2@1+ (1,0) [0|0] ""  BLTN_CAM_FD
 SG_ Lamp_LedHdLmpSta : 94|2@1+ (1,0) [0|0] "" Vector__XXX
 SG_ Warn_ChaDrSwFrtSta : 96|2@1+ (1,0) [0|0] "" Vector__XXX
 SG_ Warn_ChaDrSwRrSta : 98|2@1+ (1,0) [0|0] "" Vector__XXX

BO_ 997 PDC_FD_11_200ms: 24 CGW_CCU
 SG_ PDC_FD_Crc11Val : 0|16@1+ (1,0) [0|0] "" Vector__XXX
 SG_ ICU_BS1ValFlagSta : 105|2@1+ (1,0) [0|0] "" Vector__XXX
 SG_ ICU_BS1ErrRes : 107|2@1+ (1,0) [0|0] "" Vector__XXX
 SG_ ICU_BS2SoC : 109|8@1+ (1,0) [0|0] ""  BLTN_CAM_FD
 SG_ ICU_BS2NCap : 117|8@1+ (1,0) [0|0] "" Vector__XXX
 SG_ ICU_BS2OpnCirVol : 125|12@1+ (0.001,10) [0|0] "" Vector__XXX
 SG_ ICU_BS2_FSOC : 137|1@1+ (1,0) [0|0] "" Vector__XXX
 SG_ ICU_BS2_FSOH : 138|1@1+ (1,0) [0|0] "" Vector__XXX
 SG_ ICU_BS2_FSOF : 139|1@1+ (1,0) [0|0] "" Vector__XXX
 SG_ ICU_BS2_FQSTAT : 140|1@1+ (1,0) [0|0] "" Vector__XXX
 SG_ ICU_BS2SoH : 141|8@1+ (1,0) [0|0] "" Vector__XXX
 SG_ ICU_BS2SoF : 149|8@1+ (0.05,0) [0|0] "" Vector__XXX
 SG_ PDC_FD_AlvCnt11Val : 16|8@1+ (1,0) [0|0] "" Vector__XXX
 SG_ ICU_BS1BatVol_Dis : 50|14@1+ (0.001,6) [0|0] "V" Vector__XXX
 SG_ ICU_BS1IBAT_Conversion : 64|18@1+ (10,-1200000) [-1200000|1200000] "mA" Vector__XXX
 SG_ ICU_BS1BatVol : 82|14@1+ (0.001,6) [0|0] "" Vector__XXX
 SG_ ICU_BS1BatTemp : 96|9@1+ (0.5,-40) [0|0] "" Vector__XXX

CM_ BO_ 74 "[P] Periodic";
CM_ SG_ 74 IMU_Crc1Val "IMU_CyclicRedundancyCheck1Value";
CM_ SG_ 74 IMU_SnsrTempVal "IMU_SensorTemperatureValue ##2G##YRS - YRS12 - YRS_Temp";
CM_ SG_ 74 IMU_SeralNumVal "IMU_SerialNumberValue ##2G##YRS - YRS13 - YRS_SeralNo";
CM_ SG_ 74 IMU_AlvCnt1Val "IMU_AliveCounter1Value";
CM_ SG_ 74 IMU_RollRtVal "IMU_Roll rate signal value";
CM_ SG_ 74 IMU_VerAccelVal "IMU_Vertial Acceleration value";
CM_ SG_ 74 IMU_YawSigSta "IMU_YawSignalStatus ##2G##YRS - YRS11 - CF_Yrs_YrStat";
CM_ SG_ 74 IMU_LatAccelSigSta "IMU_LateralAccelerationSignalStatus ##2G##YRS - YRS11 - CF_Yrs_LatAcStat";
CM_ SG_ 74 IMU_LongAccelSigSta "IMU_LongitudinalAccelerationSignalStatus ##2G##YRS - YRS12 - CF_Yrs_LongAcStat";
CM_ SG_ 74 IMU_VerAccelSigSta "IMU_Vertial Acceleration Signal Status";
CM_ SG_ 74 IMU_McuVoltSta "IMU_McuVoltageStatus ##2G##YRS - YRS11 - CF_Yrs_MCUStat";
CM_ SG_ 74 IMU_AcuRstSta "IMU_AcuResetStatus ##2G##YRS - YRS12 - CF_IMU_ResetStat";
CM_ SG_ 74 IMU_SnsrTyp "IMU SensorType (Axis information)##2G##YRS - YRS12 - CF_Yrs_Type";
CM_ SG_ 74 IMU_RollSigSta "IMU Rollrate signal status";
CM_ SG_ 74 IMU_YawRtVal "IMU_YawRateValue ##2G##YRS - YRS11 - CR_Yrs_Yr";
CM_ SG_ 74 IMU_LatAccelVal "IMU_LateralAccelerationValue ##2G##YRS - YRS11 - CR_Yrs_LatAc";
CM_ SG_ 74 IMU_LongAccelVal "IMU_LongitudinalAccelerationValue ##2G##YRS - YRS12 - CR_Yrs_LongAc";
CM_ BO_ 345 "[P] Periodic";
CM_ SG_ 345 LBM_FD_Crc2Val "LBM_FD_CyclicRedundancyCheck2Value";
CM_ SG_ 345 LBM_FD_AlvCnt2Val "LBM_FD_AliveCounter2Value";
CM_ SG_ 345 MainLBM_CurrVal "Main Lithium Battery Current";
CM_ SG_ 345 MainLBM_SocVal "Main Lithium Battery Stage Of Charge";
CM_ SG_ 345 MainLBM_VtgVal "Main Lithium Battery Module Voltage";
CM_ SG_ 345 MainLBM_TempVal "Main Lithium Battery Module Temperature";
CM_ SG_ 345 MainLBM_SocErrSta "Main Lithium Battery Soc Error State";
CM_ SG_ 345 MainLBM_SohVal "Main Lithium Battery State Of Health";
CM_ SG_ 345 MainLBM_SnsrInvldSta "Main Lithium Battery Sensor Invalid Status";
CM_ SG_ 345 MainLBM_RspErrSta "Main Lithium Battery Response Error Status";
CM_ SG_ 345 MainLBM_CapacityVal "Battery Capacity Value";
CM_ SG_ 345 MainLBM_SohErrSta "It consists of bits to inform whether the current battery state extraction values are reliable and bits to inform the generation of dark currents at a level that needs to be checked.";
CM_ BO_ 194 "[EW] On Event and On Write";
CM_ SG_ 194 BMS_FD_Crc1Val "BMS_FD_CyclicRedundancyCheck1Value";
CM_ SG_ 194 BMS_FD_AlvCnt1Val "BMS_FD_AliveCounter1Value";
CM_ SG_ 194 xEV_BMS_WakeUpReqfor12V "BMS-PDC/ICU Wake Up, PLBM Discharge Reqest Signal for12V Li-thium Battery";
CM_ SG_ 194 xEV_AuxBattChrgReq_HS "(12V Lithium Battery) Aux. Battery Charge Request Flag (HS-CAN)";
CM_ SG_ 194 xEV_12VBatAlarmReq_HS "BMS-PDC/ICU 3rd Cut-off, Alarm Request for12V Li-thium Battery";
CM_ SG_ 194 BMS_ResetWakeup "All vehicle controller reset functions (12V LFP BMS controller only)";
CM_ BO_ 1048 "[P] Periodic";
CM_ SG_ 1048 GNSS_Crc6Val "GNSS_CyclicRedundancyCheck6Value";
CM_ SG_ 1048 HU_MM_Altitude "Mapmatching Altitude";
CM_ SG_ 1048 GNSS_AlvCnt6Val "GNSS_AliveCounter6Value";
CM_ SG_ 1048 HU_MM_Heading "Map matching heading";
CM_ SG_ 1048 GNSS_MM_type "Map matching type info.";
CM_ SG_ 1048 HU_MM_Latitude "Map matching Latitude";
CM_ SG_ 1048 HU_MM_Longitude "Mapmatching Longitude";
CM_ BO_ 1051 "[PE] Periodic and On Event";
CM_ SG_ 1051 HU_CLOCK_Crc1Val "HU_CLOCK_CyclicRedundancyCheck1Value";
CM_ SG_ 1051 HU_DisplayYear1 "Information for Year (XXOO)
XX : HU_DisplayYear1
OO: HU_DisplayYear2";
CM_ SG_ 1051 HU_DisplayYear2 "Information for Year (XXOO)
XX : HU_DisplayYear1
OO: HU_DisplayYear2";
CM_ SG_ 1051 HU_DisplayDay "Information for Day";
CM_ SG_ 1051 HU_AM_PM_INFO "Information for AM/PM";
CM_ SG_ 1051 HU_CLOCK_AlvCnt1Val "HU_CLOCK_AliveCounter1Value";
CM_ SG_ 1051 HU_TimeSetting "Information for current time setting";
CM_ SG_ 1051 HU_Status "Information for H/U status
Transmitted on H/U status changing";
CM_ SG_ 1051 HU_TimeFormat "Information for time format
Digital CLOCK only";
CM_ SG_ 1051 HU_DisplayHour "Information for time display in Hour unit";
CM_ SG_ 1051 HU_DisplayMinute "Information for time display in Minute unit";
CM_ SG_ 1051 HU_DisplaySecond "Information for time display in Second unit";
CM_ SG_ 1051 HU_DisplayMonth "Information for Month";
CM_ BO_ 1052 "[PE] Periodic and On Event";
CM_ SG_ 1052 HU_CLU_Crc2Val "HU_CLU_CyclicRedundancyCheck2Value";
CM_ SG_ 1052 HU_EVSupport "Notification whether EV function support or not.";
CM_ SG_ 1052 HU_AutoBrightState_New "HU Display Brightness State(When automatically adjusted)";
CM_ SG_ 1052 HU_CLU_AlvCnt2Val "HU_CLU_AliveCounter2Value";
CM_ SG_ 1052 HU_OffloadBtnReq "Request to switch to off-road page";
CM_ SG_ 1052 HU_LanguageInfo "Information for System Language (for Display Font)";
CM_ SG_ 1052 HU_VolumeStatus "Information for AVN Volume";
CM_ SG_ 1052 HU_MuteStatus "Information for System Mute Display";
CM_ SG_ 1052 HU_WelcomeReady "H/U playback ready signal to play welcome/goodbye animation video.";
CM_ SG_ 1052 HU_UsmSupport "Information whether HU can support USM or not";
CM_ SG_ 1052 HU_NaviStatus "Information for Navigation Status (Booting, Normal Operation, No SD card)
-AVN NAVI Transmission Signal";
CM_ SG_ 1052 HU_NaviDisp "Information for Navi Display status on Front Monitor";
CM_ SG_ 1052 HU_BVM_Display_Message "BVM Operation Message";
CM_ SG_ 1052 HU_NaviCamSettingStatus "Information for Navi Camera alert setting status

+ Bit-coded field (On 1, Off 0)
   - bit 0 : Fixed Camera
   - bit 1 : Signal/Speed Violation Camera
   - bit 2 : Movable Camera
   - bit 3 : User Registration Fixed Camera
   - bit 4 : User Registration Signal/Speed Violation Camera
   - bit 5~6 : RESERVED
-AVN NAVI Transmission Signal";
CM_ BO_ 870 "[PE] Periodic and On Event";
CM_ SG_ 870 HU_GW_Crc3Val "HU_GW_CyclicRedundancyCheck3Value";
CM_ SG_ 870 AVN_RSPA_Disp_Rdy "Signal to inform RSPA of AVN's display ready status
(RSPA 화면 표시 가능/불가능 상태를 알리기 위한 신호)";
CM_ SG_ 870 CF_AVN_ProfileIDRValue "This signal is User ID value in H/Unit.";
CM_ SG_ 870 HazardFromHUSVM "This signal is for Hazard control";
CM_ SG_ 870 OMUOSMirCtrl "This signal is for the OutSide Mirror Control (Fold or Unfold)";
CM_ SG_ 870 OTAUIStatus "Information of the status of Head Unit";
CM_ SG_ 870 C_TeleActiveStatus "This signal is for check TMS active status";
CM_ SG_ 870 HU_RTCCheck "Checking whether RTC of AVN and HCU is operationg normally.";
CM_ SG_ 870 HU_GW_AlvCnt3Val "HU_GW_AliveCounter3Value";
CM_ SG_ 870 HU_SWRCWarmerSet "HU SW button touch command for SWRC Warmer";
CM_ SG_ 870 HU_TrModeReq_PE "Trailer/Carrier Mode On/Off request";
CM_ SG_ 870 HU_TrBrakeTypeReq_PE "Trailer Brake Type request";
CM_ SG_ 870 AVN_MPA_SelBtnSta "Button input signal from HU to ADAS_PRK to request MPA operation";
CM_ SG_ 870 AVN_PRK_Cam_Status "If camera displaying meets error condition(red, green, black screen)";
CM_ SG_ 870 HU_DistanceUnit "Request to set CLU Distance Unit";
CM_ SG_ 870 HU_AliveStatus "Information of the status of Head Unit
0x00 : Headunit is booting so, Headunit cant display any state
0x01 : Headunit is normal state, Headunit could display according to MM CAN  command.
0x02 : Headunit is doing their internal process, so Headunit cant communicate with other node.
For CLU/SCC/eCall
-AVN System transmission signal";
CM_ SG_ 870 HU_MicActivity "HU send this signal to eCall for MIC using status.
eCall unit stop the diagonosis when received 0x1:Activated from HU
Otherwise, eCall unit keep diagnosis every 1 sec. and HU can not use MIC";
CM_ SG_ 870 CF_HU_GPSFlt "Information of GPS Fault 

0x0: Normal
0x1 : Fault operation
0x2 : RESERVED
0x3:Invalid";
CM_ SG_ 870 AVN_RSPA_CancelInput "Request Signal to cancel RSPA function";
CM_ BO_ 993 "[PE] Periodic and On Event";
CM_ SG_ 993 PDC_FD_Crc2Val "PDC_FD_CyclicRedundancyCheck2Value";
CM_ SG_ 993 Lamp_StpLmpLftOpnSta "Lamp_StopLampLeftOpenStatus ##2G## -  - C_StopLampLhOpenSts";
CM_ SG_ 993 Lamp_StpLmpRtOpnSta "Lamp_StopLampRightOpenStatus ##2G## -  - C_StopLampRhOpenSts";
CM_ SG_ 993 Lamp_HmslLmpOpnSta "HMSL_OpenStatus ##2G## -  - C_HMSLOpenSts";
CM_ SG_ 993 Lamp_DrlLmpLftOpnSta "Lamp_DrlLampLeftOpenStatus ##2G## -  - C_DRLLampLhOpenSts";
CM_ SG_ 993 Lamp_DrlLmpRtOpnSta "Lamp_DrlLampRightOpenStatus ##2G## -  - C_DRLLampRhOpenSts";
CM_ SG_ 993 Lamp_FrFgLmpLftOpnSta "Lamp_FrontFogLampLeftOpenStatus ##2G## -  - C_FrontFOGLhOpenSts";
CM_ SG_ 993 Lamp_FrFgLmpRtOpnSta "Lamp_FrontFogLampRightOpenStatus ##2G## -  - C_FrontFOGRhOpenSts";
CM_ SG_ 993 Lamp_CorneringLmpLftOpnSta "ExtLamp_CorneringLampLeftOpenStatus ##2G## -  - C_CorneringLpLhOpenState";
CM_ SG_ 993 Lamp_CorneringLmpRtOpnSta "ExtLamp_CorneringLampRightOpenStatus ##2G## -  - C_CorneringLpRhOpenState";
CM_ SG_ 993 Lamp_StcBendingLmpLftOpnSta "Lamp_StaticBendingLampLeftOpenStatus ##2G## -  - C_SBendingLhOpenSts";
CM_ SG_ 993 Lamp_StcBendingLmpRtOpnSta "Lamp_StaticBendingLampRightOpenStatus ##2G## -  - C_SBendingRhOpenSts";
CM_ SG_ 993 Lamp_FrTurnSigLmpLftPCLSta "T/SIG Lamp Front Left PCL Status";
CM_ SG_ 993 Lamp_FrTurnSigLmpRtPCLSta "T/SIG Lamp Front Right PCL Status";
CM_ SG_ 993 Lamp_RrTurnSigLmpLftPCLSta "T/SIG Lamp Rear Left PCL Status";
CM_ SG_ 993 Lamp_RrTurnSigLmpRtPCLSta "T/SIG Lamp Rear Right PCL Status";
CM_ SG_ 993 HzrdSwPushSta "Hazard Switch(self return type) Push State";
CM_ SG_ 993 Lamp_LftTrnFaultSta "Left Turn Lamp Fault Status";
CM_ SG_ 993 Lamp_RtTrnFaultSta "Right Turn Lamp Fault Status";
CM_ SG_ 993 FrtTurnLampOptSta "Front Turn Signal Lamp EOL Option State";
CM_ SG_ 993 RrTurnLampOptSta "Rear Turn Signal Lamp EOL Option State";
CM_ SG_ 993 PDC_FD_AlvCnt2Val "PDC_FD_AliveCounter2Value";
CM_ SG_ 993 IntLamp_InlTailLmpSta "IntLamp_InternalTailLampStatus ##2G## -  - C_IntTailAct,CF_Gway_IntTailAct";
CM_ SG_ 993 Lamp_FootLampOnReq "##2G## -  - C_FootLpOn";
CM_ SG_ 993 Lamp_MoodLampOnReq "##2G## -  - C_MoodLpOn";
CM_ SG_ 993 USM_FuncForMdLmpBrgtSta "USM_FunctionForMoodLampBrightStatus ##2G## -  - CF_Gway_MoodLpBrightRValue";
CM_ SG_ 993 Lamp_HdLmpLoLftOpnSta "Lamp_HeadLampLowLeftOpenStatus ##2G## -  - C_HLampLowLhOpenSts";
CM_ SG_ 993 Lamp_HdLmpLoRtOpnSta "Lamp_HeadLampLowRightOpenStatus ##2G## -  - C_HLampLowRhOpenSts";
CM_ SG_ 993 Lamp_HdLmpBiFuncLftOpnSta "Lamp_HeadLampBiFunctionLeftOpenStatus ##2G## -  - C_HLampBifuncLhOpenSts";
CM_ SG_ 993 Lamp_HdLmpBiFuncRtOpnSta "Lamp_HeadLampBiFunctionRightOpenStatus ##2G## -  - C_HLampBifuncRhOpenSts";
CM_ SG_ 993 Lamp_HdLmpHiLftOpnSta "Lamp_HeadLampHighLeftOpenStatus ##2G## -  - C_HLampHighLhOpenSts";
CM_ SG_ 993 Lamp_HdLmpHiRtOpnSta "Lamp_HeadLampHighRightOpenStatus ##2G## -  - C_HLampHighRhOpenSts";
CM_ SG_ 993 ExtLamp_HzrdSwSta "ExtLamp_HazardSwitchStatus ##2G## -  - C_HazardSw,CF_Gway_HazardSw";
CM_ SG_ 993 Lamp_FrTrnSigLmpLftOpnSta "Lamp_FrontTurnSignalLampLeftOpenStatus ##2G## -  - C_FrontTSIGLhOpenSts";
CM_ SG_ 993 Lamp_FrTrnSigLmpRtOpnSta "Lamp_FrontTurnSignalLampRightOpenStatus ##2G## -  - C_FrontTSIGRhOpenSts";
CM_ SG_ 993 Lamp_RrTrnSigLmpLftOpnSta "Lamp_RearTurnSignalLampLeftOpenStatus ##2G## -  - C_RearTSIGLhOpenSts";
CM_ SG_ 993 Lamp_RrTrnSigLmpRtOpnSta "Lamp_RearTurnSignalLampRightOpenStatus ##2G## -  - C_RearTSIGRhOpenSts";
CM_ SG_ 993 Brake_SwSta_ICU "Brake Switch Status ##2G## -  - C_BrakeSw";
CM_ BO_ 992 "[PE] Periodic and On Event";
CM_ SG_ 992 PDC_FD_Crc1Val "PDC_FD_CyclicRedundancyCheck1Value";
CM_ SG_ 992 C_3rdRRSeatBeltSW "3rd Rear Right Seat Belt Switch Status";
CM_ SG_ 992 DPDMat_HDPSpprtSWVer "HDP-DPD Mat signal processing Requirement Spec Version";
CM_ SG_ 992 Warn_PassStOccSta "Warn_PassengerSeatOccupyStatus ##2G## -  - C_SBRMatSw";
CM_ SG_ 992 Warn_RrLftSBRMATSwSta "##2G## -  - C_RLSBRMatSw";
CM_ SG_ 992 Warn_RrRhtSBRMATSwSta "##2G## -  - C_RRSBRMatSw";
CM_ SG_ 992 ChildLock_ActnFlSta "ChildLock_ActuationFailedStatus ##2G## -  - C_ChildLockFail";
CM_ SG_ 992 DoorLock_LkOutSta "DoorLock_LockOutputStatus ##2G## -  - C_LockUnlockOutState";
CM_ SG_ 992 VSAutoDrLkRetryFailSta "Door lock fail status after vehicle speed auto door lock retry 3 times";
CM_ SG_ 992 Trunk_TrnkTlgtOutReleaseSwSta "Trunk_TrunkTailgateOutReleaseSwitchStatus ##2G## -  - C_TrunkTgOtrReleaseSW";
CM_ SG_ 992 Trunk_TrnkInReleaseSwSta "Trunk_TrunkInnerReleaseSwitchStatus ##2G## -  - C_TrunkInnerReleaseSw";
CM_ SG_ 992 Trunk_GlvBxTrnkLkSwSta "Trunk_GloveBoxTrunkLockSwitchStatus ##2G## -  - C_GloveBoxTrunkLockSw";
CM_ SG_ 992 Trunk_TrnkTlgtSwSta "Trunk_TrunkTailgateSwitchStatus ##2G## -  - C_TrunkTgSw,CF_Gway_TrunkTgSw,Trunk_TrnkTlgtSwSta";
CM_ SG_ 992 Trunk_TlgtFullOpnSwSta "Trunk_TailGateFullOpenSwitchStatus ##2G## -  - C_TgFullOpenSW";
CM_ SG_ 992 Trunk_TrnkTlgtReleaseRlySta "Trunk_TrunkTailgateReleaseRelayStatus ##2G## -  - C_TrunkTgReleaseRlyAct";
CM_ SG_ 992 FrtWiper_ParkingSwState "Front wiper parking switch state";
CM_ SG_ 992 PDC_FD_AlvCnt1Val "PDC_FD_AliveCounter1Value";
CM_ SG_ 992 OBCWakeupDrLock "This signal is for OBC wake-up";
CM_ SG_ 992 OBCWakeupDrUnlock "This signal is for OBC wake-up";
CM_ SG_ 992 Trunk_BgtOpnHzrdReq "Hazzard Request by Bedgate Open";
CM_ SG_ 992 Trunk_BgtOpnBzrReq "Buzzer Request by Bedgate Open";
CM_ SG_ 992 IGN3State "Output status of ignition 3";
CM_ SG_ 992 IGN3State_By_BMS "Output status of ignition 3 by BMS request";
CM_ SG_ 992 IGN3State_By_VCMS_HMU "Output status of ignition 3 by VCMS(PHEV/EV) or HMU(FCEV) request";
CM_ SG_ 992 IGN3State_By_AfterBlow "Output status of ignition 3 by DATC(FATC/MTC) request for after blow";
CM_ SG_ 992 IGN3State_By_Bat "Output status of ignition 3 by IBS or BMS request for HEV 12V auxiliary battery charging";
CM_ SG_ 992 IGN3State_By_VCU_HCU_FCU "Output status of ignition 3 by VCU(EV) or HCU(HEV/PHEV) or FCU(FCEV) request";
CM_ SG_ 992 IGN3State_By_HU "Output status of ignition 3 by HU(AVNT) or CCU request for CCS";
CM_ SG_ 992 IGN3CutOffState "Output status of ignition 3 Cut Off";
CM_ SG_ 992 Reprogram_State_PDC2 "PDC's reprogramming state";
CM_ SG_ 992 DriveTypeOption "##2G## -  - C_DriveTypeOption,CF_Gway_DriveTypeOption";
CM_ SG_ 992 AutoLtOpt "Auto Light 사양 적용 여부 및 적용 옵션 정보 출력 (미적용/적용)";
CM_ SG_ 992 HLmpLoHiOptLtSrcTyp "Head Low&High Lamp 사양 적용 여부 및 Light Source Type, 옵션 정보 출력";
CM_ SG_ 992 ICU_MtGearPosRSta "##2G## -  - C_InhibitRMT,CF_Gway_InhibitRMT";
CM_ SG_ 992 C_AutoLeverManualSW "Auto Lever Manual Switch Status Information";
CM_ SG_ 992 Warn_HoodSwMemorySta "Warn_HoodSwitchMemoryStatus ##2G## -  - CF_Hoodsw_memory,C_HoodSwMemory";
CM_ SG_ 992 Warn_PrkngBrkSwSta "Warn_ParkingBrakeSwitchStatus ##2G## -  - C_ParkBrakeSw";
CM_ SG_ 992 Warn_BrkFldSwSta "Warn_BrakeFluidSwitchStatus ##2G## -  - C_BrakeFluidSw,CF_Gway_BrakeFluidSw";
CM_ SG_ 992 Warn_WshrFldSwSta "Washer Fluid Switch Signal ##2G## -  - CF_Gway_WasherFluidSw";
CM_ SG_ 992 Warn_DrvStBltSwSta "Warn_DriverSeatbeltSwitchStatus ##2G## -  - C_DrvSeatBeltSw,CF_Gway_DrvSeatBeltSw";
CM_ SG_ 992 Warn_AsstStBltSwSta "Warn_AssistSeatBeltSwitchStatus ##2G## -  - C_AstSeatBeltSw,CF_Gway_AstSeatBeltSw";
CM_ SG_ 992 Warn_RrLftStBltSwSta "Warn_RearLeftSeatBeltSwitchStatus ##2G## -  - C_RLSeatBeltSw";
CM_ SG_ 992 Warn_RrCtrStBltSwSta "Warn_RearCenterSeatBeltSwitchStatus ##2G## -  - C_RCSeatBeltSw";
CM_ SG_ 992 Warn_RrRtStBltSwSta "Warn_RearRightSeatBeltSwitchStatus ##2G## -  - C_RRSeatBeltSw";
CM_ SG_ 992 C_3rdRLSeatBeltSW "3rd Rear Left Seat Belt Switch Status";
CM_ BO_ 995 "[PE] Periodic and On Event";
CM_ SG_ 995 PDC_FD_Crc4Val "PDC_FD_CyclicRedundancyCheck4Value";
CM_ SG_ 995 PDC_FD_AlvCnt4Val "PDC_FD_AliveCounter4Value";
CM_ SG_ 995 ICU_Haptic_OPT "Steering Wheel Haptic Warning Option Infomation ##2G## -  - C_ICU_Haptic_OPT";
CM_ SG_ 995 HSWS_SysWrngSta_ICU "HSWS Status ##2G## -  - C_HSWSSysStat";
CM_ SG_ 995 ICU_PwrWdwMvInhbtSta "ICU_PowerWindowMoveInhibitStatus ##2G##DDM -  - C_PwdwInhibit";
CM_ SG_ 995 Warn_OSMirrFoldSwState "Outside Mirror Folding Swtich Status";
CM_ SG_ 995 USM_OneTouchTrnSigFuncSta "USM_OneTouchTurnSignalFunctionStatus ##2G## -  - CF_Gway_OTTurnRValue,C_OTTurnRValue";
CM_ SG_ 995 ExtLamp_TrnSigLmpLftSwSta "ExtLamp_TurnSignalLampLeftSwitchStatus ##2G## -  - C_TsigLhSw";
CM_ SG_ 995 ExtLamp_TrnSigLmpRtSwSta "ExtLamp_TurnSignalLampRightSwitchStatus ##2G## -  - C_TsigRhSw";
CM_ SG_ 995 Lamp_LaneChgTrnSigLftSwSta_ICU "Lamp_LaneChangeTurnSignalLeftSwitchStatus##2G##CGW -CGW8 - 
CF_Gway_HDAIILaneChangeLh";
CM_ SG_ 995 Lamp_LaneChgTrnSigRtSwSta_ICU "Lamp_LaneChangeTurnSignalRightSwitchStatus##2G##CGW -CGW8 - 
CF_Gway_HDAIILaneChangeRh";
CM_ SG_ 995 ICU_HDPSpprtRdy "This signal is the received state information signal of the ADAS message.";
CM_ SG_ 995 HzrdLmp_HDPSpprtSWVer "HDP-HAZARD Lamp control Requirement Spec Version";
CM_ SG_ 995 Lamp_TrnSigLmpLftOnReq "Lamp_TurnSignalLampLeftOnRequest ##2G## -  - Lamp_TsigLmpFrtLftOnReq";
CM_ SG_ 995 Lamp_TrnSigLmpRtOnReq "Lamp_TurnSignalLampRightOnRequest ##2G## -  - Lamp_TSigLmpRtLftOnReq";
CM_ SG_ 995 Lamp_TrnSigLmpLftActiveSt "Lamp_TurnSignalLampLeftActiveState";
CM_ SG_ 995 Lamp_TrnSigLmpRtActiveSt "Lamp_TurnSignalLampRightActiveState";
CM_ BO_ 994 "[PE] Periodic and On Event";
CM_ SG_ 994 PDC_FD_Crc3Val "PDC_FD_CyclicRedundancyCheck3Value";
CM_ SG_ 994 PDC_FD_AlvCnt3Val "PDC_FD_AliveCounter3Value";
CM_ SG_ 994 Warn_DrvDrSwSta "DoorLock_DriverDoorSwitchStatus ##2G## -  - C_DrvDrSw,CF_Gway_DrvDrSw,Warn_DrvDrSwSta";
CM_ SG_ 994 Warn_AsstDrSwSta "Warn_AssistDoorSwitchStatus ##2G## -  - C_AstDrSw,CF_Gway_AstDrSw,Warn_AsstDrSwSta";
CM_ SG_ 994 Warn_RrLftDrSwSta "Warn_RearLeftDoorSwitchStatus ##2G## -  - C_RLDrSw,CF_Gway_RLDrSw,Warn_RrLftDrSwSta";
CM_ SG_ 994 Warn_RrRtDrSwSta "Warn_RearRightDoorSwitchStatus ##2G## -  - C_RRDrSw,CF_Gway_RRDrSw,Warn_RrRtDrSwSta";
CM_ SG_ 994 Warn_HoodSwSta "Warn_HoodSwitchStatus ##2G## -  - C_HoodSw,CF_Gway_HoodSw";
CM_ SG_ 994 DoorLock_DrvDrUnLkSta "DoorLock_DriverDoorUnLockStatus ##2G## -  - C_DrvUnlockState,CF_Gway_DrvUnlockState";
CM_ SG_ 994 DoorLock_AsstDrUnLkSta "DoorLock_AssistDoorUnLockStatus ##2G## -  - C_AstUnlockState,DoorLock_AsstDrUnLkSta";
CM_ SG_ 994 DoorLock_RrLftDrUnLkSta "DoorLock_RearLeftDoorUnLockStatus ##2G## -  - C_RLUnlockState,DoorLock_RrLftDrUnLkSta";
CM_ SG_ 994 DoorLock_RrRtDrUnLkSta "DoorLock_RearRightDoorUnLockStatus ##2G## -  - C_RRUnlockState,DoorLock_RrRtDrUnLkSta";
CM_ SG_ 994 DoorLock_DrvKeyLkSwSta "DoorLock_DriverKeyLockSwitchStatus ##2G## -  - C_DrvKeyLockSw";
CM_ SG_ 994 DoorLock_DrvKeyUnLkSwSta "DoorLock_DriverKeyUnLockSwitchStatus ##2G## -  - C_DrvKeyUnlockSw";
CM_ SG_ 994 DoorLock_CtrlDrLkSwSta_ICU "Central Door Lock Switch State(DRV or AST or RL or RR Door trim)";
CM_ SG_ 994 DoorLock_CtrlDrUnLkSwSta_ICU "Central Door Unlock Switch State(DRV or AST or RL or RR Door trim)";
CM_ SG_ 994 DoorLock_CtrlDrLkUnLkSwSta_ICU "Central Door Lock/Unlock Switch State(C/PAD, Integrated & self return type)";
CM_ SG_ 994 C_CrashUnlockState "Crash Unlock Active State";
CM_ SG_ 994 Lamp_LedHdLmpSta "Lamp_LedHeadLampStatus ##2G## -  - CF_Afs_LedHLStat";
CM_ SG_ 994 Warn_ChaDrSwFrtSta "##2G## - -  CF_Gway_ChaDrSwFrt";
CM_ SG_ 994 Warn_ChaDrSwRrSta "##2G## -  - CF_Gway_ChaDrSwRr";
CM_ BO_ 997 "[PE] Periodic and On Event";
CM_ SG_ 997 PDC_FD_Crc11Val "PDC_FD_CyclicRedundancyCheck11Value";
CM_ SG_ 997 ICU_BS1ValFlagSta "setting condition is depending on battery sensor self diagnosis information ##2G## -  - BS1_BSInvalidFlag";
CM_ SG_ 997 ICU_BS1ErrRes "Response_Error shall be set whenever a frame received by the node or a frame transmitted by the node contains an error in the response field. ##2G## -  - BS1_ErrorResp";
CM_ SG_ 997 ICU_BS2SoC "This signal is battery State of Charge as calculated by battery sensor. ##2G## -  - BS2_SOC,Batt_SoC";
CM_ SG_ 997 ICU_BS2NCap "Nominal capacity ##2G## -  - BS2_CNOM";
CM_ SG_ 997 ICU_BS2OpnCirVol "Last open circuit voltage ##2G## -  - BS2_OCV";
CM_ SG_ 997 ICU_BS2_FSOC "Fault State of SOC";
CM_ SG_ 997 ICU_BS2_FSOH "Fault State of SOH";
CM_ SG_ 997 ICU_BS2_FSOF "Fault State of SOF";
CM_ SG_ 997 ICU_BS2_FQSTAT "State of quiescent current";
CM_ SG_ 997 ICU_BS2SoH "This signal is battery State of Health(SOH) as calculated by battery sensor. ##2G## -  - BAT_SOH";
CM_ SG_ 997 ICU_BS2SoF "This signal is battery State of Function(SOF) as calculated by battery sensor. ##2G## -  - BAT_SOF";
CM_ SG_ 997 PDC_FD_AlvCnt11Val "PDC_FD_AliveCounter11Value";
CM_ SG_ 997 ICU_BS1BatVol_Dis "This is the battery voltage for displaying on the ANVT, CLU as measured on the battery pole by battery sensor.";
CM_ SG_ 997 ICU_BS1IBAT_Conversion "Actual battery current (resolution: 10mA)";
CM_ SG_ 997 ICU_BS1BatVol "This is the actual battery voltage as measured on the battery pole by battery sensor. ##2G## -  - BS1_VBAT";
CM_ SG_ 997 ICU_BS1BatTemp "This is actual battery electrolyte temperature value by battery sensor. ##2G## -  - BS1_TBAT";
BA_DEF_ BO_  "GenMsgEVName" STRING ;
BA_DEF_ BO_  "NmAsrMessage" ENUM  "No","Yes";
BA_DEF_ BO_  "DiagState" ENUM  "No","Yes";
BA_DEF_ BO_  "DiagRequest" ENUM  "No","Yes";
BA_DEF_ BO_  "TpMessage" ENUM  "No","Yes";
BA_DEF_ BO_  "UsrMsgIDSforwardDeviation" INT 0 100;
BA_DEF_ BO_  "UsrMsgIDSbackwardDeviation" INT 50 1000;
BA_DEF_ BO_  "GenMsgCycleTime" INT 0 2000;
BA_DEF_ BO_  "GenMsgStartDelayTime" INT 0 2000;
BA_DEF_ BO_  "GenMsgSendType" ENUM  "Cyclic","NoMsgSendType";
BA_DEF_ BO_  "GenMsgCycleTimeFast" INT 0 500;
BA_DEF_ BO_  "GenMsgDelayTime" INT 0 20;
BA_DEF_ BO_  "GenMsgILSupport" ENUM  "No","Yes";
BA_DEF_ BO_  "GenMsgNrOfRepetition" INT 0 3;
BA_DEF_ BO_  "VFrameFormat" ENUM  "StandardCAN","ExtendedCAN","reserved","reserved","reserved","reserved","reserved","reserved","reserved","reserved","reserved","reserved","reserved","reserved","StandardCAN_FD","ExtendedCAN_FD";
BA_DEF_ SG_  "UserSigValidity" ENUM  "B+","ACC","IG","IG1","IG2","IG3","IG1 or IG2","IG1 or IG3","Undef";
BA_DEF_ SG_  "TimeoutValue" STRING ;
BA_DEF_ SG_  "UsrSigPurpose" ENUM  "Undef","FN","DIAG","DIAG(Req)","DIAG(Res)","DIAG(Func)","DEV","CCP","NM","TP";
BA_DEF_ SG_  "GenSigStartValue" INT 0 1215752192;
BA_DEF_ SG_  "NetworkRequest" ENUM  "Yes","No";
BA_DEF_ SG_  "NetworkRequestHoldingTime" INT 0 65535;
BA_DEF_ SG_  "Description" STRING ;
BA_DEF_ SG_  "Version" STRING ;
BA_DEF_ SG_  "GenSigEnvVarType" ENUM  "Int","Float","Undef";
BA_DEF_ SG_  "GenSigSendType" ENUM  "Cyclic","OnWrite","OnWriteWithRepetition","OnChange","OnChangeWithRepetition","IfActive","IfActiveWithRepetition","NoSigSendType","OnChangeAndIfActive","OnChangeAndIfActiveWithRepetition";
BA_DEF_ SG_  "GwSigLatencyTime" INT 0 65536;
BA_DEF_ SG_  "GwSigMissingSourceType" ENUM  "Undef","OldValue","DefaultValue","InitialValue";
BA_DEF_ SG_  "NWM-WakeupAllowed" ENUM  "<n.a.>";
BA_DEF_ SG_  "RoutingFactor" INT 1 1215752192;
BA_DEF_ SG_  "SystemSignalLongSymbol" STRING ;
BA_DEF_REL_ BU_SG_REL_  "GenSigTimeoutTime" INT 0 7000;
BA_DEF_DEF_  "GenMsgEVName" "@Signame";
BA_DEF_DEF_  "NmAsrMessage" "No";
BA_DEF_DEF_  "DiagState" "No";
BA_DEF_DEF_  "DiagRequest" "No";
BA_DEF_DEF_  "TpMessage" "No";
BA_DEF_DEF_  "UsrMsgIDSforwardDeviation" 10;
BA_DEF_DEF_  "UsrMsgIDSbackwardDeviation" 100;
BA_DEF_DEF_  "GenMsgCycleTime" 200;
BA_DEF_DEF_  "GenMsgStartDelayTime" 0;
BA_DEF_DEF_  "GenMsgSendType" "NoMsgSendType";
BA_DEF_DEF_  "GenMsgCycleTimeFast" 40;
BA_DEF_DEF_  "GenMsgDelayTime" 20;
BA_DEF_DEF_  "GenMsgILSupport" "Yes";
BA_DEF_DEF_  "GenMsgNrOfRepetition" 3;
BA_DEF_DEF_  "VFrameFormat" "StandardCAN";
BA_DEF_DEF_  "UserSigValidity" "IG";
BA_DEF_DEF_  "TimeoutValue" "";
BA_DEF_DEF_  "UsrSigPurpose" "FN";
BA_DEF_DEF_  "GenSigStartValue" 0;
BA_DEF_DEF_  "NetworkRequest" "No";
BA_DEF_DEF_  "NetworkRequestHoldingTime" 0;
BA_DEF_DEF_  "Description" "";
BA_DEF_DEF_  "Version" "";
BA_DEF_DEF_  "GenSigEnvVarType" "Undef";
BA_DEF_DEF_  "GenSigSendType" "NoSigSendType";
BA_DEF_DEF_  "GwSigLatencyTime" 40;
BA_DEF_DEF_  "GwSigMissingSourceType" "Undef";
BA_DEF_DEF_  "NWM-WakeupAllowed" "<n.a.>";
BA_DEF_DEF_  "RoutingFactor" 1;
BA_DEF_DEF_REL_ "GenSigTimeoutTime" 500;
BA_DEF_DEF_  "SystemSignalLongSymbol" "";
BA_ "GenMsgNrOfRepetition" BO_ 74 0;
BA_ "GenMsgCycleTimeFast" BO_ 74 0;
BA_ "GenMsgCycleTime" BO_ 74 50;
BA_ "GenMsgSendType" BO_ 74 0;
BA_ "VFrameFormat" BO_ 74 14;
BA_ "GenMsgNrOfRepetition" BO_ 345 0;
BA_ "GenMsgCycleTimeFast" BO_ 345 0;
BA_ "GenMsgCycleTime" BO_ 345 300;
BA_ "GenMsgSendType" BO_ 345 0;
BA_ "VFrameFormat" BO_ 345 14;
BA_ "GenMsgDelayTime" BO_ 194 10;
BA_ "GenMsgNrOfRepetition" BO_ 194 0;
BA_ "GenMsgCycleTime" BO_ 194 0;
BA_ "VFrameFormat" BO_ 194 14;
BA_ "GenMsgNrOfRepetition" BO_ 1048 0;
BA_ "GenMsgCycleTimeFast" BO_ 1048 0;
BA_ "GenMsgCycleTime" BO_ 1048 1000;
BA_ "GenMsgSendType" BO_ 1048 0;
BA_ "VFrameFormat" BO_ 1048 14;
BA_ "GenMsgStartDelayTime" BO_ 1051 10;
BA_ "GenMsgCycleTime" BO_ 1051 1000;
BA_ "GenMsgSendType" BO_ 1051 0;
BA_ "VFrameFormat" BO_ 1051 14;
BA_ "GenMsgStartDelayTime" BO_ 1052 10;
BA_ "GenMsgCycleTime" BO_ 1052 1000;
BA_ "GenMsgSendType" BO_ 1052 0;
BA_ "VFrameFormat" BO_ 1052 14;
BA_ "GenMsgStartDelayTime" BO_ 870 50;
BA_ "GenMsgSendType" BO_ 870 0;
BA_ "VFrameFormat" BO_ 870 14;
BA_ "GenMsgSendType" BO_ 993 0;
BA_ "VFrameFormat" BO_ 993 14;
BA_ "GenMsgSendType" BO_ 992 0;
BA_ "VFrameFormat" BO_ 992 14;
BA_ "GenMsgSendType" BO_ 995 0;
BA_ "VFrameFormat" BO_ 995 14;
BA_ "GenMsgSendType" BO_ 994 0;
BA_ "VFrameFormat" BO_ 994 14;
BA_ "GenMsgStartDelayTime" BO_ 997 10;
BA_ "GenMsgSendType" BO_ 997 0;
BA_ "VFrameFormat" BO_ 997 14;
BA_ "Version" SG_ 74 IMU_Crc1Val "21.09.03";
BA_ "RoutingFactor" SG_ 74 IMU_Crc1Val 0;
BA_ "UserSigValidity" SG_ 74 IMU_Crc1Val 3;
BA_ "GenSigStartValue" SG_ 74 IMU_Crc1Val 65535;
BA_ "Description" SG_ 74 IMU_Crc1Val "The data area for CRC calculation is based on the data length (DLC) of the message DB.

The CRC shall be calculated over the entire data block (excluding the CRC bytes) including the user data, alive counter and Data ID



- CRC Polynomial (0x1021) , Ini";
BA_ "Version" SG_ 74 IMU_SnsrTempVal "20.03.05";
BA_ "RoutingFactor" SG_ 74 IMU_SnsrTempVal 0;
BA_ "UserSigValidity" SG_ 74 IMU_SnsrTempVal 3;
BA_ "GenSigStartValue" SG_ 74 IMU_SnsrTempVal 68;
BA_ "Description" SG_ 74 IMU_SnsrTempVal "The temperature is measured on sensing element chip in ACU, so it may be different from the display indicator temperature of the vehicle.



Physical range: -68°C = 00h, +60 °C = 80h, +187°C = FFh



Quantization LSB: 1[°C/digit]



Temperature [°C]";
BA_ "Version" SG_ 74 IMU_SeralNumVal "20.03.05";
BA_ "RoutingFactor" SG_ 74 IMU_SeralNumVal 0;
BA_ "UserSigValidity" SG_ 74 IMU_SeralNumVal 3;
BA_ "Description" SG_ 74 IMU_SeralNumVal "IMU serial number in range of 



0x000000000000 = 0......0xFFFFFFFFFFFF

※Initial value shall be actual value

※This information is only for chipset with yaw sensor.";
BA_ "Version" SG_ 74 IMU_AlvCnt1Val "21.09.03";
BA_ "RoutingFactor" SG_ 74 IMU_AlvCnt1Val 0;
BA_ "UserSigValidity" SG_ 74 IMU_AlvCnt1Val 3;
BA_ "Description" SG_ 74 IMU_AlvCnt1Val "For the first transmission request for a data element the counter shall be initialized with 0 and shall be incremented by 1 for every subsequent send request. 

When the counter reaches the maximum value(0xFF), then it shall restart with 0 for the next s";
BA_ "Version" SG_ 74 IMU_RollRtVal "20.03.05";
BA_ "RoutingFactor" SG_ 74 IMU_RollRtVal 0;
BA_ "UserSigValidity" SG_ 74 IMU_RollRtVal 3;
BA_ "GenSigStartValue" SG_ 74 IMU_RollRtVal 32768;
BA_ "Description" SG_ 74 IMU_RollRtVal "This signal indicates Information regarding Roll rate.



physical range : -163.84..163.83 ˚/s = 0000H..FFFEh



Conversion : (PH) = ((HEX)-8000H)*0.005[˚/s/digit]



                            = (HEX)*0.005[˚/s/digit] - 163.84[˚/s]



             ";
BA_ "Version" SG_ 74 IMU_VerAccelVal "20.03.05";
BA_ "RoutingFactor" SG_ 74 IMU_VerAccelVal 0;
BA_ "UserSigValidity" SG_ 74 IMU_VerAccelVal 3;
BA_ "GenSigStartValue" SG_ 74 IMU_VerAccelVal 32768;
BA_ "Description" SG_ 74 IMU_VerAccelVal "This signal indicates Information regarding Vertical acceleration.



physical range : -4.1768g..4.1765g = 0000H..FFFEh



Conversion : (PH) = ((HEX)-8000H)*0.000127465[g/digit]



                            = (HEX)*0.000127465[g/digit] - 4.17677312[g]

";
BA_ "Version" SG_ 74 IMU_YawSigSta "20.03.05";
BA_ "RoutingFactor" SG_ 74 IMU_YawSigSta 0;
BA_ "UserSigValidity" SG_ 74 IMU_YawSigSta 3;
BA_ "GenSigStartValue" SG_ 74 IMU_YawSigSta 2;
BA_ "Description" SG_ 74 IMU_YawSigSta "This signal indicates failure status of yaw rate signal and yaw rate sensing element.



0000B : No failure 



xxx1B : IMU_Yawrate_failure



xx1xB : Initialization is running



x1xxB : Reserved



1xxxB : Reserved



This signal represents the physica";
BA_ "Version" SG_ 74 IMU_LatAccelSigSta "20.03.05";
BA_ "RoutingFactor" SG_ 74 IMU_LatAccelSigSta 0;
BA_ "UserSigValidity" SG_ 74 IMU_LatAccelSigSta 3;
BA_ "GenSigStartValue" SG_ 74 IMU_LatAccelSigSta 2;
BA_ "Description" SG_ 74 IMU_LatAccelSigSta "This signal indicates failure status of lateral acceleration signal and sensing element.



0000B : No failure



xxx1B : IMU_Lateral acceleration failure



xx1xB : Initialization is running



x1xxB : Reserved



1xxxB : Reserved



This signal represe";
BA_ "Version" SG_ 74 IMU_LongAccelSigSta "20.03.05";
BA_ "RoutingFactor" SG_ 74 IMU_LongAccelSigSta 0;
BA_ "UserSigValidity" SG_ 74 IMU_LongAccelSigSta 3;
BA_ "GenSigStartValue" SG_ 74 IMU_LongAccelSigSta 2;
BA_ "Description" SG_ 74 IMU_LongAccelSigSta "This signal indicates failure status of longitudinal acceleration signal and sensing element.



0000B : No failure 



xxx1B : IMU_Longitudial acceleration failure



xx1xB : Initialization is running



x1xxB : Reserved



1xxxB : Reserved



This sign";
BA_ "Version" SG_ 74 IMU_VerAccelSigSta "20.03.05";
BA_ "RoutingFactor" SG_ 74 IMU_VerAccelSigSta 0;
BA_ "UserSigValidity" SG_ 74 IMU_VerAccelSigSta 3;
BA_ "GenSigStartValue" SG_ 74 IMU_VerAccelSigSta 2;
BA_ "Description" SG_ 74 IMU_VerAccelSigSta "This signal indicates failure status of  vertial acceleration signal and yaw rate sensing element.



0000B : No failure 



xxx1B : IMU_Vertial acceleration failure



xx1xB : Initialization is running



x1xxB : Reserved



1xxxB : Reserved



This sig";
BA_ "Version" SG_ 74 IMU_McuVoltSta "20.03.05";
BA_ "RoutingFactor" SG_ 74 IMU_McuVoltSta 0;
BA_ "UserSigValidity" SG_ 74 IMU_McuVoltSta 3;
BA_ "Description" SG_ 74 IMU_McuVoltSta "This signal indicates the failure status of MCU.



0000B : No failure



xxx1B : MCU failure



xx1xB : Under voltage detected



x1xxB : Over voltage detected



1xxxB : Bus off failure



The status information(xxx1B) occurs when MCU error is detected";
BA_ "Version" SG_ 74 IMU_AcuRstSta "20.03.05";
BA_ "RoutingFactor" SG_ 74 IMU_AcuRstSta 0;
BA_ "UserSigValidity" SG_ 74 IMU_AcuRstSta 3;
BA_ "Description" SG_ 74 IMU_AcuRstSta "This signal indicates the status of IMU.



0000B : Normal mode 



xxx1B : IMU Reset mode



xx1xB : Reserved



x1xxB : Reserved



1xxxB : Reserved



If ACU reset is required, ACU will send IMU RESET bit(XXX1B) up to 30 times and perform a reset. If ";
BA_ "Version" SG_ 74 IMU_SnsrTyp "20.03.05";
BA_ "RoutingFactor" SG_ 74 IMU_SnsrTyp 0;
BA_ "UserSigValidity" SG_ 74 IMU_SnsrTyp 3;
BA_ "GenSigStartValue" SG_ 74 IMU_SnsrTyp 2;
BA_ "Description" SG_ 74 IMU_SnsrTyp "This signal indicates supported signals that are correspond to sensor type.

0001B = IMU (yaw rate and lateral acceleration)

0010B = IMU (yaw rate, lateral and longitudinal acceleration)

0100B = IMU (yaw / roll rate, lateral and longitudinal accelerati";
BA_ "Version" SG_ 74 IMU_RollSigSta "20.03.05";
BA_ "RoutingFactor" SG_ 74 IMU_RollSigSta 0;
BA_ "UserSigValidity" SG_ 74 IMU_RollSigSta 3;
BA_ "GenSigStartValue" SG_ 74 IMU_RollSigSta 2;
BA_ "Description" SG_ 74 IMU_RollSigSta "This signal indicates failure status of roll rate signal and roll rate sensing element.



0000B : No failure 



xxx1B : IMU_Roll rate failure



xx1xB : Initialization is running



x1xxB : Reserved



1xxxB : Reserved



This signal represents the phy";
BA_ "Version" SG_ 74 IMU_YawRtVal "20.03.05";
BA_ "RoutingFactor" SG_ 74 IMU_YawRtVal 0;
BA_ "UserSigValidity" SG_ 74 IMU_YawRtVal 3;
BA_ "GenSigStartValue" SG_ 74 IMU_YawRtVal 32768;
BA_ "Description" SG_ 74 IMU_YawRtVal "This signal indicates Information regarding yaw rate.



physical range : -163.84..163.83 ˚/s = 0000H..FFFEh



Conversion : (PH) = ((HEX)-8000H)*0.005[˚/s/digit]



                            = (HEX)*0.005[˚/s/digit] - 163.84[˚/s]



              ";
BA_ "Version" SG_ 74 IMU_LatAccelVal "20.03.05";
BA_ "RoutingFactor" SG_ 74 IMU_LatAccelVal 0;
BA_ "UserSigValidity" SG_ 74 IMU_LatAccelVal 3;
BA_ "GenSigStartValue" SG_ 74 IMU_LatAccelVal 32768;
BA_ "Description" SG_ 74 IMU_LatAccelVal "This signal indicates Information regarding lateral acceleration.



physical range : -4.1768g..4.1765g = 0000H..FFFEh



Conversion : (PH) = ((HEX)-8000H)*0.000127465[g/digit]



                            = (HEX)*0.000127465[g/digit] - 4.17677312[g]

";
BA_ "Version" SG_ 74 IMU_LongAccelVal "20.03.05";
BA_ "RoutingFactor" SG_ 74 IMU_LongAccelVal 0;
BA_ "UserSigValidity" SG_ 74 IMU_LongAccelVal 3;
BA_ "GenSigStartValue" SG_ 74 IMU_LongAccelVal 32768;
BA_ "Description" SG_ 74 IMU_LongAccelVal "This signal indicates information regarding longitudinal acceleration.



physical range : -4.1768g..4.1765g = 0000H..FFFEh



Conversion : (PH) = ((HEX)-8000H)*0.000127465[g/digit]



                            = (HEX)*0.000127465[g/digit] - 4.17677312";
BA_ "Version" SG_ 345 LBM_FD_Crc2Val "24.04.07";
BA_ "RoutingFactor" SG_ 345 LBM_FD_Crc2Val 2;
BA_ "UserSigValidity" SG_ 345 LBM_FD_Crc2Val 3;
BA_ "GenSigStartValue" SG_ 345 LBM_FD_Crc2Val 65535;
BA_ "Description" SG_ 345 LBM_FD_Crc2Val "The data area for CRC calculation is based on the data length (DLC) of the message DB.

The CRC shall be calculated over the entire data block (excluding the CRC bytes) including the user data, alive counter and Data ID



- CRC Polynomial (0x1021) , Ini";
BA_ "Version" SG_ 345 LBM_FD_AlvCnt2Val "24.04.07";
BA_ "RoutingFactor" SG_ 345 LBM_FD_AlvCnt2Val 2;
BA_ "UserSigValidity" SG_ 345 LBM_FD_AlvCnt2Val 3;
BA_ "Description" SG_ 345 LBM_FD_AlvCnt2Val "For the first transmission request for a data element the counter shall be initialized with 0 and shall be incremented by 1 for every subsequent send request. 

When the counter reaches the maximum value(0xFF), then it shall restart with 0 for the next s";
BA_ "Version" SG_ 345 MainLBM_CurrVal "24.04.07";
BA_ "RoutingFactor" SG_ 345 MainLBM_CurrVal 2;
BA_ "UserSigValidity" SG_ 345 MainLBM_CurrVal 0;
BA_ "GenSigStartValue" SG_ 345 MainLBM_CurrVal 65535;
BA_ "Description" SG_ 345 MainLBM_CurrVal "This is Battery current as measured by battery sensor.

This value is  

   - IRANGE : 1 (medium current)

   - Resolution : 10mA";
BA_ "Version" SG_ 345 MainLBM_SocVal "24.04.07";
BA_ "RoutingFactor" SG_ 345 MainLBM_SocVal 2;
BA_ "UserSigValidity" SG_ 345 MainLBM_SocVal 0;
BA_ "Description" SG_ 345 MainLBM_SocVal "This signal is battery State of Charge as calculated by battery sensor.";
BA_ "Version" SG_ 345 MainLBM_VtgVal "24.04.07";
BA_ "RoutingFactor" SG_ 345 MainLBM_VtgVal 2;
BA_ "UserSigValidity" SG_ 345 MainLBM_VtgVal 0;
BA_ "GenSigStartValue" SG_ 345 MainLBM_VtgVal 16383;
BA_ "Description" SG_ 345 MainLBM_VtgVal "This is the actual battery voltage as measured on the battery pole by battery sensor.

The Resolution is 1mV.";
BA_ "Version" SG_ 345 MainLBM_TempVal "24.04.07";
BA_ "RoutingFactor" SG_ 345 MainLBM_TempVal 2;
BA_ "UserSigValidity" SG_ 345 MainLBM_TempVal 0;
BA_ "GenSigStartValue" SG_ 345 MainLBM_TempVal 511;
BA_ "Description" SG_ 345 MainLBM_TempVal "This is actual battery electrolyte temperature value by battery sensor.

The value is calculated by a Battery Temperature Model, depending on measured temperature of the battery pole.

The resolution is 0.5℃.";
BA_ "Version" SG_ 345 MainLBM_SocErrSta "24.04.07";
BA_ "RoutingFactor" SG_ 345 MainLBM_SocErrSta 2;
BA_ "UserSigValidity" SG_ 345 MainLBM_SocErrSta 0;
BA_ "GenSigStartValue" SG_ 345 MainLBM_SocErrSta 1;
BA_ "Description" SG_ 345 MainLBM_SocErrSta "This bit is flags for indication whether battery SOC detection value is plausible or not by battery sensor.

If it is set to value 0, then it means battery SOC is normal state.

If it is set to value 1, then it means battery SOC is implausible state.

 *";
BA_ "Version" SG_ 345 MainLBM_SohVal "24.04.07";
BA_ "RoutingFactor" SG_ 345 MainLBM_SohVal 2;
BA_ "UserSigValidity" SG_ 345 MainLBM_SohVal 0;
BA_ "GenSigStartValue" SG_ 345 MainLBM_SohVal 127;
BA_ "Description" SG_ 345 MainLBM_SohVal "This signal is battery State of Health(SOH) as calculated by battery sensor.

This value shows reduction rate of nominal capacity.

This value can be used for diagnosis information of application system.";
BA_ "Version" SG_ 345 MainLBM_SnsrInvldSta "24.04.07";
BA_ "RoutingFactor" SG_ 345 MainLBM_SnsrInvldSta 2;
BA_ "UserSigValidity" SG_ 345 MainLBM_SnsrInvldSta 0;
BA_ "GenSigStartValue" SG_ 345 MainLBM_SnsrInvldSta 1;
BA_ "Description" SG_ 345 MainLBM_SnsrInvldSta "This bit is Battery Sensor Invalid flag and setting condition is depending on Battery Sensor self diagnosis information.

 BS Invalid = 0 : BS is Valid Condition

 BS Invalid = 1 : BS is Invalid Condition";
BA_ "Version" SG_ 345 MainLBM_RspErrSta "24.04.07";
BA_ "RoutingFactor" SG_ 345 MainLBM_RspErrSta 2;
BA_ "UserSigValidity" SG_ 345 MainLBM_RspErrSta 0;
BA_ "GenSigStartValue" SG_ 345 MainLBM_RspErrSta 1;
BA_ "Description" SG_ 345 MainLBM_RspErrSta "Battery Sensor shall send one status bit signal, Response_Error. Response_Error shall be set whenever a frame received by the node or a frame transmitted by the node contains an error in the response field.

Response_Error shall be cleared after transmis";
BA_ "Version" SG_ 345 MainLBM_CapacityVal "24.04.07";
BA_ "RoutingFactor" SG_ 345 MainLBM_CapacityVal 2;
BA_ "UserSigValidity" SG_ 345 MainLBM_CapacityVal 0;
BA_ "Description" SG_ 345 MainLBM_CapacityVal "12V Battery Capacity Value";
BA_ "Version" SG_ 345 MainLBM_SohErrSta "24.04.07";
BA_ "RoutingFactor" SG_ 345 MainLBM_SohErrSta 2;
BA_ "UserSigValidity" SG_ 345 MainLBM_SohErrSta 0;
BA_ "Version" SG_ 194 BMS_FD_Crc1Val "22.10.20";
BA_ "UserSigValidity" SG_ 194 BMS_FD_Crc1Val 3;
BA_ "GenSigStartValue" SG_ 194 BMS_FD_Crc1Val 65535;
BA_ "GenSigSendType" SG_ 194 BMS_FD_Crc1Val 2;
BA_ "Description" SG_ 194 BMS_FD_Crc1Val "The data area for CRC calculation is based on the data length (DLC) of the message DB.

The CRC shall be calculated over the entire data block (excluding the CRC bytes) including the user data, alive counter and Data ID



- CRC Polynomial (0x1021) , Ini";
BA_ "Version" SG_ 194 BMS_FD_AlvCnt1Val "22.10.20";
BA_ "UserSigValidity" SG_ 194 BMS_FD_AlvCnt1Val 3;
BA_ "GenSigSendType" SG_ 194 BMS_FD_AlvCnt1Val 2;
BA_ "Description" SG_ 194 BMS_FD_AlvCnt1Val "For the first transmission request for a data element the counter shall be initialized with 0 and shall be incremented by 1 for every subsequent send request. 

When the counter reaches the maximum value(0xFF), then it shall restart with 0 for the next s";
BA_ "Version" SG_ 194 xEV_BatEvtAlarm_HS "20.04.06";
BA_ "UserSigValidity" SG_ 194 xEV_BatEvtAlarm_HS 0;
BA_ "GenSigSendType" SG_ 194 xEV_BatEvtAlarm_HS 2;
BA_ "Description" SG_ 194 xEV_BatEvtAlarm_HS "Battery Emergency Event Alarm Flag";
BA_ "Version" SG_ 194 xEV_BMS_WakeUpReqfor12V "22.04.02";
BA_ "UserSigValidity" SG_ 194 xEV_BMS_WakeUpReqfor12V 0;
BA_ "GenSigSendType" SG_ 194 xEV_BMS_WakeUpReqfor12V 2;
BA_ "Description" SG_ 194 xEV_BMS_WakeUpReqfor12V "BMS-PDC/ICU Wake Up, PLBM Discharge Reqest Signal for12V Li-thium Battery";
BA_ "Version" SG_ 194 xEV_AuxBattChrgReq_HS "23.02.01";
BA_ "UserSigValidity" SG_ 194 xEV_AuxBattChrgReq_HS 7;
BA_ "GenSigSendType" SG_ 194 xEV_AuxBattChrgReq_HS 2;
BA_ "Description" SG_ 194 xEV_AuxBattChrgReq_HS "(12V Lithium Battery) Aux. Battery Charge Request Flag (HS-CAN)

LV2 Charge Request : Battery Saver

LV1 Charge Request : Auxiliary Charge";
BA_ "Version" SG_ 194 xEV_12VBatAlarmReq_HS "21.05.01";
BA_ "UserSigValidity" SG_ 194 xEV_12VBatAlarmReq_HS 0;
BA_ "GenSigSendType" SG_ 194 xEV_12VBatAlarmReq_HS 2;
BA_ "Description" SG_ 194 xEV_12VBatAlarmReq_HS "BMS-PDC/ICU 3rd Cut-off, Alarm Request for12V Li-thium Battery";
BA_ "Version" SG_ 194 BMS_ResetWakeup "24.04.03";
BA_ "UserSigValidity" SG_ 194 BMS_ResetWakeup 0;
BA_ "GenSigSendType" SG_ 194 BMS_ResetWakeup 2;
BA_ "Description" SG_ 194 BMS_ResetWakeup "All vehicle controller reset functions

(12V LFP BMS controller only)

Send when reset condition is satisfied";
BA_ "Version" SG_ 1048 GNSS_Crc6Val "22.10.20";
BA_ "UserSigValidity" SG_ 1048 GNSS_Crc6Val 3;
BA_ "GenSigStartValue" SG_ 1048 GNSS_Crc6Val 65535;
BA_ "Description" SG_ 1048 GNSS_Crc6Val "The data area for CRC calculation is based on the data length (DLC) of the message DB.

The CRC shall be calculated over the entire data block (excluding the CRC bytes) including the user data, alive counter and Data ID



- CRC Polynomial (0x1021) , Ini";
BA_ "Version" SG_ 1048 HU_MM_Altitude "22.07.05";
BA_ "UserSigValidity" SG_ 1048 HU_MM_Altitude 1;
BA_ "Description" SG_ 1048 HU_MM_Altitude "MSL

range = -40000 <= Value <= 1000000

unit = cm";
BA_ "Version" SG_ 1048 GNSS_AlvCnt6Val "22.10.20";
BA_ "UserSigValidity" SG_ 1048 GNSS_AlvCnt6Val 3;
BA_ "Description" SG_ 1048 GNSS_AlvCnt6Val "For the first transmission request for a data element the counter shall be initialized with 0 and shall be incremented by 1 for every subsequent send request. 

When the counter reaches the maximum value(0xFF), then it shall restart with 0 for the next s";
BA_ "Version" SG_ 1048 HU_MM_Heading "22.07.05";
BA_ "UserSigValidity" SG_ 1048 HU_MM_Heading 1;
BA_ "Description" SG_ 1048 HU_MM_Heading "range = 0<=Valud <360";
BA_ "Version" SG_ 1048 GNSS_MM_type "22.07.05";
BA_ "UserSigValidity" SG_ 1048 GNSS_MM_type 1;
BA_ "GenSigStartValue" SG_ 1048 GNSS_MM_type 15;
BA_ "Version" SG_ 1048 HU_MM_Latitude "22.07.05";
BA_ "UserSigValidity" SG_ 1048 HU_MM_Latitude 1;
BA_ "Description" SG_ 1048 HU_MM_Latitude "range = -90*1,000,000 <= Value <=90*1,000,000

unit = degree*1,000,000";
BA_ "Version" SG_ 1048 HU_MM_Longitude "22.07.05";
BA_ "UserSigValidity" SG_ 1048 HU_MM_Longitude 1;
BA_ "Description" SG_ 1048 HU_MM_Longitude "range = -180*1,000,000 <= Value <= 180*1,000,000

unit = degree*1,000,000";
BA_ "Version" SG_ 1051 HU_CLOCK_Crc1Val "22.10.20";
BA_ "UserSigValidity" SG_ 1051 HU_CLOCK_Crc1Val 3;
BA_ "GenSigStartValue" SG_ 1051 HU_CLOCK_Crc1Val 65535;
BA_ "GenSigSendType" SG_ 1051 HU_CLOCK_Crc1Val 4;
BA_ "Description" SG_ 1051 HU_CLOCK_Crc1Val "The data area for CRC calculation is based on the data length (DLC) of the message DB.

The CRC shall be calculated over the entire data block (excluding the CRC bytes) including the user data, alive counter and Data ID



- CRC Polynomial (0x1021) , Ini";
BA_ "Version" SG_ 1051 HU_DisplayYear1 "18.09.02";
BA_ "NetworkRequest" SG_ 1051 HU_DisplayYear1 0;
BA_ "UserSigValidity" SG_ 1051 HU_DisplayYear1 0;
BA_ "GenSigStartValue" SG_ 1051 HU_DisplayYear1 3;
BA_ "GenSigSendType" SG_ 1051 HU_DisplayYear1 4;
BA_ "Version" SG_ 1051 HU_DisplayYear2 "21.07.07";
BA_ "NetworkRequestHoldingTime" SG_ 1051 HU_DisplayYear2 200;
BA_ "NetworkRequest" SG_ 1051 HU_DisplayYear2 0;
BA_ "UserSigValidity" SG_ 1051 HU_DisplayYear2 0;
BA_ "GenSigStartValue" SG_ 1051 HU_DisplayYear2 255;
BA_ "GenSigSendType" SG_ 1051 HU_DisplayYear2 4;
BA_ "Version" SG_ 1051 HU_DisplayDay "21.07.07";
BA_ "NetworkRequestHoldingTime" SG_ 1051 HU_DisplayDay 200;
BA_ "NetworkRequest" SG_ 1051 HU_DisplayDay 0;
BA_ "UserSigValidity" SG_ 1051 HU_DisplayDay 0;
BA_ "GenSigStartValue" SG_ 1051 HU_DisplayDay 255;
BA_ "GenSigSendType" SG_ 1051 HU_DisplayDay 4;
BA_ "Version" SG_ 1051 HU_AM_PM_INFO "18.09.02";
BA_ "NetworkRequest" SG_ 1051 HU_AM_PM_INFO 0;
BA_ "UserSigValidity" SG_ 1051 HU_AM_PM_INFO 0;
BA_ "GenSigStartValue" SG_ 1051 HU_AM_PM_INFO 3;
BA_ "GenSigSendType" SG_ 1051 HU_AM_PM_INFO 4;
BA_ "Version" SG_ 1051 HU_ComRefresh "18.09.02";
BA_ "NetworkRequest" SG_ 1051 HU_ComRefresh 0;
BA_ "UserSigValidity" SG_ 1051 HU_ComRefresh 0;
BA_ "GenSigStartValue" SG_ 1051 HU_ComRefresh 3;
BA_ "GenSigSendType" SG_ 1051 HU_ComRefresh 4;
BA_ "Version" SG_ 1051 HU_ClockInfo "18.09.02";
BA_ "NetworkRequest" SG_ 1051 HU_ClockInfo 0;
BA_ "UserSigValidity" SG_ 1051 HU_ClockInfo 0;
BA_ "GenSigStartValue" SG_ 1051 HU_ClockInfo 3;
BA_ "GenSigSendType" SG_ 1051 HU_ClockInfo 4;
BA_ "Version" SG_ 1051 HU_CLOCK_AlvCnt1Val "22.10.20";
BA_ "UserSigValidity" SG_ 1051 HU_CLOCK_AlvCnt1Val 3;
BA_ "GenSigSendType" SG_ 1051 HU_CLOCK_AlvCnt1Val 4;
BA_ "Description" SG_ 1051 HU_CLOCK_AlvCnt1Val "For the first transmission request for a data element the counter shall be initialized with 0 and shall be incremented by 1 for every subsequent send request. 

When the counter reaches the maximum value(0xFF), then it shall restart with 0 for the next s";
BA_ "Version" SG_ 1051 HU_TimeSetting "18.09.02";
BA_ "NetworkRequest" SG_ 1051 HU_TimeSetting 0;
BA_ "UserSigValidity" SG_ 1051 HU_TimeSetting 0;
BA_ "GenSigStartValue" SG_ 1051 HU_TimeSetting 3;
BA_ "GenSigSendType" SG_ 1051 HU_TimeSetting 4;
BA_ "Version" SG_ 1051 HU_Status "21.07.07";
BA_ "NetworkRequestHoldingTime" SG_ 1051 HU_Status 200;
BA_ "NetworkRequest" SG_ 1051 HU_Status 0;
BA_ "UserSigValidity" SG_ 1051 HU_Status 0;
BA_ "GenSigStartValue" SG_ 1051 HU_Status 15;
BA_ "GenSigSendType" SG_ 1051 HU_Status 4;
BA_ "Version" SG_ 1051 HU_TimeFormat "18.09.02";
BA_ "NetworkRequest" SG_ 1051 HU_TimeFormat 0;
BA_ "UserSigValidity" SG_ 1051 HU_TimeFormat 0;
BA_ "GenSigStartValue" SG_ 1051 HU_TimeFormat 3;
BA_ "GenSigSendType" SG_ 1051 HU_TimeFormat 4;
BA_ "Version" SG_ 1051 HU_DisplayHour "21.07.07";
BA_ "NetworkRequestHoldingTime" SG_ 1051 HU_DisplayHour 200;
BA_ "NetworkRequest" SG_ 1051 HU_DisplayHour 0;
BA_ "UserSigValidity" SG_ 1051 HU_DisplayHour 0;
BA_ "GenSigStartValue" SG_ 1051 HU_DisplayHour 255;
BA_ "GenSigSendType" SG_ 1051 HU_DisplayHour 4;
BA_ "Version" SG_ 1051 HU_DisplayMinute "21.07.07";
BA_ "NetworkRequestHoldingTime" SG_ 1051 HU_DisplayMinute 200;
BA_ "NetworkRequest" SG_ 1051 HU_DisplayMinute 0;
BA_ "UserSigValidity" SG_ 1051 HU_DisplayMinute 0;
BA_ "GenSigStartValue" SG_ 1051 HU_DisplayMinute 255;
BA_ "GenSigSendType" SG_ 1051 HU_DisplayMinute 4;
BA_ "Version" SG_ 1051 HU_DisplaySecond "21.07.07";
BA_ "NetworkRequestHoldingTime" SG_ 1051 HU_DisplaySecond 200;
BA_ "NetworkRequest" SG_ 1051 HU_DisplaySecond 0;
BA_ "UserSigValidity" SG_ 1051 HU_DisplaySecond 0;
BA_ "GenSigStartValue" SG_ 1051 HU_DisplaySecond 255;
BA_ "GenSigSendType" SG_ 1051 HU_DisplaySecond 4;
BA_ "Version" SG_ 1051 HU_DisplayMonth "21.07.07";
BA_ "NetworkRequestHoldingTime" SG_ 1051 HU_DisplayMonth 200;
BA_ "NetworkRequest" SG_ 1051 HU_DisplayMonth 0;
BA_ "UserSigValidity" SG_ 1051 HU_DisplayMonth 0;
BA_ "GenSigStartValue" SG_ 1051 HU_DisplayMonth 15;
BA_ "GenSigSendType" SG_ 1051 HU_DisplayMonth 4;
BA_ "Version" SG_ 1052 HU_CLU_Crc2Val "22.10.20";
BA_ "UserSigValidity" SG_ 1052 HU_CLU_Crc2Val 3;
BA_ "GenSigStartValue" SG_ 1052 HU_CLU_Crc2Val 65535;
BA_ "GenSigSendType" SG_ 1052 HU_CLU_Crc2Val 4;
BA_ "Description" SG_ 1052 HU_CLU_Crc2Val "The data area for CRC calculation is based on the data length (DLC) of the message DB.

The CRC shall be calculated over the entire data block (excluding the CRC bytes) including the user data, alive counter and Data ID



- CRC Polynomial (0x1021) , Ini";
BA_ "Version" SG_ 1052 HU_EVSupport "22.06.01";
BA_ "UserSigValidity" SG_ 1052 HU_EVSupport 7;
BA_ "GenSigStartValue" SG_ 1052 HU_EVSupport 3;
BA_ "GenSigSendType" SG_ 1052 HU_EVSupport 4;
BA_ "Description" SG_ 1052 HU_EVSupport "Notification whether EV function support or not.";
BA_ "Version" SG_ 1052 HU_DayNightState "22.06.01";
BA_ "UserSigValidity" SG_ 1052 HU_DayNightState 0;
BA_ "GenSigSendType" SG_ 1052 HU_DayNightState 4;
BA_ "Description" SG_ 1052 HU_DayNightState "HU(AVNT) display day and night time state (When automatically adjusted)";
BA_ "Version" SG_ 1052 HU_AutoBrightState_New "22.06.01";
BA_ "UserSigValidity" SG_ 1052 HU_AutoBrightState_New 0;
BA_ "GenSigSendType" SG_ 1052 HU_AutoBrightState_New 4;
BA_ "Description" SG_ 1052 HU_AutoBrightState_New "HU Display Brightness State(When automatically adjusted)";
BA_ "Version" SG_ 1052 HU_CLU_AlvCnt2Val "22.10.20";
BA_ "UserSigValidity" SG_ 1052 HU_CLU_AlvCnt2Val 3;
BA_ "GenSigSendType" SG_ 1052 HU_CLU_AlvCnt2Val 4;
BA_ "Description" SG_ 1052 HU_CLU_AlvCnt2Val "For the first transmission request for a data element the counter shall be initialized with 0 and shall be incremented by 1 for every subsequent send request. 

When the counter reaches the maximum value(0xFF), then it shall restart with 0 for the next s";
BA_ "Version" SG_ 1052 HU_OffloadBtnReq "24.05.01";
BA_ "UserSigValidity" SG_ 1052 HU_OffloadBtnReq 1;
BA_ "GenSigStartValue" SG_ 1052 HU_OffloadBtnReq 3;
BA_ "GenSigSendType" SG_ 1052 HU_OffloadBtnReq 4;
BA_ "Description" SG_ 1052 HU_OffloadBtnReq "Request to switch to off-road page";
BA_ "Version" SG_ 1052 HU_LanguageInfo "24.07.04";
BA_ "NetworkRequestHoldingTime" SG_ 1052 HU_LanguageInfo 5000;
BA_ "NetworkRequest" SG_ 1052 HU_LanguageInfo 0;
BA_ "UserSigValidity" SG_ 1052 HU_LanguageInfo 1;
BA_ "GenSigStartValue" SG_ 1052 HU_LanguageInfo 255;
BA_ "GenSigSendType" SG_ 1052 HU_LanguageInfo 4;
BA_ "Version" SG_ 1052 HU_VolumeStatus "22.06.01";
BA_ "NetworkRequest" SG_ 1052 HU_VolumeStatus 0;
BA_ "UserSigValidity" SG_ 1052 HU_VolumeStatus 1;
BA_ "GenSigStartValue" SG_ 1052 HU_VolumeStatus 63;
BA_ "GenSigSendType" SG_ 1052 HU_VolumeStatus 4;
BA_ "Version" SG_ 1052 HU_MuteStatus "22.06.01";
BA_ "NetworkRequest" SG_ 1052 HU_MuteStatus 0;
BA_ "UserSigValidity" SG_ 1052 HU_MuteStatus 1;
BA_ "GenSigStartValue" SG_ 1052 HU_MuteStatus 3;
BA_ "GenSigSendType" SG_ 1052 HU_MuteStatus 4;
BA_ "Version" SG_ 1052 HU_WelcomeReady "22.07.05";
BA_ "UserSigValidity" SG_ 1052 HU_WelcomeReady 0;
BA_ "GenSigSendType" SG_ 1052 HU_WelcomeReady 4;
BA_ "Description" SG_ 1052 HU_WelcomeReady "H/U playback ready signal to play welcome/goodbye animation video.";
BA_ "Version" SG_ 1052 HU_UsmSupport "22.06.01";
BA_ "UserSigValidity" SG_ 1052 HU_UsmSupport 1;
BA_ "GenSigStartValue" SG_ 1052 HU_UsmSupport 3;
BA_ "GenSigSendType" SG_ 1052 HU_UsmSupport 4;
BA_ "Version" SG_ 1052 HU_NaviStatus "22.06.01";
BA_ "NetworkRequest" SG_ 1052 HU_NaviStatus 0;
BA_ "UserSigValidity" SG_ 1052 HU_NaviStatus 1;
BA_ "GenSigSendType" SG_ 1052 HU_NaviStatus 4;
BA_ "Version" SG_ 1052 HU_NaviDisp "22.06.01";
BA_ "NetworkRequest" SG_ 1052 HU_NaviDisp 0;
BA_ "UserSigValidity" SG_ 1052 HU_NaviDisp 1;
BA_ "GenSigStartValue" SG_ 1052 HU_NaviDisp 3;
BA_ "GenSigSendType" SG_ 1052 HU_NaviDisp 4;
BA_ "Version" SG_ 1052 HU_BVM_Display_Message "22.06.01";
BA_ "UserSigValidity" SG_ 1052 HU_BVM_Display_Message 3;
BA_ "GenSigStartValue" SG_ 1052 HU_BVM_Display_Message 7;
BA_ "GenSigSendType" SG_ 1052 HU_BVM_Display_Message 4;
BA_ "Version" SG_ 1052 HU_NaviCamSettingStatus "22.06.01";
BA_ "NetworkRequest" SG_ 1052 HU_NaviCamSettingStatus 0;
BA_ "UserSigValidity" SG_ 1052 HU_NaviCamSettingStatus 1;
BA_ "GenSigStartValue" SG_ 1052 HU_NaviCamSettingStatus 255;
BA_ "GenSigSendType" SG_ 1052 HU_NaviCamSettingStatus 4;
BA_ "Version" SG_ 870 HU_GW_Crc3Val "22.10.20";
BA_ "UserSigValidity" SG_ 870 HU_GW_Crc3Val 3;
BA_ "GenSigStartValue" SG_ 870 HU_GW_Crc3Val 65535;
BA_ "GenSigSendType" SG_ 870 HU_GW_Crc3Val 4;
BA_ "Description" SG_ 870 HU_GW_Crc3Val "The data area for CRC calculation is based on the data length (DLC) of the message DB.

The CRC shall be calculated over the entire data block (excluding the CRC bytes) including the user data, alive counter and Data ID



- CRC Polynomial (0x1021) , Ini";
BA_ "Version" SG_ 870 AVN_RSPA_Disp_Rdy "22.06.01";
BA_ "UserSigValidity" SG_ 870 AVN_RSPA_Disp_Rdy 0;
BA_ "GenSigStartValue" SG_ 870 AVN_RSPA_Disp_Rdy 3;
BA_ "GenSigSendType" SG_ 870 AVN_RSPA_Disp_Rdy 4;
BA_ "Version" SG_ 870 CF_AVN_ProfileIDRValue "22.11.24";
BA_ "UserSigValidity" SG_ 870 CF_AVN_ProfileIDRValue 0;
BA_ "GenSigStartValue" SG_ 870 CF_AVN_ProfileIDRValue 15;
BA_ "GenSigSendType" SG_ 870 CF_AVN_ProfileIDRValue 4;
BA_ "Description" SG_ 870 CF_AVN_ProfileIDRValue "Profile 3~Profile9 value is only used from Vehicle Architecture 2.0 (STD_DB_CAR_R2, SV 24.6~) vehicle models

Vehicle Architecture 1.0 (STD_DB_CAR) vehicle models can use Guest, Profile1, Profile 2 only.";
BA_ "Version" SG_ 870 HazardFromHUSVM "22.06.01";
BA_ "UserSigValidity" SG_ 870 HazardFromHUSVM 0;
BA_ "GenSigStartValue" SG_ 870 HazardFromHUSVM 3;
BA_ "GenSigSendType" SG_ 870 HazardFromHUSVM 4;
BA_ "Version" SG_ 870 OMUOSMirCtrl "22.06.01";
BA_ "UserSigValidity" SG_ 870 OMUOSMirCtrl 0;
BA_ "GenSigStartValue" SG_ 870 OMUOSMirCtrl 3;
BA_ "GenSigSendType" SG_ 870 OMUOSMirCtrl 4;
BA_ "Version" SG_ 870 OTAUIStatus "22.06.01";
BA_ "UserSigValidity" SG_ 870 OTAUIStatus 0;
BA_ "GenSigSendType" SG_ 870 OTAUIStatus 4;
BA_ "Description" SG_ 870 OTAUIStatus "0x00 : Headunit is booting so, Headunit can't display any state

0x01 : Headunit is normal state, Headunit could display according to CCU command.";
BA_ "Version" SG_ 870 C_TeleActiveStatus "22.06.01";
BA_ "UserSigValidity" SG_ 870 C_TeleActiveStatus 0;
BA_ "GenSigStartValue" SG_ 870 C_TeleActiveStatus 3;
BA_ "GenSigSendType" SG_ 870 C_TeleActiveStatus 4;
BA_ "Version" SG_ 870 HU_RTCCheck "22.06.01";
BA_ "UserSigValidity" SG_ 870 HU_RTCCheck 3;
BA_ "TimeoutValue" SG_ 870 HU_RTCCheck "0x3";
BA_ "GenSigStartValue" SG_ 870 HU_RTCCheck 3;
BA_ "GenSigSendType" SG_ 870 HU_RTCCheck 4;
BA_ "Version" SG_ 870 HU_GW_AlvCnt3Val "22.10.20";
BA_ "UserSigValidity" SG_ 870 HU_GW_AlvCnt3Val 3;
BA_ "GenSigSendType" SG_ 870 HU_GW_AlvCnt3Val 4;
BA_ "Description" SG_ 870 HU_GW_AlvCnt3Val "For the first transmission request for a data element the counter shall be initialized with 0 and shall be incremented by 1 for every subsequent send request. 

When the counter reaches the maximum value(0xFF), then it shall restart with 0 for the next s";
BA_ "Version" SG_ 870 HU_SWRCWarmerSet "22.06.01";
BA_ "UserSigValidity" SG_ 870 HU_SWRCWarmerSet 3;
BA_ "GenSigSendType" SG_ 870 HU_SWRCWarmerSet 4;
BA_ "Description" SG_ 870 HU_SWRCWarmerSet "send 0x1(On) value while button press to ICU";
BA_ "Version" SG_ 870 HU_TrModeReq_PE "24.07.06";
BA_ "UserSigValidity" SG_ 870 HU_TrModeReq_PE 3;
BA_ "GenSigStartValue" SG_ 870 HU_TrModeReq_PE 7;
BA_ "GenSigSendType" SG_ 870 HU_TrModeReq_PE 4;
BA_ "Description" SG_ 870 HU_TrModeReq_PE "Trailer/Carrier Mode On/Off request";
BA_ "Version" SG_ 870 HU_TrBrakeTypeReq_PE "24.07.06";
BA_ "UserSigValidity" SG_ 870 HU_TrBrakeTypeReq_PE 3;
BA_ "GenSigStartValue" SG_ 870 HU_TrBrakeTypeReq_PE 7;
BA_ "GenSigSendType" SG_ 870 HU_TrBrakeTypeReq_PE 4;
BA_ "Description" SG_ 870 HU_TrBrakeTypeReq_PE "Trailer Brake Type request";
BA_ "Version" SG_ 870 AVN_MPA_SelBtnSta "24.10.03";
BA_ "UserSigValidity" SG_ 870 AVN_MPA_SelBtnSta 3;
BA_ "GenSigSendType" SG_ 870 AVN_MPA_SelBtnSta 4;
BA_ "Version" SG_ 870 AVN_PRK_Cam_Status "24.10.00";
BA_ "UserSigValidity" SG_ 870 AVN_PRK_Cam_Status 1;
BA_ "GenSigSendType" SG_ 870 AVN_PRK_Cam_Status 4;
BA_ "Description" SG_ 870 AVN_PRK_Cam_Status "Status of camera displaying when operating a pakring function(RSPA, MRA, MPA).";
BA_ "Version" SG_ 870 AVN_MRA_Disp_Rdy "24.01.04";
BA_ "UserSigValidity" SG_ 870 AVN_MRA_Disp_Rdy 3;
BA_ "GenSigSendType" SG_ 870 AVN_MRA_Disp_Rdy 4;
BA_ "Description" SG_ 870 AVN_MRA_Disp_Rdy "AVN status notification for ADAS_PRK

- status notification whether AVN can display on the navigation screen";
BA_ "Version" SG_ 870 AVN_PRK_Func_Selected "24.07.03";
BA_ "UserSigValidity" SG_ 870 AVN_PRK_Func_Selected 3;
BA_ "GenSigSendType" SG_ 870 AVN_PRK_Func_Selected 4;
BA_ "Description" SG_ 870 AVN_PRK_Func_Selected "MRA function activation button selection result feedback";
BA_ "Version" SG_ 870 AVN_MRA_CancelInput "24.01.04";
BA_ "UserSigValidity" SG_ 870 AVN_MRA_CancelInput 3;
BA_ "GenSigSendType" SG_ 870 AVN_MRA_CancelInput 4;
BA_ "Description" SG_ 870 AVN_MRA_CancelInput "Information of exit button input on the navigation screen from MRA activation to control stage";
BA_ "Version" SG_ 870 HU_DistanceUnit "22.06.01";
BA_ "NetworkRequest" SG_ 870 HU_DistanceUnit 0;
BA_ "UserSigValidity" SG_ 870 HU_DistanceUnit 1;
BA_ "GenSigStartValue" SG_ 870 HU_DistanceUnit 3;
BA_ "GenSigSendType" SG_ 870 HU_DistanceUnit 4;
BA_ "Version" SG_ 870 HU_Scheduled_Setting "22.06.01";
BA_ "UserSigValidity" SG_ 870 HU_Scheduled_Setting 3;
BA_ "GenSigSendType" SG_ 870 HU_Scheduled_Setting 4;
BA_ "Description" SG_ 870 HU_Scheduled_Setting "Information of scheduled update charge setting

The signal means that scheduled update charaging information send to BMS for BMS SOC control";
BA_ "Version" SG_ 870 HU_AliveStatus "22.06.01";
BA_ "NetworkRequest" SG_ 870 HU_AliveStatus 0;
BA_ "UserSigValidity" SG_ 870 HU_AliveStatus 0;
BA_ "GenSigStartValue" SG_ 870 HU_AliveStatus 3;
BA_ "GenSigSendType" SG_ 870 HU_AliveStatus 4;
BA_ "Version" SG_ 870 HU_ThemeType "22.06.01";
BA_ "UserSigValidity" SG_ 870 HU_ThemeType 0;
BA_ "GenSigStartValue" SG_ 870 HU_ThemeType 15;
BA_ "GenSigSendType" SG_ 870 HU_ThemeType 4;
BA_ "Description" SG_ 870 HU_ThemeType "This signal indicates current H/Unit GUI theme value. 

 

Detail value -GUI Theme matching table, refer to attachement and ES SPEC";
BA_ "Version" SG_ 870 HU_MicActivity "22.06.01";
BA_ "UserSigValidity" SG_ 870 HU_MicActivity 0;
BA_ "GenSigStartValue" SG_ 870 HU_MicActivity 3;
BA_ "GenSigSendType" SG_ 870 HU_MicActivity 4;
BA_ "Version" SG_ 870 AVN_RSPA_ModeSelect "23.10.01";
BA_ "UserSigValidity" SG_ 870 AVN_RSPA_ModeSelect 0;
BA_ "GenSigStartValue" SG_ 870 AVN_RSPA_ModeSelect 15;
BA_ "GenSigSendType" SG_ 870 AVN_RSPA_ModeSelect 4;
BA_ "Description" SG_ 870 AVN_RSPA_ModeSelect "Signal for User's RSPAⅡ mode setting

RSPAⅡ 모드 선택 메뉴 CCP Focus 및 CCP Confirm or Touch 결과";
BA_ "Version" SG_ 870 CF_HU_GPSFlt "22.06.01";
BA_ "UserSigValidity" SG_ 870 CF_HU_GPSFlt 0;
BA_ "TimeoutValue" SG_ 870 CF_HU_GPSFlt "0x2";
BA_ "GenSigStartValue" SG_ 870 CF_HU_GPSFlt 2;
BA_ "GenSigSendType" SG_ 870 CF_HU_GPSFlt 4;
BA_ "Version" SG_ 870 AVN_RSPA_CancelInput "22.06.01";
BA_ "UserSigValidity" SG_ 870 AVN_RSPA_CancelInput 0;
BA_ "GenSigSendType" SG_ 870 AVN_RSPA_CancelInput 4;
BA_ "Version" SG_ 993 PDC_FD_Crc2Val "22.10.20";
BA_ "UserSigValidity" SG_ 993 PDC_FD_Crc2Val 3;
BA_ "GenSigStartValue" SG_ 993 PDC_FD_Crc2Val 65535;
BA_ "GenSigSendType" SG_ 993 PDC_FD_Crc2Val 4;
BA_ "Description" SG_ 993 PDC_FD_Crc2Val "The data area for CRC calculation is based on the data length (DLC) of the message DB.

The CRC shall be calculated over the entire data block (excluding the CRC bytes) including the user data, alive counter and Data ID



- CRC Polynomial (0x1021) , Ini";
BA_ "Version" SG_ 993 Lamp_StpLmpLftOpnSta "17.12.00";
BA_ "NetworkRequestHoldingTime" SG_ 993 Lamp_StpLmpLftOpnSta 5000;
BA_ "NetworkRequest" SG_ 993 Lamp_StpLmpLftOpnSta 0;
BA_ "UserSigValidity" SG_ 993 Lamp_StpLmpLftOpnSta 0;
BA_ "GenSigSendType" SG_ 993 Lamp_StpLmpLftOpnSta 4;
BA_ "Description" SG_ 993 Lamp_StpLmpLftOpnSta "Stop Lamp



Left Open Status";
BA_ "Version" SG_ 993 Lamp_StpLmpRtOpnSta "17.12.00";
BA_ "NetworkRequestHoldingTime" SG_ 993 Lamp_StpLmpRtOpnSta 5000;
BA_ "NetworkRequest" SG_ 993 Lamp_StpLmpRtOpnSta 0;
BA_ "UserSigValidity" SG_ 993 Lamp_StpLmpRtOpnSta 0;
BA_ "GenSigSendType" SG_ 993 Lamp_StpLmpRtOpnSta 4;
BA_ "Description" SG_ 993 Lamp_StpLmpRtOpnSta "Stop Lamp



Right Open Status";
BA_ "Version" SG_ 993 Lamp_HmslLmpOpnSta "19.11.09";
BA_ "NetworkRequestHoldingTime" SG_ 993 Lamp_HmslLmpOpnSta 5000;
BA_ "NetworkRequest" SG_ 993 Lamp_HmslLmpOpnSta 0;
BA_ "UserSigValidity" SG_ 993 Lamp_HmslLmpOpnSta 0;
BA_ "GenSigSendType" SG_ 993 Lamp_HmslLmpOpnSta 4;
BA_ "Description" SG_ 993 Lamp_HmslLmpOpnSta "HMSL OpenStatus";
BA_ "Version" SG_ 993 Lamp_DrlLmpLftOpnSta "17.12.00";
BA_ "NetworkRequestHoldingTime" SG_ 993 Lamp_DrlLmpLftOpnSta 5000;
BA_ "NetworkRequest" SG_ 993 Lamp_DrlLmpLftOpnSta 0;
BA_ "UserSigValidity" SG_ 993 Lamp_DrlLmpLftOpnSta 0;
BA_ "GenSigSendType" SG_ 993 Lamp_DrlLmpLftOpnSta 4;
BA_ "Description" SG_ 993 Lamp_DrlLmpLftOpnSta "DRL Lamp



Left OpenStatus";
BA_ "Version" SG_ 993 Lamp_DrlLmpRtOpnSta "17.12.00";
BA_ "NetworkRequestHoldingTime" SG_ 993 Lamp_DrlLmpRtOpnSta 5000;
BA_ "NetworkRequest" SG_ 993 Lamp_DrlLmpRtOpnSta 0;
BA_ "UserSigValidity" SG_ 993 Lamp_DrlLmpRtOpnSta 0;
BA_ "GenSigSendType" SG_ 993 Lamp_DrlLmpRtOpnSta 4;
BA_ "Description" SG_ 993 Lamp_DrlLmpRtOpnSta "DRL Lamp



Right OpenStatus";
BA_ "Version" SG_ 993 Lamp_FrFgLmpLftOpnSta "17.12.00";
BA_ "NetworkRequestHoldingTime" SG_ 993 Lamp_FrFgLmpLftOpnSta 5000;
BA_ "NetworkRequest" SG_ 993 Lamp_FrFgLmpLftOpnSta 0;
BA_ "UserSigValidity" SG_ 993 Lamp_FrFgLmpLftOpnSta 0;
BA_ "GenSigSendType" SG_ 993 Lamp_FrFgLmpLftOpnSta 4;
BA_ "Description" SG_ 993 Lamp_FrFgLmpLftOpnSta "Front FOG Lamp



Left OpenStatus";
BA_ "Version" SG_ 993 Lamp_FrFgLmpRtOpnSta "17.12.00";
BA_ "NetworkRequestHoldingTime" SG_ 993 Lamp_FrFgLmpRtOpnSta 5000;
BA_ "NetworkRequest" SG_ 993 Lamp_FrFgLmpRtOpnSta 0;
BA_ "UserSigValidity" SG_ 993 Lamp_FrFgLmpRtOpnSta 0;
BA_ "GenSigSendType" SG_ 993 Lamp_FrFgLmpRtOpnSta 4;
BA_ "Description" SG_ 993 Lamp_FrFgLmpRtOpnSta "Front FOG Lamp



Right OpenStatus";
BA_ "Version" SG_ 993 Lamp_CorneringLmpLftOpnSta "19.11.11";
BA_ "NetworkRequestHoldingTime" SG_ 993 Lamp_CorneringLmpLftOpnSta 5000;
BA_ "NetworkRequest" SG_ 993 Lamp_CorneringLmpLftOpnSta 0;
BA_ "UserSigValidity" SG_ 993 Lamp_CorneringLmpLftOpnSta 0;
BA_ "GenSigSendType" SG_ 993 Lamp_CorneringLmpLftOpnSta 4;
BA_ "Description" SG_ 993 Lamp_CorneringLmpLftOpnSta "Cornering Lamp Left Open Status";
BA_ "Version" SG_ 993 Lamp_CorneringLmpRtOpnSta "19.11.11";
BA_ "NetworkRequestHoldingTime" SG_ 993 Lamp_CorneringLmpRtOpnSta 5000;
BA_ "NetworkRequest" SG_ 993 Lamp_CorneringLmpRtOpnSta 0;
BA_ "UserSigValidity" SG_ 993 Lamp_CorneringLmpRtOpnSta 0;
BA_ "GenSigSendType" SG_ 993 Lamp_CorneringLmpRtOpnSta 4;
BA_ "Description" SG_ 993 Lamp_CorneringLmpRtOpnSta "Cornering Lamp Right Open Status";
BA_ "Version" SG_ 993 Lamp_StcBendingLmpLftOpnSta "17.12.00";
BA_ "NetworkRequestHoldingTime" SG_ 993 Lamp_StcBendingLmpLftOpnSta 5000;
BA_ "NetworkRequest" SG_ 993 Lamp_StcBendingLmpLftOpnSta 0;
BA_ "UserSigValidity" SG_ 993 Lamp_StcBendingLmpLftOpnSta 0;
BA_ "GenSigSendType" SG_ 993 Lamp_StcBendingLmpLftOpnSta 4;
BA_ "Description" SG_ 993 Lamp_StcBendingLmpLftOpnSta "Static Bending Lamp



Left OpenStatus";
BA_ "Version" SG_ 993 Lamp_StcBendingLmpRtOpnSta "17.12.00";
BA_ "NetworkRequestHoldingTime" SG_ 993 Lamp_StcBendingLmpRtOpnSta 5000;
BA_ "NetworkRequest" SG_ 993 Lamp_StcBendingLmpRtOpnSta 0;
BA_ "UserSigValidity" SG_ 993 Lamp_StcBendingLmpRtOpnSta 0;
BA_ "GenSigSendType" SG_ 993 Lamp_StcBendingLmpRtOpnSta 4;
BA_ "Description" SG_ 993 Lamp_StcBendingLmpRtOpnSta "Static Bending Lamp



Right OpenStatus";
BA_ "Version" SG_ 993 Lamp_FrTurnSigLmpLftPCLSta "22.07.05";
BA_ "NetworkRequestHoldingTime" SG_ 993 Lamp_FrTurnSigLmpLftPCLSta 5000;
BA_ "NetworkRequest" SG_ 993 Lamp_FrTurnSigLmpLftPCLSta 0;
BA_ "UserSigValidity" SG_ 993 Lamp_FrTurnSigLmpLftPCLSta 0;
BA_ "GenSigSendType" SG_ 993 Lamp_FrTurnSigLmpLftPCLSta 4;
BA_ "Description" SG_ 993 Lamp_FrTurnSigLmpLftPCLSta "T/SIG Lamp Front Left PCL Status";
BA_ "Version" SG_ 993 Lamp_FrTurnSigLmpRtPCLSta "22.07.05";
BA_ "NetworkRequestHoldingTime" SG_ 993 Lamp_FrTurnSigLmpRtPCLSta 5000;
BA_ "NetworkRequest" SG_ 993 Lamp_FrTurnSigLmpRtPCLSta 0;
BA_ "UserSigValidity" SG_ 993 Lamp_FrTurnSigLmpRtPCLSta 0;
BA_ "GenSigSendType" SG_ 993 Lamp_FrTurnSigLmpRtPCLSta 4;
BA_ "Description" SG_ 993 Lamp_FrTurnSigLmpRtPCLSta "T/SIG Lamp Front Right PCL Status";
BA_ "Version" SG_ 993 Lamp_RrTurnSigLmpLftPCLSta "22.07.05";
BA_ "NetworkRequestHoldingTime" SG_ 993 Lamp_RrTurnSigLmpLftPCLSta 5000;
BA_ "NetworkRequest" SG_ 993 Lamp_RrTurnSigLmpLftPCLSta 0;
BA_ "UserSigValidity" SG_ 993 Lamp_RrTurnSigLmpLftPCLSta 0;
BA_ "GenSigSendType" SG_ 993 Lamp_RrTurnSigLmpLftPCLSta 4;
BA_ "Description" SG_ 993 Lamp_RrTurnSigLmpLftPCLSta "T/SIG Lamp Rear Left PCL Status";
BA_ "Version" SG_ 993 Lamp_RrTurnSigLmpRtPCLSta "22.07.05";
BA_ "NetworkRequestHoldingTime" SG_ 993 Lamp_RrTurnSigLmpRtPCLSta 5000;
BA_ "NetworkRequest" SG_ 993 Lamp_RrTurnSigLmpRtPCLSta 0;
BA_ "UserSigValidity" SG_ 993 Lamp_RrTurnSigLmpRtPCLSta 0;
BA_ "GenSigSendType" SG_ 993 Lamp_RrTurnSigLmpRtPCLSta 4;
BA_ "Description" SG_ 993 Lamp_RrTurnSigLmpRtPCLSta "T/SIG Lamp Rear Right PCL Status";
BA_ "Version" SG_ 993 HzrdSwPushSta "23.02.13";
BA_ "NetworkRequestHoldingTime" SG_ 993 HzrdSwPushSta 5000;
BA_ "NetworkRequest" SG_ 993 HzrdSwPushSta 0;
BA_ "UserSigValidity" SG_ 993 HzrdSwPushSta 0;
BA_ "GenSigSendType" SG_ 993 HzrdSwPushSta 4;
BA_ "Description" SG_ 993 HzrdSwPushSta "Hazard Switch(self return type) Push State";
BA_ "Version" SG_ 993 Lamp_LftTrnFaultSta "23.02.13";
BA_ "NetworkRequestHoldingTime" SG_ 993 Lamp_LftTrnFaultSta 5000;
BA_ "NetworkRequest" SG_ 993 Lamp_LftTrnFaultSta 0;
BA_ "UserSigValidity" SG_ 993 Lamp_LftTrnFaultSta 0;
BA_ "GenSigSendType" SG_ 993 Lamp_LftTrnFaultSta 4;
BA_ "Description" SG_ 993 Lamp_LftTrnFaultSta "Left Turn Lamp Fault Status";
BA_ "Version" SG_ 993 Lamp_RtTrnFaultSta "23.02.13";
BA_ "NetworkRequestHoldingTime" SG_ 993 Lamp_RtTrnFaultSta 5000;
BA_ "NetworkRequest" SG_ 993 Lamp_RtTrnFaultSta 0;
BA_ "UserSigValidity" SG_ 993 Lamp_RtTrnFaultSta 0;
BA_ "GenSigSendType" SG_ 993 Lamp_RtTrnFaultSta 4;
BA_ "Description" SG_ 993 Lamp_RtTrnFaultSta "Right Turn Lamp Fault Status";
BA_ "Version" SG_ 993 FrtTurnLampOptSta "23.04.00";
BA_ "NetworkRequestHoldingTime" SG_ 993 FrtTurnLampOptSta 5000;
BA_ "NetworkRequest" SG_ 993 FrtTurnLampOptSta 0;
BA_ "UserSigValidity" SG_ 993 FrtTurnLampOptSta 0;
BA_ "GenSigSendType" SG_ 993 FrtTurnLampOptSta 4;
BA_ "Description" SG_ 993 FrtTurnLampOptSta "Front Turn Signal Lamp EOL Option State";
BA_ "Version" SG_ 993 RrTurnLampOptSta "23.04.00";
BA_ "NetworkRequestHoldingTime" SG_ 993 RrTurnLampOptSta 5000;
BA_ "NetworkRequest" SG_ 993 RrTurnLampOptSta 0;
BA_ "UserSigValidity" SG_ 993 RrTurnLampOptSta 0;
BA_ "GenSigSendType" SG_ 993 RrTurnLampOptSta 4;
BA_ "Description" SG_ 993 RrTurnLampOptSta "Rear Turn Signal Lamp EOL Option State";
BA_ "Version" SG_ 993 PDC_FD_AlvCnt2Val "22.10.20";
BA_ "UserSigValidity" SG_ 993 PDC_FD_AlvCnt2Val 3;
BA_ "GenSigSendType" SG_ 993 PDC_FD_AlvCnt2Val 4;
BA_ "Description" SG_ 993 PDC_FD_AlvCnt2Val "For the first transmission request for a data element the counter shall be initialized with 0 and shall be incremented by 1 for every subsequent send request. 

When the counter reaches the maximum value(0xFF), then it shall restart with 0 for the next s";
BA_ "Version" SG_ 993 IntLamp_InlTailLmpSta "17.12.00";
BA_ "NetworkRequestHoldingTime" SG_ 993 IntLamp_InlTailLmpSta 5000;
BA_ "NetworkRequest" SG_ 993 IntLamp_InlTailLmpSta 0;
BA_ "UserSigValidity" SG_ 993 IntLamp_InlTailLmpSta 0;
BA_ "GenSigSendType" SG_ 993 IntLamp_InlTailLmpSta 4;
BA_ "Description" SG_ 993 IntLamp_InlTailLmpSta "-(Old)C_INTTail_Act";
BA_ "Version" SG_ 993 Lamp_FootLampOnReq "17.12.00";
BA_ "NetworkRequestHoldingTime" SG_ 993 Lamp_FootLampOnReq 5000;
BA_ "NetworkRequest" SG_ 993 Lamp_FootLampOnReq 0;
BA_ "UserSigValidity" SG_ 993 Lamp_FootLampOnReq 0;
BA_ "GenSigSendType" SG_ 993 Lamp_FootLampOnReq 4;
BA_ "Description" SG_ 993 Lamp_FootLampOnReq "Foot Lamp Command";
BA_ "Version" SG_ 993 Lamp_MoodLampOnReq "21.07.05";
BA_ "NetworkRequestHoldingTime" SG_ 993 Lamp_MoodLampOnReq 5000;
BA_ "NetworkRequest" SG_ 993 Lamp_MoodLampOnReq 0;
BA_ "UserSigValidity" SG_ 993 Lamp_MoodLampOnReq 0;
BA_ "GenSigSendType" SG_ 993 Lamp_MoodLampOnReq 4;
BA_ "Description" SG_ 993 Lamp_MoodLampOnReq "Mood lamp command";
BA_ "Version" SG_ 993 USM_FuncForMdLmpBrgtSta "21.11.00";
BA_ "NetworkRequestHoldingTime" SG_ 993 USM_FuncForMdLmpBrgtSta 5000;
BA_ "NetworkRequest" SG_ 993 USM_FuncForMdLmpBrgtSta 0;
BA_ "UserSigValidity" SG_ 993 USM_FuncForMdLmpBrgtSta 3;
BA_ "GenSigSendType" SG_ 993 USM_FuncForMdLmpBrgtSta 4;
BA_ "Description" SG_ 993 USM_FuncForMdLmpBrgtSta "USM Function for Mood Lamp bright";
BA_ "Version" SG_ 993 Lamp_HdLmpLoLftOpnSta "17.12.00";
BA_ "NetworkRequestHoldingTime" SG_ 993 Lamp_HdLmpLoLftOpnSta 5000;
BA_ "NetworkRequest" SG_ 993 Lamp_HdLmpLoLftOpnSta 0;
BA_ "UserSigValidity" SG_ 993 Lamp_HdLmpLoLftOpnSta 0;
BA_ "GenSigSendType" SG_ 993 Lamp_HdLmpLoLftOpnSta 4;
BA_ "Description" SG_ 993 Lamp_HdLmpLoLftOpnSta "Head Lamp Low



Left OpenStatus";
BA_ "Version" SG_ 993 Lamp_HdLmpLoRtOpnSta "17.12.00";
BA_ "NetworkRequestHoldingTime" SG_ 993 Lamp_HdLmpLoRtOpnSta 5000;
BA_ "NetworkRequest" SG_ 993 Lamp_HdLmpLoRtOpnSta 0;
BA_ "UserSigValidity" SG_ 993 Lamp_HdLmpLoRtOpnSta 0;
BA_ "GenSigSendType" SG_ 993 Lamp_HdLmpLoRtOpnSta 4;
BA_ "Description" SG_ 993 Lamp_HdLmpLoRtOpnSta "Head Lamp Low Right OpenStatus";
BA_ "Version" SG_ 993 Lamp_HdLmpBiFuncLftOpnSta "19.11.10";
BA_ "NetworkRequestHoldingTime" SG_ 993 Lamp_HdLmpBiFuncLftOpnSta 5000;
BA_ "NetworkRequest" SG_ 993 Lamp_HdLmpBiFuncLftOpnSta 0;
BA_ "UserSigValidity" SG_ 993 Lamp_HdLmpBiFuncLftOpnSta 0;
BA_ "GenSigSendType" SG_ 993 Lamp_HdLmpBiFuncLftOpnSta 4;
BA_ "Description" SG_ 993 Lamp_HdLmpBiFuncLftOpnSta "Bi Function Head Lamp Left Open Status";
BA_ "Version" SG_ 993 Lamp_HdLmpBiFuncRtOpnSta "19.11.10";
BA_ "NetworkRequestHoldingTime" SG_ 993 Lamp_HdLmpBiFuncRtOpnSta 5000;
BA_ "NetworkRequest" SG_ 993 Lamp_HdLmpBiFuncRtOpnSta 0;
BA_ "UserSigValidity" SG_ 993 Lamp_HdLmpBiFuncRtOpnSta 0;
BA_ "GenSigSendType" SG_ 993 Lamp_HdLmpBiFuncRtOpnSta 4;
BA_ "Description" SG_ 993 Lamp_HdLmpBiFuncRtOpnSta "Bi Function Head Lamp Right Open Status";
BA_ "Version" SG_ 993 Lamp_HdLmpHiLftOpnSta "17.12.00";
BA_ "NetworkRequestHoldingTime" SG_ 993 Lamp_HdLmpHiLftOpnSta 5000;
BA_ "NetworkRequest" SG_ 993 Lamp_HdLmpHiLftOpnSta 0;
BA_ "UserSigValidity" SG_ 993 Lamp_HdLmpHiLftOpnSta 0;
BA_ "GenSigSendType" SG_ 993 Lamp_HdLmpHiLftOpnSta 4;
BA_ "Description" SG_ 993 Lamp_HdLmpHiLftOpnSta "Head Lamp High



Left OpenStatus";
BA_ "Version" SG_ 993 Lamp_HdLmpHiRtOpnSta "17.12.00";
BA_ "NetworkRequestHoldingTime" SG_ 993 Lamp_HdLmpHiRtOpnSta 5000;
BA_ "NetworkRequest" SG_ 993 Lamp_HdLmpHiRtOpnSta 0;
BA_ "UserSigValidity" SG_ 993 Lamp_HdLmpHiRtOpnSta 0;
BA_ "GenSigSendType" SG_ 993 Lamp_HdLmpHiRtOpnSta 4;
BA_ "Description" SG_ 993 Lamp_HdLmpHiRtOpnSta "Head Lamp High Right OpenStatus";
BA_ "Version" SG_ 993 ExtLamp_HzrdSwSta "17.12.00";
BA_ "NetworkRequestHoldingTime" SG_ 993 ExtLamp_HzrdSwSta 5000;
BA_ "NetworkRequest" SG_ 993 ExtLamp_HzrdSwSta 0;
BA_ "UserSigValidity" SG_ 993 ExtLamp_HzrdSwSta 0;
BA_ "GenSigSendType" SG_ 993 ExtLamp_HzrdSwSta 4;
BA_ "Version" SG_ 993 Lamp_FrTrnSigLmpLftOpnSta "17.12.00";
BA_ "NetworkRequestHoldingTime" SG_ 993 Lamp_FrTrnSigLmpLftOpnSta 5000;
BA_ "NetworkRequest" SG_ 993 Lamp_FrTrnSigLmpLftOpnSta 0;
BA_ "UserSigValidity" SG_ 993 Lamp_FrTrnSigLmpLftOpnSta 0;
BA_ "GenSigSendType" SG_ 993 Lamp_FrTrnSigLmpLftOpnSta 4;
BA_ "Description" SG_ 993 Lamp_FrTrnSigLmpLftOpnSta "Front T/SIG Lamp



Left OpenStatus";
BA_ "Version" SG_ 993 Lamp_FrTrnSigLmpRtOpnSta "17.12.00";
BA_ "NetworkRequestHoldingTime" SG_ 993 Lamp_FrTrnSigLmpRtOpnSta 5000;
BA_ "NetworkRequest" SG_ 993 Lamp_FrTrnSigLmpRtOpnSta 0;
BA_ "UserSigValidity" SG_ 993 Lamp_FrTrnSigLmpRtOpnSta 0;
BA_ "GenSigSendType" SG_ 993 Lamp_FrTrnSigLmpRtOpnSta 4;
BA_ "Description" SG_ 993 Lamp_FrTrnSigLmpRtOpnSta "Front T/SIG Lamp



Right OpenStatus";
BA_ "Version" SG_ 993 Lamp_RrTrnSigLmpLftOpnSta "17.12.00";
BA_ "NetworkRequestHoldingTime" SG_ 993 Lamp_RrTrnSigLmpLftOpnSta 5000;
BA_ "NetworkRequest" SG_ 993 Lamp_RrTrnSigLmpLftOpnSta 0;
BA_ "UserSigValidity" SG_ 993 Lamp_RrTrnSigLmpLftOpnSta 0;
BA_ "GenSigSendType" SG_ 993 Lamp_RrTrnSigLmpLftOpnSta 4;
BA_ "Description" SG_ 993 Lamp_RrTrnSigLmpLftOpnSta "Rear T/SIG Lamp



Left OpenStatus";
BA_ "Version" SG_ 993 Lamp_RrTrnSigLmpRtOpnSta "17.12.00";
BA_ "NetworkRequestHoldingTime" SG_ 993 Lamp_RrTrnSigLmpRtOpnSta 5000;
BA_ "NetworkRequest" SG_ 993 Lamp_RrTrnSigLmpRtOpnSta 0;
BA_ "UserSigValidity" SG_ 993 Lamp_RrTrnSigLmpRtOpnSta 0;
BA_ "GenSigSendType" SG_ 993 Lamp_RrTrnSigLmpRtOpnSta 4;
BA_ "Description" SG_ 993 Lamp_RrTrnSigLmpRtOpnSta "Rear T/SIG Lamp



Right OpenStatus";
BA_ "Version" SG_ 993 Brake_SwSta_ICU "21.07.05";
BA_ "NetworkRequestHoldingTime" SG_ 993 Brake_SwSta_ICU 5000;
BA_ "NetworkRequest" SG_ 993 Brake_SwSta_ICU 0;
BA_ "UserSigValidity" SG_ 993 Brake_SwSta_ICU 0;
BA_ "GenSigSendType" SG_ 993 Brake_SwSta_ICU 4;
BA_ "Description" SG_ 993 Brake_SwSta_ICU "Brake Switch Status";
BA_ "Version" SG_ 993 BrkLmpCmd "20.08.07";
BA_ "NetworkRequestHoldingTime" SG_ 993 BrkLmpCmd 5000;
BA_ "NetworkRequest" SG_ 993 BrkLmpCmd 0;
BA_ "UserSigValidity" SG_ 993 BrkLmpCmd 0;
BA_ "GenSigSendType" SG_ 993 BrkLmpCmd 4;
BA_ "Description" SG_ 993 BrkLmpCmd "Brake Lamp Control Command";
BA_ "Version" SG_ 992 PDC_FD_Crc1Val "22.10.20";
BA_ "UserSigValidity" SG_ 992 PDC_FD_Crc1Val 3;
BA_ "GenSigStartValue" SG_ 992 PDC_FD_Crc1Val 65535;
BA_ "GenSigSendType" SG_ 992 PDC_FD_Crc1Val 4;
BA_ "Description" SG_ 992 PDC_FD_Crc1Val "The data area for CRC calculation is based on the data length (DLC) of the message DB.

The CRC shall be calculated over the entire data block (excluding the CRC bytes) including the user data, alive counter and Data ID



- CRC Polynomial (0x1021) , Ini";
BA_ "Version" SG_ 992 C_3rdRCSeatBeltSW "18.03.04";
BA_ "NetworkRequestHoldingTime" SG_ 992 C_3rdRCSeatBeltSW 5000;
BA_ "NetworkRequest" SG_ 992 C_3rdRCSeatBeltSW 0;
BA_ "UserSigValidity" SG_ 992 C_3rdRCSeatBeltSW 0;
BA_ "GenSigSendType" SG_ 992 C_3rdRCSeatBeltSW 4;
BA_ "Description" SG_ 992 C_3rdRCSeatBeltSW "3rd Rear Center Seat Belt Switch Status";
BA_ "Version" SG_ 992 C_3rdRRSeatBeltSW "18.03.04";
BA_ "NetworkRequestHoldingTime" SG_ 992 C_3rdRRSeatBeltSW 5000;
BA_ "NetworkRequest" SG_ 992 C_3rdRRSeatBeltSW 0;
BA_ "UserSigValidity" SG_ 992 C_3rdRRSeatBeltSW 0;
BA_ "GenSigSendType" SG_ 992 C_3rdRRSeatBeltSW 4;
BA_ "Description" SG_ 992 C_3rdRRSeatBeltSW "3rd Rear Right Seat Belt Switch Status";
BA_ "Version" SG_ 992 C_1stCTRSeatBeltSW "19.04.06";
BA_ "NetworkRequestHoldingTime" SG_ 992 C_1stCTRSeatBeltSW 5000;
BA_ "NetworkRequest" SG_ 992 C_1stCTRSeatBeltSW 0;
BA_ "UserSigValidity" SG_ 992 C_1stCTRSeatBeltSW 0;
BA_ "GenSigSendType" SG_ 992 C_1stCTRSeatBeltSW 4;
BA_ "Description" SG_ 992 C_1stCTRSeatBeltSW "1st Center Seat Belt Switch Status";
BA_ "Version" SG_ 992 Warn_DrvStOccSta "22.05.04";
BA_ "NetworkRequestHoldingTime" SG_ 992 Warn_DrvStOccSta 5000;
BA_ "NetworkRequest" SG_ 992 Warn_DrvStOccSta 0;
BA_ "UserSigValidity" SG_ 992 Warn_DrvStOccSta 0;
BA_ "GenSigSendType" SG_ 992 Warn_DrvStOccSta 4;
BA_ "Description" SG_ 992 Warn_DrvStOccSta "Driver Presence Detection MAT Switch Status";
BA_ "Version" SG_ 992 DPDMat_HDPSpprtSWVer "21.12.04";
BA_ "UserSigValidity" SG_ 992 DPDMat_HDPSpprtSWVer 3;
BA_ "GenSigSendType" SG_ 992 DPDMat_HDPSpprtSWVer 4;
BA_ "Description" SG_ 992 DPDMat_HDPSpprtSWVer "This signal indicates HDP-DPD Mat signal processing Requirement Spec Version";
BA_ "Version" SG_ 992 Warn_PassStOccSta "17.12.00";
BA_ "NetworkRequestHoldingTime" SG_ 992 Warn_PassStOccSta 5000;
BA_ "NetworkRequest" SG_ 992 Warn_PassStOccSta 0;
BA_ "UserSigValidity" SG_ 992 Warn_PassStOccSta 0;
BA_ "GenSigSendType" SG_ 992 Warn_PassStOccSta 4;
BA_ "Description" SG_ 992 Warn_PassStOccSta "Passenger Seated State







-Default value: 0x0 (미탑승)



-Initial value: 0x0 (미탑승)



-Timeout value: 0x0 (미탑승)";
BA_ "Version" SG_ 992 Warn_RrLftSBRMATSwSta "21.11.00";
BA_ "NetworkRequestHoldingTime" SG_ 992 Warn_RrLftSBRMATSwSta 5000;
BA_ "NetworkRequest" SG_ 992 Warn_RrLftSBRMATSwSta 0;
BA_ "UserSigValidity" SG_ 992 Warn_RrLftSBRMATSwSta 0;
BA_ "GenSigSendType" SG_ 992 Warn_RrLftSBRMATSwSta 4;
BA_ "Description" SG_ 992 Warn_RrLftSBRMATSwSta "Rear Left Seated State";
BA_ "Version" SG_ 992 Warn_RrRhtSBRMATSwSta "21.11.00";
BA_ "NetworkRequestHoldingTime" SG_ 992 Warn_RrRhtSBRMATSwSta 5000;
BA_ "NetworkRequest" SG_ 992 Warn_RrRhtSBRMATSwSta 0;
BA_ "UserSigValidity" SG_ 992 Warn_RrRhtSBRMATSwSta 0;
BA_ "GenSigSendType" SG_ 992 Warn_RrRhtSBRMATSwSta 4;
BA_ "Description" SG_ 992 Warn_RrRhtSBRMATSwSta "Rear Right Seated State";
BA_ "Version" SG_ 992 C_3rdRLSBRMatSw "18.03.04";
BA_ "NetworkRequestHoldingTime" SG_ 992 C_3rdRLSBRMatSw 5000;
BA_ "NetworkRequest" SG_ 992 C_3rdRLSBRMatSw 0;
BA_ "UserSigValidity" SG_ 992 C_3rdRLSBRMatSw 0;
BA_ "GenSigSendType" SG_ 992 C_3rdRLSBRMatSw 4;
BA_ "Description" SG_ 992 C_3rdRLSBRMatSw "3rd Rear Left Seated State



-Default value: 0x0 (미탑승)

-Initial value: 0x0 (미탑승)

-Timeout value: 0x0 (미탑승)";
BA_ "Version" SG_ 992 C_3rdRRSBRMatSw "18.03.04";
BA_ "NetworkRequestHoldingTime" SG_ 992 C_3rdRRSBRMatSw 5000;
BA_ "NetworkRequest" SG_ 992 C_3rdRRSBRMatSw 0;
BA_ "UserSigValidity" SG_ 992 C_3rdRRSBRMatSw 0;
BA_ "GenSigSendType" SG_ 992 C_3rdRRSBRMatSw 4;
BA_ "Description" SG_ 992 C_3rdRRSBRMatSw "3rd Rear Right Seated State



-Default value: 0x0 (미탑승)

-Initial value: 0x0 (미탑승)

-Timeout value: 0x0 (미탑승)";
BA_ "Version" SG_ 992 C_1stCTRSBRMatSw "19.04.06";
BA_ "NetworkRequestHoldingTime" SG_ 992 C_1stCTRSBRMatSw 5000;
BA_ "NetworkRequest" SG_ 992 C_1stCTRSBRMatSw 0;
BA_ "UserSigValidity" SG_ 992 C_1stCTRSBRMatSw 0;
BA_ "GenSigSendType" SG_ 992 C_1stCTRSBRMatSw 4;
BA_ "Description" SG_ 992 C_1stCTRSBRMatSw "1st Center Seated State



-Default value: 0x0 (미탑승)

-Initial value: 0x0 (미탑승)

-Timeout value: 0x0 (미탑승)";
BA_ "Version" SG_ 992 StrWhlWrmrSwState "20.08.07";
BA_ "UserSigValidity" SG_ 992 StrWhlWrmrSwState 4;
BA_ "GenSigSendType" SG_ 992 StrWhlWrmrSwState 4;
BA_ "Description" SG_ 992 StrWhlWrmrSwState "PDC Steering Wheel Warmer Self Return Type Manual Switch State";
BA_ "Version" SG_ 992 StrWhlWrmrFlModDetail "20.08.07";
BA_ "UserSigValidity" SG_ 992 StrWhlWrmrFlModDetail 4;
BA_ "GenSigSendType" SG_ 992 StrWhlWrmrFlModDetail 4;
BA_ "Description" SG_ 992 StrWhlWrmrFlModDetail "Steering Wheel Warmer Fail Mode Detail Information";
BA_ "Version" SG_ 992 FrHtdGlsSwState "20.08.07";
BA_ "UserSigValidity" SG_ 992 FrHtdGlsSwState 4;
BA_ "GenSigSendType" SG_ 992 FrHtdGlsSwState 4;
BA_ "Description" SG_ 992 FrHtdGlsSwState "Front Heated Glass Switch State";
BA_ "Version" SG_ 992 RrGlsHtSwState "21.01.06";
BA_ "UserSigValidity" SG_ 992 RrGlsHtSwState 4;
BA_ "GenSigSendType" SG_ 992 RrGlsHtSwState 4;
BA_ "Description" SG_ 992 RrGlsHtSwState "Rear Glass Heated Switch State";
BA_ "Version" SG_ 992 RLChldLkLatchSwState "20.08.07";
BA_ "NetworkRequestHoldingTime" SG_ 992 RLChldLkLatchSwState 5000;
BA_ "NetworkRequest" SG_ 992 RLChldLkLatchSwState 0;
BA_ "UserSigValidity" SG_ 992 RLChldLkLatchSwState 0;
BA_ "GenSigSendType" SG_ 992 RLChldLkLatchSwState 4;
BA_ "Description" SG_ 992 RLChldLkLatchSwState "Rear Left Electric Child Lock Latch Lock Unlock State";
BA_ "Version" SG_ 992 RRChldLkLatchSwState "20.08.07";
BA_ "NetworkRequestHoldingTime" SG_ 992 RRChldLkLatchSwState 5000;
BA_ "NetworkRequest" SG_ 992 RRChldLkLatchSwState 0;
BA_ "UserSigValidity" SG_ 992 RRChldLkLatchSwState 0;
BA_ "GenSigSendType" SG_ 992 RRChldLkLatchSwState 4;
BA_ "Description" SG_ 992 RRChldLkLatchSwState "Rear Right Electric Child Lock Latch Lock Unlock State";
BA_ "Version" SG_ 992 ChildLock_ActnFlSta "17.12.00";
BA_ "NetworkRequestHoldingTime" SG_ 992 ChildLock_ActnFlSta 5000;
BA_ "NetworkRequest" SG_ 992 ChildLock_ActnFlSta 0;
BA_ "UserSigValidity" SG_ 992 ChildLock_ActnFlSta 0;
BA_ "GenSigSendType" SG_ 992 ChildLock_ActnFlSta 4;
BA_ "Description" SG_ 992 ChildLock_ActnFlSta "Child Lock actuation failed";
BA_ "Version" SG_ 992 DoorLock_LkOutSta "17.12.00";
BA_ "NetworkRequestHoldingTime" SG_ 992 DoorLock_LkOutSta 5000;
BA_ "NetworkRequest" SG_ 992 DoorLock_LkOutSta 0;
BA_ "UserSigValidity" SG_ 992 DoorLock_LkOutSta 0;
BA_ "GenSigSendType" SG_ 992 DoorLock_LkOutSta 4;
BA_ "Description" SG_ 992 DoorLock_LkOutSta "- Door Lock or Unlock Output State 



0x0 : Off (Door lock/unlock output Off state)



0x1 : On (Door lock/unlock output On state)";
BA_ "Version" SG_ 992 VSAutoDrLkRetryFailSta "21.11.00";
BA_ "NetworkRequestHoldingTime" SG_ 992 VSAutoDrLkRetryFailSta 5000;
BA_ "NetworkRequest" SG_ 992 VSAutoDrLkRetryFailSta 0;
BA_ "UserSigValidity" SG_ 992 VSAutoDrLkRetryFailSta 6;
BA_ "TimeoutValue" SG_ 992 VSAutoDrLkRetryFailSta "0x0";
BA_ "GenSigSendType" SG_ 992 VSAutoDrLkRetryFailSta 4;
BA_ "Description" SG_ 992 VSAutoDrLkRetryFailSta "Door lock fail status after vehicle speed auto door lock retry 3 times";
BA_ "Version" SG_ 992 Trunk_TrnkTlgtOutReleaseSwSta "23.04.02";
BA_ "NetworkRequestHoldingTime" SG_ 992 Trunk_TrnkTlgtOutReleaseSwSta 5000;
BA_ "NetworkRequest" SG_ 992 Trunk_TrnkTlgtOutReleaseSwSta 0;
BA_ "UserSigValidity" SG_ 992 Trunk_TrnkTlgtOutReleaseSwSta 0;
BA_ "GenSigSendType" SG_ 992 Trunk_TrnkTlgtOutReleaseSwSta 4;
BA_ "Description" SG_ 992 Trunk_TrnkTlgtOutReleaseSwSta "-(Old)C_TRUNK_LID

-Trunk/Tailgate Outter Release SW";
BA_ "Version" SG_ 992 Trunk_TrnkInReleaseSwSta "23.04.02";
BA_ "NetworkRequestHoldingTime" SG_ 992 Trunk_TrnkInReleaseSwSta 5000;
BA_ "NetworkRequest" SG_ 992 Trunk_TrnkInReleaseSwSta 0;
BA_ "UserSigValidity" SG_ 992 Trunk_TrnkInReleaseSwSta 0;
BA_ "GenSigSendType" SG_ 992 Trunk_TrnkInReleaseSwSta 4;
BA_ "Description" SG_ 992 Trunk_TrnkInReleaseSwSta "-Trunk Inner Release SW";
BA_ "Version" SG_ 992 Trunk_GlvBxTrnkLkSwSta "17.12.00";
BA_ "NetworkRequestHoldingTime" SG_ 992 Trunk_GlvBxTrnkLkSwSta 5000;
BA_ "NetworkRequest" SG_ 992 Trunk_GlvBxTrnkLkSwSta 0;
BA_ "UserSigValidity" SG_ 992 Trunk_GlvBxTrnkLkSwSta 0;
BA_ "GenSigSendType" SG_ 992 Trunk_GlvBxTrnkLkSwSta 4;
BA_ "Description" SG_ 992 Trunk_GlvBxTrnkLkSwSta "- Glove Box Trunk Lock SW";
BA_ "Version" SG_ 992 Trunk_TrnkTlgtSwSta "17.12.00";
BA_ "NetworkRequestHoldingTime" SG_ 992 Trunk_TrnkTlgtSwSta 5000;
BA_ "NetworkRequest" SG_ 992 Trunk_TrnkTlgtSwSta 0;
BA_ "UserSigValidity" SG_ 992 Trunk_TrnkTlgtSwSta 0;
BA_ "GenSigSendType" SG_ 992 Trunk_TrnkTlgtSwSta 4;
BA_ "Description" SG_ 992 Trunk_TrnkTlgtSwSta "Full Lock SW Status Signal



(TailGate/TrunkLid Tpye all)



1. Luggage or Trunkroom Lamp On/Off



2. TailGate/TrunkLid Open Ind in cluster



3. Normal Open SW



  - SW Off: Full Lock(Full Close state)



  - SW On: ^Full Lock";
BA_ "Version" SG_ 992 Trunk_TlgtFullOpnSwSta "17.12.00";
BA_ "NetworkRequestHoldingTime" SG_ 992 Trunk_TlgtFullOpnSwSta 5000;
BA_ "NetworkRequest" SG_ 992 Trunk_TlgtFullOpnSwSta 0;
BA_ "UserSigValidity" SG_ 992 Trunk_TlgtFullOpnSwSta 0;
BA_ "GenSigSendType" SG_ 992 Trunk_TlgtFullOpnSwSta 4;
BA_ "Description" SG_ 992 Trunk_TlgtFullOpnSwSta "Full Open SW Status Signal



(Power TailGate/TrunkLid Tpye or tailgate latch 2sw type)



* Normal Open SW



  - SW Off: ^Full Open



  - SW On: Full Open(Full Open state)";
BA_ "Version" SG_ 992 Trunk_TrnkTlgtReleaseRlySta "17.12.00";
BA_ "NetworkRequestHoldingTime" SG_ 992 Trunk_TrnkTlgtReleaseRlySta 5000;
BA_ "NetworkRequest" SG_ 992 Trunk_TrnkTlgtReleaseRlySta 0;
BA_ "UserSigValidity" SG_ 992 Trunk_TrnkTlgtReleaseRlySta 0;
BA_ "GenSigSendType" SG_ 992 Trunk_TrnkTlgtReleaseRlySta 4;
BA_ "Version" SG_ 992 FrtWiper_ParkingSwState "23.04.06";
BA_ "UserSigValidity" SG_ 992 FrtWiper_ParkingSwState 0;
BA_ "TimeoutValue" SG_ 992 FrtWiper_ParkingSwState "0x0";
BA_ "GenSigSendType" SG_ 992 FrtWiper_ParkingSwState 4;
BA_ "Description" SG_ 992 FrtWiper_ParkingSwState "Front wiper parking switch state";
BA_ "Version" SG_ 992 PDC_TlgtUnLkSta "24.01.00";
BA_ "NetworkRequestHoldingTime" SG_ 992 PDC_TlgtUnLkSta 5000;
BA_ "NetworkRequest" SG_ 992 PDC_TlgtUnLkSta 0;
BA_ "UserSigValidity" SG_ 992 PDC_TlgtUnLkSta 0;
BA_ "GenSigSendType" SG_ 992 PDC_TlgtUnLkSta 4;
BA_ "Description" SG_ 992 PDC_TlgtUnLkSta "Tailgate unlocked status of MPV vehicle with twin swing tailgate";
BA_ "Version" SG_ 992 PDC_PSDPwrModeOffSwSta "24.01.00";
BA_ "NetworkRequestHoldingTime" SG_ 992 PDC_PSDPwrModeOffSwSta 5000;
BA_ "NetworkRequest" SG_ 992 PDC_PSDPwrModeOffSwSta 0;
BA_ "UserSigValidity" SG_ 992 PDC_PSDPwrModeOffSwSta 0;
BA_ "GenSigSendType" SG_ 992 PDC_PSDPwrModeOffSwSta 4;
BA_ "Description" SG_ 992 PDC_PSDPwrModeOffSwSta "PSD power mode off switch state(Self-return type)

-'On' value is output only during the time the switch is pressed";
BA_ "Version" SG_ 992 PDC_FuelDrOpenSta "24.04.03";
BA_ "NetworkRequestHoldingTime" SG_ 992 PDC_FuelDrOpenSta 5000;
BA_ "NetworkRequest" SG_ 992 PDC_FuelDrOpenSta 0;
BA_ "UserSigValidity" SG_ 992 PDC_FuelDrOpenSta 0;
BA_ "GenSigSendType" SG_ 992 PDC_FuelDrOpenSta 4;
BA_ "Description" SG_ 992 PDC_FuelDrOpenSta "Fuel door open status(Open/Close)

Fuel door switch located in fuel door, thus switch states means physical status of fuel door(Open/Close)";
BA_ "Version" SG_ 992 PDC_FD_AlvCnt1Val "22.10.20";
BA_ "UserSigValidity" SG_ 992 PDC_FD_AlvCnt1Val 3;
BA_ "GenSigSendType" SG_ 992 PDC_FD_AlvCnt1Val 4;
BA_ "Description" SG_ 992 PDC_FD_AlvCnt1Val "For the first transmission request for a data element the counter shall be initialized with 0 and shall be incremented by 1 for every subsequent send request. 

When the counter reaches the maximum value(0xFF), then it shall restart with 0 for the next s";
BA_ "Version" SG_ 992 OBCWakeupDrLock "19.04.06";
BA_ "UserSigValidity" SG_ 992 OBCWakeupDrLock 0;
BA_ "GenSigSendType" SG_ 992 OBCWakeupDrLock 4;
BA_ "Description" SG_ 992 OBCWakeupDrLock "This signal is for OBC wake-up, When ICU Lock event";
BA_ "Version" SG_ 992 OBCWakeupDrUnlock "19.04.06";
BA_ "UserSigValidity" SG_ 992 OBCWakeupDrUnlock 0;
BA_ "GenSigSendType" SG_ 992 OBCWakeupDrUnlock 4;
BA_ "Description" SG_ 992 OBCWakeupDrUnlock "This signal is for OBC wake-up, When ICU Unlock event";
BA_ "Version" SG_ 992 Trunk_BgtOpnHzrdReq "22.07.06";
BA_ "NetworkRequestHoldingTime" SG_ 992 Trunk_BgtOpnHzrdReq 5000;
BA_ "NetworkRequest" SG_ 992 Trunk_BgtOpnHzrdReq 0;
BA_ "UserSigValidity" SG_ 992 Trunk_BgtOpnHzrdReq 0;
BA_ "GenSigSendType" SG_ 992 Trunk_BgtOpnHzrdReq 4;
BA_ "Description" SG_ 992 Trunk_BgtOpnHzrdReq "Hazzard Request by Bedgate Open";
BA_ "Version" SG_ 992 Trunk_BgtOpnBzrReq "22.07.06";
BA_ "NetworkRequestHoldingTime" SG_ 992 Trunk_BgtOpnBzrReq 5000;
BA_ "NetworkRequest" SG_ 992 Trunk_BgtOpnBzrReq 0;
BA_ "UserSigValidity" SG_ 992 Trunk_BgtOpnBzrReq 0;
BA_ "GenSigSendType" SG_ 992 Trunk_BgtOpnBzrReq 4;
BA_ "Description" SG_ 992 Trunk_BgtOpnBzrReq "Buzzer Request by Bedgate Open";
BA_ "Version" SG_ 992 IGN3State "23.09.00";
BA_ "UserSigValidity" SG_ 992 IGN3State 7;
BA_ "TimeoutValue" SG_ 992 IGN3State "0x0";
BA_ "GenSigSendType" SG_ 992 IGN3State 4;
BA_ "Description" SG_ 992 IGN3State "Output status of ignition 3";
BA_ "Version" SG_ 992 IGN3State_By_BMS "23.02.02";
BA_ "UserSigValidity" SG_ 992 IGN3State_By_BMS 7;
BA_ "TimeoutValue" SG_ 992 IGN3State_By_BMS "0x0";
BA_ "GenSigSendType" SG_ 992 IGN3State_By_BMS 4;
BA_ "Description" SG_ 992 IGN3State_By_BMS "Output status of ignition 3 by BMS request";
BA_ "Version" SG_ 992 IGN3State_By_VCMS_HMU "23.02.02";
BA_ "UserSigValidity" SG_ 992 IGN3State_By_VCMS_HMU 7;
BA_ "TimeoutValue" SG_ 992 IGN3State_By_VCMS_HMU "0x0";
BA_ "GenSigSendType" SG_ 992 IGN3State_By_VCMS_HMU 4;
BA_ "Description" SG_ 992 IGN3State_By_VCMS_HMU "Output status of ignition 3 by VCMS(PHEV/EV) or HMU(FCEV) request";
BA_ "Version" SG_ 992 IGN3State_By_AfterBlow "23.02.02";
BA_ "UserSigValidity" SG_ 992 IGN3State_By_AfterBlow 7;
BA_ "TimeoutValue" SG_ 992 IGN3State_By_AfterBlow "0x0";
BA_ "GenSigSendType" SG_ 992 IGN3State_By_AfterBlow 4;
BA_ "Description" SG_ 992 IGN3State_By_AfterBlow "Output status of ignition 3 by DATC(FATC/MTC) request for after blow";
BA_ "Version" SG_ 992 IGN3State_By_Bat "23.02.01";
BA_ "UserSigValidity" SG_ 992 IGN3State_By_Bat 7;
BA_ "TimeoutValue" SG_ 992 IGN3State_By_Bat "0x0";
BA_ "GenSigSendType" SG_ 992 IGN3State_By_Bat 4;
BA_ "Description" SG_ 992 IGN3State_By_Bat "Output status of ignition 3 by IBS or BMS request for HEV 12V auxiliary battery charging";
BA_ "Version" SG_ 992 IGN3State_By_VCU_HCU_FCU "23.02.02";
BA_ "UserSigValidity" SG_ 992 IGN3State_By_VCU_HCU_FCU 7;
BA_ "TimeoutValue" SG_ 992 IGN3State_By_VCU_HCU_FCU "0x0";
BA_ "GenSigSendType" SG_ 992 IGN3State_By_VCU_HCU_FCU 4;
BA_ "Description" SG_ 992 IGN3State_By_VCU_HCU_FCU "Output status of ignition 3 by VCU(EV) or HCU(HEV/PHEV) or FCU(FCEV) request";
BA_ "Version" SG_ 992 IGN3State_By_HU "23.02.02";
BA_ "UserSigValidity" SG_ 992 IGN3State_By_HU 7;
BA_ "TimeoutValue" SG_ 992 IGN3State_By_HU "0x0";
BA_ "GenSigSendType" SG_ 992 IGN3State_By_HU 4;
BA_ "Description" SG_ 992 IGN3State_By_HU "Output status of ignition 3 by HU(AVNT) or CCU request for CCS";
BA_ "Version" SG_ 992 IGN3CutOffState "24.07.06";
BA_ "UserSigValidity" SG_ 992 IGN3CutOffState 7;
BA_ "TimeoutValue" SG_ 992 IGN3CutOffState "0x0";
BA_ "GenSigSendType" SG_ 992 IGN3CutOffState 4;
BA_ "Description" SG_ 992 IGN3CutOffState "Output status of ignition 3 Cut Off



0x0:CutOffNotApplied (Cut Off Funtion Not Applied in PDC)

0x1:NoRequest (No IGN3 Request)

0x2:Normal (IGN3 Request and Power State is OK)

0x3:PreWarn (IGN3 Request and Power State is NOK, IGN3 Cut Off PreWarning)";
BA_ "Version" SG_ 992 SeatBeltSwSta_Drv "23.07.03";
BA_ "NetworkRequestHoldingTime" SG_ 992 SeatBeltSwSta_Drv 5000;
BA_ "NetworkRequest" SG_ 992 SeatBeltSwSta_Drv 0;
BA_ "UserSigValidity" SG_ 992 SeatBeltSwSta_Drv 0;
BA_ "GenSigSendType" SG_ 992 SeatBeltSwSta_Drv 4;
BA_ "Description" SG_ 992 SeatBeltSwSta_Drv "Driver Seat Belt Switch Status.

This signal is set as 'Not Supported' if the seat belt is not installed for EDR law(UN ECE R160.01) and EURO NCAP";
BA_ "Version" SG_ 992 SeatBeltSwSta_1stCtr "23.07.03";
BA_ "NetworkRequestHoldingTime" SG_ 992 SeatBeltSwSta_1stCtr 5000;
BA_ "NetworkRequest" SG_ 992 SeatBeltSwSta_1stCtr 0;
BA_ "UserSigValidity" SG_ 992 SeatBeltSwSta_1stCtr 0;
BA_ "GenSigSendType" SG_ 992 SeatBeltSwSta_1stCtr 4;
BA_ "Description" SG_ 992 SeatBeltSwSta_1stCtr "1st Center Seat Belt Switch Status

This signal is set as 'Not Supported' if the seat belt is not installed for EDR law(UN ECE R160.01) and EURO NCAP";
BA_ "Version" SG_ 992 SeatBeltSwSta_Asst "23.07.03";
BA_ "NetworkRequestHoldingTime" SG_ 992 SeatBeltSwSta_Asst 5000;
BA_ "NetworkRequest" SG_ 992 SeatBeltSwSta_Asst 0;
BA_ "UserSigValidity" SG_ 992 SeatBeltSwSta_Asst 0;
BA_ "GenSigSendType" SG_ 992 SeatBeltSwSta_Asst 4;
BA_ "Description" SG_ 992 SeatBeltSwSta_Asst "Assistance Seat Belt Switch Status

This signal is set as 'Not Supported' if the seat belt is not installed for EDR law(UN ECE R160.01) and EURO NCAP";
BA_ "Version" SG_ 992 SeatBeltSwSta_2ndLft "23.07.03";
BA_ "NetworkRequestHoldingTime" SG_ 992 SeatBeltSwSta_2ndLft 5000;
BA_ "NetworkRequest" SG_ 992 SeatBeltSwSta_2ndLft 0;
BA_ "UserSigValidity" SG_ 992 SeatBeltSwSta_2ndLft 0;
BA_ "GenSigSendType" SG_ 992 SeatBeltSwSta_2ndLft 4;
BA_ "Description" SG_ 992 SeatBeltSwSta_2ndLft "2nd Left Seat Belt Switch Status

This signal is set as 'Not Supported' if the seat belt is not installed for EDR law(UN ECE R160.01) and EURO NCAP";
BA_ "Version" SG_ 992 SeatBeltSwSta_2ndCtr "23.07.03";
BA_ "NetworkRequestHoldingTime" SG_ 992 SeatBeltSwSta_2ndCtr 5000;
BA_ "NetworkRequest" SG_ 992 SeatBeltSwSta_2ndCtr 0;
BA_ "UserSigValidity" SG_ 992 SeatBeltSwSta_2ndCtr 0;
BA_ "GenSigSendType" SG_ 992 SeatBeltSwSta_2ndCtr 4;
BA_ "Description" SG_ 992 SeatBeltSwSta_2ndCtr "2nd Center Seat Belt Switch Status

This signal is set as 'Not Supported' if the seat belt is not installed for EDR law(UN ECE R160.01) and EURO NCAP";
BA_ "Version" SG_ 992 SeatBeltSwSta_2ndRt "23.07.03";
BA_ "NetworkRequestHoldingTime" SG_ 992 SeatBeltSwSta_2ndRt 5000;
BA_ "NetworkRequest" SG_ 992 SeatBeltSwSta_2ndRt 0;
BA_ "UserSigValidity" SG_ 992 SeatBeltSwSta_2ndRt 0;
BA_ "GenSigSendType" SG_ 992 SeatBeltSwSta_2ndRt 4;
BA_ "Description" SG_ 992 SeatBeltSwSta_2ndRt "2nd Right Seat Belt Switch Status

This signal is set as 'Not Supported' if the seat belt is not installed for EDR law(UN ECE R160.01) and EURO NCAP";
BA_ "Version" SG_ 992 SeatBeltSwSta_3rdLft "23.07.03";
BA_ "NetworkRequestHoldingTime" SG_ 992 SeatBeltSwSta_3rdLft 5000;
BA_ "NetworkRequest" SG_ 992 SeatBeltSwSta_3rdLft 0;
BA_ "UserSigValidity" SG_ 992 SeatBeltSwSta_3rdLft 0;
BA_ "GenSigSendType" SG_ 992 SeatBeltSwSta_3rdLft 4;
BA_ "Description" SG_ 992 SeatBeltSwSta_3rdLft "3rd Left Seat Belt Switch Status

This signal is set as 'Not Supported' if the seat belt is not installed for EDR law(UN ECE R160.01) and EURO NCAP";
BA_ "Version" SG_ 992 SeatBeltSwSta_3rdCtr "23.07.03";
BA_ "NetworkRequestHoldingTime" SG_ 992 SeatBeltSwSta_3rdCtr 5000;
BA_ "NetworkRequest" SG_ 992 SeatBeltSwSta_3rdCtr 0;
BA_ "UserSigValidity" SG_ 992 SeatBeltSwSta_3rdCtr 0;
BA_ "GenSigSendType" SG_ 992 SeatBeltSwSta_3rdCtr 4;
BA_ "Description" SG_ 992 SeatBeltSwSta_3rdCtr "3rd Center Seat Belt Switch Status

This signal is set as 'Not Supported' if the seat belt is not installed for EDR law(UN ECE R160.01) and EURO NCAP";
BA_ "Version" SG_ 992 SeatBeltSwSta_3rdRt "23.07.03";
BA_ "NetworkRequestHoldingTime" SG_ 992 SeatBeltSwSta_3rdRt 5000;
BA_ "NetworkRequest" SG_ 992 SeatBeltSwSta_3rdRt 0;
BA_ "UserSigValidity" SG_ 992 SeatBeltSwSta_3rdRt 0;
BA_ "GenSigSendType" SG_ 992 SeatBeltSwSta_3rdRt 4;
BA_ "Description" SG_ 992 SeatBeltSwSta_3rdRt "3rd Right Seat Belt Switch Status

This signal is set as 'Not Supported' if the seat belt is not installed for EDR law(UN ECE R160.01) and EURO NCAP";
BA_ "Version" SG_ 992 SeatBelt4th_InstallInfo "23.07.05";
BA_ "NetworkRequestHoldingTime" SG_ 992 SeatBelt4th_InstallInfo 5000;
BA_ "NetworkRequest" SG_ 992 SeatBelt4th_InstallInfo 0;
BA_ "UserSigValidity" SG_ 992 SeatBelt4th_InstallInfo 0;
BA_ "GenSigSendType" SG_ 992 SeatBelt4th_InstallInfo 4;
BA_ "Description" SG_ 992 SeatBelt4th_InstallInfo "4th Seat Belt installation Information";
BA_ "Version" SG_ 992 PDCex_CurtainOpt "23.07.04";
BA_ "UserSigValidity" SG_ 992 PDCex_CurtainOpt 0;
BA_ "GenSigSendType" SG_ 992 PDCex_CurtainOpt 4;
BA_ "Description" SG_ 992 PDCex_CurtainOpt "PDCex Curtain Option Information

0x0 : No Curtain

0x1 : Rear Curtain Only

0x2 : Quarter Glass Curtain Only

0x3 : All Curtain(Rear+Quarter Glass Curtain)";
BA_ "Version" SG_ 992 Reprogram_State_PDC2 "24.04.09";
BA_ "NetworkRequestHoldingTime" SG_ 992 Reprogram_State_PDC2 5000;
BA_ "NetworkRequest" SG_ 992 Reprogram_State_PDC2 0;
BA_ "UserSigValidity" SG_ 992 Reprogram_State_PDC2 0;
BA_ "TimeoutValue" SG_ 992 Reprogram_State_PDC2 "0x1";
BA_ "GenSigStartValue" SG_ 992 Reprogram_State_PDC2 3;
BA_ "GenSigSendType" SG_ 992 Reprogram_State_PDC2 4;
BA_ "Description" SG_ 992 Reprogram_State_PDC2 "This signal indicates reprogramming progress of PDC.

0x0: normal operation / 0x1: reprogramming / 0x2: RESERVED /0x3: Invalid (default)";
BA_ "Version" SG_ 992 Warn_RrCTRSBRMATSwSta "24.05.00";
BA_ "NetworkRequestHoldingTime" SG_ 992 Warn_RrCTRSBRMATSwSta 5000;
BA_ "NetworkRequest" SG_ 992 Warn_RrCTRSBRMATSwSta 0;
BA_ "UserSigValidity" SG_ 992 Warn_RrCTRSBRMATSwSta 0;
BA_ "GenSigSendType" SG_ 992 Warn_RrCTRSBRMATSwSta 4;
BA_ "Description" SG_ 992 Warn_RrCTRSBRMATSwSta "2nd Center SBR MAT Switch State";
BA_ "Version" SG_ 992 C_3rdRCSBRMatSw "24.05.00";
BA_ "NetworkRequestHoldingTime" SG_ 992 C_3rdRCSBRMatSw 5000;
BA_ "NetworkRequest" SG_ 992 C_3rdRCSBRMatSw 0;
BA_ "UserSigValidity" SG_ 992 C_3rdRCSBRMatSw 0;
BA_ "GenSigSendType" SG_ 992 C_3rdRCSBRMatSw 4;
BA_ "Description" SG_ 992 C_3rdRCSBRMatSw "3rd Rear Center SBR MAT Switch State";
BA_ "Version" SG_ 992 DriveTypeOption "21.11.00";
BA_ "NetworkRequestHoldingTime" SG_ 992 DriveTypeOption 5000;
BA_ "NetworkRequest" SG_ 992 DriveTypeOption 0;
BA_ "UserSigValidity" SG_ 992 DriveTypeOption 0;
BA_ "GenSigSendType" SG_ 992 DriveTypeOption 4;
BA_ "Description" SG_ 992 DriveTypeOption "Drive Type Option

This signal is used to determine driver's seat position('Drive Type') about this vehicle.";
BA_ "Version" SG_ 992 AutoLtOpt "20.09.00";
BA_ "UserSigValidity" SG_ 992 AutoLtOpt 0;
BA_ "GenSigSendType" SG_ 992 AutoLtOpt 4;
BA_ "Description" SG_ 992 AutoLtOpt "Auto Light 사양 적용 여부 및 적용 옵션 정보 출력 (미적용/적용)";
BA_ "Version" SG_ 992 HLmpLoHiOptLtSrcTyp "20.09.00";
BA_ "UserSigValidity" SG_ 992 HLmpLoHiOptLtSrcTyp 0;
BA_ "GenSigSendType" SG_ 992 HLmpLoHiOptLtSrcTyp 4;
BA_ "Description" SG_ 992 HLmpLoHiOptLtSrcTyp "Head Low and High Lamp Option and Light Source Type";
BA_ "Version" SG_ 992 C_StrgWhlHeatingOpt "23.02.02";
BA_ "UserSigValidity" SG_ 992 C_StrgWhlHeatingOpt 0;
BA_ "GenSigSendType" SG_ 992 C_StrgWhlHeatingOpt 4;
BA_ "Description" SG_ 992 C_StrgWhlHeatingOpt "Steering wheel heating option signal";
BA_ "Version" SG_ 992 C_StrgWhlHeatingSWInf "19.11.11";
BA_ "UserSigValidity" SG_ 992 C_StrgWhlHeatingSWInf 3;
BA_ "GenSigSendType" SG_ 992 C_StrgWhlHeatingSWInf 4;
BA_ "Description" SG_ 992 C_StrgWhlHeatingSWInf "Steering wheel heating Step information signal";
BA_ "Version" SG_ 992 ICU_MtGearPosRSta "21.07.05";
BA_ "UserSigValidity" SG_ 992 ICU_MtGearPosRSta 3;
BA_ "GenSigSendType" SG_ 992 ICU_MtGearPosRSta 4;
BA_ "Description" SG_ 992 ICU_MtGearPosRSta "Manual Shift Lever R Switch Status 0x0:Off/0x1:On";
BA_ "Version" SG_ 992 C_AutoLeverManualSW "19.09.06";
BA_ "UserSigValidity" SG_ 992 C_AutoLeverManualSW 3;
BA_ "GenSigSendType" SG_ 992 C_AutoLeverManualSW 4;
BA_ "Description" SG_ 992 C_AutoLeverManualSW "This signal represents operating status of AT/CVT/DCT Lever Manual Switch";
BA_ "Version" SG_ 992 Warn_HoodSwMemorySta "21.11.00";
BA_ "NetworkRequestHoldingTime" SG_ 992 Warn_HoodSwMemorySta 5000;
BA_ "NetworkRequest" SG_ 992 Warn_HoodSwMemorySta 0;
BA_ "UserSigValidity" SG_ 992 Warn_HoodSwMemorySta 3;
BA_ "GenSigSendType" SG_ 992 Warn_HoodSwMemorySta 4;
BA_ "Description" SG_ 992 Warn_HoodSwMemorySta "Hood swtich open->close information(memory)



This signal is for oil level warning lamp reset In case hood open->close when IG-OFF, 0x01 sent for 5 sec at next IG-ON";
BA_ "Version" SG_ 992 Warn_PrkngBrkSwSta "17.12.00";
BA_ "NetworkRequestHoldingTime" SG_ 992 Warn_PrkngBrkSwSta 5000;
BA_ "NetworkRequest" SG_ 992 Warn_PrkngBrkSwSta 0;
BA_ "UserSigValidity" SG_ 992 Warn_PrkngBrkSwSta 0;
BA_ "GenSigSendType" SG_ 992 Warn_PrkngBrkSwSta 4;
BA_ "Version" SG_ 992 PrkngBrkNotchSwState "20.08.07";
BA_ "NetworkRequestHoldingTime" SG_ 992 PrkngBrkNotchSwState 5000;
BA_ "NetworkRequest" SG_ 992 PrkngBrkNotchSwState 0;
BA_ "UserSigValidity" SG_ 992 PrkngBrkNotchSwState 0;
BA_ "GenSigSendType" SG_ 992 PrkngBrkNotchSwState 4;
BA_ "Description" SG_ 992 PrkngBrkNotchSwState "Parking Brake High Notch Switch State";
BA_ "Version" SG_ 992 Warn_BrkFldSwSta "17.12.00";
BA_ "NetworkRequestHoldingTime" SG_ 992 Warn_BrkFldSwSta 5000;
BA_ "NetworkRequest" SG_ 992 Warn_BrkFldSwSta 0;
BA_ "UserSigValidity" SG_ 992 Warn_BrkFldSwSta 0;
BA_ "GenSigSendType" SG_ 992 Warn_BrkFldSwSta 4;
BA_ "Version" SG_ 992 Warn_WshrFldSwSta "21.07.05";
BA_ "NetworkRequestHoldingTime" SG_ 992 Warn_WshrFldSwSta 5000;
BA_ "NetworkRequest" SG_ 992 Warn_WshrFldSwSta 0;
BA_ "UserSigValidity" SG_ 992 Warn_WshrFldSwSta 3;
BA_ "GenSigSendType" SG_ 992 Warn_WshrFldSwSta 4;
BA_ "Description" SG_ 992 Warn_WshrFldSwSta "Washer Fluid Switch Signal

This signal indicates Washer Fluid Switch Signal

0x0:Off/0x1:On";
BA_ "Version" SG_ 992 Warn_DrvStBltSwSta "17.12.00";
BA_ "NetworkRequestHoldingTime" SG_ 992 Warn_DrvStBltSwSta 5000;
BA_ "NetworkRequest" SG_ 992 Warn_DrvStBltSwSta 0;
BA_ "UserSigValidity" SG_ 992 Warn_DrvStBltSwSta 0;
BA_ "GenSigSendType" SG_ 992 Warn_DrvStBltSwSta 4;
BA_ "Version" SG_ 992 Warn_AsstStBltSwSta "17.12.00";
BA_ "NetworkRequestHoldingTime" SG_ 992 Warn_AsstStBltSwSta 5000;
BA_ "NetworkRequest" SG_ 992 Warn_AsstStBltSwSta 0;
BA_ "UserSigValidity" SG_ 992 Warn_AsstStBltSwSta 0;
BA_ "GenSigStartValue" SG_ 992 Warn_AsstStBltSwSta 1;
BA_ "GenSigSendType" SG_ 992 Warn_AsstStBltSwSta 4;
BA_ "Description" SG_ 992 Warn_AsstStBltSwSta "-Default value: 0x1 (Belt)



-Initial value: 0x1 (Belt)



-Timeout value: 0x1 (Belt)";
BA_ "Version" SG_ 992 Warn_RrLftStBltSwSta "17.12.00";
BA_ "NetworkRequestHoldingTime" SG_ 992 Warn_RrLftStBltSwSta 5000;
BA_ "NetworkRequest" SG_ 992 Warn_RrLftStBltSwSta 0;
BA_ "UserSigValidity" SG_ 992 Warn_RrLftStBltSwSta 0;
BA_ "GenSigSendType" SG_ 992 Warn_RrLftStBltSwSta 4;
BA_ "Version" SG_ 992 Warn_RrCtrStBltSwSta "17.12.00";
BA_ "NetworkRequestHoldingTime" SG_ 992 Warn_RrCtrStBltSwSta 5000;
BA_ "NetworkRequest" SG_ 992 Warn_RrCtrStBltSwSta 0;
BA_ "UserSigValidity" SG_ 992 Warn_RrCtrStBltSwSta 0;
BA_ "GenSigSendType" SG_ 992 Warn_RrCtrStBltSwSta 4;
BA_ "Version" SG_ 992 Warn_RrRtStBltSwSta "17.12.00";
BA_ "NetworkRequestHoldingTime" SG_ 992 Warn_RrRtStBltSwSta 5000;
BA_ "NetworkRequest" SG_ 992 Warn_RrRtStBltSwSta 0;
BA_ "UserSigValidity" SG_ 992 Warn_RrRtStBltSwSta 0;
BA_ "GenSigSendType" SG_ 992 Warn_RrRtStBltSwSta 4;
BA_ "Version" SG_ 992 C_3rdRLSeatBeltSW "18.03.04";
BA_ "NetworkRequestHoldingTime" SG_ 992 C_3rdRLSeatBeltSW 5000;
BA_ "NetworkRequest" SG_ 992 C_3rdRLSeatBeltSW 0;
BA_ "UserSigValidity" SG_ 992 C_3rdRLSeatBeltSW 0;
BA_ "GenSigSendType" SG_ 992 C_3rdRLSeatBeltSW 4;
BA_ "Description" SG_ 992 C_3rdRLSeatBeltSW "3rd Rear Left Seat Belt Switch Status";
BA_ "Version" SG_ 995 PDC_FD_Crc4Val "22.10.20";
BA_ "UserSigValidity" SG_ 995 PDC_FD_Crc4Val 3;
BA_ "GenSigStartValue" SG_ 995 PDC_FD_Crc4Val 65535;
BA_ "GenSigSendType" SG_ 995 PDC_FD_Crc4Val 4;
BA_ "Description" SG_ 995 PDC_FD_Crc4Val "The data area for CRC calculation is based on the data length (DLC) of the message DB.

The CRC shall be calculated over the entire data block (excluding the CRC bytes) including the user data, alive counter and Data ID



- CRC Polynomial (0x1021) , Ini";
BA_ "Version" SG_ 995 PDC_FD_AlvCnt4Val "22.10.20";
BA_ "UserSigValidity" SG_ 995 PDC_FD_AlvCnt4Val 3;
BA_ "GenSigSendType" SG_ 995 PDC_FD_AlvCnt4Val 4;
BA_ "Description" SG_ 995 PDC_FD_AlvCnt4Val "For the first transmission request for a data element the counter shall be initialized with 0 and shall be incremented by 1 for every subsequent send request. 

When the counter reaches the maximum value(0xFF), then it shall restart with 0 for the next s";
BA_ "Version" SG_ 995 ICU_Haptic_OPT "18.07.07";
BA_ "NetworkRequestHoldingTime" SG_ 995 ICU_Haptic_OPT 5000;
BA_ "NetworkRequest" SG_ 995 ICU_Haptic_OPT 0;
BA_ "UserSigValidity" SG_ 995 ICU_Haptic_OPT 0;
BA_ "GenSigSendType" SG_ 995 ICU_Haptic_OPT 4;
BA_ "Description" SG_ 995 ICU_Haptic_OPT "Steering Wheel Haptic Warning Option Infomation (From ICU)";
BA_ "Version" SG_ 995 HSWS_SysWrngSta_ICU "21.11.00";
BA_ "UserSigValidity" SG_ 995 HSWS_SysWrngSta_ICU 4;
BA_ "GenSigSendType" SG_ 995 HSWS_SysWrngSta_ICU 4;
BA_ "Description" SG_ 995 HSWS_SysWrngSta_ICU "0x0 : Normal

0x1 : System Fail

0x2 : Reserved

0x3 : Invalid";
BA_ "Version" SG_ 995 ICU_PwrWdwMvInhbtSta "19.02.05";
BA_ "NetworkRequestHoldingTime" SG_ 995 ICU_PwrWdwMvInhbtSta 5000;
BA_ "NetworkRequest" SG_ 995 ICU_PwrWdwMvInhbtSta 0;
BA_ "UserSigValidity" SG_ 995 ICU_PwrWdwMvInhbtSta 0;
BA_ "GenSigSendType" SG_ 995 ICU_PwrWdwMvInhbtSta 4;
BA_ "Version" SG_ 995 Warn_OSMirrFoldSwState "18.12.01";
BA_ "NetworkRequestHoldingTime" SG_ 995 Warn_OSMirrFoldSwState 5000;
BA_ "NetworkRequest" SG_ 995 Warn_OSMirrFoldSwState 0;
BA_ "UserSigValidity" SG_ 995 Warn_OSMirrFoldSwState 0;
BA_ "GenSigSendType" SG_ 995 Warn_OSMirrFoldSwState 4;
BA_ "Description" SG_ 995 Warn_OSMirrFoldSwState "Outside Mirror folding Sw input signal. It has two type .

1) 0x0 : FOLD , 0x1: UNFOLD or Auto (Seasaw type folding SW)

2) 0x0 :OFF , 0x1 : ON (Self Return Type Folding SW)";
BA_ "Version" SG_ 995 USM_OneTouchTrnSigFuncSta "21.07.05";
BA_ "NetworkRequestHoldingTime" SG_ 995 USM_OneTouchTrnSigFuncSta 5000;
BA_ "NetworkRequest" SG_ 995 USM_OneTouchTrnSigFuncSta 0;
BA_ "UserSigValidity" SG_ 995 USM_OneTouchTrnSigFuncSta 0;
BA_ "GenSigSendType" SG_ 995 USM_OneTouchTrnSigFuncSta 4;
BA_ "Description" SG_ 995 USM_OneTouchTrnSigFuncSta "This signal is 



- For One Touch Turn Signal Function,



 the advanced version of One Touch triple turn signal



- Communicated with Cluster for setting USM



- Periodic Event Signal to notice current staus to USM of Cluster";
BA_ "Version" SG_ 995 ExtLamp_TrnSigLmpLftSwSta "18.08.07";
BA_ "NetworkRequestHoldingTime" SG_ 995 ExtLamp_TrnSigLmpLftSwSta 5000;
BA_ "NetworkRequest" SG_ 995 ExtLamp_TrnSigLmpLftSwSta 0;
BA_ "UserSigValidity" SG_ 995 ExtLamp_TrnSigLmpLftSwSta 0;
BA_ "GenSigSendType" SG_ 995 ExtLamp_TrnSigLmpLftSwSta 4;
BA_ "Version" SG_ 995 ExtLamp_TrnSigLmpRtSwSta "18.08.07";
BA_ "NetworkRequestHoldingTime" SG_ 995 ExtLamp_TrnSigLmpRtSwSta 5000;
BA_ "NetworkRequest" SG_ 995 ExtLamp_TrnSigLmpRtSwSta 0;
BA_ "UserSigValidity" SG_ 995 ExtLamp_TrnSigLmpRtSwSta 0;
BA_ "GenSigSendType" SG_ 995 ExtLamp_TrnSigLmpRtSwSta 4;
BA_ "Version" SG_ 995 Lamp_LaneChgTrnSigLftSwSta_ICU "18.09.05";
BA_ "NetworkRequestHoldingTime" SG_ 995 Lamp_LaneChgTrnSigLftSwSta_ICU 5000;
BA_ "NetworkRequest" SG_ 995 Lamp_LaneChgTrnSigLftSwSta_ICU 0;
BA_ "UserSigValidity" SG_ 995 Lamp_LaneChgTrnSigLftSwSta_ICU 0;
BA_ "GenSigSendType" SG_ 995 Lamp_LaneChgTrnSigLftSwSta_ICU 4;
BA_ "Description" SG_ 995 Lamp_LaneChgTrnSigLftSwSta_ICU "LANE CHANGE TURN SIGNAL FOR LH";
BA_ "Version" SG_ 995 Lamp_LaneChgTrnSigRtSwSta_ICU "18.09.05";
BA_ "NetworkRequestHoldingTime" SG_ 995 Lamp_LaneChgTrnSigRtSwSta_ICU 5000;
BA_ "NetworkRequest" SG_ 995 Lamp_LaneChgTrnSigRtSwSta_ICU 0;
BA_ "UserSigValidity" SG_ 995 Lamp_LaneChgTrnSigRtSwSta_ICU 0;
BA_ "GenSigSendType" SG_ 995 Lamp_LaneChgTrnSigRtSwSta_ICU 4;
BA_ "Description" SG_ 995 Lamp_LaneChgTrnSigRtSwSta_ICU "LANE CHANGE TURN SIGNAL FOR RH";
BA_ "Version" SG_ 995 ICU_HDPSpprtRdy "22.03.02";
BA_ "UserSigValidity" SG_ 995 ICU_HDPSpprtRdy 3;
BA_ "GenSigSendType" SG_ 995 ICU_HDPSpprtRdy 4;
BA_ "Description" SG_ 995 ICU_HDPSpprtRdy "This signal is the received state information signal of the ADAS message.";
BA_ "Version" SG_ 995 HzrdLmp_HDPSpprtSWVer "21.12.04";
BA_ "UserSigValidity" SG_ 995 HzrdLmp_HDPSpprtSWVer 3;
BA_ "GenSigSendType" SG_ 995 HzrdLmp_HDPSpprtSWVer 4;
BA_ "Description" SG_ 995 HzrdLmp_HDPSpprtSWVer "This signal indicates HDP-HAZARD Lamp control Requirement Spec Version";
BA_ "Version" SG_ 995 Lamp_TrnSigLmpLftOnReq "22.05.04";
BA_ "NetworkRequestHoldingTime" SG_ 995 Lamp_TrnSigLmpLftOnReq 5000;
BA_ "NetworkRequest" SG_ 995 Lamp_TrnSigLmpLftOnReq 0;
BA_ "UserSigValidity" SG_ 995 Lamp_TrnSigLmpLftOnReq 0;
BA_ "GenSigSendType" SG_ 995 Lamp_TrnSigLmpLftOnReq 4;
BA_ "Version" SG_ 995 Lamp_TrnSigLmpRtOnReq "22.05.04";
BA_ "NetworkRequestHoldingTime" SG_ 995 Lamp_TrnSigLmpRtOnReq 5000;
BA_ "NetworkRequest" SG_ 995 Lamp_TrnSigLmpRtOnReq 0;
BA_ "UserSigValidity" SG_ 995 Lamp_TrnSigLmpRtOnReq 0;
BA_ "GenSigSendType" SG_ 995 Lamp_TrnSigLmpRtOnReq 4;
BA_ "Version" SG_ 995 Lamp_TrnSigLmpLftActiveSt "21.11.00";
BA_ "NetworkRequestHoldingTime" SG_ 995 Lamp_TrnSigLmpLftActiveSt 5000;
BA_ "NetworkRequest" SG_ 995 Lamp_TrnSigLmpLftActiveSt 0;
BA_ "UserSigValidity" SG_ 995 Lamp_TrnSigLmpLftActiveSt 0;
BA_ "GenSigSendType" SG_ 995 Lamp_TrnSigLmpLftActiveSt 4;
BA_ "Description" SG_ 995 Lamp_TrnSigLmpLftActiveSt "Turn Signal Lmap Blink Info";
BA_ "Version" SG_ 995 Lamp_TrnSigLmpRtActiveSt "21.11.00";
BA_ "NetworkRequestHoldingTime" SG_ 995 Lamp_TrnSigLmpRtActiveSt 5000;
BA_ "NetworkRequest" SG_ 995 Lamp_TrnSigLmpRtActiveSt 0;
BA_ "UserSigValidity" SG_ 995 Lamp_TrnSigLmpRtActiveSt 0;
BA_ "GenSigSendType" SG_ 995 Lamp_TrnSigLmpRtActiveSt 4;
BA_ "Description" SG_ 995 Lamp_TrnSigLmpRtActiveSt "Turn Signal Lamp Blink Info";
BA_ "Version" SG_ 995 TrnLmpSeqEnblCmd "20.08.07";
BA_ "NetworkRequestHoldingTime" SG_ 995 TrnLmpSeqEnblCmd 5000;
BA_ "NetworkRequest" SG_ 995 TrnLmpSeqEnblCmd 0;
BA_ "UserSigValidity" SG_ 995 TrnLmpSeqEnblCmd 0;
BA_ "GenSigSendType" SG_ 995 TrnLmpSeqEnblCmd 4;
BA_ "Description" SG_ 995 TrnLmpSeqEnblCmd "Turn Signal Sequential Enable CAN Command";
BA_ "Version" SG_ 995 CrashHazardLampOnReq "24.07.06";
BA_ "NetworkRequestHoldingTime" SG_ 995 CrashHazardLampOnReq 5000;
BA_ "NetworkRequest" SG_ 995 CrashHazardLampOnReq 0;
BA_ "UserSigValidity" SG_ 995 CrashHazardLampOnReq 0;
BA_ "GenSigSendType" SG_ 995 CrashHazardLampOnReq 4;
BA_ "Description" SG_ 995 CrashHazardLampOnReq "Hazard lamp on request by crash for EURO NCAP2030";
BA_ "Version" SG_ 994 PDC_FD_Crc3Val "22.10.20";
BA_ "UserSigValidity" SG_ 994 PDC_FD_Crc3Val 3;
BA_ "GenSigStartValue" SG_ 994 PDC_FD_Crc3Val 65535;
BA_ "GenSigSendType" SG_ 994 PDC_FD_Crc3Val 4;
BA_ "Description" SG_ 994 PDC_FD_Crc3Val "The data area for CRC calculation is based on the data length (DLC) of the message DB.

The CRC shall be calculated over the entire data block (excluding the CRC bytes) including the user data, alive counter and Data ID



- CRC Polynomial (0x1021) , Ini";
BA_ "Version" SG_ 994 PDC_FD_AlvCnt3Val "22.10.20";
BA_ "UserSigValidity" SG_ 994 PDC_FD_AlvCnt3Val 3;
BA_ "GenSigSendType" SG_ 994 PDC_FD_AlvCnt3Val 4;
BA_ "Description" SG_ 994 PDC_FD_AlvCnt3Val "For the first transmission request for a data element the counter shall be initialized with 0 and shall be incremented by 1 for every subsequent send request. 

When the counter reaches the maximum value(0xFF), then it shall restart with 0 for the next s";
BA_ "Version" SG_ 994 Warn_DrvDrSwSta "17.12.00";
BA_ "NetworkRequestHoldingTime" SG_ 994 Warn_DrvDrSwSta 5000;
BA_ "NetworkRequest" SG_ 994 Warn_DrvDrSwSta 0;
BA_ "UserSigValidity" SG_ 994 Warn_DrvDrSwSta 0;
BA_ "GenSigSendType" SG_ 994 Warn_DrvDrSwSta 4;
BA_ "Version" SG_ 994 Warn_AsstDrSwSta "17.12.00";
BA_ "NetworkRequestHoldingTime" SG_ 994 Warn_AsstDrSwSta 5000;
BA_ "NetworkRequest" SG_ 994 Warn_AsstDrSwSta 0;
BA_ "UserSigValidity" SG_ 994 Warn_AsstDrSwSta 0;
BA_ "GenSigSendType" SG_ 994 Warn_AsstDrSwSta 4;
BA_ "Version" SG_ 994 Warn_RrLftDrSwSta "17.12.00";
BA_ "NetworkRequestHoldingTime" SG_ 994 Warn_RrLftDrSwSta 5000;
BA_ "NetworkRequest" SG_ 994 Warn_RrLftDrSwSta 0;
BA_ "UserSigValidity" SG_ 994 Warn_RrLftDrSwSta 0;
BA_ "GenSigSendType" SG_ 994 Warn_RrLftDrSwSta 4;
BA_ "Version" SG_ 994 Warn_RrRtDrSwSta "17.12.00";
BA_ "NetworkRequestHoldingTime" SG_ 994 Warn_RrRtDrSwSta 5000;
BA_ "NetworkRequest" SG_ 994 Warn_RrRtDrSwSta 0;
BA_ "UserSigValidity" SG_ 994 Warn_RrRtDrSwSta 0;
BA_ "GenSigSendType" SG_ 994 Warn_RrRtDrSwSta 4;
BA_ "Version" SG_ 994 Warn_HoodSwSta "17.12.00";
BA_ "NetworkRequestHoldingTime" SG_ 994 Warn_HoodSwSta 5000;
BA_ "NetworkRequest" SG_ 994 Warn_HoodSwSta 0;
BA_ "UserSigValidity" SG_ 994 Warn_HoodSwSta 0;
BA_ "GenSigSendType" SG_ 994 Warn_HoodSwSta 4;
BA_ "Version" SG_ 994 DoorLock_DrvDrUnLkSta "21.09.05";
BA_ "NetworkRequestHoldingTime" SG_ 994 DoorLock_DrvDrUnLkSta 5000;
BA_ "NetworkRequest" SG_ 994 DoorLock_DrvDrUnLkSta 0;
BA_ "UserSigValidity" SG_ 994 DoorLock_DrvDrUnLkSta 0;
BA_ "GenSigSendType" SG_ 994 DoorLock_DrvDrUnLkSta 4;
BA_ "Version" SG_ 994 DoorLock_AsstDrUnLkSta "17.12.00";
BA_ "NetworkRequestHoldingTime" SG_ 994 DoorLock_AsstDrUnLkSta 5000;
BA_ "NetworkRequest" SG_ 994 DoorLock_AsstDrUnLkSta 0;
BA_ "UserSigValidity" SG_ 994 DoorLock_AsstDrUnLkSta 0;
BA_ "GenSigSendType" SG_ 994 DoorLock_AsstDrUnLkSta 4;
BA_ "Version" SG_ 994 DoorLock_RrLftDrUnLkSta "17.12.00";
BA_ "NetworkRequestHoldingTime" SG_ 994 DoorLock_RrLftDrUnLkSta 5000;
BA_ "NetworkRequest" SG_ 994 DoorLock_RrLftDrUnLkSta 0;
BA_ "UserSigValidity" SG_ 994 DoorLock_RrLftDrUnLkSta 0;
BA_ "GenSigSendType" SG_ 994 DoorLock_RrLftDrUnLkSta 4;
BA_ "Version" SG_ 994 DoorLock_RrRtDrUnLkSta "17.12.00";
BA_ "NetworkRequestHoldingTime" SG_ 994 DoorLock_RrRtDrUnLkSta 5000;
BA_ "NetworkRequest" SG_ 994 DoorLock_RrRtDrUnLkSta 0;
BA_ "UserSigValidity" SG_ 994 DoorLock_RrRtDrUnLkSta 0;
BA_ "GenSigSendType" SG_ 994 DoorLock_RrRtDrUnLkSta 4;
BA_ "Version" SG_ 994 DoorLock_DrvKeyLkSwSta "17.12.00";
BA_ "NetworkRequestHoldingTime" SG_ 994 DoorLock_DrvKeyLkSwSta 5000;
BA_ "NetworkRequest" SG_ 994 DoorLock_DrvKeyLkSwSta 0;
BA_ "UserSigValidity" SG_ 994 DoorLock_DrvKeyLkSwSta 0;
BA_ "GenSigSendType" SG_ 994 DoorLock_DrvKeyLkSwSta 4;
BA_ "Version" SG_ 994 DoorLock_DrvKeyUnLkSwSta "17.12.00";
BA_ "NetworkRequestHoldingTime" SG_ 994 DoorLock_DrvKeyUnLkSwSta 5000;
BA_ "NetworkRequest" SG_ 994 DoorLock_DrvKeyUnLkSwSta 0;
BA_ "UserSigValidity" SG_ 994 DoorLock_DrvKeyUnLkSwSta 0;
BA_ "GenSigSendType" SG_ 994 DoorLock_DrvKeyUnLkSwSta 4;
BA_ "Version" SG_ 994 DoorLock_CtrlDrLkSwSta_ICU "19.07.01";
BA_ "NetworkRequestHoldingTime" SG_ 994 DoorLock_CtrlDrLkSwSta_ICU 5000;
BA_ "NetworkRequest" SG_ 994 DoorLock_CtrlDrLkSwSta_ICU 0;
BA_ "UserSigValidity" SG_ 994 DoorLock_CtrlDrLkSwSta_ICU 0;
BA_ "GenSigSendType" SG_ 994 DoorLock_CtrlDrLkSwSta_ICU 4;
BA_ "Description" SG_ 994 DoorLock_CtrlDrLkSwSta_ICU "Central Door Lock Switch State

(DRV or AST or RL or RR Door trim)";
BA_ "Version" SG_ 994 DoorLock_CtrlDrUnLkSwSta_ICU "19.07.01";
BA_ "NetworkRequestHoldingTime" SG_ 994 DoorLock_CtrlDrUnLkSwSta_ICU 5000;
BA_ "NetworkRequest" SG_ 994 DoorLock_CtrlDrUnLkSwSta_ICU 0;
BA_ "UserSigValidity" SG_ 994 DoorLock_CtrlDrUnLkSwSta_ICU 0;
BA_ "GenSigSendType" SG_ 994 DoorLock_CtrlDrUnLkSwSta_ICU 4;
BA_ "Description" SG_ 994 DoorLock_CtrlDrUnLkSwSta_ICU "Central Door Unlock Switch State

(DRV or AST or RL or RR Door trim)";
BA_ "Version" SG_ 994 DoorLock_CtrlDrLkUnLkSwSta_ICU "19.07.01";
BA_ "NetworkRequestHoldingTime" SG_ 994 DoorLock_CtrlDrLkUnLkSwSta_ICU 5000;
BA_ "NetworkRequest" SG_ 994 DoorLock_CtrlDrLkUnLkSwSta_ICU 0;
BA_ "UserSigValidity" SG_ 994 DoorLock_CtrlDrLkUnLkSwSta_ICU 0;
BA_ "GenSigSendType" SG_ 994 DoorLock_CtrlDrLkUnLkSwSta_ICU 4;
BA_ "Description" SG_ 994 DoorLock_CtrlDrLkUnLkSwSta_ICU "Central Door Lock/Unlock Switch State

(C/PAD, Integrated & self return type)";
BA_ "Version" SG_ 994 C_CrashUnlockState "21.07.05";
BA_ "NetworkRequest" SG_ 994 C_CrashUnlockState 0;
BA_ "UserSigValidity" SG_ 994 C_CrashUnlockState 0;
BA_ "GenSigSendType" SG_ 994 C_CrashUnlockState 4;
BA_ "Description" SG_ 994 C_CrashUnlockState "Crash Unlock Active State

-0x0:Off

-0x1:Unlock(crash)";
BA_ "Version" SG_ 994 Lamp_LedHdLmpSta "21.11.00";
BA_ "NetworkRequestHoldingTime" SG_ 994 Lamp_LedHdLmpSta 5000;
BA_ "NetworkRequest" SG_ 994 Lamp_LedHdLmpSta 0;
BA_ "UserSigValidity" SG_ 994 Lamp_LedHdLmpSta 3;
BA_ "GenSigSendType" SG_ 994 Lamp_LedHdLmpSta 4;
BA_ "Description" SG_ 994 Lamp_LedHdLmpSta "This signal is LED headlamp status inform whether LED fail or not which is regulation of ECE, Domestic.



If LED H/Lamp detects LED failure then a cluster shall be turn on to 'LED' indicator in the display panel and It should be to display the words 'Ch";
BA_ "Version" SG_ 994 Warn_ChaDrSwFrtSta "18.08.12";
BA_ "UserSigValidity" SG_ 994 Warn_ChaDrSwFrtSta 7;
BA_ "GenSigSendType" SG_ 994 Warn_ChaDrSwFrtSta 4;
BA_ "Description" SG_ 994 Warn_ChaDrSwFrtSta "Front Charging Door Open Switch";
BA_ "Version" SG_ 994 Warn_ChaDrSwRrSta "18.08.12";
BA_ "UserSigValidity" SG_ 994 Warn_ChaDrSwRrSta 7;
BA_ "GenSigSendType" SG_ 994 Warn_ChaDrSwRrSta 4;
BA_ "Description" SG_ 994 Warn_ChaDrSwRrSta "Rear Charging Door Open Switch";
BA_ "Version" SG_ 997 PDC_FD_Crc11Val "22.10.20";
BA_ "UserSigValidity" SG_ 997 PDC_FD_Crc11Val 3;
BA_ "GenSigStartValue" SG_ 997 PDC_FD_Crc11Val 65535;
BA_ "GenSigSendType" SG_ 997 PDC_FD_Crc11Val 4;
BA_ "Description" SG_ 997 PDC_FD_Crc11Val "The data area for CRC calculation is based on the data length (DLC) of the message DB.

The CRC shall be calculated over the entire data block (excluding the CRC bytes) including the user data, alive counter and Data ID



- CRC Polynomial (0x1021) , Ini";
BA_ "Version" SG_ 997 ICU_BS1ValFlagSta "21.11.00";
BA_ "UserSigValidity" SG_ 997 ICU_BS1ValFlagSta 3;
BA_ "GenSigStartValue" SG_ 997 ICU_BS1ValFlagSta 1;
BA_ "GenSigSendType" SG_ 997 ICU_BS1ValFlagSta 4;
BA_ "Description" SG_ 997 ICU_BS1ValFlagSta "setting condition is depending on battery sensor self diagnosis information";
BA_ "Version" SG_ 997 ICU_BS1ErrRes "21.11.00";
BA_ "UserSigValidity" SG_ 997 ICU_BS1ErrRes 3;
BA_ "GenSigStartValue" SG_ 997 ICU_BS1ErrRes 1;
BA_ "GenSigSendType" SG_ 997 ICU_BS1ErrRes 4;
BA_ "Version" SG_ 997 ICU_BS2SoC "21.09.05";
BA_ "UserSigValidity" SG_ 997 ICU_BS2SoC 3;
BA_ "GenSigStartValue" SG_ 997 ICU_BS2SoC 255;
BA_ "GenSigSendType" SG_ 997 ICU_BS2SoC 4;
BA_ "Description" SG_ 997 ICU_BS2SoC "This signal is battery State of Charge as calculated by battery sensor.";
BA_ "Version" SG_ 997 ICU_BS2NCap "21.07.05";
BA_ "UserSigValidity" SG_ 997 ICU_BS2NCap 3;
BA_ "GenSigStartValue" SG_ 997 ICU_BS2NCap 255;
BA_ "GenSigSendType" SG_ 997 ICU_BS2NCap 4;
BA_ "Description" SG_ 997 ICU_BS2NCap "Nominal capacity";
BA_ "Version" SG_ 997 ICU_BS2OpnCirVol "21.07.05";
BA_ "UserSigValidity" SG_ 997 ICU_BS2OpnCirVol 3;
BA_ "GenSigStartValue" SG_ 997 ICU_BS2OpnCirVol 4095;
BA_ "GenSigSendType" SG_ 997 ICU_BS2OpnCirVol 4;
BA_ "Description" SG_ 997 ICU_BS2OpnCirVol "Last open circuit voltage";
BA_ "Version" SG_ 997 ICU_BS2_FSOC "18.08.03";
BA_ "UserSigValidity" SG_ 997 ICU_BS2_FSOC 3;
BA_ "GenSigStartValue" SG_ 997 ICU_BS2_FSOC 1;
BA_ "GenSigSendType" SG_ 997 ICU_BS2_FSOC 4;
BA_ "Description" SG_ 997 ICU_BS2_FSOC "This signal indicates whether the state of SOC signal is fault or not";
BA_ "Version" SG_ 997 ICU_BS2_FSOH "18.08.03";
BA_ "UserSigValidity" SG_ 997 ICU_BS2_FSOH 3;
BA_ "GenSigStartValue" SG_ 997 ICU_BS2_FSOH 1;
BA_ "GenSigSendType" SG_ 997 ICU_BS2_FSOH 4;
BA_ "Description" SG_ 997 ICU_BS2_FSOH "This signal indicates whether the state of SOH signal is fault or not";
BA_ "Version" SG_ 997 ICU_BS2_FSOF "18.08.03";
BA_ "UserSigValidity" SG_ 997 ICU_BS2_FSOF 3;
BA_ "GenSigStartValue" SG_ 997 ICU_BS2_FSOF 1;
BA_ "GenSigSendType" SG_ 997 ICU_BS2_FSOF 4;
BA_ "Description" SG_ 997 ICU_BS2_FSOF "This signal indicates whether the state of SOF signal is fault or not";
BA_ "Version" SG_ 997 ICU_BS2_FQSTAT "18.08.03";
BA_ "UserSigValidity" SG_ 997 ICU_BS2_FQSTAT 3;
BA_ "GenSigStartValue" SG_ 997 ICU_BS2_FQSTAT 1;
BA_ "GenSigSendType" SG_ 997 ICU_BS2_FQSTAT 4;
BA_ "Description" SG_ 997 ICU_BS2_FQSTAT "This signal indicates whether quiescent current is high or not compared to pre-defined value";
BA_ "Version" SG_ 997 ICU_BS2SoH "21.07.05";
BA_ "UserSigValidity" SG_ 997 ICU_BS2SoH 3;
BA_ "GenSigStartValue" SG_ 997 ICU_BS2SoH 255;
BA_ "GenSigSendType" SG_ 997 ICU_BS2SoH 4;
BA_ "Description" SG_ 997 ICU_BS2SoH "This signal is battery State of Health(SOH) as calculated by battery sensor.



This value shows reduction rate of nominal capacity.



This value can be used for diagnosis information of application system.";
BA_ "Version" SG_ 997 ICU_BS2SoF "21.07.05";
BA_ "UserSigValidity" SG_ 997 ICU_BS2SoF 3;
BA_ "GenSigStartValue" SG_ 997 ICU_BS2SoF 255;
BA_ "GenSigSendType" SG_ 997 ICU_BS2SoF 4;
BA_ "Description" SG_ 997 ICU_BS2SoF "This signal is battery State of Function(SOF) as calculated by battery sensor.



This value shows information about the battery ability to crank the engine (both of warm & cold cranking).



This value is prediction value of the minimum voltage for the ";
BA_ "Version" SG_ 997 PDC_FD_AlvCnt11Val "22.10.20";
BA_ "UserSigValidity" SG_ 997 PDC_FD_AlvCnt11Val 3;
BA_ "GenSigSendType" SG_ 997 PDC_FD_AlvCnt11Val 4;
BA_ "Description" SG_ 997 PDC_FD_AlvCnt11Val "For the first transmission request for a data element the counter shall be initialized with 0 and shall be incremented by 1 for every subsequent send request. 

When the counter reaches the maximum value(0xFF), then it shall restart with 0 for the next s";
BA_ "Version" SG_ 997 ICU_BS1BatVol_Dis "24.05.02";
BA_ "UserSigValidity" SG_ 997 ICU_BS1BatVol_Dis 3;
BA_ "GenSigStartValue" SG_ 997 ICU_BS1BatVol_Dis 16383;
BA_ "GenSigSendType" SG_ 997 ICU_BS1BatVol_Dis 4;
BA_ "Description" SG_ 997 ICU_BS1BatVol_Dis "This is the battery voltage for displaying on the ANVT, CLU as measured on the battery pole by battery sensor.";
BA_ "Version" SG_ 997 ICU_BS1IBAT_Conversion "22.06.05";
BA_ "UserSigValidity" SG_ 997 ICU_BS1IBAT_Conversion 3;
BA_ "GenSigSendType" SG_ 997 ICU_BS1IBAT_Conversion 4;
BA_ "Description" SG_ 997 ICU_BS1IBAT_Conversion "This is Battery current as measured by battery sensor.

The resolution is 10mA



- 0x3FFFF : 262,143 (Error) , 0x00000 ~ 0x3A980 : 0 ~ 240,000

- Physical value min. : (0 * 10mA) + (-1,200,000) = -1,200 A

- Physical value max. : (240,000 * 10mA) + (-1,";
BA_ "Version" SG_ 997 ICU_BS1BatVol "21.07.05";
BA_ "UserSigValidity" SG_ 997 ICU_BS1BatVol 3;
BA_ "GenSigStartValue" SG_ 997 ICU_BS1BatVol 16383;
BA_ "GenSigSendType" SG_ 997 ICU_BS1BatVol 4;
BA_ "Description" SG_ 997 ICU_BS1BatVol "This is the actual battery voltage as measured on the battery pole by battery sensor.



The resolution is 1mV.";
BA_ "Version" SG_ 997 ICU_BS1BatTemp "21.07.05";
BA_ "UserSigValidity" SG_ 997 ICU_BS1BatTemp 3;
BA_ "GenSigStartValue" SG_ 997 ICU_BS1BatTemp 511;
BA_ "GenSigSendType" SG_ 997 ICU_BS1BatTemp 4;
BA_ "Description" SG_ 997 ICU_BS1BatTemp "This is actual battery electrolyte temperature value by battery sensor.



The value is calculated by a Battery Temperature Model, depending on measured temperature of the battery pole.





The resolution is 0.5℃.";
BA_REL_ "GenSigTimeoutTime" BU_SG_REL_ BLTN_CAM_FD SG_ 345 MainLBM_CurrVal 1500;
BA_REL_ "GenSigTimeoutTime" BU_SG_REL_ BLTN_CAM_FD SG_ 345 MainLBM_SocVal 1500;
BA_REL_ "GenSigTimeoutTime" BU_SG_REL_ BLTN_CAM_FD SG_ 345 MainLBM_VtgVal 1500;
BA_REL_ "GenSigTimeoutTime" BU_SG_REL_ BLTN_CAM_FD SG_ 345 MainLBM_TempVal 1500;
BA_REL_ "GenSigTimeoutTime" BU_SG_REL_ BLTN_CAM_FD SG_ 345 MainLBM_SocErrSta 1500;
BA_REL_ "GenSigTimeoutTime" BU_SG_REL_ BLTN_CAM_FD SG_ 345 MainLBM_SohVal 1500;
BA_REL_ "GenSigTimeoutTime" BU_SG_REL_ BLTN_CAM_FD SG_ 345 MainLBM_SnsrInvldSta 1500;
BA_REL_ "GenSigTimeoutTime" BU_SG_REL_ BLTN_CAM_FD SG_ 345 MainLBM_RspErrSta 1500;
BA_REL_ "GenSigTimeoutTime" BU_SG_REL_ BLTN_CAM_FD SG_ 345 MainLBM_CapacityVal 1500;
BA_REL_ "GenSigTimeoutTime" BU_SG_REL_ BLTN_CAM_FD SG_ 345 MainLBM_SohErrSta 1500;
BA_REL_ "GenSigTimeoutTime" BU_SG_REL_ BLTN_CAM_FD SG_ 194 xEV_AuxBattChrgReq_HS 0;
BA_REL_ "GenSigTimeoutTime" BU_SG_REL_ BLTN_CAM_FD SG_ 194 xEV_12VBatAlarmReq_HS 0;
BA_REL_ "GenSigTimeoutTime" BU_SG_REL_ BLTN_CAM_FD SG_ 1048 HU_MM_Altitude 5000;
BA_REL_ "GenSigTimeoutTime" BU_SG_REL_ BLTN_CAM_FD SG_ 1048 HU_MM_Heading 5000;
BA_REL_ "GenSigTimeoutTime" BU_SG_REL_ BLTN_CAM_FD SG_ 1048 GNSS_MM_type 5000;
BA_REL_ "GenSigTimeoutTime" BU_SG_REL_ BLTN_CAM_FD SG_ 1048 HU_MM_Latitude 5000;
BA_REL_ "GenSigTimeoutTime" BU_SG_REL_ BLTN_CAM_FD SG_ 1048 HU_MM_Longitude 5000;
BA_REL_ "GenSigTimeoutTime" BU_SG_REL_ ATS_FD SG_ 1051 HU_DisplayYear1 5000;
BA_REL_ "GenSigTimeoutTime" BU_SG_REL_ BLTN_CAM_FD SG_ 1051 HU_DisplayYear1 5000;
BA_REL_ "GenSigTimeoutTime" BU_SG_REL_ ATS_FD SG_ 1051 HU_DisplayYear2 5000;
BA_REL_ "GenSigTimeoutTime" BU_SG_REL_ BLTN_CAM_FD SG_ 1051 HU_DisplayYear2 5000;
BA_REL_ "GenSigTimeoutTime" BU_SG_REL_ ATS_FD SG_ 1051 HU_DisplayDay 5000;
BA_REL_ "GenSigTimeoutTime" BU_SG_REL_ BLTN_CAM_FD SG_ 1051 HU_DisplayDay 5000;
BA_REL_ "GenSigTimeoutTime" BU_SG_REL_ ATS_FD SG_ 1051 HU_AM_PM_INFO 5000;
BA_REL_ "GenSigTimeoutTime" BU_SG_REL_ BLTN_CAM_FD SG_ 1051 HU_AM_PM_INFO 5000;
BA_REL_ "GenSigTimeoutTime" BU_SG_REL_ ATS_FD SG_ 1051 HU_ComRefresh 5000;
BA_REL_ "GenSigTimeoutTime" BU_SG_REL_ BLTN_CAM_FD SG_ 1051 HU_ComRefresh 5000;
BA_REL_ "GenSigTimeoutTime" BU_SG_REL_ ATS_FD SG_ 1051 HU_ClockInfo 5000;
BA_REL_ "GenSigTimeoutTime" BU_SG_REL_ BLTN_CAM_FD SG_ 1051 HU_ClockInfo 5000;
BA_REL_ "GenSigTimeoutTime" BU_SG_REL_ ATS_FD SG_ 1051 HU_TimeSetting 5000;
BA_REL_ "GenSigTimeoutTime" BU_SG_REL_ BLTN_CAM_FD SG_ 1051 HU_TimeSetting 5000;
BA_REL_ "GenSigTimeoutTime" BU_SG_REL_ ATS_FD SG_ 1051 HU_Status 5000;
BA_REL_ "GenSigTimeoutTime" BU_SG_REL_ BLTN_CAM_FD SG_ 1051 HU_Status 5000;
BA_REL_ "GenSigTimeoutTime" BU_SG_REL_ ATS_FD SG_ 1051 HU_TimeFormat 5000;
BA_REL_ "GenSigTimeoutTime" BU_SG_REL_ BLTN_CAM_FD SG_ 1051 HU_TimeFormat 5000;
BA_REL_ "GenSigTimeoutTime" BU_SG_REL_ ATS_FD SG_ 1051 HU_DisplayHour 5000;
BA_REL_ "GenSigTimeoutTime" BU_SG_REL_ BLTN_CAM_FD SG_ 1051 HU_DisplayHour 5000;
BA_REL_ "GenSigTimeoutTime" BU_SG_REL_ ATS_FD SG_ 1051 HU_DisplayMinute 5000;
BA_REL_ "GenSigTimeoutTime" BU_SG_REL_ BLTN_CAM_FD SG_ 1051 HU_DisplayMinute 5000;
BA_REL_ "GenSigTimeoutTime" BU_SG_REL_ ATS_FD SG_ 1051 HU_DisplaySecond 5000;
BA_REL_ "GenSigTimeoutTime" BU_SG_REL_ BLTN_CAM_FD SG_ 1051 HU_DisplaySecond 5000;
BA_REL_ "GenSigTimeoutTime" BU_SG_REL_ ATS_FD SG_ 1051 HU_DisplayMonth 5000;
BA_REL_ "GenSigTimeoutTime" BU_SG_REL_ BLTN_CAM_FD SG_ 1051 HU_DisplayMonth 5000;
BA_REL_ "GenSigTimeoutTime" BU_SG_REL_ ATS_FD SG_ 1052 HU_LanguageInfo 5000;
BA_REL_ "GenSigTimeoutTime" BU_SG_REL_ BLTN_CAM_FD SG_ 1052 HU_LanguageInfo 5000;
BA_REL_ "GenSigTimeoutTime" BU_SG_REL_ DCM_FD SG_ 1052 HU_LanguageInfo 5000;
BA_REL_ "GenSigTimeoutTime" BU_SG_REL_ GW_PSU_DRV_FD SG_ 870 HU_GW_Crc3Val 1500;
BA_REL_ "GenSigTimeoutTime" BU_SG_REL_ BLTN_CAM_FD SG_ 870 CF_AVN_ProfileIDRValue 1500;
BA_REL_ "GenSigTimeoutTime" BU_SG_REL_ GW_PSU_DRV_FD SG_ 870 CF_AVN_ProfileIDRValue 1500;
BA_REL_ "GenSigTimeoutTime" BU_SG_REL_ GW_SAU_DRV_FD SG_ 870 CF_AVN_ProfileIDRValue 1500;
BA_REL_ "GenSigTimeoutTime" BU_SG_REL_ RCM_FD SG_ 870 CF_AVN_ProfileIDRValue 1500;
BA_REL_ "GenSigTimeoutTime" BU_SG_REL_ RWPC_FD SG_ 870 CF_AVN_ProfileIDRValue 1500;
BA_REL_ "GenSigTimeoutTime" BU_SG_REL_ SGU_FD SG_ 870 CF_AVN_ProfileIDRValue 1500;
BA_REL_ "GenSigTimeoutTime" BU_SG_REL_ WPC2_FD SG_ 870 CF_AVN_ProfileIDRValue 1500;
BA_REL_ "GenSigTimeoutTime" BU_SG_REL_ WPC_FD SG_ 870 CF_AVN_ProfileIDRValue 1500;
BA_REL_ "GenSigTimeoutTime" BU_SG_REL_ GW_PSU_AST_FD SG_ 870 HU_RTCCheck 1500;
BA_REL_ "GenSigTimeoutTime" BU_SG_REL_ GW_PSU_DRV_FD SG_ 870 HU_GW_AlvCnt3Val 1500;
BA_REL_ "GenSigTimeoutTime" BU_SG_REL_ ATS_FD SG_ 870 HU_ThemeType 1500;
BA_REL_ "GenSigTimeoutTime" BU_SG_REL_ BLTN_CAM_FD SG_ 870 HU_ThemeType 1500;
BA_REL_ "GenSigTimeoutTime" BU_SG_REL_ GW_PSU_DRV_FD SG_ 993 PDC_FD_Crc2Val 1500;
BA_REL_ "GenSigTimeoutTime" BU_SG_REL_ GW_PSU_DRV_FD SG_ 993 PDC_FD_AlvCnt2Val 1500;
BA_REL_ "GenSigTimeoutTime" BU_SG_REL_ BLTN_CAM_FD SG_ 993 IntLamp_InlTailLmpSta 1500;
BA_REL_ "GenSigTimeoutTime" BU_SG_REL_ FCS_FD SG_ 993 IntLamp_InlTailLmpSta 1500;
BA_REL_ "GenSigTimeoutTime" BU_SG_REL_ GW_PSU_3RD_FD SG_ 993 IntLamp_InlTailLmpSta 1500;
BA_REL_ "GenSigTimeoutTime" BU_SG_REL_ GW_PSU_AST_FD SG_ 993 IntLamp_InlTailLmpSta 1500;
BA_REL_ "GenSigTimeoutTime" BU_SG_REL_ GW_PSU_DRV_FD SG_ 993 IntLamp_InlTailLmpSta 1500;
BA_REL_ "GenSigTimeoutTime" BU_SG_REL_ GW_PSU_RL_FD SG_ 993 IntLamp_InlTailLmpSta 1500;
BA_REL_ "GenSigTimeoutTime" BU_SG_REL_ GW_PSU_RR_FD SG_ 993 IntLamp_InlTailLmpSta 1500;
BA_REL_ "GenSigTimeoutTime" BU_SG_REL_ WPC2_FD SG_ 993 IntLamp_InlTailLmpSta 1500;
BA_REL_ "GenSigTimeoutTime" BU_SG_REL_ GW_PSU_DRV_FD SG_ 992 PDC_FD_Crc1Val 1500;
BA_REL_ "GenSigTimeoutTime" BU_SG_REL_ ARS_FD SG_ 992 C_3rdRCSeatBeltSW 1500;
BA_REL_ "GenSigTimeoutTime" BU_SG_REL_ GW_PSU_RL_FD SG_ 992 C_3rdRCSeatBeltSW 1500;
BA_REL_ "GenSigTimeoutTime" BU_SG_REL_ GW_PSU_RR_FD SG_ 992 C_3rdRCSeatBeltSW 1500;
BA_REL_ "GenSigTimeoutTime" BU_SG_REL_ PSB_FD SG_ 992 C_3rdRCSeatBeltSW 1500;
BA_REL_ "GenSigTimeoutTime" BU_SG_REL_ WPC2_FD SG_ 992 C_3rdRCSeatBeltSW 1500;
BA_REL_ "GenSigTimeoutTime" BU_SG_REL_ ARS_FD SG_ 992 C_3rdRRSeatBeltSW 1500;
BA_REL_ "GenSigTimeoutTime" BU_SG_REL_ GW_PSU_RR_FD SG_ 992 C_3rdRRSeatBeltSW 1500;
BA_REL_ "GenSigTimeoutTime" BU_SG_REL_ PSB_FD SG_ 992 C_3rdRRSeatBeltSW 1500;
BA_REL_ "GenSigTimeoutTime" BU_SG_REL_ WPC2_FD SG_ 992 C_3rdRRSeatBeltSW 1500;
BA_REL_ "GenSigTimeoutTime" BU_SG_REL_ GW_PSU_AST_FD SG_ 992 Warn_PassStOccSta 1500;
BA_REL_ "GenSigTimeoutTime" BU_SG_REL_ PSB_FD SG_ 992 Warn_PassStOccSta 1500;
BA_REL_ "GenSigTimeoutTime" BU_SG_REL_ GW_PSU_DRV_FD SG_ 992 Warn_RrLftSBRMATSwSta 1500;
BA_REL_ "GenSigTimeoutTime" BU_SG_REL_ GW_PSU_DRV_FD SG_ 992 Warn_RrRhtSBRMATSwSta 1500;
BA_REL_ "GenSigTimeoutTime" BU_SG_REL_ ARS_FD SG_ 992 C_3rdRLSBRMatSw 1500;
BA_REL_ "GenSigTimeoutTime" BU_SG_REL_ GW_PSU_RL_FD SG_ 992 C_3rdRLSBRMatSw 1500;
BA_REL_ "GenSigTimeoutTime" BU_SG_REL_ WPC2_FD SG_ 992 C_3rdRLSBRMatSw 1500;
BA_REL_ "GenSigTimeoutTime" BU_SG_REL_ ARS_FD SG_ 992 C_3rdRRSBRMatSw 1500;
BA_REL_ "GenSigTimeoutTime" BU_SG_REL_ GW_PSU_RR_FD SG_ 992 C_3rdRRSBRMatSw 1500;
BA_REL_ "GenSigTimeoutTime" BU_SG_REL_ WPC2_FD SG_ 992 C_3rdRRSBRMatSw 1500;
BA_REL_ "GenSigTimeoutTime" BU_SG_REL_ BLTN_CAM_FD SG_ 992 Trunk_TrnkTlgtSwSta 1500;
BA_REL_ "GenSigTimeoutTime" BU_SG_REL_ GW_PSU_3RD_FD SG_ 992 Trunk_TrnkTlgtSwSta 1500;
BA_REL_ "GenSigTimeoutTime" BU_SG_REL_ GW_PSU_AST_FD SG_ 992 Trunk_TrnkTlgtSwSta 1500;
BA_REL_ "GenSigTimeoutTime" BU_SG_REL_ GW_PSU_RL_FD SG_ 992 Trunk_TrnkTlgtSwSta 1500;
BA_REL_ "GenSigTimeoutTime" BU_SG_REL_ GW_PSU_RR_FD SG_ 992 Trunk_TrnkTlgtSwSta 1500;
BA_REL_ "GenSigTimeoutTime" BU_SG_REL_ SHVU_RL_FD SG_ 992 Trunk_TrnkTlgtSwSta 1500;
BA_REL_ "GenSigTimeoutTime" BU_SG_REL_ SHVU_RR_FD SG_ 992 Trunk_TrnkTlgtSwSta 1500;
BA_REL_ "GenSigTimeoutTime" BU_SG_REL_ GW_PSU_DRV_FD SG_ 992 PDC_FD_AlvCnt1Val 1500;
BA_REL_ "GenSigTimeoutTime" BU_SG_REL_ GW_PSU_3RD_FD SG_ 992 IGN3State 1500;
BA_REL_ "GenSigTimeoutTime" BU_SG_REL_ GW_PSU_AST_FD SG_ 992 IGN3State 1500;
BA_REL_ "GenSigTimeoutTime" BU_SG_REL_ GW_PSU_DRV_FD SG_ 992 IGN3State 1500;
BA_REL_ "GenSigTimeoutTime" BU_SG_REL_ GW_PSU_RL_FD SG_ 992 IGN3State 1500;
BA_REL_ "GenSigTimeoutTime" BU_SG_REL_ GW_PSU_RR_FD SG_ 992 IGN3State 1500;
BA_REL_ "GenSigTimeoutTime" BU_SG_REL_ GW_SAU_DRV_FD SG_ 992 IGN3State 1500;
BA_REL_ "GenSigTimeoutTime" BU_SG_REL_ SHVU_3RD_FD SG_ 992 IGN3State 1500;
BA_REL_ "GenSigTimeoutTime" BU_SG_REL_ SHVU_CCS_FD SG_ 992 IGN3State 1500;
BA_REL_ "GenSigTimeoutTime" BU_SG_REL_ SHVU_FRNT_FD SG_ 992 IGN3State 1500;
BA_REL_ "GenSigTimeoutTime" BU_SG_REL_ SHVU_REAR_FD SG_ 992 IGN3State 1500;
BA_REL_ "GenSigTimeoutTime" BU_SG_REL_ SHVU_RL_FD SG_ 992 IGN3State 1500;
BA_REL_ "GenSigTimeoutTime" BU_SG_REL_ SHVU_RR_FD SG_ 992 IGN3State 1500;
BA_REL_ "GenSigTimeoutTime" BU_SG_REL_ GW_PSU_3RD_FD SG_ 992 IGN3CutOffState 1500;
BA_REL_ "GenSigTimeoutTime" BU_SG_REL_ GW_PSU_AST_FD SG_ 992 IGN3CutOffState 1500;
BA_REL_ "GenSigTimeoutTime" BU_SG_REL_ GW_PSU_DRV_FD SG_ 992 IGN3CutOffState 1500;
BA_REL_ "GenSigTimeoutTime" BU_SG_REL_ GW_PSU_RL_FD SG_ 992 IGN3CutOffState 1500;
BA_REL_ "GenSigTimeoutTime" BU_SG_REL_ GW_PSU_RR_FD SG_ 992 IGN3CutOffState 1500;
BA_REL_ "GenSigTimeoutTime" BU_SG_REL_ SHVU_3RD_FD SG_ 992 IGN3CutOffState 1500;
BA_REL_ "GenSigTimeoutTime" BU_SG_REL_ SHVU_CCS_FD SG_ 992 IGN3CutOffState 1500;
BA_REL_ "GenSigTimeoutTime" BU_SG_REL_ SHVU_FRNT_FD SG_ 992 IGN3CutOffState 1500;
BA_REL_ "GenSigTimeoutTime" BU_SG_REL_ SHVU_REAR_FD SG_ 992 IGN3CutOffState 1500;
BA_REL_ "GenSigTimeoutTime" BU_SG_REL_ SHVU_RL_FD SG_ 992 IGN3CutOffState 1500;
BA_REL_ "GenSigTimeoutTime" BU_SG_REL_ SHVU_RR_FD SG_ 992 IGN3CutOffState 1500;
BA_REL_ "GenSigTimeoutTime" BU_SG_REL_ GW_SAU_DRV_FD SG_ 992 SeatBeltSwSta_Asst 1500;
BA_REL_ "GenSigTimeoutTime" BU_SG_REL_ ATS_FD SG_ 992 PDCex_CurtainOpt 1500;
BA_REL_ "GenSigTimeoutTime" BU_SG_REL_ ATS_FD SG_ 992 DriveTypeOption 1500;
BA_REL_ "GenSigTimeoutTime" BU_SG_REL_ BLTN_CAM_FD SG_ 992 DriveTypeOption 1500;
BA_REL_ "GenSigTimeoutTime" BU_SG_REL_ GW_PSU_AST_FD SG_ 992 DriveTypeOption 1500;
BA_REL_ "GenSigTimeoutTime" BU_SG_REL_ GW_PSU_DRV_FD SG_ 992 DriveTypeOption 1500;
BA_REL_ "GenSigTimeoutTime" BU_SG_REL_ GW_PSU_RL_FD SG_ 992 DriveTypeOption 1500;
BA_REL_ "GenSigTimeoutTime" BU_SG_REL_ GW_PSU_RR_FD SG_ 992 DriveTypeOption 1500;
BA_REL_ "GenSigTimeoutTime" BU_SG_REL_ GW_SAU_DRV_FD SG_ 992 DriveTypeOption 1500;
BA_REL_ "GenSigTimeoutTime" BU_SG_REL_ PSB_FD SG_ 992 DriveTypeOption 1500;
BA_REL_ "GenSigTimeoutTime" BU_SG_REL_ SGU_FD SG_ 992 DriveTypeOption 1500;
BA_REL_ "GenSigTimeoutTime" BU_SG_REL_ SHVU_3RD_FD SG_ 992 DriveTypeOption 1500;
BA_REL_ "GenSigTimeoutTime" BU_SG_REL_ SHVU_FRNT_FD SG_ 992 DriveTypeOption 1500;
BA_REL_ "GenSigTimeoutTime" BU_SG_REL_ SHVU_REAR_FD SG_ 992 DriveTypeOption 1500;
BA_REL_ "GenSigTimeoutTime" BU_SG_REL_ BLTN_CAM_FD SG_ 992 ICU_MtGearPosRSta 1500;
BA_REL_ "GenSigTimeoutTime" BU_SG_REL_ GW_PSU_3RD_FD SG_ 992 Warn_PrkngBrkSwSta 1500;
BA_REL_ "GenSigTimeoutTime" BU_SG_REL_ GW_PSU_AST_FD SG_ 992 Warn_PrkngBrkSwSta 1500;
BA_REL_ "GenSigTimeoutTime" BU_SG_REL_ GW_PSU_RL_FD SG_ 992 Warn_PrkngBrkSwSta 1500;
BA_REL_ "GenSigTimeoutTime" BU_SG_REL_ GW_PSU_RR_FD SG_ 992 Warn_PrkngBrkSwSta 1500;
BA_REL_ "GenSigTimeoutTime" BU_SG_REL_ SHVU_RL_FD SG_ 992 Warn_PrkngBrkSwSta 1500;
BA_REL_ "GenSigTimeoutTime" BU_SG_REL_ SHVU_RR_FD SG_ 992 Warn_PrkngBrkSwSta 1500;
BA_REL_ "GenSigTimeoutTime" BU_SG_REL_ ATS_FD SG_ 992 Warn_DrvStBltSwSta 1500;
BA_REL_ "GenSigTimeoutTime" BU_SG_REL_ GW_PSU_DRV_FD SG_ 992 Warn_DrvStBltSwSta 1500;
BA_REL_ "GenSigTimeoutTime" BU_SG_REL_ GW_SAU_DRV_FD SG_ 992 Warn_DrvStBltSwSta 1500;
BA_REL_ "GenSigTimeoutTime" BU_SG_REL_ PSB_FD SG_ 992 Warn_DrvStBltSwSta 1500;
BA_REL_ "GenSigTimeoutTime" BU_SG_REL_ GW_PSU_AST_FD SG_ 992 Warn_AsstStBltSwSta 1500;
BA_REL_ "GenSigTimeoutTime" BU_SG_REL_ GW_PSU_RL_FD SG_ 992 Warn_AsstStBltSwSta 1500;
BA_REL_ "GenSigTimeoutTime" BU_SG_REL_ GW_SAU_DRV_FD SG_ 992 Warn_AsstStBltSwSta 1500;
BA_REL_ "GenSigTimeoutTime" BU_SG_REL_ PSB_FD SG_ 992 Warn_AsstStBltSwSta 1500;
BA_REL_ "GenSigTimeoutTime" BU_SG_REL_ GW_PSU_AST_FD SG_ 992 Warn_RrLftStBltSwSta 1500;
BA_REL_ "GenSigTimeoutTime" BU_SG_REL_ GW_PSU_DRV_FD SG_ 992 Warn_RrLftStBltSwSta 1500;
BA_REL_ "GenSigTimeoutTime" BU_SG_REL_ PSB_FD SG_ 992 Warn_RrLftStBltSwSta 1500;
BA_REL_ "GenSigTimeoutTime" BU_SG_REL_ PSB_FD SG_ 992 Warn_RrCtrStBltSwSta 1500;
BA_REL_ "GenSigTimeoutTime" BU_SG_REL_ GW_PSU_AST_FD SG_ 992 Warn_RrRtStBltSwSta 1500;
BA_REL_ "GenSigTimeoutTime" BU_SG_REL_ GW_PSU_DRV_FD SG_ 992 Warn_RrRtStBltSwSta 1500;
BA_REL_ "GenSigTimeoutTime" BU_SG_REL_ PSB_FD SG_ 992 Warn_RrRtStBltSwSta 1500;
BA_REL_ "GenSigTimeoutTime" BU_SG_REL_ ARS_FD SG_ 992 C_3rdRLSeatBeltSW 1500;
BA_REL_ "GenSigTimeoutTime" BU_SG_REL_ GW_PSU_RL_FD SG_ 992 C_3rdRLSeatBeltSW 1500;
BA_REL_ "GenSigTimeoutTime" BU_SG_REL_ PSB_FD SG_ 992 C_3rdRLSeatBeltSW 1500;
BA_REL_ "GenSigTimeoutTime" BU_SG_REL_ WPC2_FD SG_ 992 C_3rdRLSeatBeltSW 1500;
BA_REL_ "GenSigTimeoutTime" BU_SG_REL_ BLTN_CAM_FD SG_ 995 Lamp_TrnSigLmpLftOnReq 1500;
BA_REL_ "GenSigTimeoutTime" BU_SG_REL_ BLTN_CAM_FD SG_ 995 Lamp_TrnSigLmpRtOnReq 1500;
BA_REL_ "GenSigTimeoutTime" BU_SG_REL_ GW_PSU_DRV_FD SG_ 994 PDC_FD_Crc3Val 1500;
BA_REL_ "GenSigTimeoutTime" BU_SG_REL_ GW_PSU_DRV_FD SG_ 994 PDC_FD_AlvCnt3Val 1500;
BA_REL_ "GenSigTimeoutTime" BU_SG_REL_ BLTN_CAM_FD SG_ 994 Warn_DrvDrSwSta 1500;
BA_REL_ "GenSigTimeoutTime" BU_SG_REL_ DCM_FD SG_ 994 Warn_DrvDrSwSta 1500;
BA_REL_ "GenSigTimeoutTime" BU_SG_REL_ GW_PSU_DRV_FD SG_ 994 Warn_DrvDrSwSta 1500;
BA_REL_ "GenSigTimeoutTime" BU_SG_REL_ PSB_FD SG_ 994 Warn_DrvDrSwSta 1500;
BA_REL_ "GenSigTimeoutTime" BU_SG_REL_ RWPC_FD SG_ 994 Warn_DrvDrSwSta 1500;
BA_REL_ "GenSigTimeoutTime" BU_SG_REL_ WPC2_FD SG_ 994 Warn_DrvDrSwSta 1500;
BA_REL_ "GenSigTimeoutTime" BU_SG_REL_ WPC_FD SG_ 994 Warn_DrvDrSwSta 1500;
BA_REL_ "GenSigTimeoutTime" BU_SG_REL_ BLTN_CAM_FD SG_ 994 Warn_AsstDrSwSta 1500;
BA_REL_ "GenSigTimeoutTime" BU_SG_REL_ DCM_FD SG_ 994 Warn_AsstDrSwSta 1500;
BA_REL_ "GenSigTimeoutTime" BU_SG_REL_ GW_PSU_AST_FD SG_ 994 Warn_AsstDrSwSta 1500;
BA_REL_ "GenSigTimeoutTime" BU_SG_REL_ GW_PSU_RL_FD SG_ 994 Warn_AsstDrSwSta 1500;
BA_REL_ "GenSigTimeoutTime" BU_SG_REL_ GW_SAU_DRV_FD SG_ 994 Warn_AsstDrSwSta 1500;
BA_REL_ "GenSigTimeoutTime" BU_SG_REL_ PSB_FD SG_ 994 Warn_AsstDrSwSta 1500;
BA_REL_ "GenSigTimeoutTime" BU_SG_REL_ RWPC_FD SG_ 994 Warn_AsstDrSwSta 1500;
BA_REL_ "GenSigTimeoutTime" BU_SG_REL_ WPC2_FD SG_ 994 Warn_AsstDrSwSta 1500;
BA_REL_ "GenSigTimeoutTime" BU_SG_REL_ WPC_FD SG_ 994 Warn_AsstDrSwSta 1500;
BA_REL_ "GenSigTimeoutTime" BU_SG_REL_ BLTN_CAM_FD SG_ 994 Warn_RrLftDrSwSta 1500;
BA_REL_ "GenSigTimeoutTime" BU_SG_REL_ DCM_FD SG_ 994 Warn_RrLftDrSwSta 1500;
BA_REL_ "GenSigTimeoutTime" BU_SG_REL_ GW_PSU_AST_FD SG_ 994 Warn_RrLftDrSwSta 1500;
BA_REL_ "GenSigTimeoutTime" BU_SG_REL_ GW_PSU_RL_FD SG_ 994 Warn_RrLftDrSwSta 1500;
BA_REL_ "GenSigTimeoutTime" BU_SG_REL_ GW_PSU_RR_FD SG_ 994 Warn_RrLftDrSwSta 1500;
BA_REL_ "GenSigTimeoutTime" BU_SG_REL_ PSB_FD SG_ 994 Warn_RrLftDrSwSta 1500;
BA_REL_ "GenSigTimeoutTime" BU_SG_REL_ RWPC_FD SG_ 994 Warn_RrLftDrSwSta 1500;
BA_REL_ "GenSigTimeoutTime" BU_SG_REL_ SHVU_RL_FD SG_ 994 Warn_RrLftDrSwSta 1500;
BA_REL_ "GenSigTimeoutTime" BU_SG_REL_ WPC2_FD SG_ 994 Warn_RrLftDrSwSta 1500;
BA_REL_ "GenSigTimeoutTime" BU_SG_REL_ WPC_FD SG_ 994 Warn_RrLftDrSwSta 1500;
BA_REL_ "GenSigTimeoutTime" BU_SG_REL_ BLTN_CAM_FD SG_ 994 Warn_RrRtDrSwSta 1500;
BA_REL_ "GenSigTimeoutTime" BU_SG_REL_ DCM_FD SG_ 994 Warn_RrRtDrSwSta 1500;
BA_REL_ "GenSigTimeoutTime" BU_SG_REL_ GW_PSU_AST_FD SG_ 994 Warn_RrRtDrSwSta 1500;
BA_REL_ "GenSigTimeoutTime" BU_SG_REL_ GW_PSU_RL_FD SG_ 994 Warn_RrRtDrSwSta 1500;
BA_REL_ "GenSigTimeoutTime" BU_SG_REL_ GW_PSU_RR_FD SG_ 994 Warn_RrRtDrSwSta 1500;
BA_REL_ "GenSigTimeoutTime" BU_SG_REL_ PSB_FD SG_ 994 Warn_RrRtDrSwSta 1500;
BA_REL_ "GenSigTimeoutTime" BU_SG_REL_ RWPC_FD SG_ 994 Warn_RrRtDrSwSta 1500;
BA_REL_ "GenSigTimeoutTime" BU_SG_REL_ SHVU_RR_FD SG_ 994 Warn_RrRtDrSwSta 1500;
BA_REL_ "GenSigTimeoutTime" BU_SG_REL_ WPC2_FD SG_ 994 Warn_RrRtDrSwSta 1500;
BA_REL_ "GenSigTimeoutTime" BU_SG_REL_ WPC_FD SG_ 994 Warn_RrRtDrSwSta 1500;
BA_REL_ "GenSigTimeoutTime" BU_SG_REL_ BLTN_CAM_FD SG_ 994 Warn_HoodSwSta 1500;
BA_REL_ "GenSigTimeoutTime" BU_SG_REL_ GW_PSU_DRV_FD SG_ 994 DoorLock_DrvDrUnLkSta 1500;
BA_REL_ "GenSigTimeoutTime" BU_SG_REL_ BLTN_CAM_FD SG_ 994 C_CrashUnlockState 1500;
BA_REL_ "GenSigTimeoutTime" BU_SG_REL_ BLTN_CAM_FD SG_ 997 ICU_BS2SoC 1500;
VAL_ 74 IMU_Crc1Val 0 "0x0x0~0xFFFF:CRCValue" 65535 "0x0x0~0xFFFF:CRCValue" ;
VAL_ 74 IMU_AlvCnt1Val 0 "0x0x0~0xFF:AlvCntValue" 255 "0x0x0~0xFF:AlvCntValue" ;
VAL_ 345 LBM_FD_Crc2Val 0 "0x0x0~0xFFFF:CRCValue" 65535 "0x0x0~0xFFFF:CRCValue" ;
VAL_ 345 LBM_FD_AlvCnt2Val 0 "0x0x0~0xFF:AlvCntValue" 255 "0x0x0~0xFF:AlvCntValue" ;
VAL_ 345 MainLBM_CurrVal 0 "0x0x0~0xFFFF:Vaild Value" 65535 "0x0x0~0xFFFF:Vaild Value" ;
VAL_ 345 MainLBM_SocVal 0 "0x0x00~0x64:0% ~ 100 %" 100 "0x0x00~0x64:0% ~ 100 %" 101 "0x65~0xFE:Invalid" 254 "0x65~0xFE:Invalid" 255 "Error" ;
VAL_ 345 MainLBM_VtgVal 0 "0x0x0000~0x2EE0:6.000V ~ 18.000V" 12000 "0x0x0000~0x2EE0:6.000V ~ 18.000V" 12001 "0x2EE1~0x3FFE:Invalid" 16382 "0x2EE1~0x3FFE:Invalid" 16383 "Error" ;
VAL_ 345 MainLBM_TempVal 0 "0x0x000~0x14A:0~330" 330 "0x0x000~0x14A:0~330" 331 "0x14B~0x1FE:RESERVED" 510 "0x14B~0x1FE:RESERVED" 511 "Error" ;
VAL_ 345 MainLBM_SocErrSta 0 "Nomal State" 1 "Implausible State" 2 "Not used" 3 "Error indicator" ;
VAL_ 345 MainLBM_SohVal 0 "0x0x00~0x64:0~100" 100 "0x0x00~0x64:0~100" 101 "0x65~0xFE:RESERVED" 254 "0x65~0xFE:RESERVED" 255 "Error" ;
VAL_ 345 MainLBM_SnsrInvldSta 0 "Valid Condition" 1 "Invalid Condition" 2 "Not used" 3 "Error indicator" ;
VAL_ 345 MainLBM_RspErrSta 0 "Operating correctly" 1 "Response error" 2 "Not used" 3 "Error indicator" ;
VAL_ 345 MainLBM_CapacityVal 0 "0x0x0~0xFE:Capacity Value" 254 "0x0x0~0xFE:Capacity Value" 255 "Error Indicator" ;
VAL_ 345 MainLBM_SohErrSta 0 "SOH valid" 1 "SOH invalid" 2 "NotUsed" 3 "Error Indicate" ;
VAL_ 194 BMS_FD_Crc1Val 0 "0x0x0~0xFFFF:CRCValue" 65535 "0x0x0~0xFFFF:CRCValue" ;
VAL_ 194 BMS_FD_AlvCnt1Val 0 "0x0x0~0xFF:AlvCntValue" 255 "0x0x0~0xFF:AlvCntValue" ;
VAL_ 194 xEV_BatEvtAlarm_HS 0 "Default" 1 "Level 1" 2 "Level 2" 3 "Level 3" 4 "Level 4" ;
VAL_ 194 xEV_BMS_WakeUpReqfor12V 0 "Default" 1 "Discharge Request" 2 "Reserved(Not Used)" 3 "Error Indicator" ;
VAL_ 194 xEV_AuxBattChrgReq_HS 0 "Charge Finish Request" 1 "LV2 Charge Request" 2 "LV1 Charge Request" 3 "Error Indicator" ;
VAL_ 194 xEV_12VBatAlarmReq_HS 0 "Normal" 1 "3rd Cut Off" 2 "Warn. MSG & 3rd Cut Off Req" 3 "Reserved(Not Used)" ;
VAL_ 194 BMS_ResetWakeup 0 "No Wakeup" 1 "Reset Wakeup" 2 "RESERVED" 3 "Invalid" ;
VAL_ 1048 GNSS_Crc6Val 0 "0x0x0~0xFFFF:CRCValue" 65535 "0x0x0~0xFFFF:CRCValue" ;
VAL_ 1048 GNSS_AlvCnt6Val 0 "0x0x0~0xFF:AlvCntValue" 255 "0x0x0~0xFF:AlvCntValue" ;
VAL_ 1048 GNSS_MM_type 0 "WGS84" 1 "Bessel" 2 "Coordshift(for china)" 15 "invalid" ;
VAL_ 1051 HU_CLOCK_Crc1Val 0 "0x0x0~0xFFFF:CRCValue" 65535 "0x0x0~0xFFFF:CRCValue" ;
VAL_ 1051 HU_DisplayYear1 0 "19" 1 "20" 2 "21" 3 "invalid" ;
VAL_ 1051 HU_DisplayYear2 0 "00 year" 1 "01~99 year" 2 "01~99 year" 3 "01~99 year" 4 "01~99 year" 5 "01~99 year" 6 "01~99 year" 7 "01~99 year" 8 "01~99 year" 9 "01~99 year" 10 "01~99 year" 11 "01~99 year" 12 "01~99 year" 13 "01~99 year" 14 "01~99 year" 15 "01~99 year" 16 "01~99 year" 17 "01~99 year" 18 "01~99 year" 19 "01~99 year" 20 "01~99 year" 21 "01~99 year" 22 "01~99 year" 23 "01~99 year" 24 "01~99 year" 25 "01~99 year" 26 "01~99 year" 27 "01~99 year" 28 "01~99 year" 29 "01~99 year" 30 "01~99 year" 31 "01~99 year" 32 "01~99 year" 33 "01~99 year" 34 "01~99 year" 35 "01~99 year" 36 "01~99 year" 37 "01~99 year" 38 "01~99 year" 39 "01~99 year" 40 "01~99 year" 41 "01~99 year" 42 "01~99 year" 43 "01~99 year" 44 "01~99 year" 45 "01~99 year" 46 "01~99 year" 47 "01~99 year" 48 "01~99 year" 49 "01~99 year" 50 "01~99 year" 51 "01~99 year" 52 "01~99 year" 53 "01~99 year" 54 "01~99 year" 55 "01~99 year" 56 "01~99 year" 57 "01~99 year" 58 "01~99 year" 59 "01~99 year" 60 "01~99 year" 61 "01~99 year" 62 "01~99 year" 63 "01~99 year" 64 "01~99 year" 65 "01~99 year" 66 "01~99 year" 67 "01~99 year" 68 "01~99 year" 69 "01~99 year" 70 "01~99 year" 71 "01~99 year" 72 "01~99 year" 73 "01~99 year" 74 "01~99 year" 75 "01~99 year" 76 "01~99 year" 77 "01~99 year" 78 "01~99 year" 79 "01~99 year" 80 "01~99 year" 81 "01~99 year" 82 "01~99 year" 83 "01~99 year" 84 "01~99 year" 85 "01~99 year" 86 "01~99 year" 87 "01~99 year" 88 "01~99 year" 89 "01~99 year" 90 "01~99 year" 91 "01~99 year" 92 "01~99 year" 93 "01~99 year" 94 "01~99 year" 95 "01~99 year" 96 "01~99 year" 97 "01~99 year" 98 "01~99 year" 99 "01~99 year" 100 "0x64~0xFE:RESERVED" 254 "0x64~0xFE:RESERVED" 255 "Invalid" ;
VAL_ 1051 HU_DisplayDay 0 "Not used" 1 "1~31 day" 2 "1~31 day" 3 "1~31 day" 4 "1~31 day" 5 "1~31 day" 6 "1~31 day" 7 "1~31 day" 8 "1~31 day" 9 "1~31 day" 10 "1~31 day" 11 "1~31 day" 12 "1~31 day" 13 "1~31 day" 14 "1~31 day" 15 "1~31 day" 16 "1~31 day" 17 "1~31 day" 18 "1~31 day" 19 "1~31 day" 20 "1~31 day" 21 "1~31 day" 22 "1~31 day" 23 "1~31 day" 24 "1~31 day" 25 "1~31 day" 26 "1~31 day" 27 "1~31 day" 28 "1~31 day" 29 "1~31 day" 30 "1~31 day" 31 "1~31 day" 32 "0x20~0xFE:RESERVED" 254 "0x20~0xFE:RESERVED" 255 "Invalid" ;
VAL_ 1051 HU_AM_PM_INFO 0 "Not Used" 1 "AM" 2 "PM" 3 "invalid" ;
VAL_ 1051 HU_ComRefresh 0 "Not Used" 1 "Internal Clock None" 2 "Internal Clock Exist" 3 "Invalid" ;
VAL_ 1051 HU_ClockInfo 0 "Not Used" 1 "ACLOCK Refresh" 2 "Not Used" 3 "invalid" ;
VAL_ 1051 HU_CLOCK_AlvCnt1Val 0 "0x0x0~0xFF:AlvCntValue" 255 "0x0x0~0xFF:AlvCntValue" ;
VAL_ 1051 HU_TimeSetting 0 "not used" 1 "User Time" 2 "GPS Time" 3 "invalid" ;
VAL_ 1051 HU_Status 0 "Not used" 1 "Booting Head Unit" 2 "GPS receiving" 3 "Setting Mode" 4 "GPS Unavailable Mode" 5 "No GPS" 6 "RESERVED" 7 "RESERVED" 8 "RESERVED" 9 "RESERVED" 10 "RESERVED" 11 "RESERVED" 12 "RESERVED" 13 "RESERVED" 14 "RESERVED" 15 "Invalid" ;
VAL_ 1051 HU_TimeFormat 0 "Not used" 1 "12Hour" 2 "24Hour" 3 "invalid" ;
VAL_ 1051 HU_DisplayHour 0 "0 hour" 1 "1~23 hour" 2 "1~23 hour" 3 "1~23 hour" 4 "1~23 hour" 5 "1~23 hour" 6 "1~23 hour" 7 "1~23 hour" 8 "1~23 hour" 9 "1~23 hour" 10 "1~23 hour" 11 "1~23 hour" 12 "1~23 hour" 13 "1~23 hour" 14 "1~23 hour" 15 "1~23 hour" 16 "1~23 hour" 17 "1~23 hour" 18 "1~23 hour" 19 "1~23 hour" 20 "1~23 hour" 21 "1~23 hour" 22 "1~23 hour" 23 "1~23 hour" 24 "0x18~0xFE:RESERVED" 254 "0x18~0xFE:RESERVED" 255 "Invalid" ;
VAL_ 1051 HU_DisplayMinute 0 "0 minute" 1 "1~59 minute" 2 "1~59 minute" 3 "1~59 minute" 4 "1~59 minute" 5 "1~59 minute" 6 "1~59 minute" 7 "1~59 minute" 8 "1~59 minute" 9 "1~59 minute" 10 "1~59 minute" 11 "1~59 minute" 12 "1~59 minute" 13 "1~59 minute" 14 "1~59 minute" 15 "1~59 minute" 16 "1~59 minute" 17 "1~59 minute" 18 "1~59 minute" 19 "1~59 minute" 20 "1~59 minute" 21 "1~59 minute" 22 "1~59 minute" 23 "1~59 minute" 24 "1~59 minute" 25 "1~59 minute" 26 "1~59 minute" 27 "1~59 minute" 28 "1~59 minute" 29 "1~59 minute" 30 "1~59 minute" 31 "1~59 minute" 32 "1~59 minute" 33 "1~59 minute" 34 "1~59 minute" 35 "1~59 minute" 36 "1~59 minute" 37 "1~59 minute" 38 "1~59 minute" 39 "1~59 minute" 40 "1~59 minute" 41 "1~59 minute" 42 "1~59 minute" 43 "1~59 minute" 44 "1~59 minute" 45 "1~59 minute" 46 "1~59 minute" 47 "1~59 minute" 48 "1~59 minute" 49 "1~59 minute" 50 "1~59 minute" 51 "1~59 minute" 52 "1~59 minute" 53 "1~59 minute" 54 "1~59 minute" 55 "1~59 minute" 56 "1~59 minute" 57 "1~59 minute" 58 "1~59 minute" 59 "1~59 minute" 60 "0x3C~0xFE:RESERVED" 254 "0x3C~0xFE:RESERVED" 255 "Invalid" ;
VAL_ 1051 HU_DisplaySecond 0 "0 second" 1 "1~59 second" 2 "1~59 second" 3 "1~59 second" 4 "1~59 second" 5 "1~59 second" 6 "1~59 second" 7 "1~59 second" 8 "1~59 second" 9 "1~59 second" 10 "1~59 second" 11 "1~59 second" 12 "1~59 second" 13 "1~59 second" 14 "1~59 second" 15 "1~59 second" 16 "1~59 second" 17 "1~59 second" 18 "1~59 second" 19 "1~59 second" 20 "1~59 second" 21 "1~59 second" 22 "1~59 second" 23 "1~59 second" 24 "1~59 second" 25 "1~59 second" 26 "1~59 second" 27 "1~59 second" 28 "1~59 second" 29 "1~59 second" 30 "1~59 second" 31 "1~59 second" 32 "1~59 second" 33 "1~59 second" 34 "1~59 second" 35 "1~59 second" 36 "1~59 second" 37 "1~59 second" 38 "1~59 second" 39 "1~59 second" 40 "1~59 second" 41 "1~59 second" 42 "1~59 second" 43 "1~59 second" 44 "1~59 second" 45 "1~59 second" 46 "1~59 second" 47 "1~59 second" 48 "1~59 second" 49 "1~59 second" 50 "1~59 second" 51 "1~59 second" 52 "1~59 second" 53 "1~59 second" 54 "1~59 second" 55 "1~59 second" 56 "1~59 second" 57 "1~59 second" 58 "1~59 second" 59 "1~59 second" 60 "0x3C~0xFE:RESERVED" 254 "0x3C~0xFE:RESERVED" 255 "Invalid" ;
VAL_ 1051 HU_DisplayMonth 0 "Not used" 1 "1~12 month" 2 "1~12 month" 3 "1~12 month" 4 "1~12 month" 5 "1~12 month" 6 "1~12 month" 7 "1~12 month" 8 "1~12 month" 9 "1~12 month" 10 "1~12 month" 11 "1~12 month" 12 "1~12 month" 13 "RESERVED" 14 "RESERVED" 15 "Invalid" ;
VAL_ 1052 HU_CLU_Crc2Val 0 "0x0x0~0xFFFF:CRCValue" 65535 "0x0x0~0xFFFF:CRCValue" ;
VAL_ 1052 HU_EVSupport 0 "Not support" 1 "Support" 2 "RESERVED" 3 "Invalid" ;
VAL_ 1052 HU_DayNightState 0 "Default" 1 "Day" 2 "Night" 3 "Invalid" ;
VAL_ 1052 HU_AutoBrightState_New 0 "Default" 1 "0x1~0x3FE:Brightness" 1022 "0x1~0x3FE:Brightness" 1023 "Invalid" ;
VAL_ 1052 HU_CLU_AlvCnt2Val 0 "0x0x0~0xFF:AlvCntValue" 255 "0x0x0~0xFF:AlvCntValue" ;
VAL_ 1052 HU_OffloadBtnReq 0 "Default" 1 "Off" 2 "On" 3 "Invaild" ;
VAL_ 1052 HU_LanguageInfo 0 "Off" 1 "Korea" 2 "English(US)" 3 "English(UK)" 4 "Simplified chinese" 5 "Traditional chinese" 6 "French(EU)" 7 "Spanish(EU)" 8 "Arabic" 9 "Czech" 10 "Danish" 11 "German" 12 "Italian" 13 "Dutch" 14 "Polish" 15 "Portuguese" 16 "Russain" 17 "Slovak" 18 "Swedish" 19 "Turkish" 20 "French(US)" 21 "Spanish(US)" 22 "English(India)" 23 "Norwegian" 24 "Finnish" 25 "Indonesian" 26 "Brazilian Portuguese" 27 "Malay" 28 "Hungarian" 29 "English (Australia)" 30 "Japanese" 31 "Hindi" 32 "Hebrew" 33 "Greek" 34 "Ukrainian" 35 "Slovenian" 36 "Bulgarian" 37 "Croatian" 38 "Romanian" 39 "Bengali" 40 "Marathi" 41 "Telugu" 42 "Tamil" 43 "Gujarati" 44 "Kannada" 45 "Odia" 46 "Malayalam" 47 "Punjabi" 48 "Thai" 49 "Tagalog" 50 "Vietnamese" 51 "Lithuanian" 52 "Latvian" 53 "Estonian" 54 "0x36~0xFE:RESERVED" 254 "0x36~0xFE:RESERVED" 255 "Invalid" ;
VAL_ 1052 HU_VolumeStatus 63 "Invalid" ;
VAL_ 1052 HU_MuteStatus 0 "Off" 1 "Mute On" 2 "RESERVED" 3 "Invalid" ;
VAL_ 1052 HU_WelcomeReady 0 "Default" 1 "Welcome ready" 2 "Goodbye ready" 3 "Invalid" ;
VAL_ 1052 HU_UsmSupport 0 "Not support" 1 "Support" 2 "RESERVED" 3 "Invalid" ;
VAL_ 1052 HU_NaviStatus 0 "Booting" 1 "Normal Operation" 2 "No SD Card(Map)" 3 "Invalid" ;
VAL_ 1052 HU_NaviDisp 0 "Non_Navi" 1 "Navi" 2 "RESERVED" 3 "Invalid" ;
VAL_ 1052 HU_BVM_Display_Message 0 "Not Used" 1 "No Message" 2 "Rain_Warning Message" 3 "RESERVED" 4 "RESERVED" 5 "RESERVED" 6 "RESERVED" 7 "Invalid" ;
VAL_ 1052 HU_NaviCamSettingStatus 0 "Navi Camera Alert Setting Status" 1 "Navi Camera Alert Setting Status" 2 "Navi Camera Alert Setting Status" 3 "Navi Camera Alert Setting Status" 4 "Navi Camera Alert Setting Status" 5 "Navi Camera Alert Setting Status" 6 "Navi Camera Alert Setting Status" 7 "Navi Camera Alert Setting Status" 8 "Navi Camera Alert Setting Status" 9 "Navi Camera Alert Setting Status" 10 "Navi Camera Alert Setting Status" 11 "Navi Camera Alert Setting Status" 12 "Navi Camera Alert Setting Status" 13 "Navi Camera Alert Setting Status" 14 "Navi Camera Alert Setting Status" 15 "Navi Camera Alert Setting Status" 16 "Navi Camera Alert Setting Status" 17 "Navi Camera Alert Setting Status" 18 "Navi Camera Alert Setting Status" 19 "Navi Camera Alert Setting Status" 20 "Navi Camera Alert Setting Status" 21 "Navi Camera Alert Setting Status" 22 "Navi Camera Alert Setting Status" 23 "Navi Camera Alert Setting Status" 24 "Navi Camera Alert Setting Status" 25 "Navi Camera Alert Setting Status" 26 "Navi Camera Alert Setting Status" 27 "Navi Camera Alert Setting Status" 28 "Navi Camera Alert Setting Status" 29 "Navi Camera Alert Setting Status" 30 "Navi Camera Alert Setting Status" 31 "Navi Camera Alert Setting Status" 32 "0x20~0xFE:RESERVED" 254 "0x20~0xFE:RESERVED" 255 "Invalid" ;
VAL_ 870 HU_GW_Crc3Val 0 "0x0x0~0xFFFF:CRCValue" 65535 "0x0x0~0xFFFF:CRCValue" ;
VAL_ 870 AVN_RSPA_Disp_Rdy 0 "Impossible to display" 1 "Possible to display" 2 "RESERVED" 3 "Invalid" ;
VAL_ 870 CF_AVN_ProfileIDRValue 0 "Default" 1 "Guest" 2 "Profile 1" 3 "Profile 2" 4 "Profile 3" 5 "Profile 4" 6 "Profile 5" 7 "Profile 6" 8 "Profile 7" 9 "Profile 8" 10 "Profile 9" 11 "RESERVED" 12 "RESERVED" 13 "RESERVED" 14 "RESERVED" 15 "Invalid" ;
VAL_ 870 HazardFromHUSVM 0 "inactive" 1 "active" 2 "RESERVED" 3 "invalid" ;
VAL_ 870 OMUOSMirCtrl 0 "Off" 1 "Fold" 2 "Unfold" 3 "invalid" ;
VAL_ 870 OTAUIStatus 0 "Not Ready" 1 "Ready" 2 "RESERVED" 3 "Invalid" ;
VAL_ 870 C_TeleActiveStatus 0 "Active" 1 "Deactive" 2 "RESERVED" 3 "Invalid" ;
VAL_ 870 HU_RTCCheck 0 "Ready" 1 "Checking" 2 "RESERVED" 3 "Invalid" ;
VAL_ 870 HU_GW_AlvCnt3Val 0 "0x0x0~0xFF:AlvCntValue" 255 "0x0x0~0xFF:AlvCntValue" ;
VAL_ 870 HU_SWRCWarmerSet 0 "Off (Release)" 1 "On (Press)" 2 "RESERVED" 3 "Invalid" ;
VAL_ 870 HU_TrModeReq_PE 0 "Default" 1 "Trailer On" 2 "Carrier On" 3 "Off" 4 "RESERVED" 5 "RESERVED" 6 "RESERVED" 7 "Invalid" ;
VAL_ 870 HU_TrBrakeTypeReq_PE 0 "Default" 1 "Off" 2 "Light Electric" 3 "Heavy Electric" 4 "EOH Light" 5 "EOH Heavy" 6 "RESERVED" 7 "Invalid" ;
VAL_ 870 AVN_MPA_SelBtnSta 0 "Init" 1 "Record new path button input" 2 "Cancel path edit PU input" 3 "RESERVED" 4 "RESERVED" 5 "RESERVED" 6 "RESERVED" 7 "RESERVED" 8 "Path_ID1 button input" 9 "Path_ID2 button input" 10 "Path_ID3 button input" 11 "Path_ID4 button input" 12 "Path_ID5 button input" 13 "Path_ID6 button input" 14 "Path_ID7 button input" 15 "Path_ID8 button input" 16 "Path_ID9 button input" 17 "Path_ID10 button input" 18 "RESERVED" 19 "RESERVED" 20 "RESERVED" 21 "RESERVED" 22 "Path_ID1 delete button input" 23 "Path_ID2 delete button input" 24 "Path_ID3 delete button input" 25 "Path_ID4 delete button input" 26 "Path_ID5 delete button input" 27 "Path_ID6 delete button input" 28 "Path_ID7 delete button input" 29 "Path_ID8 delete button input" 30 "Path_ID9 delete button input" 31 "Path_ID10 delete button input" 32 "RESERVED" 33 "RESERVED" 34 "RESERVED" 35 "RESERVED" 36 "RESERVED" 37 "RESERVED" 38 "RESERVED" 39 "RESERVED" 40 "RESERVED" 41 "RESERVED" 42 "RESERVED" 43 "RESERVED" 44 "RESERVED" 45 "RESERVED" 46 "RESERVED" 47 "RESERVED" 48 "RESERVED" 49 "RESERVED" 50 "RESERVED" 51 "RESERVED" 52 "RESERVED" 53 "RESERVED" 54 "RESERVED" 55 "RESERVED" 56 "RESERVED" 57 "RESERVED" 58 "RESERVED" 59 "RESERVED" 60 "RESERVED" 61 "RESERVED" 62 "RESERVED" 63 "Invalid" ;
VAL_ 870 AVN_PRK_Cam_Status 0 "Default" 1 "Normal" 2 "Error" 3 "Invalid" ;
VAL_ 870 AVN_MRA_Disp_Rdy 0 "Impossible to display" 1 "Possible to display" 2 "RESERVED" 3 "Invalid" ;
VAL_ 870 AVN_PRK_Func_Selected 0 "Init" 1 "No input" 2 "RSPA Soft Button input" 3 "MRA Soft Button input" 4 "MPA Soft Button input" 5 "Add New Route Soft Button input" 6 "Route Management Soft Button input" 7 "Search_Slot_along_way Soft Button input" 8 "SVM Soft Button input" 9 "Remote Forward/Backward Soft Button input" 10 "RESERVED" 11 "RESERVED" 12 "RESERVED" 13 "RESERVED" 14 "RESERVED" 15 "Invalid" ;
VAL_ 870 AVN_MRA_CancelInput 0 "Init" 1 "No input" 2 "Cancel input" 3 "Invalid" ;
VAL_ 870 HU_DistanceUnit 0 "Km" 1 "Mile" 2 "RESERVED" 3 "Invalid" ;
VAL_ 870 HU_Scheduled_Setting 0 "Scheduled not set" 1 "Scheduled set" 2 "RESERVED" 3 "RESERVED" 4 "RESERVED" 5 "RESERVED" 6 "60% SoC Requested" 7 "70% SoC Requested" 8 "80% SoC Requested" 9 "90% SoC Requested" 10 "100% SoC Requested" 11 "RESERVED" 12 "RESERVED" 13 "RESERVED" 14 "RESERVED" 15 "Invalid" ;
VAL_ 870 HU_AliveStatus 0 "Not Ready" 1 "On Mode" 2 "Head Unit Update Mode" 3 "Invalid" ;
VAL_ 870 HU_ThemeType 0 "Default" 1 "Aqua(Hyundai)" 2 "Magenta(Kia)" 3 "Eco White" 4 "Eco Black" 5 "Genesis(IKPE)" 6 "Magenta White" 7 "RESERVED" 8 "RESERVED" 9 "RESERVED" 10 "RESERVED" 11 "RESERVED" 12 "RESERVED" 13 "RESERVED" 14 "RESERVED" 15 "Invalid" 16 "Copper" 17 "Copper Rust" 18 "RESERVED" 19 "RESERVED" 20 "RESERVED" 21 "RESERVED" 22 "RESERVED" 23 "RESERVED" 24 "RESERVED" 25 "RESERVED" 26 "RESERVED" 27 "RESERVED" 28 "RESERVED" 29 "RESERVED" 30 "RESERVED" 31 "RESERVED" 32 "ccIC Light" 33 "ccIC Dark" 34 "RESERVED" 35 "RESERVED" 36 "RESERVED" 37 "RESERVED" 38 "RESERVED" 39 "RESERVED" 40 "RESERVED" 41 "RESERVED" 42 "RESERVED" 43 "RESERVED" 44 "RESERVED" 45 "RESERVED" 46 "RESERVED" 47 "RESERVED" 48 "RESERVED" 49 "RESERVED" 50 "RESERVED" 51 "RESERVED" 52 "RESERVED" 53 "RESERVED" 54 "RESERVED" 55 "RESERVED" 56 "RESERVED" 57 "RESERVED" 58 "RESERVED" 59 "RESERVED" 60 "RESERVED" 61 "RESERVED" 62 "RESERVED" 63 "RESERVED" ;
VAL_ 870 HU_MicActivity 0 "Deactivated" 1 "Activated" 2 "RESERVED" 3 "Invalid" ;
VAL_ 870 AVN_RSPA_ModeSelect 0 "None" 1 "CCP focus (1st menu on the left)" 2 "Touch or CCP confirm (1st menu on the left)" 3 "CCP focus (2nd menu on the left)" 4 "Touch or CCP confirm (2nd menu on the left)" 5 "CCP focus (1st menu on the right)" 6 "Touch or CCP confirm (1st menu on the right)" 7 "CCP focus (2nd menu on the right)" 8 "Touch or CCP confirm (2nd menu on the right)" 9 "Touch or CCP confirm (1st menu Forward perpendicular on the left)" 10 "Touch or CCP confirm (2nd menu Forward perpendicular on the left)" 11 "Touch or CCP confirm (1st menu Forward perpendicular on the right)" 12 "Touch or CCP confirm (2nd menu Forward perpendicular on the right)" 13 "RESERVED" 14 "RESERVED" 15 "Invalid" ;
VAL_ 870 CF_HU_GPSFlt 0 "Normal" 1 "Fault operation" 2 "TimeOut" 3 "Invalid" ;
VAL_ 870 AVN_RSPA_CancelInput 0 "Init" 1 "No Input" 2 "Cancel Input" 3 "Invalid" ;
VAL_ 993 PDC_FD_Crc2Val 0 "0x0x0~0xFFFF:CRCValue" 65535 "0x0x0~0xFFFF:CRCValue" ;
VAL_ 993 Lamp_StpLmpLftOpnSta 0 "Normal" 1 "Open Status" 2 "Not Used" 3 "Error Indicator" ;
VAL_ 993 Lamp_StpLmpRtOpnSta 0 "Normal" 1 "Open Status" 2 "Not Used" 3 "Error Indicator" ;
VAL_ 993 Lamp_HmslLmpOpnSta 0 "Normal" 1 "Open Status" 2 "Not Used" 3 "Error Indicator" ;
VAL_ 993 Lamp_DrlLmpLftOpnSta 0 "Normal" 1 "Open Status" 2 "Not Used" 3 "Error Indicator" ;
VAL_ 993 Lamp_DrlLmpRtOpnSta 0 "Normal" 1 "Open Status" 2 "Not Used" 3 "Error Indicator" ;
VAL_ 993 Lamp_FrFgLmpLftOpnSta 0 "Normal" 1 "Open Status" 2 "Not Used" 3 "Error Indicator" ;
VAL_ 993 Lamp_FrFgLmpRtOpnSta 0 "Normal" 1 "Open Status" 2 "Not Used" 3 "Error Indicator" ;
VAL_ 993 Lamp_CorneringLmpLftOpnSta 0 "Normal" 1 "Open Status" 2 "Not Used" 3 "Error Indicator" ;
VAL_ 993 Lamp_CorneringLmpRtOpnSta 0 "Normal" 1 "Open Status" 2 "Not Used" 3 "Error Indicator" ;
VAL_ 993 Lamp_StcBendingLmpLftOpnSta 0 "Normal" 1 "Open Status" 2 "Not Used" 3 "Error Indicator" ;
VAL_ 993 Lamp_StcBendingLmpRtOpnSta 0 "Normal" 1 "Open Status" 2 "Not Used" 3 "Error Indicator" ;
VAL_ 993 Lamp_FrTurnSigLmpLftPCLSta 0 "Normal" 1 "PCL Status" 2 "Not Used" 3 "Error Indicator" ;
VAL_ 993 Lamp_FrTurnSigLmpRtPCLSta 0 "Normal" 1 "PCL Status" 2 "Not Used" 3 "Error Indicator" ;
VAL_ 993 Lamp_RrTurnSigLmpLftPCLSta 0 "Normal" 1 "PCL Status" 2 "Not Used" 3 "Error Indicator" ;
VAL_ 993 Lamp_RrTurnSigLmpRtPCLSta 0 "Normal" 1 "PCL Status" 2 "Not Used" 3 "Error Indicator" ;
VAL_ 993 HzrdSwPushSta 0 "Off" 1 "On" 2 "Not Used" 3 "Error Indicator" ;
VAL_ 993 Lamp_LftTrnFaultSta 0 "Off" 1 "On" 2 "Not Used" 3 "Error Indicator" ;
VAL_ 993 Lamp_RtTrnFaultSta 0 "Off" 1 "On" 2 "Not Used" 3 "Error Indicator" ;
VAL_ 993 FrtTurnLampOptSta 0 "Not Applied" 1 "Bulb" 2 "LED" 3 "RESERVED" ;
VAL_ 993 RrTurnLampOptSta 0 "Not Applied" 1 "Bulb" 2 "LED" 3 "2Bulb" ;
VAL_ 993 PDC_FD_AlvCnt2Val 0 "0x0x0~0xFF:AlvCntValue" 255 "0x0x0~0xFF:AlvCntValue" ;
VAL_ 993 IntLamp_InlTailLmpSta 0 "Off" 1 "On" 2 "Not Used" 3 "Error Indicator" ;
VAL_ 993 Lamp_FootLampOnReq 0 "Off" 1 "On" 2 "Dim Out" 3 "Error Indicator" ;
VAL_ 993 Lamp_MoodLampOnReq 0 "0%" 1 "FadeIn" 2 "MoodBrightPercent" 3 "FadeOut" 4 "100%" 5 "RESERVED" 6 "RESERVED" 7 "RESERVED" ;
VAL_ 993 USM_FuncForMdLmpBrgtSta 0 "Default Value" 1 "Off" 2 "step 1" 3 "step 2" 4 "step 3" 5 "step 4" 6 "RESERVED" 7 "Invalid" ;
VAL_ 993 Lamp_HdLmpLoLftOpnSta 0 "Normal" 1 "Open Status" 2 "Not Used" 3 "Error Indicator" ;
VAL_ 993 Lamp_HdLmpLoRtOpnSta 0 "Normal" 1 "Open Status" 2 "Not Used" 3 "Error Indicator" ;
VAL_ 993 Lamp_HdLmpBiFuncLftOpnSta 0 "Normal" 1 "Open Status" 2 "Not Used" 3 "Error Indicator" ;
VAL_ 993 Lamp_HdLmpBiFuncRtOpnSta 0 "Normal" 1 "Open Status" 2 "Not Used" 3 "Error Indicator" ;
VAL_ 993 Lamp_HdLmpHiLftOpnSta 0 "Normal" 1 "Open Status" 2 "Not Used" 3 "Error Indicator" ;
VAL_ 993 Lamp_HdLmpHiRtOpnSta 0 "Normal" 1 "Open Status" 2 "Not Used" 3 "Error Indicator" ;
VAL_ 993 ExtLamp_HzrdSwSta 0 "Off" 1 "On" 2 "Not Used" 3 "Error Indicator" ;
VAL_ 993 Lamp_FrTrnSigLmpLftOpnSta 0 "Normal" 1 "Open Status" 2 "Not Used" 3 "Error Indicator" ;
VAL_ 993 Lamp_FrTrnSigLmpRtOpnSta 0 "Normal" 1 "Open Status" 2 "Not Used" 3 "Error Indicator" ;
VAL_ 993 Lamp_RrTrnSigLmpLftOpnSta 0 "Normal" 1 "Open Status" 2 "Not Used" 3 "Error Indicator" ;
VAL_ 993 Lamp_RrTrnSigLmpRtOpnSta 0 "Normal" 1 "Open Status" 2 "Not Used" 3 "Error Indicator" ;
VAL_ 993 Brake_SwSta_ICU 0 "Off" 1 "On" 2 "RESERVED" 3 "RESERVED" ;
VAL_ 993 BrkLmpCmd 0 "Inactive" 1 "Blink Off" 2 "Blink On" 3 "Steady On" ;
VAL_ 992 PDC_FD_Crc1Val 0 "0x0x0~0xFFFF:CRCValue" 65535 "0x0x0~0xFFFF:CRCValue" ;
VAL_ 992 C_3rdRCSeatBeltSW 0 "Unbelted" 1 "Belted" ;
VAL_ 992 C_3rdRRSeatBeltSW 0 "Unbelted" 1 "Belted" ;
VAL_ 992 C_1stCTRSeatBeltSW 0 "Unbelted" 1 "Belted" ;
VAL_ 992 Warn_DrvStOccSta 0 "UnSeated" 1 "Seated" 2 "RESERVED" 3 "RESERVED" 4 "RESERVED" 5 "Fault 1 (Cable Cut-off)" 6 "Fault 2 (Cable Short)" 7 "Error Indicator" ;
VAL_ 992 DPDMat_HDPSpprtSWVer 0 "Requirement Spec Version" 1 "Requirement Spec Version" 2 "Requirement Spec Version" 3 "Requirement Spec Version" 4 "Requirement Spec Version" 5 "Requirement Spec Version" 6 "Requirement Spec Version" 7 "Requirement Spec Version" 8 "Requirement Spec Version" 9 "Requirement Spec Version" 10 "Requirement Spec Version" 11 "Requirement Spec Version" 12 "Requirement Spec Version" 13 "Requirement Spec Version" 14 "Requirement Spec Version" 15 "Requirement Spec Version" 16 "Requirement Spec Version" 17 "Requirement Spec Version" 18 "Requirement Spec Version" 19 "Requirement Spec Version" 20 "Requirement Spec Version" 21 "Requirement Spec Version" 22 "Requirement Spec Version" 23 "Requirement Spec Version" 24 "Requirement Spec Version" 25 "Requirement Spec Version" 26 "Requirement Spec Version" 27 "Requirement Spec Version" 28 "Requirement Spec Version" 29 "Requirement Spec Version" 30 "Requirement Spec Version" 31 "Requirement Spec Version" ;
VAL_ 992 Warn_PassStOccSta 0 "Off (UnSeated)" 1 "On (Seated)" 2 "Not Used" 3 "Error Indicator" ;
VAL_ 992 Warn_RrLftSBRMATSwSta 0 "Off (UnSeated)" 1 "On (Seated)" 2 "RESERVED" 3 "Error Indicator" ;
VAL_ 992 Warn_RrRhtSBRMATSwSta 0 "Off (UnSeated)" 1 "On (Seated)" 2 "RESERVED" 3 "Error Indicator" ;
VAL_ 992 C_3rdRLSBRMatSw 0 "Off (UnSeated)" 1 "On (Seated)" ;
VAL_ 992 C_3rdRRSBRMatSw 0 "Off (UnSeated)" 1 "On (Seated)" ;
VAL_ 992 C_1stCTRSBRMatSw 0 "Off (UnSeated)" 1 "On (Seated)" ;
VAL_ 992 StrWhlWrmrSwState 0 "Off" 1 "On" 2 "Not Used" 3 "Error Indicator" ;
VAL_ 992 StrWhlWrmrFlModDetail 0 "Off" 1 "OverVoltage" 2 "UnderVoltage" 3 "OverCurrent" 4 "CircuitOpen" 5 "OverLimitTemperature" 6 "LowLimitTemperature" 7 "Reserved" ;
VAL_ 992 FrHtdGlsSwState 0 "Off" 1 "On" 2 "Not Used" 3 "Error Indicator" ;
VAL_ 992 RrGlsHtSwState 0 "Off" 1 "On" 2 "Not Used" 3 "Error Indicator" ;
VAL_ 992 RLChldLkLatchSwState 0 "Unlock" 1 "Lock" 2 "Not Used" 3 "Error Indicator" ;
VAL_ 992 RRChldLkLatchSwState 0 "Unlock" 1 "Lock" 2 "Not Used" 3 "Error Indicator" ;
VAL_ 992 ChildLock_ActnFlSta 0 "OK" 1 "Failed" 2 "Not Used" 3 "Error Indicator" ;
VAL_ 992 DoorLock_LkOutSta 0 "Off" 1 "On" 2 "Not Used" 3 "Error Indicator" ;
VAL_ 992 VSAutoDrLkRetryFailSta 0 "Normal" 1 "Fail" 2 "RESERVED" 3 "RESERVED" ;
VAL_ 992 Trunk_TrnkTlgtOutReleaseSwSta 0 "Off" 1 "On" 2 "Stuck" 3 "Error Indicator" ;
VAL_ 992 Trunk_TrnkInReleaseSwSta 0 "Off" 1 "On" 2 "Stuck" 3 "Error Indicator" ;
VAL_ 992 Trunk_GlvBxTrnkLkSwSta 0 "Off" 1 "On" 2 "Not Used" 3 "Error Indicator" ;
VAL_ 992 Trunk_TrnkTlgtSwSta 0 "Close(Full Lock)" 1 "Open(Not Full Lock)" 2 "Not Used" 3 "Error Indicator" ;
VAL_ 992 Trunk_TlgtFullOpnSwSta 0 "Close(Not Full Open)" 1 "Open(Full Open)" 2 "Not Used" 3 "Error Indicator" ;
VAL_ 992 Trunk_TrnkTlgtReleaseRlySta 0 "OFF" 1 "ON" 2 "Not Used" 3 "Error Indicator" ;
VAL_ 992 FrtWiper_ParkingSwState 0 "Off" 1 "On" 2 "RESERVED" 3 "RESERVED" ;
VAL_ 992 PDC_TlgtUnLkSta 0 "Lock" 1 "Unlock" 2 "Not Used" 3 "Error Indicator" ;
VAL_ 992 PDC_PSDPwrModeOffSwSta 0 "Off" 1 "On" 2 "Not Used" 3 "Error Indicator" ;
VAL_ 992 PDC_FuelDrOpenSta 0 "Close" 1 "Open" 2 "Not Used" 3 "RESERVED" ;
VAL_ 992 PDC_FD_AlvCnt1Val 0 "0x0x0~0xFF:AlvCntValue" 255 "0x0x0~0xFF:AlvCntValue" ;
VAL_ 992 OBCWakeupDrLock 0 "Default" 1 "Off" 2 "On(DrLock)" 3 "Error Indicator" ;
VAL_ 992 OBCWakeupDrUnlock 0 "Default" 1 "Off" 2 "On(Unlock)" 3 "Error Indicator" ;
VAL_ 992 Trunk_BgtOpnHzrdReq 0 "Off" 1 "On" 2 "Not Used" 3 "Error Indicator" ;
VAL_ 992 Trunk_BgtOpnBzrReq 0 "Off" 1 "On" 2 "Not Used" 3 "Error Indicator" ;
VAL_ 992 IGN3State 0 "Off" 1 "On" 2 "RESERVED" 3 "RESERVED" ;
VAL_ 992 IGN3State_By_BMS 0 "Off" 1 "On" 2 "RESERVED" 3 "RESERVED" ;
VAL_ 992 IGN3State_By_VCMS_HMU 0 "Off" 1 "On" 2 "RESERVED" 3 "RESERVED" ;
VAL_ 992 IGN3State_By_AfterBlow 0 "Off" 1 "On" 2 "RESERVED" 3 "RESERVED" ;
VAL_ 992 IGN3State_By_Bat 0 "Off" 1 "On" 2 "RESERVED" 3 "RESERVED" ;
VAL_ 992 IGN3State_By_VCU_HCU_FCU 0 "Off" 1 "On" 2 "RESERVED" 3 "RESERVED" ;
VAL_ 992 IGN3State_By_HU 0 "Off" 1 "On" 2 "RESERVED" 3 "RESERVED" ;
VAL_ 992 IGN3CutOffState 0 "CutOffNotApplied" 1 "NoRequest" 2 "Normal" 3 "PreWarn" 4 "CutOff" 5 "RESERVED" 6 "RESERVED" 7 "RESERVED" ;
VAL_ 992 SeatBeltSwSta_Drv 0 "Unbelted" 1 "Belted" 2 "Not Supported" 3 "Virgin Mode" ;
VAL_ 992 SeatBeltSwSta_1stCtr 0 "Unbelted" 1 "Belted" 2 "Not Supported" 3 "Virgin Mode" ;
VAL_ 992 SeatBeltSwSta_Asst 0 "Unbelted" 1 "Belted" 2 "Not Supported" 3 "Virgin Mode" ;
VAL_ 992 SeatBeltSwSta_2ndLft 0 "Unbelted" 1 "Belted" 2 "Not Supported" 3 "Virgin Mode" ;
VAL_ 992 SeatBeltSwSta_2ndCtr 0 "Unbelted" 1 "Belted" 2 "Not Supported" 3 "Virgin Mode" ;
VAL_ 992 SeatBeltSwSta_2ndRt 0 "Unbelted" 1 "Belted" 2 "Not Supported" 3 "Virgin Mode" ;
VAL_ 992 SeatBeltSwSta_3rdLft 0 "Unbelted" 1 "Belted" 2 "Not Supported" 3 "Virgin Mode" ;
VAL_ 992 SeatBeltSwSta_3rdCtr 0 "Unbelted" 1 "Belted" 2 "Not Supported" 3 "Virgin Mode" ;
VAL_ 992 SeatBeltSwSta_3rdRt 0 "Unbelted" 1 "Belted" 2 "Not Supported" 3 "Virgin Mode" ;
VAL_ 992 SeatBelt4th_InstallInfo 0 "Virgin Mode" 1 "No Seat" 2 "All Seat" 3 "Left and Right" 4 "RESERVED" 5 "RESERVED" 6 "RESERVED" 7 "RESERVED" ;
VAL_ 992 PDCex_CurtainOpt 0 "No Curtain" 1 "Rear Curtain" 2 "Quarter Glass Curtain" 3 "All Curtain" ;
VAL_ 992 Reprogram_State_PDC2 0 "normal operation" 1 "reprogramming" 2 "RESERVED" 3 "Invalid (default)" ;
VAL_ 992 Warn_RrCTRSBRMATSwSta 0 "Off (Unseated)" 1 "On (Seated)" 2 "Not Used" 3 "Error Indicator" ;
VAL_ 992 C_3rdRCSBRMatSw 0 "Off (UnSeated)" 1 "On (Seated)" ;
VAL_ 992 DriveTypeOption 0 "Left Handle Drive Type" 1 "Right Handle Drive Type" 2 "RESERVED" 3 "Error Indicator" ;
VAL_ 992 AutoLtOpt 0 "Not Applied" 1 "Applied" 2 "Reserved" 3 "Reserved" ;
VAL_ 992 HLmpLoHiOptLtSrcTyp 0 "Not Applied" 1 "2 Light MFR Bulb" 2 "4 Light Bulb" 3 "4 Light Led Ldm" 4 "Bi-Function Bulb" 5 "Bi-Function Led Ldm" 6 "Reserved" 7 "Reserved" ;
VAL_ 992 C_StrgWhlHeatingOpt 0 "Not Applied" 1 "Applied(steering wheel applied)" 2 "RESERVED" 3 "Invalid" ;
VAL_ 992 C_StrgWhlHeatingSWInf 0 "Default" 1 "1step opt(On/Off)" 2 "2step opt(step1,step2,Off)" 3 "Invalid" ;
VAL_ 992 ICU_MtGearPosRSta 0 "Off" 1 "On" 2 "RESERVED" 3 "RESERVED" ;
VAL_ 992 C_AutoLeverManualSW 0 "Not Manual" 1 "Manual" 2 "Manual +" 3 "Manual -" ;
VAL_ 992 Warn_HoodSwMemorySta 0 "No event" 1 "hood_open_close" 2 "RESERVED" 3 "RESERVED" ;
VAL_ 992 Warn_PrkngBrkSwSta 0 "Off" 1 "On" 2 "Not Used" 3 "Error Indicator" ;
VAL_ 992 PrkngBrkNotchSwState 0 "Off" 1 "On" 2 "Reserved" 3 "InvalidState" ;
VAL_ 992 Warn_BrkFldSwSta 0 "Off" 1 "On" 2 "Not Used" 3 "Error Indicator" ;
VAL_ 992 Warn_WshrFldSwSta 0 "Off" 1 "On" 2 "RESERVED" 3 "RESERVED" ;
VAL_ 992 Warn_DrvStBltSwSta 0 "Unbelted" 1 "Belted" 2 "Not Used" 3 "Error Indicator" ;
VAL_ 992 Warn_AsstStBltSwSta 0 "Unbelted" 1 "Belted" 2 "Not Used" 3 "Error Indicator" ;
VAL_ 992 Warn_RrLftStBltSwSta 0 "Unbelted" 1 "Belted" 2 "Not Used" 3 "Error Indicator" ;
VAL_ 992 Warn_RrCtrStBltSwSta 0 "Unbelted" 1 "Belted" 2 "Not Used" 3 "Error Indicator" ;
VAL_ 992 Warn_RrRtStBltSwSta 0 "Unbelted" 1 "Belted" 2 "Not Used" 3 "Error Indicator" ;
VAL_ 992 C_3rdRLSeatBeltSW 0 "Unbelted" 1 "Belted" ;
VAL_ 995 PDC_FD_Crc4Val 0 "0x0x0~0xFFFF:CRCValue" 65535 "0x0x0~0xFFFF:CRCValue" ;
VAL_ 995 PDC_FD_AlvCnt4Val 0 "0x0x0~0xFF:AlvCntValue" 255 "0x0x0~0xFF:AlvCntValue" ;
VAL_ 995 ICU_Haptic_OPT 0 "Default" 1 "No option(None Haptic Option)" 2 "Option" 3 "Invalid" ;
VAL_ 995 HSWS_SysWrngSta_ICU 0 "Normal" 1 "System Fail" 2 "RESERVED" 3 "Invalid" ;
VAL_ 995 ICU_PwrWdwMvInhbtSta 0 "Off" 1 "Inhabit" ;
VAL_ 995 Warn_OSMirrFoldSwState 0 "OFF(Seasaw Type=Fold, Return Type=Off)" 1 "ON(Seasaw Type=Unfold or Auto, Return Type" 2 "Not Used" 3 "Error Indicator" ;
VAL_ 995 USM_OneTouchTrnSigFuncSta 0 "Default" 1 "One Touch Turn Off" 2 "3 Flashing" 3 "5 Flashing" 4 "7 Flashing" 5 "Invalid" 6 "RESERVED" 7 "RESERVED" ;
VAL_ 995 ExtLamp_TrnSigLmpLftSwSta 0 "Off" 1 "On" 2 "Not Used" 3 "Error Indicator" ;
VAL_ 995 ExtLamp_TrnSigLmpRtSwSta 0 "Off" 1 "On" 2 "Not Used" 3 "Error Indicator" ;
VAL_ 995 Lamp_LaneChgTrnSigLftSwSta_ICU 0 "Off" 1 "On" 2 "Not Used" 3 "Error Indicator" ;
VAL_ 995 Lamp_LaneChgTrnSigRtSwSta_ICU 0 "Off" 1 "On" 2 "Not Used" 3 "Error Indicator" ;
VAL_ 995 ICU_HDPSpprtRdy 0 "Normal" 1 "ADAS Message Not Recognized" 2 "RESERVED" 3 "RESERVED" ;
VAL_ 995 HzrdLmp_HDPSpprtSWVer 0 "Requirement Spec Version" 1 "Requirement Spec Version" 2 "Requirement Spec Version" 3 "Requirement Spec Version" 4 "Requirement Spec Version" 5 "Requirement Spec Version" 6 "Requirement Spec Version" 7 "Requirement Spec Version" 8 "Requirement Spec Version" 9 "Requirement Spec Version" 10 "Requirement Spec Version" 11 "Requirement Spec Version" 12 "Requirement Spec Version" 13 "Requirement Spec Version" 14 "Requirement Spec Version" 15 "Requirement Spec Version" 16 "Requirement Spec Version" 17 "Requirement Spec Version" 18 "Requirement Spec Version" 19 "Requirement Spec Version" 20 "Requirement Spec Version" 21 "Requirement Spec Version" 22 "Requirement Spec Version" 23 "Requirement Spec Version" 24 "Requirement Spec Version" 25 "Requirement Spec Version" 26 "Requirement Spec Version" 27 "Requirement Spec Version" 28 "Requirement Spec Version" 29 "Requirement Spec Version" 30 "Requirement Spec Version" 31 "Requirement Spec Version" ;
VAL_ 995 Lamp_TrnSigLmpLftOnReq 0 "Inactive" 1 "Active Off(Flasher Off)" 2 "Active On(Flasher On)" 3 "RESERVED" ;
VAL_ 995 Lamp_TrnSigLmpRtOnReq 0 "Inactive" 1 "Active Off(Flasher Off)" 2 "Active On(Flasher On)" 3 "RESERVED" ;
VAL_ 995 Lamp_TrnSigLmpLftActiveSt 0 "Off (Inactive)" 1 "On (Active)" 2 "RESERVED" 3 "Invalid" ;
VAL_ 995 Lamp_TrnSigLmpRtActiveSt 0 "Off (Inactive)" 1 "On (Active)" 2 "RESERVED" 3 "Invalid" ;
VAL_ 995 TrnLmpSeqEnblCmd 0 "Off" 1 "On" 2 "Reserved" 3 "Reserved" ;
VAL_ 995 CrashHazardLampOnReq 0 "No Request" 1 "Lamp On Request" 2 "RESERVED" 3 "Error Indicator" ;
VAL_ 994 PDC_FD_Crc3Val 0 "0x0x0~0xFFFF:CRCValue" 65535 "0x0x0~0xFFFF:CRCValue" ;
VAL_ 994 PDC_FD_AlvCnt3Val 0 "0x0x0~0xFF:AlvCntValue" 255 "0x0x0~0xFF:AlvCntValue" ;
VAL_ 994 Warn_DrvDrSwSta 0 "Close" 1 "Open" 2 "Not Used" 3 "Error Indicator" ;
VAL_ 994 Warn_AsstDrSwSta 0 "Close" 1 "Open" 2 "Not Used" 3 "Error Indicator" ;
VAL_ 994 Warn_RrLftDrSwSta 0 "Close" 1 "Open" 2 "Not Used" 3 "Error Indicator" ;
VAL_ 994 Warn_RrRtDrSwSta 0 "Close" 1 "Open" 2 "Not Used" 3 "Error Indicator" ;
VAL_ 994 Warn_HoodSwSta 0 "Off" 1 "On" 2 "Not Used" 3 "Error Indicator" ;
VAL_ 994 DoorLock_DrvDrUnLkSta 0 "Lock" 1 "Unlock" 2 "Not Used" 3 "Error Indicator" ;
VAL_ 994 DoorLock_AsstDrUnLkSta 0 "Lock" 1 "Unlock" 2 "Not Used" 3 "Error Indicator" ;
VAL_ 994 DoorLock_RrLftDrUnLkSta 0 "Lock" 1 "Unlock" 2 "Not Used" 3 "Error Indicator" ;
VAL_ 994 DoorLock_RrRtDrUnLkSta 0 "Lock" 1 "Unlock" 2 "Not Used" 3 "Error Indicator" ;
VAL_ 994 DoorLock_DrvKeyLkSwSta 0 "Off" 1 "Lock" 2 "Not Used" 3 "Error Indicator" ;
VAL_ 994 DoorLock_DrvKeyUnLkSwSta 0 "Off" 1 "Unlock" 2 "Not Used" 3 "Error Indicator" ;
VAL_ 994 DoorLock_CtrlDrLkSwSta_ICU 0 "Off" 1 "On(Lock On)" 2 "Not Used" 3 "Error Indicator" ;
VAL_ 994 DoorLock_CtrlDrUnLkSwSta_ICU 0 "Off" 1 "On(Unlock On)" 2 "Not Used" 3 "Error Indicator" ;
VAL_ 994 DoorLock_CtrlDrLkUnLkSwSta_ICU 0 "Off" 1 "On" 2 "Not Used" 3 "Error Indicator" ;
VAL_ 994 C_CrashUnlockState 0 "Off" 1 "Unlock(Crash)" 2 "RESERVED" 3 "RESERVED" ;
VAL_ 994 Lamp_LedHdLmpSta 0 "LED Headlamp is in nornal condition" 1 "RESERVED" 2 "LED Fail" 3 "RESERVED" ;
VAL_ 994 Warn_ChaDrSwFrtSta 0 "Default" 1 "Close" 2 "Open" 3 "Error Indicator" ;
VAL_ 994 Warn_ChaDrSwRrSta 0 "Default" 1 "Close" 2 "Open" 3 "Error Indicator" ;
VAL_ 997 PDC_FD_Crc11Val 0 "0x0x0~0xFFFF:CRCValue" 65535 "0x0x0~0xFFFF:CRCValue" ;
VAL_ 997 ICU_BS1ValFlagSta 0 "Valid condition" 1 "Invalid condition" 2 "RESERVED" 3 "RESERVED" ;
VAL_ 997 ICU_BS1ErrRes 0 "opeartion correctly" 1 "response error" 2 "RESERVED" 3 "Error Indicator" ;
VAL_ 997 ICU_BS2SoC 0 "0x0x00~0x64:0% ~ 100 %" 100 "0x0x00~0x64:0% ~ 100 %" 101 "0x65~0xFE:Invalid" 254 "0x65~0xFE:Invalid" 255 "Error" ;
VAL_ 997 ICU_BS2NCap 0 "0x0x00~0xFA:0Ah ~ 250Ah" 250 "0x0x00~0xFA:0Ah ~ 250Ah" 251 "Invalid" 252 "Invalid" 253 "Invalid" 254 "Invalid" 255 "Error" ;
VAL_ 997 ICU_BS2OpnCirVol 0 "0x0x000~0xFA0:10.000V ~ 14.000V" 4000 "0x0x000~0xFA0:10.000V ~ 14.000V" 4001 "Invailid" 4002 "Invailid" 4003 "Invailid" 4004 "Invailid" 4005 "Invailid" 4006 "Invailid" 4007 "Invailid" 4008 "Invailid" 4009 "Invailid" 4010 "Invailid" 4011 "Invailid" 4012 "Invailid" 4013 "Invailid" 4014 "Invailid" 4015 "Invailid" 4016 "Invailid" 4017 "Invailid" 4018 "Invailid" 4019 "Invailid" 4020 "Invailid" 4021 "Invailid" 4022 "Invailid" 4023 "Invailid" 4024 "Invailid" 4025 "Invailid" 4026 "Invailid" 4027 "Invailid" 4028 "Invailid" 4029 "Invailid" 4030 "Invailid" 4031 "Invailid" 4032 "Invailid" 4033 "Invailid" 4034 "Invailid" 4035 "Invailid" 4036 "Invailid" 4037 "Invailid" 4038 "Invailid" 4039 "Invailid" 4040 "Invailid" 4041 "Invailid" 4042 "Invailid" 4043 "Invailid" 4044 "Invailid" 4045 "Invailid" 4046 "Invailid" 4047 "Invailid" 4048 "Invailid" 4049 "Invailid" 4050 "Invailid" 4051 "Invailid" 4052 "Invailid" 4053 "Invailid" 4054 "Invailid" 4055 "Invailid" 4056 "Invailid" 4057 "Invailid" 4058 "Invailid" 4059 "Invailid" 4060 "Invailid" 4061 "Invailid" 4062 "Invailid" 4063 "Invailid" 4064 "Invailid" 4065 "Invailid" 4066 "Invailid" 4067 "Invailid" 4068 "Invailid" 4069 "Invailid" 4070 "Invailid" 4071 "Invailid" 4072 "Invailid" 4073 "Invailid" 4074 "Invailid" 4075 "Invailid" 4076 "Invailid" 4077 "Invailid" 4078 "Invailid" 4079 "Invailid" 4080 "Invailid" 4081 "Invailid" 4082 "Invailid" 4083 "Invailid" 4084 "Invailid" 4085 "Invailid" 4086 "Invailid" 4087 "Invailid" 4088 "Invailid" 4089 "Invailid" 4090 "Invailid" 4091 "Invailid" 4092 "Invailid" 4093 "Invailid" 4094 "Invailid" 4095 "Error" ;
VAL_ 997 ICU_BS2_FSOC 0 "valid" 1 "invalid" ;
VAL_ 997 ICU_BS2_FSOH 0 "valid" 1 "invalid" ;
VAL_ 997 ICU_BS2_FSOF 0 "valid" 1 "invalid" ;
VAL_ 997 ICU_BS2_FQSTAT 0 "valid" 1 "invalid" ;
VAL_ 997 ICU_BS2SoH 0 "0x0x00~0x64:0% ~ 100 %" 100 "0x0x00~0x64:0% ~ 100 %" 101 "0x65~0xFE:Invalid" 254 "0x65~0xFE:Invalid" 255 "Error" ;
VAL_ 997 ICU_BS2SoF 0 "0x0x00~0xF0:0.00V ~ 12.00V" 240 "0x0x00~0xF0:0.00V ~ 12.00V" 241 "Invalid" 242 "Invalid" 243 "Invalid" 244 "Invalid" 245 "Invalid" 246 "Invalid" 247 "Invalid" 248 "Invalid" 249 "Invalid" 250 "Invalid" 251 "Invalid" 252 "Invalid" 253 "Invalid" 254 "Invalid" 255 "Error" ;
VAL_ 997 PDC_FD_AlvCnt11Val 0 "0x0x0~0xFF:AlvCntValue" 255 "0x0x0~0xFF:AlvCntValue" ;
VAL_ 997 ICU_BS1BatVol_Dis 0 "0x0x0000~0x2EE0:6.000V ~ 18.000V" 12000 "0x0x0000~0x2EE0:6.000V ~ 18.000V" 12001 "0x2EE1~0x3FFE:Invalid" 16382 "0x2EE1~0x3FFE:Invalid" 16383 "Error" ;
VAL_ 997 ICU_BS1IBAT_Conversion 0 "0x0x00000~0x3A980:-1,200,000mA ~ 1,200,000mA" 240000 "0x0x00000~0x3A980:-1,200,000mA ~ 1,200,000mA" 240001 "0x3A981~0x3FFFE:Invalid" 262142 "0x3A981~0x3FFFE:Invalid" 262143 "Error" ;
VAL_ 997 ICU_BS1BatVol 0 "0x0x0000~0x2EE0:6.000V ~ 18.000V" 12000 "0x0x0000~0x2EE0:6.000V ~ 18.000V" 12001 "0x2EE1~0x3FFE:Invalid" 16382 "0x2EE1~0x3FFE:Invalid" 16383 "Error" ;
VAL_ 997 ICU_BS1BatTemp 0 "0x0x000~0x14A:-40℃ ~ 125℃" 330 "0x0x000~0x14A:-40℃ ~ 125℃" 331 "0x14B~0x1FE:Invalid" 510 "0x14B~0x1FE:Invalid" 511 "Error" ;
