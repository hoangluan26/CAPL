VERSION ""

NS_ :

BS_:

BU_: SHVU_CCS_FD ARS_FD WPC_FD WPC2_FD SCM_FD SHVU_FRNT_FD GW_SAU_DRV_FD ATS_FD PSB_FD GW_PSU_RR_FD SHVU_RL_FD RWPC_FD CGW_CCU SHVU_REAR_FD OHCL_FD BLTN_CAM_FD GW_PSU_DRV_FD FCS_FD GW_PSU_AST_FD GW_PSU_3RD_FD RCS_FD SHVU_3RD_FD GW_PSU_RL_FD SHVU_RR_FD RCM_FD SGU_FD DCM_FD

BO_ 813 SBCM_DRV_FD_01_200ms: 32 CGW_CCU
 SG_ SBCM_DRV_FD_Crc1Val : 0|16@1+ (1,0) [0|0] ""  GW_PSU_DRV_FD
 SG_ Latch_TypeOption_DRV : 100|2@1+ (1,0) [0|0] ""  RWPC_FD,WPC2_FD,WPC_FD
 SG_ DRV_SWFailAlarm : 102|2@1+ (1,0) [0|0] ""  ATS_FD
 SG_ USM_PwrDRApprOpnSetSta : 104|2@1+ (1,0) [0|0] "" Vector__XXX
 SG_ USM_PwrDRApprOpnSetOpt : 106|2@1+ (1,0) [0|0] "" Vector__XXX
 SG_ USM_PwrDRCloseByRKELockSta : 108|2@1+ (1,0) [0|0] "" Vector__XXX
 SG_ USM_PwrDRCloseByRKELockOpt : 110|2@1+ (1,0) [0|0] "" Vector__XXX
 SG_ USM_PwrDRCloseByBrakeSta : 112|2@1+ (1,0) [0|0] "" Vector__XXX
 SG_ USM_PwrDRCloseByBrakeOpt : 114|2@1+ (1,0) [0|0] "" Vector__XXX
 SG_ USM_PwrDRBuzzerSta : 116|2@1+ (1,0) [0|0] "" Vector__XXX
 SG_ USM_PwrDRBuzzerOpt : 118|2@1+ (1,0) [0|0] "" Vector__XXX
 SG_ PDS_TypeOption_DRV : 120|2@1+ (1,0) [0|0] ""  ATS_FD
 SG_ C_DrvDoorApproachOpen : 122|2@1+ (1,0) [0|0] "" Vector__XXX
 SG_ C_DrvDoorApproachClose : 124|2@1+ (1,0) [0|0] "" Vector__XXX
 SG_ DoorLock_PDSLkSwSta_DRV : 126|2@1+ (1,0) [0|0] "" Vector__XXX
 SG_ SBCM_DRV_DiagSta : 136|2@1+ (1,0) [0|0] "" Vector__XXX
 SG_ DoorLock_CtrlDrLkUnLkSwSta_SBCM : 138|2@1+ (1,0) [0|0] "" Vector__XXX
 SG_ SBCM_PsvDrLkReq : 144|2@1+ (1,0) [0|0] "" Vector__XXX
 SG_ CDMAutoWashModeSet_SBCM : 146|3@1+ (1,0) [0|0] "" Vector__XXX
 SG_ USM_DrvGhostDoorSta : 150|2@1+ (1,0) [0|0] "" Vector__XXX
 SG_ Mirror_LH_FoldingSta : 152|2@1+ (1,0) [0|0] "" Vector__XXX
 SG_ Mirror_LH_UnfoldingSta : 154|2@1+ (1,0) [0|0] "" Vector__XXX
 SG_ DRV_CrashMRActAlarm : 156|2@1+ (1,0) [0|0] "" Vector__XXX
 SG_ AFH_DRV_FldUnFldSta : 158|2@1+ (1,0) [0|0] "" Vector__XXX
 SG_ SBCM_DRV_FD_AlvCnt1Val : 16|8@1+ (1,0) [0|0] ""  GW_PSU_DRV_FD
 SG_ MirrorFldReq : 160|2@1+ (1,0) [0|0] "" Vector__XXX
 SG_ OMU_TypeOption_DRV : 162|2@1+ (1,0) [0|0] "" Vector__XXX
 SG_ IMS_OSMirPlayBackSta_LH : 164|4@1+ (1,0) [0|0] ""  GW_PSU_DRV_FD
 SG_ ECMMRR_PLUS : 168|8@1+ (1,0) [0|0] "" Vector__XXX
 SG_ EHL_TxInfo_SBCM_DRV : 176|3@1+ (1,0) [0|0] "" Vector__XXX
 SG_ IMS_OSMirPlayBackSta_LH_New : 184|4@1+ (1,0) [0|0] ""  GW_PSU_DRV_FD
 SG_ CDM_InsideOpnSwSta : 200|2@1+ (1,0) [0|0] "" Vector__XXX
 SG_ CDM_TypeOption : 202|2@1+ (1,0) [0|0] "" Vector__XXX
 SG_ CDM_ImmeChgSw_SBCM : 208|2@1+ (1,0) [0|0] "" Vector__XXX
 SG_ CDM_FobSrchReq_DRV : 210|2@1+ (1,0) [0|0] "" Vector__XXX
 SG_ CDM_OpnClsState_SBCM : 212|2@1+ (1,0) [0|0] "" Vector__XXX
 SG_ CDM_WarnMsg_SBCM : 214|2@1+ (1,0) [0|0] "" Vector__XXX
 SG_ CDM_AutoWashModeSta : 216|3@1+ (1,0) [0|0] "" Vector__XXX
 SG_ CDM_CmdStatus_SBCM : 220|4@1+ (1,0) [0|0] "" Vector__XXX
 SG_ CDM_OutsideOpnSwSta : 224|2@1+ (1,0) [0|0] "" Vector__XXX
 SG_ PwrDRBuzzerOut_DRV : 226|2@1+ (1,0) [0|0] "" Vector__XXX
 SG_ Warn_HoodSwSta_SBCM : 228|2@1+ (1,0) [0|0] ""  BLTN_CAM_FD
 SG_ Hood_TypeOption : 230|2@1+ (1,0) [0|0] ""  BLTN_CAM_FD
 SG_ SBCM_FrunkSta : 232|2@1+ (1,0) [0|0] "" Vector__XXX
 SG_ Warn_HoodSwFullSta_SBCM : 234|2@1+ (1,0) [0|0] "" Vector__XXX
 SG_ FrunkWarning_SBCM : 236|2@1+ (1,0) [0|0] "" Vector__XXX
 SG_ SBCM_Longkey_DRVDrAtClsSwSta : 238|2@1+ (1,0) [0|0] "" Vector__XXX
 SG_ FrunkReleaseSwSta_SBCM : 24|2@1+ (1,0) [0|0] "" Vector__XXX
 SG_ PwrDRClosingDRVDrSta : 240|3@1+ (1,0) [0|0] ""  ATS_FD
 SG_ Drv_DrLkRetryFail_SBCM : 243|2@1+ (1,0) [0|0] "" Vector__XXX
 SG_ CDM_GbtImmeChgSw_SBCM : 246|2@1+ (1,0) [0|0] "" Vector__XXX
 SG_ CDM_GbtOpnClsState_SBCM : 248|2@1+ (1,0) [0|0] "" Vector__XXX
 SG_ CDM_GbtWarnMsg_SBCM : 250|2@1+ (1,0) [0|0] "" Vector__XXX
 SG_ CDM_GbtOutsideOpnSwSta : 252|2@1+ (1,0) [0|0] "" Vector__XXX
 SG_ DoorLock_DrvLkOutSta_SBCM : 254|2@1+ (1,0) [0|0] "" Vector__XXX
 SG_ FrunkEmergencySwSta_SBCM : 28|2@1+ (1,0) [0|0] "" Vector__XXX
 SG_ DRV_DetectObj_warn_LH : 30|2@1+ (1,0) [0|0] ""  ATS_FD
 SG_ PwrDROpenClosingDdvSdDRSta : 32|3@1+ (1,0) [0|0] ""  ATS_FD
 SG_ PwrDRBuzzerOut_DRV_New : 35|3@1+ (1,0) [0|0] "" Vector__XXX
 SG_ Coach_TypeOption_DRV : 38|2@1+ (1,0) [0|0] ""  ATS_FD,GW_PSU_RL_FD,GW_PSU_RR_FD
 SG_ PwrDrSta_Drv : 40|2@1+ (1,0) [0|0] ""  ATS_FD
 SG_ PwrDrSta_DrvSd : 42|2@1+ (1,0) [0|0] ""  ATS_FD
 SG_ USM_PwrDrOpnTypSta : 44|2@1+ (1,0) [0|0] "" Vector__XXX
 SG_ DischrgDr_OpnClsState_SBCM : 46|2@1+ (1,0) [0|0] "" Vector__XXX
 SG_ SBCM_FL_DoorAngle : 48|7@1+ (1,0) [0|0] "˚"  ATS_FD
 SG_ SBCM_DoorType_DRV : 60|2@1+ (1,0) [0|0] "" Vector__XXX
 SG_ CDM_DrType_DRV : 62|2@1+ (1,0) [0|0] "" Vector__XXX
 SG_ DRVDoorPushAlarm : 72|2@1+ (1,0) [0|0] "" Vector__XXX
 SG_ DRV_CrashUnlockCmd : 74|1@1+ (1,0) [0|0] ""  BLTN_CAM_FD
 SG_ C_ApprOpenStatus : 75|1@1+ (1,0) [0|0] "" Vector__XXX
 SG_ DoorLock_DrvKeyLkSwSta_SBCM : 80|2@1+ (1,0) [0|0] "" Vector__XXX
 SG_ DoorLock_DrvKeyUnLkSwSta_SBCM : 82|2@1+ (1,0) [0|0] "" Vector__XXX
 SG_ Warn_DrvDrSwSta_SBCM : 84|2@1+ (1,0) [0|0] ""  ATS_FD,BLTN_CAM_FD,DCM_FD,GW_PSU_DRV_FD,PSB_FD,RWPC_FD,WPC2_FD,WPC_FD
 SG_ DoorLock_DrvDrUnLkSta_SBCM : 86|2@1+ (1,0) [0|0] ""  ATS_FD,FCS_FD,GW_PSU_DRV_FD
 SG_ DRV_SEAWarn_LH : 88|2@1+ (1,0) [0|0] ""  ATS_FD
 SG_ DRV_SEAWarn_RH : 90|2@1+ (1,0) [0|0] "" Vector__XXX
 SG_ DRV_SEWWarn_LH : 92|2@1+ (1,0) [0|0] "" Vector__XXX
 SG_ DRV_SEWWarn_RH : 94|2@1+ (1,0) [0|0] "" Vector__XXX
 SG_ DRV_MRActivationAlarm : 96|2@1+ (1,0) [0|0] "" Vector__XXX
 SG_ DRV_ReleaseWarn : 98|2@1+ (1,0) [0|0] "" Vector__XXX

BO_ 811 SBCM_AST_FD_01_200ms: 32 CGW_CCU
 SG_ SBCM_AST_FD_Crc1Val : 0|16@1+ (1,0) [0|0] ""  GW_PSU_DRV_FD
 SG_ USM_AstGhostDoorSta : 100|2@1+ (1,0) [0|0] "" Vector__XXX
 SG_ AST_SWFailAlarm : 102|2@1+ (1,0) [0|0] ""  ATS_FD
 SG_ DoorLock_PDSLkSwSta_AST : 104|2@1+ (1,0) [0|0] "" Vector__XXX
 SG_ PDS_TypeOption_AST : 106|2@1+ (1,0) [0|0] "" Vector__XXX
 SG_ AFCU_AutoWashModeSta_SBCM_AST : 120|3@1+ (1,0) [0|0] "" Vector__XXX
 SG_ CDM_AutoWashModeSta_SBCM_AST : 123|3@1+ (1,0) [0|0] "" Vector__XXX
 SG_ AFH_AST_FldUnFldSta : 126|2@1+ (1,0) [0|0] "" Vector__XXX
 SG_ SBCM_AST_DiagSta : 136|2@1+ (1,0) [0|0] "" Vector__XXX
 SG_ CDM_TypeOption_AST : 138|2@1+ (1,0) [0|0] "" Vector__XXX
 SG_ CDM_ImmeChgSw_AST : 144|2@1+ (1,0) [0|0] "" Vector__XXX
 SG_ CDM_FobSrchReq_AST : 146|2@1+ (1,0) [0|0] "" Vector__XXX
 SG_ CDM_OpnClsState_AST : 148|2@1+ (1,0) [0|0] "" Vector__XXX
 SG_ CDM_WarnMsg_AST : 150|2@1+ (1,0) [0|0] "" Vector__XXX
 SG_ Mirror_RH_FoldingSta : 152|2@1+ (1,0) [0|0] "" Vector__XXX
 SG_ Mirror_RH_UnfoldingSta : 154|2@1+ (1,0) [0|0] "" Vector__XXX
 SG_ CDM_CmdStatus_AST : 156|4@1+ (1,0) [0|0] "" Vector__XXX
 SG_ SBCM_AST_FD_AlvCnt1Val : 16|8@1+ (1,0) [0|0] ""  GW_PSU_DRV_FD
 SG_ AST_CrashMRActAlarm : 160|2@1+ (1,0) [0|0] "" Vector__XXX
 SG_ PwrDRBuzzerOut_AST : 162|2@1+ (1,0) [0|0] "" Vector__XXX
 SG_ IMS_OSMirPlayBackSta_RH : 164|4@1+ (1,0) [0|0] ""  GW_PSU_DRV_FD
 SG_ PwrDRClosingASTDrSta : 168|3@1+ (1,0) [0|0] ""  ATS_FD
 SG_ CDM_OutsideOpnSwSta_AST : 172|2@1+ (1,0) [0|0] "" Vector__XXX
 SG_ SBCM_Longkey_ASTDrAtClsSwSta : 174|2@1+ (1,0) [0|0] "" Vector__XXX
 SG_ Hood_TypeOption_AST : 176|2@1+ (1,0) [0|0] "" Vector__XXX
 SG_ Warn_HoodSwSta_AST : 178|2@1+ (1,0) [0|0] "" Vector__XXX
 SG_ FrunkWarning_AST : 180|2@1+ (1,0) [0|0] "" Vector__XXX
 SG_ SBCM_FrunkSta_AST : 182|2@1+ (1,0) [0|0] "" Vector__XXX
 SG_ IMS_OSMirPlayBackSta_RH_New : 184|4@1+ (1,0) [0|0] ""  GW_PSU_DRV_FD
 SG_ Ast_DrLkRetryFail_SBCM : 188|2@1+ (1,0) [0|0] "" Vector__XXX
 SG_ DoorLock_AstLkOutSta_SBCM : 190|2@1+ (1,0) [0|0] "" Vector__XXX
 SG_ FrunkReleaseSwSta_SBCM_AST : 192|2@1+ (1,0) [0|0] "" Vector__XXX
 SG_ FrunkInsideRelSwSta_SBCM_AST : 194|2@1+ (1,0) [0|0] "" Vector__XXX
 SG_ FrunkEmergencySwSta_SBCM_AST : 196|2@1+ (1,0) [0|0] "" Vector__XXX
 SG_ PwrDrSta_Ast : 24|2@1+ (1,0) [0|0] ""  ATS_FD
 SG_ PwrDrSta_AstSd : 26|2@1+ (1,0) [0|0] ""  ATS_FD
 SG_ DischrgDr_OpnClsState_SBCM_AST : 28|2@1+ (1,0) [0|0] "" Vector__XXX
 SG_ AST_DetectObj_warn_LH : 30|2@1+ (1,0) [0|0] ""  ATS_FD
 SG_ PwrDROpenClosingAstSdDRSta : 32|3@1+ (1,0) [0|0] ""  ATS_FD
 SG_ PwrDRBuzzerOut_AST_New : 35|3@1+ (1,0) [0|0] "" Vector__XXX
 SG_ SBCM_FR_DoorAngle : 40|7@1+ (1,0) [0|0] "˚"  ATS_FD
 SG_ EHL_TxInfo_SBCM_AST : 47|3@1+ (1,0) [0|0] "" Vector__XXX
 SG_ CDM_DrType_AST : 62|2@1+ (1,0) [0|0] "" Vector__XXX
 SG_ ASTDoorPushAlarm : 72|2@1+ (1,0) [0|0] "" Vector__XXX
 SG_ AST_CrashUnlockCmd : 74|1@1+ (1,0) [0|0] ""  BLTN_CAM_FD
 SG_ DoorLock_CtrlDrLkSwSta_SBCM : 80|2@1+ (1,0) [0|0] "" Vector__XXX
 SG_ DoorLock_CtrlDrUnLkSwSta_SBCM : 82|2@1+ (1,0) [0|0] "" Vector__XXX
 SG_ Warn_AsstDrSwSta_SBCM : 84|2@1+ (1,0) [0|0] ""  ATS_FD,BLTN_CAM_FD,DCM_FD,GW_PSU_AST_FD,GW_SAU_DRV_FD,PSB_FD,RWPC_FD,WPC2_FD,WPC_FD
 SG_ DoorLock_AsstDrUnLkSta_SBCM : 86|2@1+ (1,0) [0|0] ""  ATS_FD,FCS_FD
 SG_ AST_SEAWarn_RH : 88|2@1+ (1,0) [0|0] "" Vector__XXX
 SG_ AST_SEAWarn_LH : 90|2@1+ (1,0) [0|0] ""  ATS_FD
 SG_ AST_SEWWarn_LH : 92|2@1+ (1,0) [0|0] "" Vector__XXX
 SG_ AST_SEWWarn_RH : 94|2@1+ (1,0) [0|0] "" Vector__XXX
 SG_ AST_MRActivationAlarm : 96|2@1+ (1,0) [0|0] "" Vector__XXX
 SG_ AST_ReleaseWarn : 98|2@1+ (1,0) [0|0] "" Vector__XXX

BO_ 930 CLU_HU_03_200ms: 32 CGW_CCU
 SG_ CLU_HU_Crc3Val : 0|16@1+ (1,0) [0|0] "" Vector__XXX
 SG_ CLU_TermAvgSync_MM : 128|2@1+ (1,0) [0|0] "" Vector__XXX
 SG_ CLU_TermAvgFCL_Digit_MM : 130|2@1+ (1,0) [0|0] "" Vector__XXX
 SG_ CLU_TermAvgFuelCnsmptnVal_MM : 132|10@1+ (0.1,0) [0|0] "" Vector__XXX
 SG_ CLU_OptionInfo : 144|8@1+ (1,0) [0|0] "" Vector__XXX
 SG_ CLU_DispThmSetRdy : 152|2@1+ (1,0) [0|0] "" Vector__XXX
 SG_ CLU_DispThmMemSta : 154|8@1+ (1,0) [0|0] "" Vector__XXX
 SG_ CLU_HU_AlvCnt3Val : 16|8@1+ (1,0) [0|0] "" Vector__XXX
 SG_ CLU_DispThmDeleteSta : 162|3@1+ (1,0) [0|0] "" Vector__XXX
 SG_ CLU_DispThmCopySta : 165|3@1+ (1,0) [0|0] "" Vector__XXX
 SG_ CLU_DispThmSetStaMem : 168|3@1+ (1,0) [0|0] "" Vector__XXX
 SG_ CLU_LapTimer_LapNumber_MM : 192|7@1+ (1,0) [0|0] ""  BLTN_CAM_FD
 SG_ CLU_LapTimer_Hour_MM : 199|7@1+ (1,0) [0|0] "Hour"  BLTN_CAM_FD
 SG_ CLU_LapTimer_Minute_MM : 206|6@1+ (1,0) [0|0] "minute"  BLTN_CAM_FD
 SG_ CLU_LapTimer_Second_MM : 212|6@1+ (1,0) [0|0] "Sec"  BLTN_CAM_FD
 SG_ CLU_LapTimer_MeasuringStatus_MM : 218|2@1+ (1,0) [0|0] ""  BLTN_CAM_FD
 SG_ CLU_LapTimer_milisecond_MM : 220|7@1+ (1,0) [0|0] ""  BLTN_CAM_FD
 SG_ CLU_N1SetVal_MM : 64|4@1+ (1,0) [0|0] "" Vector__XXX
 SG_ CLU_N2SetVal_MM : 68|4@1+ (1,0) [0|0] "" Vector__XXX
 SG_ Usm_TorqueUnitSetSta_MM : 72|2@1+ (1,0) [0|0] "" Vector__XXX
 SG_ Usm_TurboPressureUnitSetSta_MM : 74|3@1+ (1,0) [0|0] "" Vector__XXX
 SG_ USM_ShiftLightNmodeSetSta_MM : 77|2@1+ (1,0) [0|0] "" Vector__XXX
 SG_ USM_ShiftLightCustomSetSta_MM : 79|2@1+ (1,0) [0|0] "" Vector__XXX
 SG_ USM_ShiftLightSportSetSta_MM : 81|2@1+ (1,0) [0|0] "" Vector__XXX
 SG_ USM_ShiftLightNormalSetSta_MM : 83|2@1+ (1,0) [0|0] "" Vector__XXX
 SG_ USM_ShiftLightEcoSetSta_MM : 85|2@1+ (1,0) [0|0] "" Vector__XXX
 SG_ USM_ShiftLightBeepSndSetSta_MM : 87|2@1+ (1,0) [0|0] "" Vector__XXX
 SG_ USM_ShiftLightCustom2SetSta_MM : 89|2@1+ (1,0) [0|0] "" Vector__XXX
 SG_ USM_LapTimerAutoMsreSetSta_MM : 91|2@1+ (1,0) [0|0] ""  BLTN_CAM_FD
 SG_ USM_LapTimerTimeGapSetSta_MM : 93|2@1+ (1,0) [0|0] ""  BLTN_CAM_FD

BO_ 518 GNSS_07_100ms: 32 CGW_CCU
 SG_ GNSS_Crc7Val : 0|16@1+ (1,0) [0|0] "" Vector__XXX
 SG_ HU_DR_Latitude : 128|32@1- (1,0) [0|0] "˚"  BLTN_CAM_FD
 SG_ GNSS_AlvCnt7Val : 16|8@1+ (1,0) [0|0] "" Vector__XXX
 SG_ HU_DR_Longitude : 160|32@1- (1,0) [0|0] "˚"  BLTN_CAM_FD
 SG_ HU_DR_Heading : 192|16@1+ (1,0) [0|0] "˚"  BLTN_CAM_FD
 SG_ HU_DR_Speed : 208|16@1- (0.01,0) [0|0] "m/s" Vector__XXX
 SG_ HU_DR_TimeOfWeek : 24|32@1+ (1,0) [0|0] "ms" Vector__XXX
 SG_ HU_DR_Position_Status : 64|1@1+ (1,0) [0|0] "" Vector__XXX
 SG_ HU_DR_Altitude_Status : 65|1@1+ (1,0) [0|0] "" Vector__XXX
 SG_ HU_DR_Heading_Status : 66|1@1+ (1,0) [0|0] "" Vector__XXX
 SG_ HU_DR_Speed_Status : 67|1@1+ (1,0) [0|0] "" Vector__XXX
 SG_ HU_DR_DirectionSwitch_Sta : 68|1@1+ (1,0) [0|0] "" Vector__XXX
 SG_ HU_DR_Direction : 69|1@1+ (1,0) [0|0] "" Vector__XXX
 SG_ HU_DR_GyroCalib_Sta : 70|1@1+ (1,0) [0|0] "" Vector__XXX
 SG_ HU_DR_TachoCalib_Sta : 71|1@1+ (1,0) [0|0] "" Vector__XXX
 SG_ HU_DR_Solution_Sta : 72|1@1+ (1,0) [0|0] "" Vector__XXX
 SG_ HU_DR_GNSS_Fix_Age : 73|8@1+ (1,0) [0|0] "Sec" Vector__XXX
 SG_ HU_DR_Altitude : 81|16@1- (1,0) [0|0] "m"  BLTN_CAM_FD

BO_ 309 BAT_01_10ms: 16 CGW_CCU
 SG_ BAT_Crc1Val : 0|16@1+ (1,0) [0|0] "" Vector__XXX
 SG_ BAT_AlvCnt1Val : 16|8@1+ (1,0) [0|0] "" Vector__XXX
 SG_ BAT_CurrVal : 24|16@1+ (0.01,-327) [0|0] "A" Vector__XXX
 SG_ BAT_SocVal : 40|8@1+ (1,0) [0|0] "%"  BLTN_CAM_FD
 SG_ BAT_VoltVal : 48|14@1+ (0.001,6) [0|0] "V" Vector__XXX
 SG_ BAT_AuxBattOpt : 62|2@1+ (1,0) [0|0] "" Vector__XXX
 SG_ BAT_TempVal : 64|9@1+ (0.5,-40) [0|0] "℃"  BLTN_CAM_FD
 SG_ BAT_SocErrSta : 73|2@1+ (1,0) [0|0] "" Vector__XXX
 SG_ BAT_SohVal : 75|7@1+ (1,0) [0|0] "%" Vector__XXX
 SG_ BAT_SnsrInvldSta : 82|2@1+ (1,0) [0|0] "" Vector__XXX
 SG_ BAT_SofVal : 84|7@1+ (0.1,0) [0|0] "V" Vector__XXX
 SG_ BAT_RspErrSta : 91|2@1+ (1,0) [0|0] "" Vector__XXX
 SG_ BAT_CapacityVal : 96|8@1+ (1,0) [0|0] "" Vector__XXX

BO_ 920 CTM_FD_02_200ms: 16 CGW_CCU
 SG_ CTM_FD_Crc2Val : 0|16@1+ (1,0) [0|0] "" Vector__XXX
 SG_ CTM_FD_AlvCnt2Val : 16|8@1+ (1,0) [0|0] "" Vector__XXX
 SG_ ITBC_Brk_FaultWarnSta : 24|3@1+ (1,0) [0|0] "" Vector__XXX
 SG_ USM_TrailerTypSta : 27|3@1+ (1,0) [0|0] "" Vector__XXX
 SG_ ITBC_TrailerDisplayAppliedSta : 30|2@1+ (1,0) [0|0] "" Vector__XXX
 SG_ ITBC_Brk_FnctWarnSta : 32|3@1+ (1,0) [0|0] "" Vector__XXX
 SG_ ITBC_LampWarnSta : 35|2@1+ (1,0) [0|0] "" Vector__XXX
 SG_ ITBC_Brk_DisconnWarnSta : 37|2@1+ (1,0) [0|0] "" Vector__XXX
 SG_ ITBC_TrailerBrkOut : 40|7@1+ (1,0) [0|0] "%" Vector__XXX
 SG_ ITBC_TrailerBrkGainVal : 48|5@1+ (0.5,0) [0|0] "%" Vector__XXX
 SG_ ITBC_SysWarn : 53|3@1+ (1,0) [0|0] "" Vector__XXX
 SG_ ITBC_ResetOpSta : 56|2@1+ (1,0) [0|0] "" Vector__XXX
 SG_ ITBC_BrkWarn : 58|2@1+ (1,0) [0|0] "" Vector__XXX
 SG_ ITBC_TrnSigLmpWarn : 60|2@1+ (1,0) [0|0] "" Vector__XXX
 SG_ ITBC_StpLmpWarn : 62|2@1+ (1,0) [0|0] "" Vector__XXX
 SG_ CTM_TrailerAct : 64|2@1+ (1,0) [0|0] ""  BLTN_CAM_FD
 SG_ CTM_RearfogAct : 66|2@1+ (1,0) [0|0] "" Vector__XXX
 SG_ CTM_StpLmpOpnSta : 68|2@1+ (1,0) [0|0] "" Vector__XXX
 SG_ CTM_TrnSigLmpLftOpnSta : 70|2@1+ (1,0) [0|0] "" Vector__XXX
 SG_ CTM_TrnSigLmpRtOpnSta : 72|2@1+ (1,0) [0|0] "" Vector__XXX
 SG_ CTM_ExtTailLmpLftOpnSta : 74|2@1+ (1,0) [0|0] "" Vector__XXX
 SG_ CTM_ExtTailLmpRtOpnSta : 76|2@1+ (1,0) [0|0] "" Vector__XXX
 SG_ CTM_Exra_EbrakSta : 78|2@1+ (1,0) [0|0] "" Vector__XXX
 SG_ CTM_TrlAngl_200ms : 80|16@1+ (0.0055,-180) [0|0] "" Vector__XXX

BO_ 160 WHL_01_10ms: 24 CGW_CCU
 SG_ WHL_Crc1Val : 0|16@1+ (1,0) [0|0] "" Vector__XXX
 SG_ WHL_SpdRRVal : 112|14@1+ (0.03125,0) [0|0] "km^h"  BLTN_CAM_FD,GW_PSU_AST_FD,PSB_FD
 SG_ WHL_SpdCalParmtr : 136|9@1+ (0.5,200) [0|0] "mm" Vector__XXX
 SG_ WHL_AlvCnt1Val : 16|8@1+ (1,0) [0|0] "" Vector__XXX
 SG_ WHL_PlsFLVal : 24|8@1+ (0.5,0) [0|0] "pulse count" Vector__XXX
 SG_ WHL_PlsFRVal : 32|8@1+ (0.5,0) [0|0] "pulse count" Vector__XXX
 SG_ WHL_PlsRLVal : 40|8@1+ (0.5,0) [0|0] "pulse count" Vector__XXX
 SG_ WHL_PlsRRVal : 48|8@1+ (0.5,0) [0|0] "pulse count" Vector__XXX
 SG_ WHL_DirFLVal : 56|2@1+ (1,0) [0|0] "" Vector__XXX
 SG_ WHL_DirFRVal : 58|2@1+ (1,0) [0|0] "" Vector__XXX
 SG_ WHL_DirRLVal : 60|2@1+ (1,0) [0|0] "" Vector__XXX
 SG_ WHL_DirRRVal : 62|2@1+ (1,0) [0|0] "" Vector__XXX
 SG_ WHL_SpdFLVal : 64|14@1+ (0.03125,0) [0|0] "km^h"  BLTN_CAM_FD,PSB_FD
 SG_ WHL_SpdFRVal : 80|14@1+ (0.03125,0) [0|0] "km^h"  BLTN_CAM_FD,PSB_FD
 SG_ WHL_SpdRLVal : 96|14@1+ (0.03125,0) [0|0] "km^h"  BLTN_CAM_FD,GW_PSU_AST_FD,PSB_FD

BO_ 426 CLU_01_20ms: 16 CGW_CCU
 SG_ CLU_Crc1Val : 0|16@1+ (1,0) [0|0] ""  ATS_FD,GW_PSU_DRV_FD,RCM_FD,SHVU_3RD_FD,SHVU_REAR_FD
 SG_ CLU_FuelSenderRstReq : 110|2@1+ (1,0) [0|0] "" Vector__XXX
 SG_ CLU_PRKDispRdy : 112|2@1+ (1,0) [0|0] "" Vector__XXX
 SG_ CLU_AlvCnt1Val : 16|8@1+ (1,0) [0|0] ""  ATS_FD,GW_PSU_DRV_FD,RCM_FD,SHVU_3RD_FD,SHVU_REAR_FD
 SG_ CLU_DtntOutSta : 28|2@1+ (1,0) [0|0] ""  ARS_FD,ATS_FD,FCS_FD,GW_PSU_3RD_FD,GW_PSU_AST_FD,GW_PSU_DRV_FD,GW_PSU_RL_FD,GW_PSU_RR_FD,GW_SAU_DRV_FD,OHCL_FD,RCS_FD,RWPC_FD,SHVU_3RD_FD,SHVU_FRNT_FD,SHVU_REAR_FD,SHVU_RL_FD,SHVU_RR_FD,WPC2_FD,WPC_FD
 SG_ CLU_SpdUnitTyp : 30|2@1+ (1,0) [0|0] ""  BLTN_CAM_FD,GW_PSU_DRV_FD,WPC2_FD
 SG_ CLU_DisSpdDcmlVal : 32|2@1+ (0.125,0) [0|0] "" Vector__XXX
 SG_ CLU_SWRCCrsMainSwSta : 34|2@1+ (1,0) [0|0] "" Vector__XXX
 SG_ CLU_SWRCCrsSwSta : 36|3@1+ (1,0) [0|0] "" Vector__XXX
 SG_ CLU_SWRCLFASwSta : 39|2@1+ (1,0) [0|0] "" Vector__XXX
 SG_ CLU_SWRCSldMainSwSta : 41|2@1+ (1,0) [0|0] "" Vector__XXX
 SG_ CLU_RhstaLvlSta : 43|5@1+ (1,0) [0|0] ""  ARS_FD,ATS_FD,FCS_FD,GW_PSU_3RD_FD,GW_PSU_AST_FD,GW_PSU_DRV_FD,GW_PSU_RL_FD,GW_PSU_RR_FD,GW_SAU_DRV_FD,OHCL_FD,RCS_FD,RWPC_FD,SHVU_3RD_FD,SHVU_FRNT_FD,SHVU_REAR_FD,SHVU_RL_FD,SHVU_RR_FD,WPC2_FD,WPC_FD
 SG_ CLU_DisSpdVal : 48|10@1+ (0.5,0) [0|0] "km/h or MPH"  BLTN_CAM_FD,GW_PSU_AST_FD,GW_PSU_DRV_FD,WPC2_FD
 SG_ CLU_OKSwSta : 62|2@1+ (1,0) [0|0] "" Vector__XXX
 SG_ CLU_DisSpdVal_KPH : 64|9@1+ (1,0) [0|0] "km/h"  ATS_FD,DCM_FD,GW_PSU_3RD_FD,GW_PSU_AST_FD,GW_PSU_DRV_FD,GW_PSU_RL_FD,GW_PSU_RR_FD,GW_SAU_DRV_FD,RCM_FD,RWPC_FD,SHVU_3RD_FD,SHVU_FRNT_FD,SHVU_REAR_FD,SHVU_RL_FD,SHVU_RR_FD,WPC2_FD,WPC_FD
 SG_ CLU_PwrAutoOffResetReq_HCU : 73|2@1+ (1,0) [0|0] "" Vector__XXX
 SG_ CLU_CUSTOMSta_NEW : 75|4@1+ (1,0) [0|0] "" Vector__XXX
 SG_ CLU_AutoBrightSta : 79|8@1+ (1,0) [0|0] ""  ATS_FD,BLTN_CAM_FD,FCS_FD,GW_PSU_3RD_FD,GW_PSU_AST_FD,GW_PSU_DRV_FD,GW_PSU_RL_FD,GW_PSU_RR_FD,GW_SAU_DRV_FD,OHCL_FD,RCS_FD,RWPC_FD,SHVU_3RD_FD,SHVU_FRNT_FD,SHVU_REAR_FD,SHVU_RL_FD,SHVU_RR_FD,WPC2_FD,WPC_FD
 SG_ CLU_NotMinModeBrightSta : 87|8@1+ (1,0) [0|0] "" Vector__XXX
 SG_ CLU_FuelSenderResistVal : 97|13@1+ (0.1,0) [0|0] "" Vector__XXX

BO_ 293 SAS_01_10ms: 16 CGW_CCU
 SG_ SAS_Crc1Val : 0|16@1+ (1,0) [0|0] "" Vector__XXX
 SG_ SAS_AlvCnt1Val : 16|8@1+ (1,0) [0|0] "" Vector__XXX
 SG_ SAS_AnglVal : 24|16@1- (0.1,0) [0|0] "Deg"  BLTN_CAM_FD,PSB_FD
 SG_ SAS_SpdVal : 40|8@1+ (4,0) [0|0] "Deg/s" Vector__XXX
 SG_ SAS_IntSta : 48|8@1+ (1,0) [0|0] "" Vector__XXX

BO_ 53 VCU_01_10ms: 32 CGW_CCU
 SG_ VCU_Crc1Val : 0|16@1+ (1,0) [0|0] ""  GW_PSU_DRV_FD
 SG_ VCU_ScuKeepWakeReq : 110|2@1+ (1,0) [0|0] "flag" Vector__XXX
 SG_ VCU_MotTqCmdRearVal : 112|14@1- (0.125,0) [-1024|1023.875] "Nm" Vector__XXX
 SG_ VCU_FmcuZeroTqOfsReq : 126|2@1+ (1,0) [0|0] "flag" Vector__XXX
 SG_ VCU_EcmSeqSta : 128|8@1+ (1,0) [0|255] "" Vector__XXX
 SG_ VCU_EcmDiagSta : 136|8@1+ (1,0) [0|255] "" Vector__XXX
 SG_ VCU_CltActDiagSta : 144|8@1+ (1,0) [0|255] "" Vector__XXX
 SG_ VCU_CltActDrvCrntVal : 152|12@1- (0.025,0) [-51.2|51.175] "A" Vector__XXX
 SG_ VCU_AlvCnt1Val : 16|8@1+ (1,0) [0|0] ""  GW_PSU_DRV_FD
 SG_ VCU_CltActPosStrokeVal : 164|12@1- (0.0125,0) [-25.6|25.5875] "mm" Vector__XXX
 SG_ VCU_MainBattTypeSta : 176|2@1+ (1,0) [0|3] "" Vector__XXX
 SG_ VCU_MainBattTypeLrnSta : 178|2@1+ (1,0) [0|3] "" Vector__XXX
 SG_ VCU_WarmupCycSta : 180|2@1+ (1,0) [0|3] "" Vector__XXX
 SG_ VCU_FatcPermPwrVal : 182|10@1+ (20,0) [0|12700] "W" Vector__XXX
 SG_ VCU_GearPosStaDisp : 192|4@1+ (1,0) [0|0] ""  BLTN_CAM_FD,DCM_FD,FCS_FD
 SG_ VCU_PdlStopCtrlSta : 196|2@1+ (1,0) [0|0] "" Vector__XXX
 SG_ VCU_PdlStopReqTqNmVal : 198|16@1+ (1,0) [0|0] "" Vector__XXX
 SG_ VCU_PMPDActSta : 214|2@1+ (1,0) [0|0] "" Vector__XXX
 SG_ VCU_PMPDWarnSta : 216|2@1+ (1,0) [0|0] "" Vector__XXX
 SG_ VCU_VgsVirSoundBackFireIndex : 218|5@1+ (1,0) [0|0] "" Vector__XXX
 SG_ VCU_VgsVirEngSpdRpmVal : 224|16@1- (1,0) [0|0] ""  BLTN_CAM_FD
 SG_ VCU_RdySta : 24|2@1+ (1,0) [0|3] "" Vector__XXX
 SG_ VCU_VgsVirSoundVolume : 240|8@1+ (0.392156863,0) [0|0] "" Vector__XXX
 SG_ VCU_VgsVirGearStep : 248|4@1+ (1,0) [0|0] ""  BLTN_CAM_FD
 SG_ VCU_StandbyModSta : 252|2@1+ (1,0) [0|0] "" Vector__XXX
 SG_ VCU_HVIntLkDischrgReq : 254|2@1+ (1,0) [0|0] "" Vector__XXX
 SG_ VCU_StartKeyHoldSta : 26|2@1+ (1,0) [0|3] "" Vector__XXX
 SG_ VCU_EvDrvRdySta : 28|2@1+ (1,0) [0|3] ""  BLTN_CAM_FD,FCS_FD,GW_PSU_3RD_FD,GW_PSU_AST_FD,GW_PSU_DRV_FD,GW_PSU_RL_FD,GW_PSU_RR_FD,GW_SAU_DRV_FD,PSB_FD,RCM_FD,RWPC_FD,SCM_FD,SGU_FD,SHVU_3RD_FD,SHVU_CCS_FD,SHVU_FRNT_FD,SHVU_REAR_FD,SHVU_RL_FD,SHVU_RR_FD,WPC2_FD,WPC_FD
 SG_ VCU_MotPwrEnReq : 30|2@1+ (1,0) [0|3] "" Vector__XXX
 SG_ VCU_GearPosSta : 32|4@1+ (1,0) [0|15] ""  BLTN_CAM_FD,DCM_FD,GW_PSU_3RD_FD,GW_PSU_AST_FD,GW_PSU_DRV_FD,GW_PSU_RL_FD,GW_PSU_RR_FD,RWPC_FD,SGU_FD,WPC2_FD,WPC_FD
 SG_ VCU_LdcInhReq : 36|2@1+ (1,0) [0|3] "" Vector__XXX
 SG_ VCU_MainRlyOffReq : 38|2@1+ (1,0) [0|3] "" Vector__XXX
 SG_ VCU_AccPedDepVal : 40|8@1+ (0.3921568627,0) [0|100] "%"  BLTN_CAM_FD
 SG_ VCU_FatcOperPermSta : 48|2@1+ (1,0) [0|3] "" Vector__XXX
 SG_ VCU_DrvCycSta : 50|2@1+ (1,0) [0|3] "" Vector__XXX
 SG_ VCU_CltActOpSta : 52|4@1+ (1,0) [0|15] "" Vector__XXX
 SG_ VCU_WhlSpdSnsrAlvReq : 56|2@1+ (1,0) [0|0] "flag" Vector__XXX
 SG_ VCU_DrvModOpSta : 58|4@1+ (1,0) [0|0] "" Vector__XXX
 SG_ VCU_HydBrkFcHoldRq : 62|2@1+ (1,0) [0|0] "" Vector__XXX
 SG_ VCU_FatcPwrUseVal : 64|8@1+ (10,0) [0|2550] "W" Vector__XXX
 SG_ VCU_WhlDemTqVal : 72|16@1- (1,0) [-32768|32767] "Nm" Vector__XXX
 SG_ VCU_McuAntiJerkInhFrntSta : 88|2@1+ (1,0) [0|3] "" Vector__XXX
 SG_ VCU_McuAntiJerkInhRearSta : 90|2@1+ (1,0) [0|3] "" Vector__XXX
 SG_ VCU_McuPwrLatchHoldReq : 92|2@1+ (1,0) [0|0] "" Vector__XXX
 SG_ VCU_ScuParkReq : 94|2@1+ (1,0) [0|0] "flag" Vector__XXX
 SG_ VCU_MotTqCmdFrntVal : 96|14@1- (0.125,0) [-1024|1023.875] "Nm" Vector__XXX

CM_ BO_ 813 "[PE] Periodic and On Event";
CM_ SG_ 813 SBCM_DRV_FD_Crc1Val "SBCM_DRV_FD_CyclicRedundancyCheck1Value";
CM_ SG_ 813 C_DrvDoorApproachOpen "Approach open";
CM_ SG_ 813 DoorLock_CtrlDrLkUnLkSwSta_SBCM "Central Door Lock/Unlock Switch State";
CM_ SG_ 813 CDMAutoWashModeSet_SBCM "Auto wash mode set signal for CDM from SBCM_DRV";
CM_ SG_ 813 SBCM_DRV_FD_AlvCnt1Val "SBCM_DRV_FD_AliveCounter1Value";
CM_ SG_ 813 ECMMRR_PLUS "ECM Voltage value";
CM_ SG_ 813 EHL_TxInfo_SBCM_DRV "Electronic hood latch status signal transfer for dual hood latch type (Copy to CANFD)";
CM_ SG_ 813 CDM_TypeOption "CDM_HS_OptionType";
CM_ SG_ 813 CDM_ImmeChgSw_SBCM "State of Immediate Charging Switch";
CM_ SG_ 813 CDM_OpnClsState_SBCM "CDM_HS_ OpenCloseState";
CM_ SG_ 813 CDM_WarnMsg_SBCM "CDM_HS_WarningMessage";
CM_ SG_ 813 CDM_CmdStatus_SBCM "CDM_HS_CommandStatus";
CM_ SG_ 813 Hood_TypeOption "E-Hood_Option Type";
CM_ SG_ 813 FrunkReleaseSwSta_SBCM "FrunkReleaseState";
CM_ SG_ 813 CDM_GbtImmeChgSw_SBCM "State of Immediate Charging Switch";
CM_ SG_ 813 CDM_GbtOpnClsState_SBCM "CDM_HS_ OpenCloseState";
CM_ SG_ 813 CDM_GbtWarnMsg_SBCM "CDM_HS_WarningMessage";
CM_ SG_ 813 FrunkEmergencySwSta_SBCM "FrunkEmergencySwState";
CM_ SG_ 813 C_ApprOpenStatus "Stop fob searching signal";
CM_ SG_ 813 DoorLock_DrvKeyLkSwSta_SBCM "DoorLock_DriverKeyLockSwitchStatus ##2G## -  - C_DrvKeyLockSw";
CM_ SG_ 813 DoorLock_DrvKeyUnLkSwSta_SBCM "DoorLock_DriverKeyUnLockSwitchStatus ##2G## -  - C_DrvKeyUnlockSw";
CM_ SG_ 813 Warn_DrvDrSwSta_SBCM "DoorLock_DriverDoorSwitchStatus ##2G## -  - C_DrvDrSw,CF_Gway_DrvDrSw,Warn_DrvDrSwSta";
CM_ SG_ 813 DoorLock_DrvDrUnLkSta_SBCM "DoorLock_DriverDoorUnLockStatus ##2G## -  - C_DrvUnlockState,CF_Gway_DrvUnlockState";
CM_ BO_ 811 "[PE] Periodic and On Event";
CM_ SG_ 811 SBCM_AST_FD_Crc1Val "SBCM_AST_FD_CyclicRedundancyCheck1Value";
CM_ SG_ 811 SBCM_AST_FD_AlvCnt1Val "SBCM_AST_FD_AliveCounter1Value";
CM_ SG_ 811 SBCM_Longkey_ASTDrAtClsSwSta "FCS Power Door Long key Status";
CM_ SG_ 811 Hood_TypeOption_AST "E-Hood_Option Type";
CM_ SG_ 811 FrunkReleaseSwSta_SBCM_AST "FrunkReleaseState (SBCM_AST_FD to SBCM_DRV_FD) RHD Spec";
CM_ SG_ 811 FrunkInsideRelSwSta_SBCM_AST "FrunkInsideReleaseSwState (SBCM_AST_FD to SBCM_DRV_FD) RHD Spec";
CM_ SG_ 811 FrunkEmergencySwSta_SBCM_AST "FrunkEmergencySwState (SBCM_AST_FD to SBCM_DRV_FD) RHD Spec";
CM_ SG_ 811 EHL_TxInfo_SBCM_AST "Electronic hood latch status signal transfer for dual hood latch type";
CM_ SG_ 811 AST_CrashUnlockCmd "AssistCrashUnlockCommand";
CM_ SG_ 811 DoorLock_CtrlDrLkSwSta_SBCM "DoorLock_CentralDoorLockAssistSwitchStatus";
CM_ SG_ 811 DoorLock_CtrlDrUnLkSwSta_SBCM "DoorLock_CentralDoorUnLockAssistSwitchStatus";
CM_ SG_ 811 Warn_AsstDrSwSta_SBCM "Warn_AssistDoorSwitchStatus ##2G## -  - C_AstDrSw,CF_Gway_AstDrSw,Warn_AsstDrSwSta";
CM_ SG_ 811 DoorLock_AsstDrUnLkSta_SBCM "DoorLock_AssistDoorUnLockStatus ##2G## -  - C_AstUnlockState,DoorLock_AsstDrUnLkSta";
CM_ SG_ 811 AST_SEAWarn_RH "Assist SEA Warning (LHD)";
CM_ BO_ 930 "[PE] Periodic and On Event";
CM_ SG_ 930 CLU_HU_Crc3Val "CLU_HU_CyclicRedundancyCheck3Value";
CM_ SG_ 930 CLU_TermAvgSync_MM "2nd General ? MM-CAN(LS):CF_Clu_TermAvgSync";
CM_ SG_ 930 CLU_TermAvgFCL_Digit_MM "2nd General ? MM-CAN(LS):CR_Clu_TermAvgFCI_Digit";
CM_ SG_ 930 CLU_TermAvgFuelCnsmptnVal_MM "2nd General ? MM-CAN(LS):CR_Clu_TermAvgFCI";
CM_ SG_ 930 CLU_OptionInfo "Information of CLU functions";
CM_ SG_ 930 CLU_DispThmSetRdy "Available of CLU DisplayTheme change";
CM_ SG_ 930 CLU_DispThmMemSta "The signal indicates CLU FoD Diplay Theme Memory status for sync with HU";
CM_ SG_ 930 CLU_HU_AlvCnt3Val "CLU_HU_AliveCounter3Value";
CM_ SG_ 930 CLU_LapTimer_LapNumber_MM "MM-CAN(LS):CLU_HU_PE_04/LapTimer_LapNumber";
CM_ SG_ 930 CLU_LapTimer_Hour_MM "MM-CAN(LS):CLU_HU_PE_04/LapTimer_Hour";
CM_ SG_ 930 CLU_LapTimer_Minute_MM "MM-CAN(LS):CLU_HU_PE_04/LapTimer_Minute";
CM_ SG_ 930 CLU_LapTimer_Second_MM "MM-CAN(LS):CLU_HU_PE_04/LapTimer_Second";
CM_ SG_ 930 CLU_LapTimer_MeasuringStatus_MM "MM-CAN(LS):CLU_HU_PE_04/LapTimer_MeasuringStatus";
CM_ SG_ 930 CLU_LapTimer_milisecond_MM "MM-CAN(LS):CLU_HU_PE_04/LapTimer_milisecond";
CM_ SG_ 930 CLU_N1SetVal_MM "N1 S/W set value feedback to H/U";
CM_ SG_ 930 CLU_N2SetVal_MM "N2 S/W set value feedback to H/U";
CM_ SG_ 930 Usm_TorqueUnitSetSta_MM "MM-CAN(LS) : CLU_HU_PE_05/Clu_Usm_TorqueUnit";
CM_ SG_ 930 Usm_TurboPressureUnitSetSta_MM "MM-CAN(LS):CLU_HU_PE_05/Clu_Usm_TurboPressureUnit";
CM_ SG_ 930 USM_ShiftLightNmodeSetSta_MM "It is a signal for Shiftlight AVN USM";
CM_ SG_ 930 USM_ShiftLightCustomSetSta_MM "When AVN send a signal(Event), Cluster send this feeback signal for changing setting value";
CM_ SG_ 930 USM_ShiftLightSportSetSta_MM "When AVN send a signal(Event), Cluster send this feeback signal for changing setting value";
CM_ SG_ 930 USM_ShiftLightNormalSetSta_MM "When AVN send a signal(Event), Cluster send this feeback signal for changing setting value";
CM_ SG_ 930 USM_ShiftLightEcoSetSta_MM "When AVN send a signal(Event), Cluster send this feeback signal for changing setting value";
CM_ SG_ 930 USM_ShiftLightBeepSndSetSta_MM "When AVN send a signal(Event), Cluster send this feeback signal for changing setting value";
CM_ SG_ 930 USM_ShiftLightCustom2SetSta_MM "When AVN send a signal(Event), Cluster send this feeback signal for changing setting value";
CM_ SG_ 930 USM_LapTimerAutoMsreSetSta_MM "Setting value for auto-measurement of Laptimer";
CM_ SG_ 930 USM_LapTimerTimeGapSetSta_MM "setting value for laptimer time gap displaying";
CM_ BO_ 518 "[P] Periodic";
CM_ SG_ 518 GNSS_Crc7Val "GNSS_CyclicRedundancyCheck7Value";
CM_ SG_ 518 HU_DR_Latitude "1sc(semi-cicle)= pi rad=180  /   unit : 2^-31sc  /  range [-1/2~1/2] sc";
CM_ SG_ 518 GNSS_AlvCnt7Val "GNSS_AliveCounter7Value";
CM_ SG_ 518 HU_DR_Longitude "1sc(semi-circle)=pi rad=180 / unit:2^-31sc / range:[-1, 1]sc";
CM_ SG_ 518 HU_DR_Heading "1sc(semi-circle)=pi rad=180 / unit=2^-15sc / range:[0,2]SC";
CM_ SG_ 518 HU_DR_Speed "unit : 1cm/s";
CM_ SG_ 518 HU_DR_TimeOfWeek "Local Time which DR data is transmitted";
CM_ SG_ 518 HU_DR_Position_Status "DR Position status";
CM_ SG_ 518 HU_DR_Altitude_Status "DR Altitude Status";
CM_ SG_ 518 HU_DR_Heading_Status "DR Heading Status";
CM_ SG_ 518 HU_DR_Speed_Status "DR Speed status";
CM_ SG_ 518 HU_DR_DirectionSwitch_Sta "DR DirectionSwitch Status";
CM_ SG_ 518 HU_DR_Direction "DR Direction, Backward";
CM_ SG_ 518 HU_DR_GyroCalib_Sta "DR Gyro Calibration Status";
CM_ SG_ 518 HU_DR_TachoCalib_Sta "DR Tacho Calibration Status";
CM_ SG_ 518 HU_DR_GNSS_Fix_Age "Time since last GNSS fix";
CM_ SG_ 518 HU_DR_Altitude "range [-400,10000]";
CM_ BO_ 309 "[P] Periodic";
CM_ SG_ 309 BAT_Crc1Val "BAT_CyclicRedundancyCheck1Value";
CM_ SG_ 309 BAT_AlvCnt1Val "BAT_AliveCounter1Value";
CM_ SG_ 309 BAT_CurrVal "BAT_CurrentValue";
CM_ SG_ 309 BAT_SocVal "BAT_StateOfChargeValue";
CM_ SG_ 309 BAT_VoltVal "BAT_VoltageValue";
CM_ SG_ 309 BAT_AuxBattOpt "12V Battery Option Value(LFP 12V Battery)";
CM_ SG_ 309 BAT_TempVal "BAT_TemperatureValue";
CM_ SG_ 309 BAT_SocErrSta "BAT_SoCErrorStatus";
CM_ SG_ 309 BAT_SohVal "BAT_StateOfHealthValue";
CM_ SG_ 309 BAT_SnsrInvldSta "BAT_SensorInvalidStatus";
CM_ SG_ 309 BAT_SofVal "BAT_StateOfFunctionValue";
CM_ SG_ 309 BAT_RspErrSta "BAT_ResponseErrorStatus";
CM_ SG_ 309 BAT_CapacityVal "12V Battery Capacity Value";
CM_ BO_ 920 "[PE] Periodic and On Event";
CM_ SG_ 920 CTM_FD_Crc2Val "CTM_FD_CyclicRedundancyCheck2Value";
CM_ SG_ 920 CTM_FD_AlvCnt2Val "CTM_FD_AliveCounter2Value";
CM_ SG_ 920 ITBC_Brk_FaultWarnSta "Request for cluster to provide audible warning & pop up on Trailer Brake out Fail situation (conditions TBD eg fault).";
CM_ SG_ 920 USM_TrailerTypSta "Trailer type status";
CM_ SG_ 920 ITBC_TrailerDisplayAppliedSta "Determination of ITBC application";
CM_ SG_ 920 ITBC_Brk_FnctWarnSta "Auto Disabled (Autobrake disable 발생 시)/ Manual Disabled (Manual brake disable 발생 시) / All Disabled(Auto/Manual brake disable 발생 시)";
CM_ SG_ 920 ITBC_LampWarnSta "TailLamp, RearFog, BackupLamp의 고장 상태 알림";
CM_ SG_ 920 ITBC_Brk_DisconnWarnSta "Occurs when the Trailer is not connected and the ITBC switch is operated";
CM_ SG_ 920 ITBC_TrailerBrkOut "Trailer Brake Output sent to cluster. PWM duty cycle 0 - 100%.";
CM_ SG_ 920 ITBC_TrailerBrkGainVal "Gain setting 0 - 10 in steps of 0.5 on cluster.";
CM_ SG_ 920 ITBC_SysWarn "Request for cluster to provide audible warning & pop up (conditions TBD eg fault).";
CM_ SG_ 920 ITBC_ResetOpSta "This signal indicates whether the reset operation has been completed or not";
CM_ SG_ 920 ITBC_BrkWarn "Request for cluster to provide audible warning & pop up on Trailer Brake out Fail situation(conditions TBD eg fault).";
CM_ SG_ 920 ITBC_TrnSigLmpWarn "Request for cluster to provide audible warning & pop up about Trailer Trun Signal Error(conditions TBD eg fault).";
CM_ SG_ 920 ITBC_StpLmpWarn "Request for cluster to provide audible warning & pop up about Trailer Stop Lamp ERROR(conditions TBD eg fault).";
CM_ SG_ 920 CTM_TrailerAct "This signal is used for control the Trailer Act function.";
CM_ SG_ 920 CTM_RearfogAct "This signal is used for display the rear fog lamp mounted on the trailer.";
CM_ SG_ 920 CTM_StpLmpOpnSta "Trailer Stop Lamp OpenStatus";
CM_ SG_ 920 CTM_TrnSigLmpLftOpnSta "Trailer T/SIG Lamp Left OpenStatus";
CM_ SG_ 920 CTM_TrnSigLmpRtOpnSta "Trailer T/SIG Lamp Right OpenStatus";
CM_ SG_ 920 CTM_ExtTailLmpLftOpnSta "Trailer Exterior Tail Lamp Left OpenStatus";
CM_ SG_ 920 CTM_ExtTailLmpRtOpnSta "Trailer Exterior Tail Lamp Right OpenStatus";
CM_ SG_ 920 CTM_Exra_EbrakSta "Trailer Exterior Ebrake Out OnOffStatus";
CM_ SG_ 920 CTM_TrlAngl_200ms "CTM_TrailerAngle_200ms";
CM_ BO_ 160 "[P] Periodic";
CM_ SG_ 160 WHL_Crc1Val "WHL_CyclicRedundancyCheck1Value";
CM_ SG_ 160 WHL_SpdRRVal "WHL_SpeedRearRightValue ##2G##ESC - WHL_SPD11 - WHL_SPD_RR";
CM_ SG_ 160 WHL_SpdCalParmtr "WHL_SpeedCalculationParameter";
CM_ SG_ 160 WHL_AlvCnt1Val "WHL_AliveCounter1Value";
CM_ SG_ 160 WHL_PlsFLVal "WHL_PulseFrontLeftValue ##2G##ESC - WHL_PUL11 - WHL_PUL_FL";
CM_ SG_ 160 WHL_PlsFRVal "WHL_PulseFrontRightValue ##2G##ESC - WHL_PUL11 - WHL_PUL_FR";
CM_ SG_ 160 WHL_PlsRLVal "WHL_PulseRearLeftValue ##2G##ESC - WHL_PUL11 - WHL_PUL_RL";
CM_ SG_ 160 WHL_PlsRRVal "WHL_PulseRearRightValue ##2G##ESC - WHL_PUL11 - WHL_PUL_RR";
CM_ SG_ 160 WHL_DirFLVal "WHL_DirectionFrontLeftValue ##2G##ESC - WHL_PUL11 - WHL_DIR_FL";
CM_ SG_ 160 WHL_DirFRVal "WHL_DirectionFrontRightValue ##2G##ESC - WHL_PUL11 - WHL_DIR_FR";
CM_ SG_ 160 WHL_DirRLVal "WHL_DirectionRearLeftValue ##2G##ESC - WHL_PUL11 - WHL_DIR_RL";
CM_ SG_ 160 WHL_DirRRVal "WHL_DirectionRearRightValue ##2G##ESC - WHL_PUL11 - WHL_DIR_RR";
CM_ SG_ 160 WHL_SpdFLVal "WHL_SpeedFrontLeftValue ##2G##ESC - WHL_SPD11 - WHL_SPD_FL";
CM_ SG_ 160 WHL_SpdFRVal "WHL_SpeedFrontRightValue ##2G##ESC - WHL_SPD11 - WHL_SPD_FR";
CM_ SG_ 160 WHL_SpdRLVal "WHL_SpeedRearLeftValue ##2G##ESC - WHL_SPD11 - WHL_SPD_RL";
CM_ BO_ 426 "[P] Periodic";
CM_ SG_ 426 CLU_Crc1Val "CLU_CyclicRedundancyCheck1Value";
CM_ SG_ 426 CLU_FuelSenderRstReq "Reset request signal for ICV fuel-sender";
CM_ SG_ 426 CLU_PRKDispRdy "To inform the steady state of the cluster";
CM_ SG_ 426 CLU_AlvCnt1Val "CLU_AliveCounter1Value";
CM_ SG_ 426 CLU_DtntOutSta "CLU_DetentOutStatus";
CM_ SG_ 426 CLU_SpdUnitTyp "CLU_SpeedUnitType";
CM_ SG_ 426 CLU_DisSpdDcmlVal "CLU_DisplaySpeedDecimalValue";
CM_ SG_ 426 CLU_SWRCCrsMainSwSta "CLU_SWRCCrsMainSwSta";
CM_ SG_ 426 CLU_SWRCCrsSwSta "CLU_SWRCCrsSwSta";
CM_ SG_ 426 CLU_SWRCLFASwSta "SWRC_LFASwitchStatus";
CM_ SG_ 426 CLU_SWRCSldMainSwSta "SWRC_SpeedLimiterMainSwitchStatus";
CM_ SG_ 426 CLU_RhstaLvlSta "CLU_RheostatLevelStatus";
CM_ SG_ 426 CLU_DisSpdVal "CLU_DisplaySpeedValue";
CM_ SG_ 426 CLU_OKSwSta "OK Switch On/Off State";
CM_ SG_ 426 CLU_DisSpdVal_KPH "CLU_DisplaySpeedValue_KPH";
CM_ SG_ 426 CLU_PwrAutoOffResetReq_HCU "reset power auto off time";
CM_ SG_ 426 CLU_AutoBrightSta "CLU_AutoBrightStatus";
CM_ SG_ 426 CLU_NotMinModeBrightSta "CLU_NotMinimumModeBrightStaus";
CM_ SG_ 426 CLU_FuelSenderResistVal "This is the resistance data come from fuel sender.";
CM_ BO_ 293 "[P] Periodic";
CM_ SG_ 293 SAS_Crc1Val "SAS_CyclicRedundancyCheck1Value";
CM_ SG_ 293 SAS_AlvCnt1Val "SAS_AliveCounter1Value";
CM_ SG_ 293 SAS_AnglVal "SAS_AngleValue";
CM_ SG_ 293 SAS_SpdVal "SAS_SpeedValue";
CM_ SG_ 293 SAS_IntSta "SAS_InternalStatus";
CM_ BO_ 53 "[P] Periodic";
CM_ SG_ 53 VCU_Crc1Val "VCU_CyclicRedundancyCheck1Value";
CM_ SG_ 53 VCU_ScuKeepWakeReq "VCU_ScuKeepWakeRequest ##2G##VCU - VCU12 - CF_Vcu_SSD";
CM_ SG_ 53 VCU_MotTqCmdRearVal "VCU_MotorTorqueCommandRearValue";
CM_ SG_ 53 VCU_FmcuZeroTqOfsReq "VCU_FmcuZeroTorqueOffsetRequest";
CM_ SG_ 53 VCU_EcmSeqSta "VCU_EcmSequenceStatus ##2G##VCU - VCU1 - CF_Vcu_IGONStatus";
CM_ SG_ 53 VCU_EcmDiagSta "VCU_EcmDiagnosisStatus";
CM_ SG_ 53 VCU_CltActDiagSta "VCU_ClutchActuatorDiagnosisStatus";
CM_ SG_ 53 VCU_CltActDrvCrntVal "VCU_ClutchActuatorDriveCurrentValue";
CM_ SG_ 53 VCU_AlvCnt1Val "VCU_AliveCounter1Value";
CM_ SG_ 53 VCU_CltActPosStrokeVal "VCU_ClutchActuatorPositionStrokeValue";
CM_ SG_ 53 VCU_MainBattTypeSta "VCU_MainBatteryTypeStatus ##2G##VCU - VCU18 - CF_Vcu_MainBattType";
CM_ SG_ 53 VCU_MainBattTypeLrnSta "VCU_MainBatteryTypeLearnStatus ##2G##VCU - VCU18 - CF_Vcu_MainBattTypeLrnSts";
CM_ SG_ 53 VCU_WarmupCycSta "VCU_WarmupCycleStatus ##2G##VCU - VCU1 - CF_Vcu_WarmupCyc";
CM_ SG_ 53 VCU_FatcPermPwrVal "VCU_FatcPermissionPowerValue ##2G##VCU - VCU5 - CR_Vcu_ClimatePerm_W";
CM_ SG_ 53 VCU_GearPosStaDisp "VCU_GearPositionStatusDisp";
CM_ SG_ 53 VCU_PdlStopCtrlSta "Cooperative control state of VCU for stop assist control with IEB";
CM_ SG_ 53 VCU_PdlStopReqTqNmVal "Requested brake torque for cooperative stop assist control";
CM_ SG_ 53 VCU_PMPDActSta "PMPD Function Active State";
CM_ SG_ 53 VCU_PMPDWarnSta "PMPD Function Warning State";
CM_ SG_ 53 VCU_VgsVirSoundBackFireIndex "Virtual sound back fire noise index for VGS mode";
CM_ SG_ 53 VCU_VgsVirEngSpdRpmVal "Virtual engine speed for VGS mode";
CM_ SG_ 53 VCU_RdySta "VCU_ReadyStatus ##2G##VCU - VCU1 - CF_Vcu_Rdy";
CM_ SG_ 53 VCU_VgsVirSoundVolume "Virtual engine sound volume for VGS mode[%]";
CM_ SG_ 53 VCU_VgsVirGearStep "Shift gear when entering VGS mode";
CM_ SG_ 53 VCU_StandbyModSta "Stand by Mode Status";
CM_ SG_ 53 VCU_HVIntLkDischrgReq "VCU_HighVoltageInterlockDischargeRequest";
CM_ SG_ 53 VCU_StartKeyHoldSta "VCU_StartKeyHoldStatus ##2G##VCU - VCU1 - CF_Vcu_Key_ST";
CM_ SG_ 53 VCU_EvDrvRdySta "VCU_EvDriveReadyStatus ##2G##VCU - VCU1 - CF_Vcu_EvRdy";
CM_ SG_ 53 VCU_MotPwrEnReq "VCU_MotorPowerEnableRequest ##2G##VCU - VCU3 - CF_Vcu_MotPwrEna";
CM_ SG_ 53 VCU_GearPosSta "VCU_GearPositionStatus ##2G##VCU - VCU1 - CF_Vcu_GarSelDisp";
CM_ SG_ 53 VCU_LdcInhReq "VCU_LdcInhibitRequest ##2G##VCU - VCU5 - CF_Vcu_LdcInh";
CM_ SG_ 53 VCU_MainRlyOffReq "VCU_MainRelayCutOffRequest ##2G##VCU - VCU1 - CF_Vcu_RelayOffReq";
CM_ SG_ 53 VCU_AccPedDepVal "VCU_AcceleratorPedalDepthValue ##2G##VCU - VCU1 - CR_Vcu_AccPedDep_Pc";
CM_ SG_ 53 VCU_FatcOperPermSta "VCU_FatcOperatingPermissionStatus ##2G##VCU - VCU20 - CF_Vcu_ClimateOperPerm";
CM_ SG_ 53 VCU_DrvCycSta "VCU_DrivingCycleStatus ##2G##VCU - VCU1 - CF_Vcu_Veh_DC";
CM_ SG_ 53 VCU_CltActOpSta "VCU_ClutchActuatorOperatingStatus";
CM_ SG_ 53 VCU_WhlSpdSnsrAlvReq "VCU_WheelSpeedSensorAliveRequest";
CM_ SG_ 53 VCU_DrvModOpSta "VCU's operating drive mode according to CLU and DMIC signals";
CM_ SG_ 53 VCU_HydBrkFcHoldRq "Hydraulic brake force holding request from VCU";
CM_ SG_ 53 VCU_FatcPwrUseVal "VCU_FatcPowerUseValue ##2G##VCU - VCU5 - CR_Vcu_FatcCst";
CM_ SG_ 53 VCU_WhlDemTqVal "VCU_WheelDemandTorqueValue ##2G##VCU - VCU2 - CR_Vcu_WhlDemTq_Nm";
CM_ SG_ 53 VCU_McuAntiJerkInhFrntSta "VCU_McuAntiJerkInhibitionFrontStatus";
CM_ SG_ 53 VCU_McuAntiJerkInhRearSta "VCU_McuAntiJerkInhibitionRearStatus ##2G##VCU - VCU3 - CF_Vcu_MCUAntiJerkInh";
CM_ SG_ 53 VCU_McuPwrLatchHoldReq "VCU_McuPowerLatchHoldRequest ##2G##VCU - VCU20 - CF_Vcu_McuPwrLatchHoldReq";
CM_ SG_ 53 VCU_ScuParkReq "VCU_ScuParkingRequest ##2G##VCU - VCU12 - CF_Vcu_PARKCMD";
CM_ SG_ 53 VCU_MotTqCmdFrntVal "VCU_MotorTorqueCommandFrontValue";
BA_DEF_ BO_  "GenMsgEVName" STRING ;
BA_DEF_ BO_  "NmAsrMessage" ENUM  "No","Yes";
BA_DEF_ BO_  "DiagState" ENUM  "No","Yes";
BA_DEF_ BO_  "DiagRequest" ENUM  "No","Yes";
BA_DEF_ BO_  "TpMessage" ENUM  "No","Yes";
BA_DEF_ BO_  "UsrMsgIDSforwardDeviation" INT 0 100;
BA_DEF_ BO_  "UsrMsgIDSbackwardDeviation" INT 50 1000;
BA_DEF_ BO_  "GenMsgCycleTime" INT 0 2000;
BA_DEF_ BO_  "GenMsgStartDelayTime" INT 0 2000;
BA_DEF_ BO_  "GenMsgSendType" ENUM  "Cyclic","NoMsgSendType";
BA_DEF_ BO_  "GenMsgCycleTimeFast" INT 0 500;
BA_DEF_ BO_  "GenMsgDelayTime" INT 0 20;
BA_DEF_ BO_  "GenMsgILSupport" ENUM  "No","Yes";
BA_DEF_ BO_  "GenMsgNrOfRepetition" INT 0 3;
BA_DEF_ BO_  "VFrameFormat" ENUM  "StandardCAN","ExtendedCAN","reserved","reserved","reserved","reserved","reserved","reserved","reserved","reserved","reserved","reserved","reserved","reserved","StandardCAN_FD","ExtendedCAN_FD";
BA_DEF_ SG_  "UserSigValidity" ENUM  "B+","ACC","IG","IG1","IG2","IG3","IG1 or IG2","IG1 or IG3","Undef";
BA_DEF_ SG_  "TimeoutValue" STRING ;
BA_DEF_ SG_  "UsrSigPurpose" ENUM  "Undef","FN","DIAG","DIAG(Req)","DIAG(Res)","DIAG(Func)","DEV","CCP","NM","TP";
BA_DEF_ SG_  "GenSigStartValue" INT 0 1215752192;
BA_DEF_ SG_  "NetworkRequest" ENUM  "Yes","No";
BA_DEF_ SG_  "NetworkRequestHoldingTime" INT 0 65535;
BA_DEF_ SG_  "Description" STRING ;
BA_DEF_ SG_  "Version" STRING ;
BA_DEF_ SG_  "GenSigEnvVarType" ENUM  "Int","Float","Undef";
BA_DEF_ SG_  "GenSigSendType" ENUM  "Cyclic","OnWrite","OnWriteWithRepetition","OnChange","OnChangeWithRepetition","IfActive","IfActiveWithRepetition","NoSigSendType","OnChangeAndIfActive","OnChangeAndIfActiveWithRepetition";
BA_DEF_ SG_  "GwSigLatencyTime" INT 0 65536;
BA_DEF_ SG_  "GwSigMissingSourceType" ENUM  "Undef","OldValue","DefaultValue","InitialValue";
BA_DEF_ SG_  "NWM-WakeupAllowed" ENUM  "<n.a.>";
BA_DEF_ SG_  "RoutingFactor" INT 1 1215752192;
BA_DEF_ SG_  "SystemSignalLongSymbol" STRING ;
BA_DEF_REL_ BU_SG_REL_  "GenSigTimeoutTime" INT 0 7000;
BA_DEF_DEF_  "GenMsgEVName" "@Signame";
BA_DEF_DEF_  "NmAsrMessage" "No";
BA_DEF_DEF_  "DiagState" "No";
BA_DEF_DEF_  "DiagRequest" "No";
BA_DEF_DEF_  "TpMessage" "No";
BA_DEF_DEF_  "UsrMsgIDSforwardDeviation" 10;
BA_DEF_DEF_  "UsrMsgIDSbackwardDeviation" 100;
BA_DEF_DEF_  "GenMsgCycleTime" 200;
BA_DEF_DEF_  "GenMsgStartDelayTime" 0;
BA_DEF_DEF_  "GenMsgSendType" "NoMsgSendType";
BA_DEF_DEF_  "GenMsgCycleTimeFast" 40;
BA_DEF_DEF_  "GenMsgDelayTime" 20;
BA_DEF_DEF_  "GenMsgILSupport" "Yes";
BA_DEF_DEF_  "GenMsgNrOfRepetition" 3;
BA_DEF_DEF_  "VFrameFormat" "StandardCAN";
BA_DEF_DEF_  "UserSigValidity" "IG";
BA_DEF_DEF_  "TimeoutValue" "";
BA_DEF_DEF_  "UsrSigPurpose" "FN";
BA_DEF_DEF_  "GenSigStartValue" 0;
BA_DEF_DEF_  "NetworkRequest" "No";
BA_DEF_DEF_  "NetworkRequestHoldingTime" 0;
BA_DEF_DEF_  "Description" "";
BA_DEF_DEF_  "Version" "";
BA_DEF_DEF_  "GenSigEnvVarType" "Undef";
BA_DEF_DEF_  "GenSigSendType" "NoSigSendType";
BA_DEF_DEF_  "GwSigLatencyTime" 40;
BA_DEF_DEF_  "GwSigMissingSourceType" "Undef";
BA_DEF_DEF_  "NWM-WakeupAllowed" "<n.a.>";
BA_DEF_DEF_  "RoutingFactor" 1;
BA_DEF_DEF_REL_ "GenSigTimeoutTime" 500;
BA_DEF_DEF_  "SystemSignalLongSymbol" "";
BA_ "GenMsgSendType" BO_ 813 0;
BA_ "VFrameFormat" BO_ 813 14;
BA_ "GenMsgSendType" BO_ 811 0;
BA_ "VFrameFormat" BO_ 811 14;
BA_ "GenMsgStartDelayTime" BO_ 930 10;
BA_ "GenMsgSendType" BO_ 930 0;
BA_ "VFrameFormat" BO_ 930 14;
BA_ "GenMsgNrOfRepetition" BO_ 518 0;
BA_ "GenMsgCycleTimeFast" BO_ 518 0;
BA_ "GenMsgCycleTime" BO_ 518 100;
BA_ "GenMsgSendType" BO_ 518 0;
BA_ "VFrameFormat" BO_ 518 14;
BA_ "GenMsgNrOfRepetition" BO_ 309 0;
BA_ "GenMsgCycleTimeFast" BO_ 309 0;
BA_ "GenMsgCycleTime" BO_ 309 50;
BA_ "GenMsgSendType" BO_ 309 0;
BA_ "VFrameFormat" BO_ 309 14;
BA_ "GenMsgSendType" BO_ 920 0;
BA_ "VFrameFormat" BO_ 920 14;
BA_ "GenMsgNrOfRepetition" BO_ 160 0;
BA_ "GenMsgCycleTimeFast" BO_ 160 0;
BA_ "GenMsgCycleTime" BO_ 160 50;
BA_ "GenMsgSendType" BO_ 160 0;
BA_ "VFrameFormat" BO_ 160 14;
BA_ "GenMsgNrOfRepetition" BO_ 426 0;
BA_ "GenMsgCycleTimeFast" BO_ 426 0;
BA_ "GenMsgCycleTime" BO_ 426 100;
BA_ "GenMsgSendType" BO_ 426 0;
BA_ "VFrameFormat" BO_ 426 14;
BA_ "GenMsgNrOfRepetition" BO_ 293 0;
BA_ "GenMsgCycleTimeFast" BO_ 293 0;
BA_ "GenMsgCycleTime" BO_ 293 50;
BA_ "GenMsgSendType" BO_ 293 0;
BA_ "VFrameFormat" BO_ 293 14;
BA_ "GenMsgNrOfRepetition" BO_ 53 0;
BA_ "GenMsgCycleTimeFast" BO_ 53 0;
BA_ "GenMsgCycleTime" BO_ 53 50;
BA_ "GenMsgSendType" BO_ 53 0;
BA_ "VFrameFormat" BO_ 53 14;
BA_ "Version" SG_ 813 SBCM_DRV_FD_Crc1Val "22.10.20";
BA_ "UserSigValidity" SG_ 813 SBCM_DRV_FD_Crc1Val 3;
BA_ "GenSigStartValue" SG_ 813 SBCM_DRV_FD_Crc1Val 65535;
BA_ "GenSigSendType" SG_ 813 SBCM_DRV_FD_Crc1Val 4;
BA_ "Description" SG_ 813 SBCM_DRV_FD_Crc1Val "The data area for CRC calculation is based on the data length (DLC) of the message DB.

The CRC shall be calculated over the entire data block (excluding the CRC bytes) including the user data, alive counter and Data ID



- CRC Polynomial (0x1021) , Ini";
BA_ "Version" SG_ 813 Latch_TypeOption_DRV "21.07.07";
BA_ "NetworkRequest" SG_ 813 Latch_TypeOption_DRV 0;
BA_ "UserSigValidity" SG_ 813 Latch_TypeOption_DRV 0;
BA_ "GenSigSendType" SG_ 813 Latch_TypeOption_DRV 4;
BA_ "Description" SG_ 813 Latch_TypeOption_DRV "If the E-Lacth is applied, the signal will be send for identify the door lock/unlock function and option.";
BA_ "Version" SG_ 813 DRV_SWFailAlarm "21.07.07";
BA_ "NetworkRequestHoldingTime" SG_ 813 DRV_SWFailAlarm 5000;
BA_ "NetworkRequest" SG_ 813 DRV_SWFailAlarm 0;
BA_ "UserSigValidity" SG_ 813 DRV_SWFailAlarm 0;
BA_ "GenSigSendType" SG_ 813 DRV_SWFailAlarm 4;
BA_ "Version" SG_ 813 USM_PwrDRApprOpnSetSta "21.07.07";
BA_ "NetworkRequestHoldingTime" SG_ 813 USM_PwrDRApprOpnSetSta 5000;
BA_ "NetworkRequest" SG_ 813 USM_PwrDRApprOpnSetSta 0;
BA_ "UserSigValidity" SG_ 813 USM_PwrDRApprOpnSetSta 0;
BA_ "GenSigSendType" SG_ 813 USM_PwrDRApprOpnSetSta 4;
BA_ "Version" SG_ 813 USM_PwrDRApprOpnSetOpt "21.07.07";
BA_ "NetworkRequestHoldingTime" SG_ 813 USM_PwrDRApprOpnSetOpt 5000;
BA_ "NetworkRequest" SG_ 813 USM_PwrDRApprOpnSetOpt 0;
BA_ "UserSigValidity" SG_ 813 USM_PwrDRApprOpnSetOpt 0;
BA_ "GenSigSendType" SG_ 813 USM_PwrDRApprOpnSetOpt 4;
BA_ "Version" SG_ 813 USM_PwrDRCloseByRKELockSta "22.10.01";
BA_ "NetworkRequestHoldingTime" SG_ 813 USM_PwrDRCloseByRKELockSta 5000;
BA_ "NetworkRequest" SG_ 813 USM_PwrDRCloseByRKELockSta 0;
BA_ "UserSigValidity" SG_ 813 USM_PwrDRCloseByRKELockSta 0;
BA_ "GenSigSendType" SG_ 813 USM_PwrDRCloseByRKELockSta 4;
BA_ "Version" SG_ 813 USM_PwrDRCloseByRKELockOpt "22.10.01";
BA_ "NetworkRequestHoldingTime" SG_ 813 USM_PwrDRCloseByRKELockOpt 5000;
BA_ "NetworkRequest" SG_ 813 USM_PwrDRCloseByRKELockOpt 0;
BA_ "UserSigValidity" SG_ 813 USM_PwrDRCloseByRKELockOpt 0;
BA_ "GenSigSendType" SG_ 813 USM_PwrDRCloseByRKELockOpt 4;
BA_ "Version" SG_ 813 USM_PwrDRCloseByBrakeSta "21.07.07";
BA_ "NetworkRequestHoldingTime" SG_ 813 USM_PwrDRCloseByBrakeSta 5000;
BA_ "NetworkRequest" SG_ 813 USM_PwrDRCloseByBrakeSta 0;
BA_ "UserSigValidity" SG_ 813 USM_PwrDRCloseByBrakeSta 0;
BA_ "GenSigSendType" SG_ 813 USM_PwrDRCloseByBrakeSta 4;
BA_ "Version" SG_ 813 USM_PwrDRCloseByBrakeOpt "21.07.07";
BA_ "NetworkRequestHoldingTime" SG_ 813 USM_PwrDRCloseByBrakeOpt 5000;
BA_ "NetworkRequest" SG_ 813 USM_PwrDRCloseByBrakeOpt 0;
BA_ "UserSigValidity" SG_ 813 USM_PwrDRCloseByBrakeOpt 0;
BA_ "GenSigSendType" SG_ 813 USM_PwrDRCloseByBrakeOpt 4;
BA_ "Version" SG_ 813 USM_PwrDRBuzzerSta "21.07.07";
BA_ "NetworkRequestHoldingTime" SG_ 813 USM_PwrDRBuzzerSta 5000;
BA_ "NetworkRequest" SG_ 813 USM_PwrDRBuzzerSta 0;
BA_ "UserSigValidity" SG_ 813 USM_PwrDRBuzzerSta 0;
BA_ "GenSigSendType" SG_ 813 USM_PwrDRBuzzerSta 4;
BA_ "Version" SG_ 813 USM_PwrDRBuzzerOpt "21.07.07";
BA_ "NetworkRequestHoldingTime" SG_ 813 USM_PwrDRBuzzerOpt 5000;
BA_ "NetworkRequest" SG_ 813 USM_PwrDRBuzzerOpt 0;
BA_ "UserSigValidity" SG_ 813 USM_PwrDRBuzzerOpt 0;
BA_ "GenSigSendType" SG_ 813 USM_PwrDRBuzzerOpt 4;
BA_ "Version" SG_ 813 PDS_TypeOption_DRV "23.04.02";
BA_ "NetworkRequest" SG_ 813 PDS_TypeOption_DRV 0;
BA_ "UserSigValidity" SG_ 813 PDS_TypeOption_DRV 0;
BA_ "GenSigSendType" SG_ 813 PDS_TypeOption_DRV 4;
BA_ "Version" SG_ 813 C_DrvDoorApproachOpen "21.07.07";
BA_ "UserSigValidity" SG_ 813 C_DrvDoorApproachOpen 0;
BA_ "GenSigSendType" SG_ 813 C_DrvDoorApproachOpen 4;
BA_ "Description" SG_ 813 C_DrvDoorApproachOpen "Fob searching start and stop signal for PDS.";
BA_ "Version" SG_ 813 C_DrvDoorApproachClose "21.07.07";
BA_ "UserSigValidity" SG_ 813 C_DrvDoorApproachClose 0;
BA_ "GenSigSendType" SG_ 813 C_DrvDoorApproachClose 4;
BA_ "Description" SG_ 813 C_DrvDoorApproachClose "To close the door automatically, request the fob searching signal";
BA_ "Version" SG_ 813 DoorLock_PDSLkSwSta_DRV "21.07.07";
BA_ "NetworkRequest" SG_ 813 DoorLock_PDSLkSwSta_DRV 0;
BA_ "UserSigValidity" SG_ 813 DoorLock_PDSLkSwSta_DRV 0;
BA_ "GenSigSendType" SG_ 813 DoorLock_PDSLkSwSta_DRV 4;
BA_ "Version" SG_ 813 SBCM_DRV_DiagSta "21.07.07";
BA_ "NetworkRequestHoldingTime" SG_ 813 SBCM_DRV_DiagSta 5000;
BA_ "NetworkRequest" SG_ 813 SBCM_DRV_DiagSta 0;
BA_ "UserSigValidity" SG_ 813 SBCM_DRV_DiagSta 0;
BA_ "GenSigSendType" SG_ 813 SBCM_DRV_DiagSta 4;
BA_ "Version" SG_ 813 DoorLock_CtrlDrLkUnLkSwSta_SBCM "21.07.07";
BA_ "NetworkRequestHoldingTime" SG_ 813 DoorLock_CtrlDrLkUnLkSwSta_SBCM 5000;
BA_ "NetworkRequest" SG_ 813 DoorLock_CtrlDrLkUnLkSwSta_SBCM 0;
BA_ "UserSigValidity" SG_ 813 DoorLock_CtrlDrLkUnLkSwSta_SBCM 0;
BA_ "GenSigSendType" SG_ 813 DoorLock_CtrlDrLkUnLkSwSta_SBCM 4;
BA_ "Description" SG_ 813 DoorLock_CtrlDrLkUnLkSwSta_SBCM "Central Door Lock/Unlock Switch State";
BA_ "Version" SG_ 813 SBCM_PsvDrLkReq "21.07.07";
BA_ "NetworkRequest" SG_ 813 SBCM_PsvDrLkReq 0;
BA_ "UserSigValidity" SG_ 813 SBCM_PsvDrLkReq 0;
BA_ "GenSigSendType" SG_ 813 SBCM_PsvDrLkReq 4;
BA_ "Version" SG_ 813 CDMAutoWashModeSet_SBCM "22.07.00";
BA_ "UserSigValidity" SG_ 813 CDMAutoWashModeSet_SBCM 3;
BA_ "GenSigSendType" SG_ 813 CDMAutoWashModeSet_SBCM 4;
BA_ "Version" SG_ 813 USM_DrvGhostDoorSta "21.07.07";
BA_ "NetworkRequestHoldingTime" SG_ 813 USM_DrvGhostDoorSta 5000;
BA_ "NetworkRequest" SG_ 813 USM_DrvGhostDoorSta 0;
BA_ "UserSigValidity" SG_ 813 USM_DrvGhostDoorSta 0;
BA_ "GenSigSendType" SG_ 813 USM_DrvGhostDoorSta 4;
BA_ "Version" SG_ 813 Mirror_LH_FoldingSta "21.07.07";
BA_ "NetworkRequestHoldingTime" SG_ 813 Mirror_LH_FoldingSta 5000;
BA_ "NetworkRequest" SG_ 813 Mirror_LH_FoldingSta 0;
BA_ "UserSigValidity" SG_ 813 Mirror_LH_FoldingSta 0;
BA_ "GenSigSendType" SG_ 813 Mirror_LH_FoldingSta 4;
BA_ "Version" SG_ 813 Mirror_LH_UnfoldingSta "21.07.07";
BA_ "NetworkRequestHoldingTime" SG_ 813 Mirror_LH_UnfoldingSta 5000;
BA_ "NetworkRequest" SG_ 813 Mirror_LH_UnfoldingSta 0;
BA_ "UserSigValidity" SG_ 813 Mirror_LH_UnfoldingSta 0;
BA_ "GenSigSendType" SG_ 813 Mirror_LH_UnfoldingSta 4;
BA_ "Version" SG_ 813 DRV_CrashMRActAlarm "21.07.07";
BA_ "NetworkRequestHoldingTime" SG_ 813 DRV_CrashMRActAlarm 5000;
BA_ "NetworkRequest" SG_ 813 DRV_CrashMRActAlarm 0;
BA_ "UserSigValidity" SG_ 813 DRV_CrashMRActAlarm 0;
BA_ "GenSigSendType" SG_ 813 DRV_CrashMRActAlarm 4;
BA_ "Version" SG_ 813 AFH_DRV_FldUnFldSta "24.07.06";
BA_ "NetworkRequestHoldingTime" SG_ 813 AFH_DRV_FldUnFldSta 5000;
BA_ "NetworkRequest" SG_ 813 AFH_DRV_FldUnFldSta 0;
BA_ "UserSigValidity" SG_ 813 AFH_DRV_FldUnFldSta 0;
BA_ "GenSigSendType" SG_ 813 AFH_DRV_FldUnFldSta 4;
BA_ "Version" SG_ 813 SBCM_DRV_FD_AlvCnt1Val "22.10.20";
BA_ "UserSigValidity" SG_ 813 SBCM_DRV_FD_AlvCnt1Val 3;
BA_ "GenSigSendType" SG_ 813 SBCM_DRV_FD_AlvCnt1Val 4;
BA_ "Description" SG_ 813 SBCM_DRV_FD_AlvCnt1Val "For the first transmission request for a data element the counter shall be initialized with 0 and shall be incremented by 1 for every subsequent send request. 

When the counter reaches the maximum value(0xFF), then it shall restart with 0 for the next s";
BA_ "Version" SG_ 813 MirrorFldReq "21.07.07";
BA_ "NetworkRequestHoldingTime" SG_ 813 MirrorFldReq 5000;
BA_ "NetworkRequest" SG_ 813 MirrorFldReq 0;
BA_ "UserSigValidity" SG_ 813 MirrorFldReq 0;
BA_ "GenSigSendType" SG_ 813 MirrorFldReq 4;
BA_ "Version" SG_ 813 OMU_TypeOption_DRV "21.07.07";
BA_ "NetworkRequestHoldingTime" SG_ 813 OMU_TypeOption_DRV 5000;
BA_ "NetworkRequest" SG_ 813 OMU_TypeOption_DRV 0;
BA_ "UserSigValidity" SG_ 813 OMU_TypeOption_DRV 0;
BA_ "GenSigSendType" SG_ 813 OMU_TypeOption_DRV 4;
BA_ "Version" SG_ 813 IMS_OSMirPlayBackSta_LH "21.07.07";
BA_ "NetworkRequestHoldingTime" SG_ 813 IMS_OSMirPlayBackSta_LH 5000;
BA_ "NetworkRequest" SG_ 813 IMS_OSMirPlayBackSta_LH 0;
BA_ "UserSigValidity" SG_ 813 IMS_OSMirPlayBackSta_LH 0;
BA_ "GenSigSendType" SG_ 813 IMS_OSMirPlayBackSta_LH 4;
BA_ "Version" SG_ 813 ECMMRR_PLUS "21.07.07";
BA_ "NetworkRequestHoldingTime" SG_ 813 ECMMRR_PLUS 5000;
BA_ "NetworkRequest" SG_ 813 ECMMRR_PLUS 0;
BA_ "UserSigValidity" SG_ 813 ECMMRR_PLUS 0;
BA_ "GenSigSendType" SG_ 813 ECMMRR_PLUS 4;
BA_ "Description" SG_ 813 ECMMRR_PLUS "This signal for passenger outside mirror OEC function(or ECM)

SBCM_DRV receive the ECM voltage value via H/wiring and then send this signal to SBCM_AST";
BA_ "Version" SG_ 813 EHL_TxInfo_SBCM_DRV "24.07.03";
BA_ "NetworkRequestHoldingTime" SG_ 813 EHL_TxInfo_SBCM_DRV 5000;
BA_ "NetworkRequest" SG_ 813 EHL_TxInfo_SBCM_DRV 0;
BA_ "UserSigValidity" SG_ 813 EHL_TxInfo_SBCM_DRV 0;
BA_ "GenSigSendType" SG_ 813 EHL_TxInfo_SBCM_DRV 4;
BA_ "Description" SG_ 813 EHL_TxInfo_SBCM_DRV "Electronic hood latch status signal transfer for dual hood latch type

(Copy to CANFD)";
BA_ "Version" SG_ 813 IMS_OSMirPlayBackSta_LH_New "23.01.03";
BA_ "NetworkRequestHoldingTime" SG_ 813 IMS_OSMirPlayBackSta_LH_New 5000;
BA_ "NetworkRequest" SG_ 813 IMS_OSMirPlayBackSta_LH_New 0;
BA_ "UserSigValidity" SG_ 813 IMS_OSMirPlayBackSta_LH_New 0;
BA_ "GenSigSendType" SG_ 813 IMS_OSMirPlayBackSta_LH_New 4;
BA_ "Description" SG_ 813 IMS_OSMirPlayBackSta_LH_New "Applied from standard DB 2.0";
BA_ "Version" SG_ 813 CDM_InsideOpnSwSta "23.04.05";
BA_ "NetworkRequestHoldingTime" SG_ 813 CDM_InsideOpnSwSta 5000;
BA_ "NetworkRequest" SG_ 813 CDM_InsideOpnSwSta 0;
BA_ "UserSigValidity" SG_ 813 CDM_InsideOpnSwSta 0;
BA_ "GenSigSendType" SG_ 813 CDM_InsideOpnSwSta 4;
BA_ "Version" SG_ 813 CDM_TypeOption "23.04.02";
BA_ "NetworkRequestHoldingTime" SG_ 813 CDM_TypeOption 5000;
BA_ "NetworkRequest" SG_ 813 CDM_TypeOption 0;
BA_ "UserSigValidity" SG_ 813 CDM_TypeOption 0;
BA_ "GenSigSendType" SG_ 813 CDM_TypeOption 4;
BA_ "Description" SG_ 813 CDM_TypeOption "0x1 : On (CDM is applied)

0x2 : On_2EA (CDM 2EA are applied)";
BA_ "Version" SG_ 813 CDM_ImmeChgSw_SBCM "23.04.05";
BA_ "UserSigValidity" SG_ 813 CDM_ImmeChgSw_SBCM 0;
BA_ "GenSigSendType" SG_ 813 CDM_ImmeChgSw_SBCM 4;
BA_ "Description" SG_ 813 CDM_ImmeChgSw_SBCM "State of Immediate Charging Switch";
BA_ "Version" SG_ 813 CDM_FobSrchReq_DRV "24.05.03";
BA_ "NetworkRequestHoldingTime" SG_ 813 CDM_FobSrchReq_DRV 5000;
BA_ "NetworkRequest" SG_ 813 CDM_FobSrchReq_DRV 0;
BA_ "UserSigValidity" SG_ 813 CDM_FobSrchReq_DRV 0;
BA_ "GenSigSendType" SG_ 813 CDM_FobSrchReq_DRV 4;
BA_ "Version" SG_ 813 CDM_OpnClsState_SBCM "23.04.05";
BA_ "UserSigValidity" SG_ 813 CDM_OpnClsState_SBCM 0;
BA_ "GenSigSendType" SG_ 813 CDM_OpnClsState_SBCM 4;
BA_ "Description" SG_ 813 CDM_OpnClsState_SBCM "This signal indicates CDM Open/Close Status";
BA_ "Version" SG_ 813 CDM_WarnMsg_SBCM "23.04.05";
BA_ "UserSigValidity" SG_ 813 CDM_WarnMsg_SBCM 0;
BA_ "GenSigSendType" SG_ 813 CDM_WarnMsg_SBCM 4;
BA_ "Description" SG_ 813 CDM_WarnMsg_SBCM "Command for CDM Warning on cluster";
BA_ "Version" SG_ 813 CDM_AutoWashModeSta "22.02.00";
BA_ "NetworkRequestHoldingTime" SG_ 813 CDM_AutoWashModeSta 5000;
BA_ "NetworkRequest" SG_ 813 CDM_AutoWashModeSta 0;
BA_ "UserSigValidity" SG_ 813 CDM_AutoWashModeSta 0;
BA_ "GenSigSendType" SG_ 813 CDM_AutoWashModeSta 4;
BA_ "Version" SG_ 813 CDM_CmdStatus_SBCM "23.04.05";
BA_ "UserSigValidity" SG_ 813 CDM_CmdStatus_SBCM 0;
BA_ "GenSigStartValue" SG_ 813 CDM_CmdStatus_SBCM 15;
BA_ "GenSigSendType" SG_ 813 CDM_CmdStatus_SBCM 4;
BA_ "Description" SG_ 813 CDM_CmdStatus_SBCM "User Condition Check For CDM Operation";
BA_ "Version" SG_ 813 CDM_OutsideOpnSwSta "23.04.05";
BA_ "NetworkRequestHoldingTime" SG_ 813 CDM_OutsideOpnSwSta 5000;
BA_ "NetworkRequest" SG_ 813 CDM_OutsideOpnSwSta 0;
BA_ "UserSigValidity" SG_ 813 CDM_OutsideOpnSwSta 0;
BA_ "GenSigSendType" SG_ 813 CDM_OutsideOpnSwSta 4;
BA_ "Description" SG_ 813 CDM_OutsideOpnSwSta "Charing Dorr O/S SW State";
BA_ "Version" SG_ 813 PwrDRBuzzerOut_DRV "21.07.07";
BA_ "NetworkRequestHoldingTime" SG_ 813 PwrDRBuzzerOut_DRV 5000;
BA_ "NetworkRequest" SG_ 813 PwrDRBuzzerOut_DRV 0;
BA_ "UserSigValidity" SG_ 813 PwrDRBuzzerOut_DRV 0;
BA_ "GenSigSendType" SG_ 813 PwrDRBuzzerOut_DRV 4;
BA_ "Version" SG_ 813 Warn_HoodSwSta_SBCM "21.09.08";
BA_ "NetworkRequestHoldingTime" SG_ 813 Warn_HoodSwSta_SBCM 5000;
BA_ "NetworkRequest" SG_ 813 Warn_HoodSwSta_SBCM 0;
BA_ "UserSigValidity" SG_ 813 Warn_HoodSwSta_SBCM 0;
BA_ "GenSigSendType" SG_ 813 Warn_HoodSwSta_SBCM 4;
BA_ "Version" SG_ 813 Hood_TypeOption "22.03.01";
BA_ "NetworkRequestHoldingTime" SG_ 813 Hood_TypeOption 5000;
BA_ "NetworkRequest" SG_ 813 Hood_TypeOption 0;
BA_ "UserSigValidity" SG_ 813 Hood_TypeOption 0;
BA_ "GenSigSendType" SG_ 813 Hood_TypeOption 4;
BA_ "Description" SG_ 813 Hood_TypeOption "If the E-Hood is applied, the signal will be send.";
BA_ "Version" SG_ 813 SBCM_FrunkSta "22.01.06";
BA_ "NetworkRequestHoldingTime" SG_ 813 SBCM_FrunkSta 5000;
BA_ "NetworkRequest" SG_ 813 SBCM_FrunkSta 0;
BA_ "UserSigValidity" SG_ 813 SBCM_FrunkSta 0;
BA_ "GenSigSendType" SG_ 813 SBCM_FrunkSta 4;
BA_ "Version" SG_ 813 Warn_HoodSwFullSta_SBCM "22.01.06";
BA_ "NetworkRequestHoldingTime" SG_ 813 Warn_HoodSwFullSta_SBCM 5000;
BA_ "NetworkRequest" SG_ 813 Warn_HoodSwFullSta_SBCM 0;
BA_ "UserSigValidity" SG_ 813 Warn_HoodSwFullSta_SBCM 0;
BA_ "GenSigSendType" SG_ 813 Warn_HoodSwFullSta_SBCM 4;
BA_ "Version" SG_ 813 FrunkWarning_SBCM "22.03.01";
BA_ "NetworkRequestHoldingTime" SG_ 813 FrunkWarning_SBCM 5000;
BA_ "NetworkRequest" SG_ 813 FrunkWarning_SBCM 0;
BA_ "UserSigValidity" SG_ 813 FrunkWarning_SBCM 0;
BA_ "GenSigSendType" SG_ 813 FrunkWarning_SBCM 4;
BA_ "Version" SG_ 813 SBCM_Longkey_DRVDrAtClsSwSta "22.04.02";
BA_ "NetworkRequestHoldingTime" SG_ 813 SBCM_Longkey_DRVDrAtClsSwSta 5000;
BA_ "NetworkRequest" SG_ 813 SBCM_Longkey_DRVDrAtClsSwSta 0;
BA_ "UserSigValidity" SG_ 813 SBCM_Longkey_DRVDrAtClsSwSta 0;
BA_ "GenSigSendType" SG_ 813 SBCM_Longkey_DRVDrAtClsSwSta 4;
BA_ "Description" SG_ 813 SBCM_Longkey_DRVDrAtClsSwSta "FCS Power Door Long key Status";
BA_ "Version" SG_ 813 FrunkReleaseSwSta_SBCM "23.04.04";
BA_ "NetworkRequestHoldingTime" SG_ 813 FrunkReleaseSwSta_SBCM 50000;
BA_ "NetworkRequest" SG_ 813 FrunkReleaseSwSta_SBCM 0;
BA_ "UserSigValidity" SG_ 813 FrunkReleaseSwSta_SBCM 0;
BA_ "GenSigSendType" SG_ 813 FrunkReleaseSwSta_SBCM 4;
BA_ "Description" SG_ 813 FrunkReleaseSwSta_SBCM "FrunkReleaseState";
BA_ "Version" SG_ 813 PwrDRClosingDRVDrSta "23.10.11";
BA_ "NetworkRequestHoldingTime" SG_ 813 PwrDRClosingDRVDrSta 5000;
BA_ "NetworkRequest" SG_ 813 PwrDRClosingDRVDrSta 0;
BA_ "UserSigValidity" SG_ 813 PwrDRClosingDRVDrSta 0;
BA_ "GenSigSendType" SG_ 813 PwrDRClosingDRVDrSta 4;
BA_ "Version" SG_ 813 Drv_DrLkRetryFail_SBCM "23.03.00";
BA_ "NetworkRequestHoldingTime" SG_ 813 Drv_DrLkRetryFail_SBCM 5000;
BA_ "NetworkRequest" SG_ 813 Drv_DrLkRetryFail_SBCM 0;
BA_ "UserSigValidity" SG_ 813 Drv_DrLkRetryFail_SBCM 0;
BA_ "TimeoutValue" SG_ 813 Drv_DrLkRetryFail_SBCM "0x0";
BA_ "GenSigSendType" SG_ 813 Drv_DrLkRetryFail_SBCM 4;
BA_ "Version" SG_ 813 CDM_GbtImmeChgSw_SBCM "23.04.02";
BA_ "UserSigValidity" SG_ 813 CDM_GbtImmeChgSw_SBCM 0;
BA_ "GenSigSendType" SG_ 813 CDM_GbtImmeChgSw_SBCM 4;
BA_ "Description" SG_ 813 CDM_GbtImmeChgSw_SBCM "State of Immediate Charging Switch";
BA_ "Version" SG_ 813 CDM_GbtOpnClsState_SBCM "23.04.02";
BA_ "UserSigValidity" SG_ 813 CDM_GbtOpnClsState_SBCM 0;
BA_ "GenSigSendType" SG_ 813 CDM_GbtOpnClsState_SBCM 4;
BA_ "Description" SG_ 813 CDM_GbtOpnClsState_SBCM "This signal indicates CDM Open/Close Status(Gbt)";
BA_ "Version" SG_ 813 CDM_GbtWarnMsg_SBCM "23.04.02";
BA_ "UserSigValidity" SG_ 813 CDM_GbtWarnMsg_SBCM 0;
BA_ "GenSigSendType" SG_ 813 CDM_GbtWarnMsg_SBCM 4;
BA_ "Description" SG_ 813 CDM_GbtWarnMsg_SBCM "Command for CDM Warning on cluster(Gbt)";
BA_ "Version" SG_ 813 CDM_GbtOutsideOpnSwSta "24.01.03";
BA_ "NetworkRequestHoldingTime" SG_ 813 CDM_GbtOutsideOpnSwSta 5000;
BA_ "NetworkRequest" SG_ 813 CDM_GbtOutsideOpnSwSta 0;
BA_ "UserSigValidity" SG_ 813 CDM_GbtOutsideOpnSwSta 0;
BA_ "GenSigSendType" SG_ 813 CDM_GbtOutsideOpnSwSta 4;
BA_ "Version" SG_ 813 DoorLock_DrvLkOutSta_SBCM "23.02.09";
BA_ "NetworkRequestHoldingTime" SG_ 813 DoorLock_DrvLkOutSta_SBCM 5000;
BA_ "NetworkRequest" SG_ 813 DoorLock_DrvLkOutSta_SBCM 0;
BA_ "UserSigValidity" SG_ 813 DoorLock_DrvLkOutSta_SBCM 0;
BA_ "GenSigSendType" SG_ 813 DoorLock_DrvLkOutSta_SBCM 4;
BA_ "Description" SG_ 813 DoorLock_DrvLkOutSta_SBCM "- Door Lock or Unlock Output State 

0x0 : Off (Door lock/unlock output Off state)

0x1 : On (Door lock/unlock output On state)";
BA_ "Version" SG_ 813 FrunkEmergencySwSta_SBCM "23.04.04";
BA_ "NetworkRequestHoldingTime" SG_ 813 FrunkEmergencySwSta_SBCM 5000;
BA_ "NetworkRequest" SG_ 813 FrunkEmergencySwSta_SBCM 0;
BA_ "UserSigValidity" SG_ 813 FrunkEmergencySwSta_SBCM 0;
BA_ "GenSigSendType" SG_ 813 FrunkEmergencySwSta_SBCM 4;
BA_ "Description" SG_ 813 FrunkEmergencySwSta_SBCM "FrunkEmergencySwState";
BA_ "Version" SG_ 813 DRV_DetectObj_warn_LH "23.10.11";
BA_ "NetworkRequestHoldingTime" SG_ 813 DRV_DetectObj_warn_LH 5000;
BA_ "NetworkRequest" SG_ 813 DRV_DetectObj_warn_LH 0;
BA_ "UserSigValidity" SG_ 813 DRV_DetectObj_warn_LH 0;
BA_ "GenSigSendType" SG_ 813 DRV_DetectObj_warn_LH 4;
BA_ "Version" SG_ 813 PwrDROpenClosingDdvSdDRSta "23.10.11";
BA_ "NetworkRequestHoldingTime" SG_ 813 PwrDROpenClosingDdvSdDRSta 5000;
BA_ "NetworkRequest" SG_ 813 PwrDROpenClosingDdvSdDRSta 0;
BA_ "UserSigValidity" SG_ 813 PwrDROpenClosingDdvSdDRSta 0;
BA_ "GenSigSendType" SG_ 813 PwrDROpenClosingDdvSdDRSta 4;
BA_ "Version" SG_ 813 PwrDRBuzzerOut_DRV_New "24.01.05";
BA_ "NetworkRequestHoldingTime" SG_ 813 PwrDRBuzzerOut_DRV_New 5000;
BA_ "NetworkRequest" SG_ 813 PwrDRBuzzerOut_DRV_New 0;
BA_ "UserSigValidity" SG_ 813 PwrDRBuzzerOut_DRV_New 0;
BA_ "GenSigSendType" SG_ 813 PwrDRBuzzerOut_DRV_New 4;
BA_ "Description" SG_ 813 PwrDRBuzzerOut_DRV_New "JG~ 적용";
BA_ "Version" SG_ 813 Coach_TypeOption_DRV "24.01.07";
BA_ "NetworkRequestHoldingTime" SG_ 813 Coach_TypeOption_DRV 5000;
BA_ "NetworkRequest" SG_ 813 Coach_TypeOption_DRV 0;
BA_ "UserSigValidity" SG_ 813 Coach_TypeOption_DRV 0;
BA_ "GenSigStartValue" SG_ 813 Coach_TypeOption_DRV 3;
BA_ "GenSigSendType" SG_ 813 Coach_TypeOption_DRV 4;
BA_ "Version" SG_ 813 PwrDrSta_Drv "24.01.05";
BA_ "NetworkRequestHoldingTime" SG_ 813 PwrDrSta_Drv 5000;
BA_ "NetworkRequest" SG_ 813 PwrDrSta_Drv 0;
BA_ "UserSigValidity" SG_ 813 PwrDrSta_Drv 0;
BA_ "GenSigSendType" SG_ 813 PwrDrSta_Drv 4;
BA_ "Version" SG_ 813 PwrDrSta_DrvSd "24.01.05";
BA_ "NetworkRequestHoldingTime" SG_ 813 PwrDrSta_DrvSd 5000;
BA_ "NetworkRequest" SG_ 813 PwrDrSta_DrvSd 0;
BA_ "UserSigValidity" SG_ 813 PwrDrSta_DrvSd 0;
BA_ "GenSigSendType" SG_ 813 PwrDrSta_DrvSd 4;
BA_ "Version" SG_ 813 USM_PwrDrOpnTypSta "24.01.05";
BA_ "NetworkRequestHoldingTime" SG_ 813 USM_PwrDrOpnTypSta 5000;
BA_ "NetworkRequest" SG_ 813 USM_PwrDrOpnTypSta 0;
BA_ "UserSigValidity" SG_ 813 USM_PwrDrOpnTypSta 0;
BA_ "GenSigSendType" SG_ 813 USM_PwrDrOpnTypSta 4;
BA_ "Version" SG_ 813 DischrgDr_OpnClsState_SBCM "24.01.04";
BA_ "NetworkRequestHoldingTime" SG_ 813 DischrgDr_OpnClsState_SBCM 5000;
BA_ "NetworkRequest" SG_ 813 DischrgDr_OpnClsState_SBCM 0;
BA_ "UserSigValidity" SG_ 813 DischrgDr_OpnClsState_SBCM 0;
BA_ "GenSigSendType" SG_ 813 DischrgDr_OpnClsState_SBCM 4;
BA_ "Version" SG_ 813 SBCM_FL_DoorAngle "24.01.05";
BA_ "NetworkRequestHoldingTime" SG_ 813 SBCM_FL_DoorAngle 5000;
BA_ "NetworkRequest" SG_ 813 SBCM_FL_DoorAngle 0;
BA_ "UserSigValidity" SG_ 813 SBCM_FL_DoorAngle 0;
BA_ "GenSigStartValue" SG_ 813 SBCM_FL_DoorAngle 100;
BA_ "GenSigSendType" SG_ 813 SBCM_FL_DoorAngle 4;
BA_ "Description" SG_ 813 SBCM_FL_DoorAngle "PDSM_FL_DoorAngle";
BA_ "Version" SG_ 813 SBCM_DoorType_DRV "24.01.07";
BA_ "NetworkRequestHoldingTime" SG_ 813 SBCM_DoorType_DRV 5000;
BA_ "NetworkRequest" SG_ 813 SBCM_DoorType_DRV 0;
BA_ "UserSigValidity" SG_ 813 SBCM_DoorType_DRV 0;
BA_ "GenSigStartValue" SG_ 813 SBCM_DoorType_DRV 2;
BA_ "GenSigSendType" SG_ 813 SBCM_DoorType_DRV 4;
BA_ "Description" SG_ 813 SBCM_DoorType_DRV "SBCM Applied Type";
BA_ "Version" SG_ 813 CDM_DrType_DRV "24.05.01";
BA_ "NetworkRequestHoldingTime" SG_ 813 CDM_DrType_DRV 5000;
BA_ "NetworkRequest" SG_ 813 CDM_DrType_DRV 0;
BA_ "UserSigValidity" SG_ 813 CDM_DrType_DRV 7;
BA_ "GenSigSendType" SG_ 813 CDM_DrType_DRV 4;
BA_ "Version" SG_ 813 DRVDoorPushAlarm "21.07.07";
BA_ "NetworkRequestHoldingTime" SG_ 813 DRVDoorPushAlarm 5000;
BA_ "NetworkRequest" SG_ 813 DRVDoorPushAlarm 0;
BA_ "UserSigValidity" SG_ 813 DRVDoorPushAlarm 0;
BA_ "GenSigSendType" SG_ 813 DRVDoorPushAlarm 4;
BA_ "Version" SG_ 813 DRV_CrashUnlockCmd "21.07.07";
BA_ "NetworkRequest" SG_ 813 DRV_CrashUnlockCmd 0;
BA_ "UserSigValidity" SG_ 813 DRV_CrashUnlockCmd 0;
BA_ "GenSigSendType" SG_ 813 DRV_CrashUnlockCmd 4;
BA_ "Description" SG_ 813 DRV_CrashUnlockCmd "Drive Crash Unlock Command";
BA_ "Version" SG_ 813 C_ApprOpenStatus "21.07.07";
BA_ "UserSigValidity" SG_ 813 C_ApprOpenStatus 0;
BA_ "GenSigSendType" SG_ 813 C_ApprOpenStatus 4;
BA_ "Description" SG_ 813 C_ApprOpenStatus "This is for Power Door System enable/disable signal.";
BA_ "Version" SG_ 813 DoorLock_DrvKeyLkSwSta_SBCM "21.07.07";
BA_ "NetworkRequest" SG_ 813 DoorLock_DrvKeyLkSwSta_SBCM 0;
BA_ "UserSigValidity" SG_ 813 DoorLock_DrvKeyLkSwSta_SBCM 0;
BA_ "GenSigSendType" SG_ 813 DoorLock_DrvKeyLkSwSta_SBCM 4;
BA_ "Description" SG_ 813 DoorLock_DrvKeyLkSwSta_SBCM "Door Lock Driver Mechanical Key Input Signal";
BA_ "Version" SG_ 813 DoorLock_DrvKeyUnLkSwSta_SBCM "21.07.07";
BA_ "NetworkRequest" SG_ 813 DoorLock_DrvKeyUnLkSwSta_SBCM 0;
BA_ "UserSigValidity" SG_ 813 DoorLock_DrvKeyUnLkSwSta_SBCM 0;
BA_ "GenSigSendType" SG_ 813 DoorLock_DrvKeyUnLkSwSta_SBCM 4;
BA_ "Description" SG_ 813 DoorLock_DrvKeyUnLkSwSta_SBCM "Door Drive Mechanical Key Unlock Switch State";
BA_ "Version" SG_ 813 Warn_DrvDrSwSta_SBCM "21.09.05";
BA_ "NetworkRequest" SG_ 813 Warn_DrvDrSwSta_SBCM 0;
BA_ "UserSigValidity" SG_ 813 Warn_DrvDrSwSta_SBCM 0;
BA_ "GenSigSendType" SG_ 813 Warn_DrvDrSwSta_SBCM 4;
BA_ "Description" SG_ 813 Warn_DrvDrSwSta_SBCM "Warning Drive Door Switch State";
BA_ "Version" SG_ 813 DoorLock_DrvDrUnLkSta_SBCM "21.09.05";
BA_ "NetworkRequest" SG_ 813 DoorLock_DrvDrUnLkSta_SBCM 0;
BA_ "UserSigValidity" SG_ 813 DoorLock_DrvDrUnLkSta_SBCM 0;
BA_ "GenSigSendType" SG_ 813 DoorLock_DrvDrUnLkSta_SBCM 4;
BA_ "Description" SG_ 813 DoorLock_DrvDrUnLkSta_SBCM "Drive Door Lock Unlock Status";
BA_ "Version" SG_ 813 DRV_SEAWarn_LH "21.07.07";
BA_ "NetworkRequest" SG_ 813 DRV_SEAWarn_LH 0;
BA_ "UserSigValidity" SG_ 813 DRV_SEAWarn_LH 0;
BA_ "GenSigSendType" SG_ 813 DRV_SEAWarn_LH 4;
BA_ "Description" SG_ 813 DRV_SEAWarn_LH "Drive (FLH) Door SEA Warning";
BA_ "Version" SG_ 813 DRV_SEAWarn_RH "21.07.07";
BA_ "NetworkRequest" SG_ 813 DRV_SEAWarn_RH 0;
BA_ "UserSigValidity" SG_ 813 DRV_SEAWarn_RH 0;
BA_ "GenSigSendType" SG_ 813 DRV_SEAWarn_RH 4;
BA_ "Description" SG_ 813 DRV_SEAWarn_RH "Drive (FRH) Door SEA Warning";
BA_ "Version" SG_ 813 DRV_SEWWarn_LH "21.07.07";
BA_ "NetworkRequest" SG_ 813 DRV_SEWWarn_LH 0;
BA_ "UserSigValidity" SG_ 813 DRV_SEWWarn_LH 0;
BA_ "GenSigSendType" SG_ 813 DRV_SEWWarn_LH 4;
BA_ "Description" SG_ 813 DRV_SEWWarn_LH "Drive (FLH) Door Safety Exit Warning";
BA_ "Version" SG_ 813 DRV_SEWWarn_RH "21.07.07";
BA_ "NetworkRequest" SG_ 813 DRV_SEWWarn_RH 0;
BA_ "UserSigValidity" SG_ 813 DRV_SEWWarn_RH 0;
BA_ "GenSigSendType" SG_ 813 DRV_SEWWarn_RH 4;
BA_ "Description" SG_ 813 DRV_SEWWarn_RH "Drive (FRH) Door Safety Exit Warning";
BA_ "Version" SG_ 813 DRV_MRActivationAlarm "21.07.07";
BA_ "NetworkRequestHoldingTime" SG_ 813 DRV_MRActivationAlarm 5000;
BA_ "NetworkRequest" SG_ 813 DRV_MRActivationAlarm 0;
BA_ "UserSigValidity" SG_ 813 DRV_MRActivationAlarm 0;
BA_ "GenSigSendType" SG_ 813 DRV_MRActivationAlarm 4;
BA_ "Version" SG_ 813 DRV_ReleaseWarn "21.09.05";
BA_ "NetworkRequestHoldingTime" SG_ 813 DRV_ReleaseWarn 5000;
BA_ "NetworkRequest" SG_ 813 DRV_ReleaseWarn 0;
BA_ "UserSigValidity" SG_ 813 DRV_ReleaseWarn 0;
BA_ "GenSigSendType" SG_ 813 DRV_ReleaseWarn 4;
BA_ "Version" SG_ 811 SBCM_AST_FD_Crc1Val "22.10.20";
BA_ "UserSigValidity" SG_ 811 SBCM_AST_FD_Crc1Val 3;
BA_ "GenSigStartValue" SG_ 811 SBCM_AST_FD_Crc1Val 65535;
BA_ "GenSigSendType" SG_ 811 SBCM_AST_FD_Crc1Val 4;
BA_ "Description" SG_ 811 SBCM_AST_FD_Crc1Val "The data area for CRC calculation is based on the data length (DLC) of the message DB.

The CRC shall be calculated over the entire data block (excluding the CRC bytes) including the user data, alive counter and Data ID



- CRC Polynomial (0x1021) , Ini";
BA_ "Version" SG_ 811 USM_AstGhostDoorSta "21.07.07";
BA_ "NetworkRequestHoldingTime" SG_ 811 USM_AstGhostDoorSta 5000;
BA_ "NetworkRequest" SG_ 811 USM_AstGhostDoorSta 0;
BA_ "UserSigValidity" SG_ 811 USM_AstGhostDoorSta 0;
BA_ "GenSigSendType" SG_ 811 USM_AstGhostDoorSta 4;
BA_ "Version" SG_ 811 AST_SWFailAlarm "21.07.07";
BA_ "NetworkRequestHoldingTime" SG_ 811 AST_SWFailAlarm 5000;
BA_ "NetworkRequest" SG_ 811 AST_SWFailAlarm 0;
BA_ "UserSigValidity" SG_ 811 AST_SWFailAlarm 0;
BA_ "GenSigSendType" SG_ 811 AST_SWFailAlarm 4;
BA_ "Version" SG_ 811 DoorLock_PDSLkSwSta_AST "21.09.05";
BA_ "NetworkRequest" SG_ 811 DoorLock_PDSLkSwSta_AST 0;
BA_ "UserSigValidity" SG_ 811 DoorLock_PDSLkSwSta_AST 0;
BA_ "GenSigSendType" SG_ 811 DoorLock_PDSLkSwSta_AST 4;
BA_ "Version" SG_ 811 PDS_TypeOption_AST "21.07.07";
BA_ "NetworkRequest" SG_ 811 PDS_TypeOption_AST 0;
BA_ "UserSigValidity" SG_ 811 PDS_TypeOption_AST 0;
BA_ "GenSigSendType" SG_ 811 PDS_TypeOption_AST 4;
BA_ "Version" SG_ 811 AFCU_AutoWashModeSta_SBCM_AST "22.07.00";
BA_ "NetworkRequestHoldingTime" SG_ 811 AFCU_AutoWashModeSta_SBCM_AST 5000;
BA_ "NetworkRequest" SG_ 811 AFCU_AutoWashModeSta_SBCM_AST 0;
BA_ "UserSigValidity" SG_ 811 AFCU_AutoWashModeSta_SBCM_AST 0;
BA_ "GenSigSendType" SG_ 811 AFCU_AutoWashModeSta_SBCM_AST 4;
BA_ "Version" SG_ 811 CDM_AutoWashModeSta_SBCM_AST "22.07.00";
BA_ "NetworkRequestHoldingTime" SG_ 811 CDM_AutoWashModeSta_SBCM_AST 5000;
BA_ "NetworkRequest" SG_ 811 CDM_AutoWashModeSta_SBCM_AST 0;
BA_ "UserSigValidity" SG_ 811 CDM_AutoWashModeSta_SBCM_AST 0;
BA_ "GenSigSendType" SG_ 811 CDM_AutoWashModeSta_SBCM_AST 4;
BA_ "Version" SG_ 811 AFH_AST_FldUnFldSta "24.07.06";
BA_ "NetworkRequestHoldingTime" SG_ 811 AFH_AST_FldUnFldSta 5000;
BA_ "NetworkRequest" SG_ 811 AFH_AST_FldUnFldSta 0;
BA_ "UserSigValidity" SG_ 811 AFH_AST_FldUnFldSta 0;
BA_ "GenSigSendType" SG_ 811 AFH_AST_FldUnFldSta 4;
BA_ "Version" SG_ 811 SBCM_AST_DiagSta "21.07.07";
BA_ "NetworkRequestHoldingTime" SG_ 811 SBCM_AST_DiagSta 5000;
BA_ "NetworkRequest" SG_ 811 SBCM_AST_DiagSta 0;
BA_ "UserSigValidity" SG_ 811 SBCM_AST_DiagSta 0;
BA_ "GenSigSendType" SG_ 811 SBCM_AST_DiagSta 4;
BA_ "Version" SG_ 811 CDM_TypeOption_AST "24.07.03";
BA_ "NetworkRequestHoldingTime" SG_ 811 CDM_TypeOption_AST 5000;
BA_ "NetworkRequest" SG_ 811 CDM_TypeOption_AST 0;
BA_ "UserSigValidity" SG_ 811 CDM_TypeOption_AST 7;
BA_ "GenSigSendType" SG_ 811 CDM_TypeOption_AST 4;
BA_ "Version" SG_ 811 CDM_ImmeChgSw_AST "21.07.07";
BA_ "NetworkRequestHoldingTime" SG_ 811 CDM_ImmeChgSw_AST 5000;
BA_ "NetworkRequest" SG_ 811 CDM_ImmeChgSw_AST 0;
BA_ "UserSigValidity" SG_ 811 CDM_ImmeChgSw_AST 7;
BA_ "GenSigSendType" SG_ 811 CDM_ImmeChgSw_AST 4;
BA_ "Version" SG_ 811 CDM_FobSrchReq_AST "24.05.03";
BA_ "NetworkRequestHoldingTime" SG_ 811 CDM_FobSrchReq_AST 5000;
BA_ "NetworkRequest" SG_ 811 CDM_FobSrchReq_AST 0;
BA_ "UserSigValidity" SG_ 811 CDM_FobSrchReq_AST 0;
BA_ "GenSigSendType" SG_ 811 CDM_FobSrchReq_AST 4;
BA_ "Version" SG_ 811 CDM_OpnClsState_AST "21.07.07";
BA_ "NetworkRequestHoldingTime" SG_ 811 CDM_OpnClsState_AST 5000;
BA_ "NetworkRequest" SG_ 811 CDM_OpnClsState_AST 0;
BA_ "UserSigValidity" SG_ 811 CDM_OpnClsState_AST 7;
BA_ "GenSigSendType" SG_ 811 CDM_OpnClsState_AST 4;
BA_ "Version" SG_ 811 CDM_WarnMsg_AST "21.07.07";
BA_ "NetworkRequestHoldingTime" SG_ 811 CDM_WarnMsg_AST 5000;
BA_ "NetworkRequest" SG_ 811 CDM_WarnMsg_AST 0;
BA_ "UserSigValidity" SG_ 811 CDM_WarnMsg_AST 7;
BA_ "GenSigSendType" SG_ 811 CDM_WarnMsg_AST 4;
BA_ "Version" SG_ 811 Mirror_RH_FoldingSta "21.07.07";
BA_ "NetworkRequestHoldingTime" SG_ 811 Mirror_RH_FoldingSta 5000;
BA_ "NetworkRequest" SG_ 811 Mirror_RH_FoldingSta 0;
BA_ "UserSigValidity" SG_ 811 Mirror_RH_FoldingSta 0;
BA_ "GenSigSendType" SG_ 811 Mirror_RH_FoldingSta 4;
BA_ "Version" SG_ 811 Mirror_RH_UnfoldingSta "21.07.07";
BA_ "NetworkRequestHoldingTime" SG_ 811 Mirror_RH_UnfoldingSta 5000;
BA_ "NetworkRequest" SG_ 811 Mirror_RH_UnfoldingSta 0;
BA_ "UserSigValidity" SG_ 811 Mirror_RH_UnfoldingSta 0;
BA_ "GenSigSendType" SG_ 811 Mirror_RH_UnfoldingSta 4;
BA_ "Version" SG_ 811 CDM_CmdStatus_AST "22.08.03";
BA_ "NetworkRequestHoldingTime" SG_ 811 CDM_CmdStatus_AST 5000;
BA_ "NetworkRequest" SG_ 811 CDM_CmdStatus_AST 0;
BA_ "UserSigValidity" SG_ 811 CDM_CmdStatus_AST 7;
BA_ "GenSigStartValue" SG_ 811 CDM_CmdStatus_AST 15;
BA_ "GenSigSendType" SG_ 811 CDM_CmdStatus_AST 4;
BA_ "Version" SG_ 811 SBCM_AST_FD_AlvCnt1Val "22.10.20";
BA_ "UserSigValidity" SG_ 811 SBCM_AST_FD_AlvCnt1Val 3;
BA_ "GenSigSendType" SG_ 811 SBCM_AST_FD_AlvCnt1Val 4;
BA_ "Description" SG_ 811 SBCM_AST_FD_AlvCnt1Val "For the first transmission request for a data element the counter shall be initialized with 0 and shall be incremented by 1 for every subsequent send request. 

When the counter reaches the maximum value(0xFF), then it shall restart with 0 for the next s";
BA_ "Version" SG_ 811 AST_CrashMRActAlarm "21.07.07";
BA_ "NetworkRequestHoldingTime" SG_ 811 AST_CrashMRActAlarm 5000;
BA_ "NetworkRequest" SG_ 811 AST_CrashMRActAlarm 0;
BA_ "UserSigValidity" SG_ 811 AST_CrashMRActAlarm 0;
BA_ "GenSigSendType" SG_ 811 AST_CrashMRActAlarm 4;
BA_ "Version" SG_ 811 PwrDRBuzzerOut_AST "21.07.07";
BA_ "NetworkRequestHoldingTime" SG_ 811 PwrDRBuzzerOut_AST 5000;
BA_ "NetworkRequest" SG_ 811 PwrDRBuzzerOut_AST 0;
BA_ "UserSigValidity" SG_ 811 PwrDRBuzzerOut_AST 0;
BA_ "GenSigSendType" SG_ 811 PwrDRBuzzerOut_AST 4;
BA_ "Version" SG_ 811 IMS_OSMirPlayBackSta_RH "21.07.07";
BA_ "NetworkRequestHoldingTime" SG_ 811 IMS_OSMirPlayBackSta_RH 5000;
BA_ "NetworkRequest" SG_ 811 IMS_OSMirPlayBackSta_RH 0;
BA_ "UserSigValidity" SG_ 811 IMS_OSMirPlayBackSta_RH 0;
BA_ "GenSigSendType" SG_ 811 IMS_OSMirPlayBackSta_RH 4;
BA_ "Version" SG_ 811 PwrDRClosingASTDrSta "23.07.06";
BA_ "NetworkRequestHoldingTime" SG_ 811 PwrDRClosingASTDrSta 5000;
BA_ "NetworkRequest" SG_ 811 PwrDRClosingASTDrSta 0;
BA_ "UserSigValidity" SG_ 811 PwrDRClosingASTDrSta 0;
BA_ "GenSigSendType" SG_ 811 PwrDRClosingASTDrSta 4;
BA_ "Version" SG_ 811 CDM_OutsideOpnSwSta_AST "23.02.02";
BA_ "NetworkRequestHoldingTime" SG_ 811 CDM_OutsideOpnSwSta_AST 5000;
BA_ "NetworkRequest" SG_ 811 CDM_OutsideOpnSwSta_AST 0;
BA_ "UserSigValidity" SG_ 811 CDM_OutsideOpnSwSta_AST 7;
BA_ "GenSigSendType" SG_ 811 CDM_OutsideOpnSwSta_AST 4;
BA_ "Description" SG_ 811 CDM_OutsideOpnSwSta_AST "Charging Door O/S SW State";
BA_ "Version" SG_ 811 SBCM_Longkey_ASTDrAtClsSwSta "22.04.02";
BA_ "NetworkRequestHoldingTime" SG_ 811 SBCM_Longkey_ASTDrAtClsSwSta 5000;
BA_ "NetworkRequest" SG_ 811 SBCM_Longkey_ASTDrAtClsSwSta 0;
BA_ "UserSigValidity" SG_ 811 SBCM_Longkey_ASTDrAtClsSwSta 0;
BA_ "GenSigSendType" SG_ 811 SBCM_Longkey_ASTDrAtClsSwSta 4;
BA_ "Version" SG_ 811 Hood_TypeOption_AST "22.10.19";
BA_ "NetworkRequestHoldingTime" SG_ 811 Hood_TypeOption_AST 5000;
BA_ "NetworkRequest" SG_ 811 Hood_TypeOption_AST 0;
BA_ "UserSigValidity" SG_ 811 Hood_TypeOption_AST 0;
BA_ "GenSigSendType" SG_ 811 Hood_TypeOption_AST 4;
BA_ "Description" SG_ 811 Hood_TypeOption_AST "If the E-Hood is applied, the signal will be send.

Frunk signal from SBCM_AST to SBCM_DRV (RHD specification)";
BA_ "Version" SG_ 811 Warn_HoodSwSta_AST "22.10.19";
BA_ "NetworkRequestHoldingTime" SG_ 811 Warn_HoodSwSta_AST 5000;
BA_ "NetworkRequest" SG_ 811 Warn_HoodSwSta_AST 0;
BA_ "UserSigValidity" SG_ 811 Warn_HoodSwSta_AST 0;
BA_ "GenSigSendType" SG_ 811 Warn_HoodSwSta_AST 4;
BA_ "Description" SG_ 811 Warn_HoodSwSta_AST "Frunk signal from SBCM_AST to SBCM_DRV (RHD specification)";
BA_ "Version" SG_ 811 FrunkWarning_AST "22.10.19";
BA_ "NetworkRequestHoldingTime" SG_ 811 FrunkWarning_AST 5000;
BA_ "NetworkRequest" SG_ 811 FrunkWarning_AST 0;
BA_ "UserSigValidity" SG_ 811 FrunkWarning_AST 0;
BA_ "GenSigSendType" SG_ 811 FrunkWarning_AST 4;
BA_ "Description" SG_ 811 FrunkWarning_AST "Frunk signal from SBCM_AST to SBCM_DRV (RHD specification)";
BA_ "Version" SG_ 811 SBCM_FrunkSta_AST "22.10.19";
BA_ "NetworkRequestHoldingTime" SG_ 811 SBCM_FrunkSta_AST 5000;
BA_ "NetworkRequest" SG_ 811 SBCM_FrunkSta_AST 0;
BA_ "UserSigValidity" SG_ 811 SBCM_FrunkSta_AST 0;
BA_ "GenSigSendType" SG_ 811 SBCM_FrunkSta_AST 4;
BA_ "Description" SG_ 811 SBCM_FrunkSta_AST "Frunk signal from SBCM_AST to SBCM_DRV (RHD specification)";
BA_ "Version" SG_ 811 IMS_OSMirPlayBackSta_RH_New "23.01.03";
BA_ "NetworkRequestHoldingTime" SG_ 811 IMS_OSMirPlayBackSta_RH_New 5000;
BA_ "NetworkRequest" SG_ 811 IMS_OSMirPlayBackSta_RH_New 0;
BA_ "UserSigValidity" SG_ 811 IMS_OSMirPlayBackSta_RH_New 0;
BA_ "GenSigSendType" SG_ 811 IMS_OSMirPlayBackSta_RH_New 4;
BA_ "Description" SG_ 811 IMS_OSMirPlayBackSta_RH_New "Applied from standard DB 2.0";
BA_ "Version" SG_ 811 Ast_DrLkRetryFail_SBCM "23.03.00";
BA_ "NetworkRequestHoldingTime" SG_ 811 Ast_DrLkRetryFail_SBCM 5000;
BA_ "NetworkRequest" SG_ 811 Ast_DrLkRetryFail_SBCM 0;
BA_ "UserSigValidity" SG_ 811 Ast_DrLkRetryFail_SBCM 0;
BA_ "TimeoutValue" SG_ 811 Ast_DrLkRetryFail_SBCM "0x0";
BA_ "GenSigSendType" SG_ 811 Ast_DrLkRetryFail_SBCM 4;
BA_ "Version" SG_ 811 DoorLock_AstLkOutSta_SBCM "23.02.09";
BA_ "NetworkRequestHoldingTime" SG_ 811 DoorLock_AstLkOutSta_SBCM 5000;
BA_ "NetworkRequest" SG_ 811 DoorLock_AstLkOutSta_SBCM 0;
BA_ "UserSigValidity" SG_ 811 DoorLock_AstLkOutSta_SBCM 0;
BA_ "GenSigSendType" SG_ 811 DoorLock_AstLkOutSta_SBCM 4;
BA_ "Description" SG_ 811 DoorLock_AstLkOutSta_SBCM "- Door Lock or Unlock Output State 

0x0 : Off (Door lock/unlock output Off state)

0x1 : On (Door lock/unlock output On state)";
BA_ "Version" SG_ 811 FrunkReleaseSwSta_SBCM_AST "23.03.01";
BA_ "NetworkRequestHoldingTime" SG_ 811 FrunkReleaseSwSta_SBCM_AST 5000;
BA_ "NetworkRequest" SG_ 811 FrunkReleaseSwSta_SBCM_AST 0;
BA_ "UserSigValidity" SG_ 811 FrunkReleaseSwSta_SBCM_AST 0;
BA_ "GenSigSendType" SG_ 811 FrunkReleaseSwSta_SBCM_AST 4;
BA_ "Description" SG_ 811 FrunkReleaseSwSta_SBCM_AST "FrunkReleaseState (SBCM_AST_FD to SBCM_DRV_FD) RHD Spec";
BA_ "Version" SG_ 811 FrunkInsideRelSwSta_SBCM_AST "23.03.01";
BA_ "NetworkRequestHoldingTime" SG_ 811 FrunkInsideRelSwSta_SBCM_AST 5000;
BA_ "NetworkRequest" SG_ 811 FrunkInsideRelSwSta_SBCM_AST 0;
BA_ "UserSigValidity" SG_ 811 FrunkInsideRelSwSta_SBCM_AST 0;
BA_ "GenSigSendType" SG_ 811 FrunkInsideRelSwSta_SBCM_AST 4;
BA_ "Description" SG_ 811 FrunkInsideRelSwSta_SBCM_AST "FrunkInsideReleaseSwState (SBCM_AST_FD to SBCM_DRV_FD) RHD Spec";
BA_ "Version" SG_ 811 FrunkEmergencySwSta_SBCM_AST "23.03.01";
BA_ "NetworkRequestHoldingTime" SG_ 811 FrunkEmergencySwSta_SBCM_AST 5000;
BA_ "NetworkRequest" SG_ 811 FrunkEmergencySwSta_SBCM_AST 0;
BA_ "UserSigValidity" SG_ 811 FrunkEmergencySwSta_SBCM_AST 0;
BA_ "GenSigSendType" SG_ 811 FrunkEmergencySwSta_SBCM_AST 4;
BA_ "Description" SG_ 811 FrunkEmergencySwSta_SBCM_AST "FrunkEmergencySwState (SBCM_AST_FD to SBCM_DRV_FD) RHD Spec";
BA_ "Version" SG_ 811 PwrDrSta_Ast "24.01.05";
BA_ "NetworkRequestHoldingTime" SG_ 811 PwrDrSta_Ast 5000;
BA_ "NetworkRequest" SG_ 811 PwrDrSta_Ast 0;
BA_ "UserSigValidity" SG_ 811 PwrDrSta_Ast 0;
BA_ "GenSigSendType" SG_ 811 PwrDrSta_Ast 4;
BA_ "Version" SG_ 811 PwrDrSta_AstSd "24.01.05";
BA_ "NetworkRequestHoldingTime" SG_ 811 PwrDrSta_AstSd 5000;
BA_ "NetworkRequest" SG_ 811 PwrDrSta_AstSd 0;
BA_ "UserSigValidity" SG_ 811 PwrDrSta_AstSd 0;
BA_ "GenSigSendType" SG_ 811 PwrDrSta_AstSd 4;
BA_ "Version" SG_ 811 DischrgDr_OpnClsState_SBCM_AST "24.07.03";
BA_ "NetworkRequestHoldingTime" SG_ 811 DischrgDr_OpnClsState_SBCM_AST 5000;
BA_ "NetworkRequest" SG_ 811 DischrgDr_OpnClsState_SBCM_AST 0;
BA_ "UserSigValidity" SG_ 811 DischrgDr_OpnClsState_SBCM_AST 0;
BA_ "GenSigSendType" SG_ 811 DischrgDr_OpnClsState_SBCM_AST 4;
BA_ "Version" SG_ 811 AST_DetectObj_warn_LH "23.10.11";
BA_ "NetworkRequestHoldingTime" SG_ 811 AST_DetectObj_warn_LH 5000;
BA_ "NetworkRequest" SG_ 811 AST_DetectObj_warn_LH 0;
BA_ "UserSigValidity" SG_ 811 AST_DetectObj_warn_LH 0;
BA_ "GenSigSendType" SG_ 811 AST_DetectObj_warn_LH 4;
BA_ "Version" SG_ 811 PwrDROpenClosingAstSdDRSta "23.10.11";
BA_ "NetworkRequestHoldingTime" SG_ 811 PwrDROpenClosingAstSdDRSta 5000;
BA_ "NetworkRequest" SG_ 811 PwrDROpenClosingAstSdDRSta 0;
BA_ "UserSigValidity" SG_ 811 PwrDROpenClosingAstSdDRSta 0;
BA_ "GenSigSendType" SG_ 811 PwrDROpenClosingAstSdDRSta 4;
BA_ "Version" SG_ 811 PwrDRBuzzerOut_AST_New "24.01.05";
BA_ "NetworkRequestHoldingTime" SG_ 811 PwrDRBuzzerOut_AST_New 5000;
BA_ "NetworkRequest" SG_ 811 PwrDRBuzzerOut_AST_New 0;
BA_ "UserSigValidity" SG_ 811 PwrDRBuzzerOut_AST_New 0;
BA_ "GenSigSendType" SG_ 811 PwrDRBuzzerOut_AST_New 4;
BA_ "Description" SG_ 811 PwrDRBuzzerOut_AST_New "JG~";
BA_ "Version" SG_ 811 SBCM_FR_DoorAngle "24.01.05";
BA_ "NetworkRequestHoldingTime" SG_ 811 SBCM_FR_DoorAngle 5000;
BA_ "NetworkRequest" SG_ 811 SBCM_FR_DoorAngle 0;
BA_ "UserSigValidity" SG_ 811 SBCM_FR_DoorAngle 0;
BA_ "GenSigStartValue" SG_ 811 SBCM_FR_DoorAngle 100;
BA_ "GenSigSendType" SG_ 811 SBCM_FR_DoorAngle 4;
BA_ "Description" SG_ 811 SBCM_FR_DoorAngle "PDSM_FR_DoorAngle";
BA_ "Version" SG_ 811 EHL_TxInfo_SBCM_AST "24.07.03";
BA_ "NetworkRequestHoldingTime" SG_ 811 EHL_TxInfo_SBCM_AST 5000;
BA_ "NetworkRequest" SG_ 811 EHL_TxInfo_SBCM_AST 0;
BA_ "UserSigValidity" SG_ 811 EHL_TxInfo_SBCM_AST 0;
BA_ "GenSigSendType" SG_ 811 EHL_TxInfo_SBCM_AST 4;
BA_ "Description" SG_ 811 EHL_TxInfo_SBCM_AST "Electronic hood latch status signal transfer for dual hood latch type";
BA_ "Version" SG_ 811 CDM_DrType_AST "24.05.01";
BA_ "NetworkRequestHoldingTime" SG_ 811 CDM_DrType_AST 5000;
BA_ "NetworkRequest" SG_ 811 CDM_DrType_AST 0;
BA_ "UserSigValidity" SG_ 811 CDM_DrType_AST 7;
BA_ "GenSigSendType" SG_ 811 CDM_DrType_AST 4;
BA_ "Version" SG_ 811 ASTDoorPushAlarm "21.07.07";
BA_ "NetworkRequestHoldingTime" SG_ 811 ASTDoorPushAlarm 5000;
BA_ "NetworkRequest" SG_ 811 ASTDoorPushAlarm 0;
BA_ "UserSigValidity" SG_ 811 ASTDoorPushAlarm 0;
BA_ "GenSigSendType" SG_ 811 ASTDoorPushAlarm 4;
BA_ "Version" SG_ 811 AST_CrashUnlockCmd "21.07.07";
BA_ "NetworkRequest" SG_ 811 AST_CrashUnlockCmd 0;
BA_ "UserSigValidity" SG_ 811 AST_CrashUnlockCmd 0;
BA_ "GenSigSendType" SG_ 811 AST_CrashUnlockCmd 4;
BA_ "Description" SG_ 811 AST_CrashUnlockCmd "Assist Crash Unlock Command";
BA_ "Version" SG_ 811 DoorLock_CtrlDrLkSwSta_SBCM "21.07.07";
BA_ "NetworkRequest" SG_ 811 DoorLock_CtrlDrLkSwSta_SBCM 0;
BA_ "UserSigValidity" SG_ 811 DoorLock_CtrlDrLkSwSta_SBCM 0;
BA_ "GenSigSendType" SG_ 811 DoorLock_CtrlDrLkSwSta_SBCM 4;
BA_ "Description" SG_ 811 DoorLock_CtrlDrLkSwSta_SBCM "Central Door Lock Assist Switch Status";
BA_ "Version" SG_ 811 DoorLock_CtrlDrUnLkSwSta_SBCM "21.07.07";
BA_ "NetworkRequest" SG_ 811 DoorLock_CtrlDrUnLkSwSta_SBCM 0;
BA_ "UserSigValidity" SG_ 811 DoorLock_CtrlDrUnLkSwSta_SBCM 0;
BA_ "GenSigSendType" SG_ 811 DoorLock_CtrlDrUnLkSwSta_SBCM 4;
BA_ "Description" SG_ 811 DoorLock_CtrlDrUnLkSwSta_SBCM "Central Door Unlock Assist Switch Status";
BA_ "Version" SG_ 811 Warn_AsstDrSwSta_SBCM "21.09.05";
BA_ "NetworkRequest" SG_ 811 Warn_AsstDrSwSta_SBCM 0;
BA_ "UserSigValidity" SG_ 811 Warn_AsstDrSwSta_SBCM 0;
BA_ "GenSigSendType" SG_ 811 Warn_AsstDrSwSta_SBCM 4;
BA_ "Description" SG_ 811 Warn_AsstDrSwSta_SBCM "Warning Assist Door Switch Status";
BA_ "Version" SG_ 811 DoorLock_AsstDrUnLkSta_SBCM "21.07.07";
BA_ "NetworkRequest" SG_ 811 DoorLock_AsstDrUnLkSta_SBCM 0;
BA_ "UserSigValidity" SG_ 811 DoorLock_AsstDrUnLkSta_SBCM 0;
BA_ "GenSigSendType" SG_ 811 DoorLock_AsstDrUnLkSta_SBCM 4;
BA_ "Description" SG_ 811 DoorLock_AsstDrUnLkSta_SBCM "Assist Door Unlock Status";
BA_ "Version" SG_ 811 AST_SEAWarn_RH "21.07.07";
BA_ "NetworkRequest" SG_ 811 AST_SEAWarn_RH 0;
BA_ "UserSigValidity" SG_ 811 AST_SEAWarn_RH 0;
BA_ "GenSigSendType" SG_ 811 AST_SEAWarn_RH 4;
BA_ "Description" SG_ 811 AST_SEAWarn_RH "Assist (FRH) SEA Warning";
BA_ "Version" SG_ 811 AST_SEAWarn_LH "21.07.07";
BA_ "NetworkRequest" SG_ 811 AST_SEAWarn_LH 0;
BA_ "UserSigValidity" SG_ 811 AST_SEAWarn_LH 0;
BA_ "GenSigSendType" SG_ 811 AST_SEAWarn_LH 4;
BA_ "Description" SG_ 811 AST_SEAWarn_LH "Assist (FLH) Door SEA Warning";
BA_ "Version" SG_ 811 AST_SEWWarn_LH "21.07.07";
BA_ "NetworkRequest" SG_ 811 AST_SEWWarn_LH 0;
BA_ "UserSigValidity" SG_ 811 AST_SEWWarn_LH 0;
BA_ "GenSigSendType" SG_ 811 AST_SEWWarn_LH 4;
BA_ "Version" SG_ 811 AST_SEWWarn_RH "21.07.07";
BA_ "NetworkRequest" SG_ 811 AST_SEWWarn_RH 0;
BA_ "UserSigValidity" SG_ 811 AST_SEWWarn_RH 0;
BA_ "GenSigSendType" SG_ 811 AST_SEWWarn_RH 4;
BA_ "Version" SG_ 811 AST_MRActivationAlarm "21.07.07";
BA_ "NetworkRequestHoldingTime" SG_ 811 AST_MRActivationAlarm 5000;
BA_ "NetworkRequest" SG_ 811 AST_MRActivationAlarm 0;
BA_ "UserSigValidity" SG_ 811 AST_MRActivationAlarm 0;
BA_ "GenSigSendType" SG_ 811 AST_MRActivationAlarm 4;
BA_ "Version" SG_ 811 AST_ReleaseWarn "21.09.05";
BA_ "NetworkRequestHoldingTime" SG_ 811 AST_ReleaseWarn 5000;
BA_ "NetworkRequest" SG_ 811 AST_ReleaseWarn 0;
BA_ "UserSigValidity" SG_ 811 AST_ReleaseWarn 0;
BA_ "GenSigSendType" SG_ 811 AST_ReleaseWarn 4;
BA_ "Version" SG_ 930 CLU_HU_Crc3Val "22.10.20";
BA_ "UserSigValidity" SG_ 930 CLU_HU_Crc3Val 3;
BA_ "GenSigStartValue" SG_ 930 CLU_HU_Crc3Val 65535;
BA_ "GenSigSendType" SG_ 930 CLU_HU_Crc3Val 4;
BA_ "Description" SG_ 930 CLU_HU_Crc3Val "The data area for CRC calculation is based on the data length (DLC) of the message DB.

The CRC shall be calculated over the entire data block (excluding the CRC bytes) including the user data, alive counter and Data ID



- CRC Polynomial (0x1021) , Ini";
BA_ "Version" SG_ 930 CLU_TermAvgSync_MM "22.07.05";
BA_ "UserSigValidity" SG_ 930 CLU_TermAvgSync_MM 3;
BA_ "GenSigSendType" SG_ 930 CLU_TermAvgSync_MM 4;
BA_ "Description" SG_ 930 CLU_TermAvgSync_MM "Information for COUNTING 2.5 minutes Sync for AVN

Circulate value 0 to 3 each 2.5 minutes";
BA_ "Version" SG_ 930 CLU_TermAvgFCL_Digit_MM "22.07.05";
BA_ "UserSigValidity" SG_ 930 CLU_TermAvgFCL_Digit_MM 3;
BA_ "GenSigSendType" SG_ 930 CLU_TermAvgFCL_Digit_MM 4;
BA_ "Description" SG_ 930 CLU_TermAvgFCL_Digit_MM "Information for 2.5 minutes interval Average Fuel Consumption Digit

- Considering CF_Clu_AvgFCL (display is changed)

- For expression of 2 digit, decimal point is on dislpay (0~99.9) 

- For expression of 3 digit, decimal point is deleted on dislpay (1";
BA_ "Version" SG_ 930 CLU_TermAvgFuelCnsmptnVal_MM "22.07.05";
BA_ "UserSigValidity" SG_ 930 CLU_TermAvgFuelCnsmptnVal_MM 3;
BA_ "GenSigSendType" SG_ 930 CLU_TermAvgFuelCnsmptnVal_MM 4;
BA_ "Description" SG_ 930 CLU_TermAvgFuelCnsmptnVal_MM "Information for 2.5 minutes interval Average Fuel Consumption



-2.5 minutes interval Average Fuel Consumption Value is displayed by bar[(km/L, L/100km: 0.0~30.0), (MPG: 0.0~45.0)]

-Consider CR_Clu_TermAvgFCI_Digit signal for decimal point

  └ 0x0 : ";
BA_ "Version" SG_ 930 CLU_OptionInfo "24.04.01";
BA_ "UserSigValidity" SG_ 930 CLU_OptionInfo 3;
BA_ "GenSigSendType" SG_ 930 CLU_OptionInfo 4;
BA_ "Description" SG_ 930 CLU_OptionInfo "Information of CLU functions

This signal is used for judging state of CLU functions(Logic,Ui.. etc)

Bit0 : (EnergyFlow) : 0 - 8 Segment Display / 1 - Linear Display

Bit1 : Theme Support (0:No, 1:Yes)

Bit2 : eSignature Result (0:Success, 1:Fail)

Bit3";
BA_ "Version" SG_ 930 CLU_DispThmSetRdy "23.07.03";
BA_ "UserSigValidity" SG_ 930 CLU_DispThmSetRdy 3;
BA_ "GenSigSendType" SG_ 930 CLU_DispThmSetRdy 4;
BA_ "Description" SG_ 930 CLU_DispThmSetRdy "0x1 (Not Ready) : CLU can't change DisplayTheme 

0x2 (Ready) : CLU can change DisplayTheme";
BA_ "Version" SG_ 930 CLU_DispThmMemSta "23.07.03";
BA_ "UserSigValidity" SG_ 930 CLU_DispThmMemSta 3;
BA_ "GenSigSendType" SG_ 930 CLU_DispThmMemSta 4;
BA_ "Description" SG_ 930 CLU_DispThmMemSta "bit0: memory 1 (0:empty / 1:saved)

bit1: memory 2 (0:empty / 1:saved)

bit2: memory 3 (0:empty / 1:saved)

bit3~6: reserved

bit7: Invalid";
BA_ "Version" SG_ 930 CLU_HU_AlvCnt3Val "22.10.20";
BA_ "UserSigValidity" SG_ 930 CLU_HU_AlvCnt3Val 3;
BA_ "GenSigSendType" SG_ 930 CLU_HU_AlvCnt3Val 4;
BA_ "Description" SG_ 930 CLU_HU_AlvCnt3Val "For the first transmission request for a data element the counter shall be initialized with 0 and shall be incremented by 1 for every subsequent send request. 

When the counter reaches the maximum value(0xFF), then it shall restart with 0 for the next s";
BA_ "Version" SG_ 930 CLU_DispThmDeleteSta "23.07.03";
BA_ "UserSigValidity" SG_ 930 CLU_DispThmDeleteSta 3;
BA_ "GenSigSendType" SG_ 930 CLU_DispThmDeleteSta 4;
BA_ "Description" SG_ 930 CLU_DispThmDeleteSta "The signal is the feedback signal of Display Theme Delete Request

※ HU_DispThmDeleteReq";
BA_ "Version" SG_ 930 CLU_DispThmCopySta "23.07.03";
BA_ "UserSigValidity" SG_ 930 CLU_DispThmCopySta 3;
BA_ "GenSigSendType" SG_ 930 CLU_DispThmCopySta 4;
BA_ "Description" SG_ 930 CLU_DispThmCopySta "The signal is the feedback signal of Display Theme Copy Request

※ HU_DispThmCopyReq";
BA_ "Version" SG_ 930 CLU_DispThmSetStaMem "23.07.03";
BA_ "UserSigValidity" SG_ 930 CLU_DispThmSetStaMem 3;
BA_ "GenSigSendType" SG_ 930 CLU_DispThmSetStaMem 4;
BA_ "Description" SG_ 930 CLU_DispThmSetStaMem "The signal indicates status of CLU theme displayed";
BA_ "Version" SG_ 930 CLU_LapTimer_LapNumber_MM "22.07.05";
BA_ "UserSigValidity" SG_ 930 CLU_LapTimer_LapNumber_MM 3;
BA_ "GenSigSendType" SG_ 930 CLU_LapTimer_LapNumber_MM 4;
BA_ "Description" SG_ 930 CLU_LapTimer_LapNumber_MM "This signal means Lap Number. Laptimer function is interoperated in Cluater and AVN. Cluster displays Lap Time in real time and AVN displays the history of Lap Time.";
BA_ "Version" SG_ 930 CLU_LapTimer_Hour_MM "22.07.05";
BA_ "UserSigValidity" SG_ 930 CLU_LapTimer_Hour_MM 3;
BA_ "GenSigSendType" SG_ 930 CLU_LapTimer_Hour_MM 4;
BA_ "Description" SG_ 930 CLU_LapTimer_Hour_MM "This signal means 'Hour' of each LapTime. Laptimer function is interoperated in Cluater and AVN. Cluster displays Lap Time in real time and AVN displays the history of Lap Time.";
BA_ "Version" SG_ 930 CLU_LapTimer_Minute_MM "22.07.05";
BA_ "UserSigValidity" SG_ 930 CLU_LapTimer_Minute_MM 3;
BA_ "GenSigSendType" SG_ 930 CLU_LapTimer_Minute_MM 4;
BA_ "Description" SG_ 930 CLU_LapTimer_Minute_MM "This signal means 'Minute' value of each LapTime. Laptimer function is interoperated in Cluater and AVN. Cluster displays Lap Time in real time and AVN displays the history of Lap Time.";
BA_ "Version" SG_ 930 CLU_LapTimer_Second_MM "22.07.05";
BA_ "UserSigValidity" SG_ 930 CLU_LapTimer_Second_MM 3;
BA_ "GenSigSendType" SG_ 930 CLU_LapTimer_Second_MM 4;
BA_ "Description" SG_ 930 CLU_LapTimer_Second_MM "This signal means 'second' value of each LapTime. Laptimer function is interoperated in Cluater and AVN. Cluster displays Lap Time in real time and AVN displays the history of Lap Time.";
BA_ "Version" SG_ 930 CLU_LapTimer_MeasuringStatus_MM "22.07.05";
BA_ "UserSigValidity" SG_ 930 CLU_LapTimer_MeasuringStatus_MM 3;
BA_ "GenSigSendType" SG_ 930 CLU_LapTimer_MeasuringStatus_MM 4;
BA_ "Description" SG_ 930 CLU_LapTimer_MeasuringStatus_MM "This signal means current measuring status of Lap Time in Cluster.";
BA_ "Version" SG_ 930 CLU_LapTimer_milisecond_MM "22.07.05";
BA_ "UserSigValidity" SG_ 930 CLU_LapTimer_milisecond_MM 3;
BA_ "GenSigSendType" SG_ 930 CLU_LapTimer_milisecond_MM 4;
BA_ "Description" SG_ 930 CLU_LapTimer_milisecond_MM "This signal means '1/100second' value of each LapTime. Laptimer function is interoperated in Cluater and AVN. Cluster displays Lap Time in real time and AVN displays the history of Lap Time.";
BA_ "Version" SG_ 930 CLU_N1SetVal_MM "22.07.05";
BA_ "UserSigValidity" SG_ 930 CLU_N1SetVal_MM 3;
BA_ "GenSigSendType" SG_ 930 CLU_N1SetVal_MM 4;
BA_ "Description" SG_ 930 CLU_N1SetVal_MM "N1 S/W set value feedback to H/U

※ 2nd general DB:CLU17/CLU_N1SetVal";
BA_ "Version" SG_ 930 CLU_N2SetVal_MM "22.07.05";
BA_ "UserSigValidity" SG_ 930 CLU_N2SetVal_MM 3;
BA_ "GenSigSendType" SG_ 930 CLU_N2SetVal_MM 4;
BA_ "Description" SG_ 930 CLU_N2SetVal_MM "N2 S/W set value feedback to H/U

※ 2nd general DB:CLU17/CLU_N2SetVal";
BA_ "Version" SG_ 930 Usm_TorqueUnitSetSta_MM "22.07.05";
BA_ "UserSigValidity" SG_ 930 Usm_TorqueUnitSetSta_MM 3;
BA_ "GenSigSendType" SG_ 930 Usm_TorqueUnitSetSta_MM 4;
BA_ "Description" SG_ 930 Usm_TorqueUnitSetSta_MM "Torque gauge unit  setting for AVN USM";
BA_ "Version" SG_ 930 Usm_TurboPressureUnitSetSta_MM "22.07.05";
BA_ "UserSigValidity" SG_ 930 Usm_TurboPressureUnitSetSta_MM 3;
BA_ "GenSigSendType" SG_ 930 Usm_TurboPressureUnitSetSta_MM 4;
BA_ "Description" SG_ 930 Usm_TurboPressureUnitSetSta_MM "Turbo boost pressre unit setting for AVN USM";
BA_ "Version" SG_ 930 USM_ShiftLightNmodeSetSta_MM "22.07.05";
BA_ "UserSigValidity" SG_ 930 USM_ShiftLightNmodeSetSta_MM 3;
BA_ "GenSigSendType" SG_ 930 USM_ShiftLightNmodeSetSta_MM 4;
BA_ "Description" SG_ 930 USM_ShiftLightNmodeSetSta_MM "It is a signal for Shiftlight AVN USM

When AVN send a signal(Event), Cluster send this feeback signal for changing setting value";
BA_ "Version" SG_ 930 USM_ShiftLightCustomSetSta_MM "22.07.05";
BA_ "UserSigValidity" SG_ 930 USM_ShiftLightCustomSetSta_MM 3;
BA_ "GenSigSendType" SG_ 930 USM_ShiftLightCustomSetSta_MM 4;
BA_ "Description" SG_ 930 USM_ShiftLightCustomSetSta_MM "It is a signal for Shiftlight AVN USM

When AVN send a signal(Event), Cluster send this feeback signal for changing setting value";
BA_ "Version" SG_ 930 USM_ShiftLightSportSetSta_MM "22.07.05";
BA_ "UserSigValidity" SG_ 930 USM_ShiftLightSportSetSta_MM 3;
BA_ "GenSigSendType" SG_ 930 USM_ShiftLightSportSetSta_MM 4;
BA_ "Description" SG_ 930 USM_ShiftLightSportSetSta_MM "It is a signal for Shiftlight AVN USM

When AVN send a signal(Event), Cluster send this feeback signal for changing setting value";
BA_ "Version" SG_ 930 USM_ShiftLightNormalSetSta_MM "22.07.05";
BA_ "UserSigValidity" SG_ 930 USM_ShiftLightNormalSetSta_MM 3;
BA_ "GenSigSendType" SG_ 930 USM_ShiftLightNormalSetSta_MM 4;
BA_ "Description" SG_ 930 USM_ShiftLightNormalSetSta_MM "It is a signal for Shiftlight AVN USM

When AVN send a signal(Event), Cluster send this feeback signal for changing setting value";
BA_ "Version" SG_ 930 USM_ShiftLightEcoSetSta_MM "22.07.05";
BA_ "UserSigValidity" SG_ 930 USM_ShiftLightEcoSetSta_MM 3;
BA_ "GenSigSendType" SG_ 930 USM_ShiftLightEcoSetSta_MM 4;
BA_ "Description" SG_ 930 USM_ShiftLightEcoSetSta_MM "It is a signal for Shiftlight AVN USM

When AVN send a signal(Event), Cluster send this feeback signal for changing setting value";
BA_ "Version" SG_ 930 USM_ShiftLightBeepSndSetSta_MM "22.07.05";
BA_ "UserSigValidity" SG_ 930 USM_ShiftLightBeepSndSetSta_MM 3;
BA_ "GenSigSendType" SG_ 930 USM_ShiftLightBeepSndSetSta_MM 4;
BA_ "Description" SG_ 930 USM_ShiftLightBeepSndSetSta_MM "It is a signal for Shiftlight AVN USM

When AVN send a signal(Event), Cluster send this feeback signal for changing setting value";
BA_ "Version" SG_ 930 USM_ShiftLightCustom2SetSta_MM "22.07.05";
BA_ "UserSigValidity" SG_ 930 USM_ShiftLightCustom2SetSta_MM 3;
BA_ "GenSigSendType" SG_ 930 USM_ShiftLightCustom2SetSta_MM 4;
BA_ "Description" SG_ 930 USM_ShiftLightCustom2SetSta_MM "It is a signal for Shiftlight AVN USM

When AVN send a signal(Event), Cluster send this feeback signal for changing setting value";
BA_ "Version" SG_ 930 USM_LapTimerAutoMsreSetSta_MM "22.07.05";
BA_ "UserSigValidity" SG_ 930 USM_LapTimerAutoMsreSetSta_MM 3;
BA_ "GenSigSendType" SG_ 930 USM_LapTimerAutoMsreSetSta_MM 4;
BA_ "Description" SG_ 930 USM_LapTimerAutoMsreSetSta_MM "Setting value for auto-measurement of Laptimer

This is signal for AVN USM 

MM-CAN(LS) :CLU_HU_PE_05/ LapTimer_AutoMeasure_Set_FB";
BA_ "Version" SG_ 930 USM_LapTimerTimeGapSetSta_MM "22.07.05";
BA_ "UserSigValidity" SG_ 930 USM_LapTimerTimeGapSetSta_MM 3;
BA_ "GenSigSendType" SG_ 930 USM_LapTimerTimeGapSetSta_MM 4;
BA_ "Description" SG_ 930 USM_LapTimerTimeGapSetSta_MM "setting value for laptimer time gap displaying

It is signal for AVN USM

MM-CAN(LS) : CLU_HU_PE_05/LapTimer_TimeGap_Setting_FB";
BA_ "Version" SG_ 518 GNSS_Crc7Val "22.10.20";
BA_ "UserSigValidity" SG_ 518 GNSS_Crc7Val 3;
BA_ "GenSigStartValue" SG_ 518 GNSS_Crc7Val 65535;
BA_ "Description" SG_ 518 GNSS_Crc7Val "The data area for CRC calculation is based on the data length (DLC) of the message DB.

The CRC shall be calculated over the entire data block (excluding the CRC bytes) including the user data, alive counter and Data ID



- CRC Polynomial (0x1021) , Ini";
BA_ "Version" SG_ 518 HU_DR_Latitude "22.07.05";
BA_ "UserSigValidity" SG_ 518 HU_DR_Latitude 1;
BA_ "Version" SG_ 518 GNSS_AlvCnt7Val "22.10.20";
BA_ "UserSigValidity" SG_ 518 GNSS_AlvCnt7Val 3;
BA_ "Description" SG_ 518 GNSS_AlvCnt7Val "For the first transmission request for a data element the counter shall be initialized with 0 and shall be incremented by 1 for every subsequent send request. 

When the counter reaches the maximum value(0xFF), then it shall restart with 0 for the next s";
BA_ "Version" SG_ 518 HU_DR_Longitude "22.07.05";
BA_ "UserSigValidity" SG_ 518 HU_DR_Longitude 1;
BA_ "Version" SG_ 518 HU_DR_Heading "22.07.05";
BA_ "UserSigValidity" SG_ 518 HU_DR_Heading 1;
BA_ "Version" SG_ 518 HU_DR_Speed "22.07.05";
BA_ "UserSigValidity" SG_ 518 HU_DR_Speed 1;
BA_ "Description" SG_ 518 HU_DR_Speed "negative if the direction is backward.";
BA_ "Version" SG_ 518 HU_DR_TimeOfWeek "23.07.03";
BA_ "UserSigValidity" SG_ 518 HU_DR_TimeOfWeek 1;
BA_ "Description" SG_ 518 HU_DR_TimeOfWeek "0x0~0x23FD41BF: PHY VALUE";
BA_ "Version" SG_ 518 HU_DR_Position_Status "22.07.05";
BA_ "UserSigValidity" SG_ 518 HU_DR_Position_Status 1;
BA_ "Description" SG_ 518 HU_DR_Position_Status "0x1:Valid";
BA_ "Version" SG_ 518 HU_DR_Altitude_Status "22.07.05";
BA_ "UserSigValidity" SG_ 518 HU_DR_Altitude_Status 1;
BA_ "Description" SG_ 518 HU_DR_Altitude_Status "0x1=Valid";
BA_ "Version" SG_ 518 HU_DR_Heading_Status "22.07.05";
BA_ "UserSigValidity" SG_ 518 HU_DR_Heading_Status 1;
BA_ "Description" SG_ 518 HU_DR_Heading_Status "0x1=Valid";
BA_ "Version" SG_ 518 HU_DR_Speed_Status "22.07.05";
BA_ "UserSigValidity" SG_ 518 HU_DR_Speed_Status 1;
BA_ "Description" SG_ 518 HU_DR_Speed_Status "0x1=Valid";
BA_ "Version" SG_ 518 HU_DR_DirectionSwitch_Sta "22.07.05";
BA_ "UserSigValidity" SG_ 518 HU_DR_DirectionSwitch_Sta 1;
BA_ "Description" SG_ 518 HU_DR_DirectionSwitch_Sta "0x1=valid";
BA_ "Version" SG_ 518 HU_DR_Direction "22.07.05";
BA_ "UserSigValidity" SG_ 518 HU_DR_Direction 1;
BA_ "Description" SG_ 518 HU_DR_Direction "0x1=Backward";
BA_ "Version" SG_ 518 HU_DR_GyroCalib_Sta "22.07.05";
BA_ "UserSigValidity" SG_ 518 HU_DR_GyroCalib_Sta 1;
BA_ "Description" SG_ 518 HU_DR_GyroCalib_Sta "0x1=Calibrated";
BA_ "Version" SG_ 518 HU_DR_TachoCalib_Sta "22.07.05";
BA_ "UserSigValidity" SG_ 518 HU_DR_TachoCalib_Sta 1;
BA_ "Description" SG_ 518 HU_DR_TachoCalib_Sta "0x1=Calibrated";
BA_ "Version" SG_ 518 HU_DR_Solution_Sta "22.07.05";
BA_ "UserSigValidity" SG_ 518 HU_DR_Solution_Sta 1;
BA_ "Description" SG_ 518 HU_DR_Solution_Sta "0x1 : Dr is fully calibrated and DR position is valid";
BA_ "Version" SG_ 518 HU_DR_GNSS_Fix_Age "22.07.05";
BA_ "UserSigValidity" SG_ 518 HU_DR_GNSS_Fix_Age 1;
BA_ "Description" SG_ 518 HU_DR_GNSS_Fix_Age "0-254 = Time since last GNSS fix

255= No GNSS fix yet";
BA_ "Version" SG_ 518 HU_DR_Altitude "22.07.05";
BA_ "UserSigValidity" SG_ 518 HU_DR_Altitude 1;
BA_ "Description" SG_ 518 HU_DR_Altitude "MSL";
BA_ "Version" SG_ 309 BAT_Crc1Val "21.09.03";
BA_ "RoutingFactor" SG_ 309 BAT_Crc1Val 5;
BA_ "UserSigValidity" SG_ 309 BAT_Crc1Val 7;
BA_ "GenSigStartValue" SG_ 309 BAT_Crc1Val 65535;
BA_ "Description" SG_ 309 BAT_Crc1Val "The data area for CRC calculation is based on the data length (DLC) of the message DB.

The CRC shall be calculated over the entire data block (excluding the CRC bytes) including the user data, alive counter and Data ID



- CRC Polynomial (0x1021) , Ini";
BA_ "Version" SG_ 309 BAT_AlvCnt1Val "21.09.03";
BA_ "RoutingFactor" SG_ 309 BAT_AlvCnt1Val 5;
BA_ "UserSigValidity" SG_ 309 BAT_AlvCnt1Val 7;
BA_ "Description" SG_ 309 BAT_AlvCnt1Val "For the first transmission request for a data element the counter shall be initialized with 0 and shall be incremented by 1 for every subsequent send request. 

When the counter reaches the maximum value(0xFF), then it shall restart with 0 for the next s";
BA_ "Version" SG_ 309 BAT_CurrVal "17.11.00";
BA_ "RoutingFactor" SG_ 309 BAT_CurrVal 5;
BA_ "UserSigValidity" SG_ 309 BAT_CurrVal 7;
BA_ "GenSigStartValue" SG_ 309 BAT_CurrVal 65535;
BA_ "Description" SG_ 309 BAT_CurrVal "[For 12V Lithium Battery vehicle model]

This is Battery current as measured by battery sensor.

This value is  

   - IRANGE : 1 (medium current)

   - Resolution : 10mA";
BA_ "Version" SG_ 309 BAT_SocVal "19.01.00";
BA_ "RoutingFactor" SG_ 309 BAT_SocVal 5;
BA_ "UserSigValidity" SG_ 309 BAT_SocVal 7;
BA_ "Description" SG_ 309 BAT_SocVal "[For 12V Lithium Battery vehicle model]

This signal is battery State of Charge as calculated by battery sensor.";
BA_ "Version" SG_ 309 BAT_VoltVal "17.11.00";
BA_ "RoutingFactor" SG_ 309 BAT_VoltVal 5;
BA_ "UserSigValidity" SG_ 309 BAT_VoltVal 7;
BA_ "GenSigStartValue" SG_ 309 BAT_VoltVal 16383;
BA_ "Description" SG_ 309 BAT_VoltVal "[For 12V Lithium Battery vehicle model]

This is the actual battery voltage as measured on the battery pole by battery sensor.

The Resolution is 1mV.";
BA_ "Version" SG_ 309 BAT_AuxBattOpt "21.10.05";
BA_ "RoutingFactor" SG_ 309 BAT_AuxBattOpt 5;
BA_ "UserSigValidity" SG_ 309 BAT_AuxBattOpt 7;
BA_ "Description" SG_ 309 BAT_AuxBattOpt "12V Battery Option Value(LFP 12V Battery)";
BA_ "Version" SG_ 309 BAT_TempVal "20.03.05";
BA_ "RoutingFactor" SG_ 309 BAT_TempVal 5;
BA_ "UserSigValidity" SG_ 309 BAT_TempVal 7;
BA_ "GenSigStartValue" SG_ 309 BAT_TempVal 511;
BA_ "Description" SG_ 309 BAT_TempVal "This is actual battery electrolyte temperature value by battery sensor.

The value is calculated by a Battery Temperature Model, depending on measured temperature of the battery pole.

The resolution is 0.5℃.";
BA_ "Version" SG_ 309 BAT_SocErrSta "19.01.00";
BA_ "RoutingFactor" SG_ 309 BAT_SocErrSta 5;
BA_ "UserSigValidity" SG_ 309 BAT_SocErrSta 7;
BA_ "GenSigStartValue" SG_ 309 BAT_SocErrSta 1;
BA_ "Description" SG_ 309 BAT_SocErrSta "[For 12V Lithium Battery vehicle model]

This bit is flags for indication whether battery SOC detection value is plausible or not by battery sensor.

If it is set to value 0, then it means battery SOC is normal state.

If it is set to value 1, then it me";
BA_ "Version" SG_ 309 BAT_SohVal "17.11.00";
BA_ "RoutingFactor" SG_ 309 BAT_SohVal 5;
BA_ "UserSigValidity" SG_ 309 BAT_SohVal 7;
BA_ "GenSigStartValue" SG_ 309 BAT_SohVal 127;
BA_ "Description" SG_ 309 BAT_SohVal "[For 12V Lithium Battery vehicle model]

This signal is battery State of Health(SOH) as calculated by battery sensor.

This value shows reduction rate of nominal capacity.

This value can be used for diagnosis information of application system.";
BA_ "Version" SG_ 309 BAT_SnsrInvldSta "17.11.00";
BA_ "RoutingFactor" SG_ 309 BAT_SnsrInvldSta 5;
BA_ "UserSigValidity" SG_ 309 BAT_SnsrInvldSta 7;
BA_ "GenSigStartValue" SG_ 309 BAT_SnsrInvldSta 1;
BA_ "Description" SG_ 309 BAT_SnsrInvldSta "[For 12V Lithium Battery vehicle model]

This bit is Battery Sensor Invalid flag and setting condition is depending on Battery Sensor self diagnosis information.

 BS Invalid = 0 : BS is Valid Condition

 BS Invalid = 1 : BS is Invalid Condition";
BA_ "Version" SG_ 309 BAT_SofVal "17.11.00";
BA_ "RoutingFactor" SG_ 309 BAT_SofVal 5;
BA_ "UserSigValidity" SG_ 309 BAT_SofVal 7;
BA_ "GenSigStartValue" SG_ 309 BAT_SofVal 127;
BA_ "Description" SG_ 309 BAT_SofVal "[For 12V Lithium Battery vehicle model]

This signal is battery State of Function(SOF) as calculated by battery sensor.

This value shows information about the battery ability to crank the engine (both of warm & cold cranking).

This value is prediction ";
BA_ "Version" SG_ 309 BAT_RspErrSta "17.11.00";
BA_ "RoutingFactor" SG_ 309 BAT_RspErrSta 5;
BA_ "UserSigValidity" SG_ 309 BAT_RspErrSta 7;
BA_ "GenSigStartValue" SG_ 309 BAT_RspErrSta 1;
BA_ "Description" SG_ 309 BAT_RspErrSta "[For 12V Lithium Battery vehicle model]

Battery Sensor shall send one status bit signal, Response_Error. Response_Error shall be set whenever a frame received by the node or a frame transmitted by the node contains an error in the response field.

Respo";
BA_ "Version" SG_ 309 BAT_CapacityVal "21.07.06";
BA_ "RoutingFactor" SG_ 309 BAT_CapacityVal 5;
BA_ "UserSigValidity" SG_ 309 BAT_CapacityVal 7;
BA_ "Description" SG_ 309 BAT_CapacityVal "12V Battery Capacity Value";
BA_ "Version" SG_ 920 CTM_FD_Crc2Val "22.10.21";
BA_ "RoutingFactor" SG_ 920 CTM_FD_Crc2Val 0;
BA_ "UserSigValidity" SG_ 920 CTM_FD_Crc2Val 3;
BA_ "GenSigStartValue" SG_ 920 CTM_FD_Crc2Val 65535;
BA_ "GenSigSendType" SG_ 920 CTM_FD_Crc2Val 4;
BA_ "Description" SG_ 920 CTM_FD_Crc2Val "The data area for CRC calculation is based on the data length (DLC) of the message DB.

The CRC shall be calculated over the entire data block (excluding the CRC bytes) including the user data, alive counter and Data ID



- CRC Polynomial (0x1021) , Ini";
BA_ "Version" SG_ 920 CTM_FD_AlvCnt2Val "22.10.21";
BA_ "RoutingFactor" SG_ 920 CTM_FD_AlvCnt2Val 0;
BA_ "UserSigValidity" SG_ 920 CTM_FD_AlvCnt2Val 3;
BA_ "GenSigSendType" SG_ 920 CTM_FD_AlvCnt2Val 4;
BA_ "Description" SG_ 920 CTM_FD_AlvCnt2Val "For the first transmission request for a data element the counter shall be initialized with 0 and shall be incremented by 1 for every subsequent send request. 

When the counter reaches the maximum value(0xFF), then it shall restart with 0 for the next s";
BA_ "Version" SG_ 920 ITBC_Brk_FaultWarnSta "24.07.06";
BA_ "RoutingFactor" SG_ 920 ITBC_Brk_FaultWarnSta 0;
BA_ "UserSigValidity" SG_ 920 ITBC_Brk_FaultWarnSta 3;
BA_ "GenSigSendType" SG_ 920 ITBC_Brk_FaultWarnSta 4;
BA_ "Description" SG_ 920 ITBC_Brk_FaultWarnSta "Request for cluster to provide audible warning & pop up on Trailer Brake out Fail situation(conditions TBD eg fault).

Wiring Fault : Brake malfunction due to trailer brake output Wiring abnormality

Module Fault : Brake malfunction due to ITBC controlle";
BA_ "Version" SG_ 920 USM_TrailerTypSta "24.02.00";
BA_ "RoutingFactor" SG_ 920 USM_TrailerTypSta 0;
BA_ "UserSigValidity" SG_ 920 USM_TrailerTypSta 3;
BA_ "GenSigSendType" SG_ 920 USM_TrailerTypSta 4;
BA_ "Description" SG_ 920 USM_TrailerTypSta "Trailer type status";
BA_ "Version" SG_ 920 ITBC_TrailerDisplayAppliedSta "24.10.03";
BA_ "RoutingFactor" SG_ 920 ITBC_TrailerDisplayAppliedSta 0;
BA_ "UserSigValidity" SG_ 920 ITBC_TrailerDisplayAppliedSta 3;
BA_ "GenSigSendType" SG_ 920 ITBC_TrailerDisplayAppliedSta 4;
BA_ "Description" SG_ 920 ITBC_TrailerDisplayAppliedSta "ITBC_TrailerDisplayAppliedSta == 0x1 Determines whether to apply ITBC content based on input.

==0x2 Determines whether to apply TCM content based on input.

- Display related information only when the signal is valid (TBC page and pop-up display)";
BA_ "Version" SG_ 920 ITBC_Brk_FnctWarnSta "24.07.06";
BA_ "RoutingFactor" SG_ 920 ITBC_Brk_FnctWarnSta 0;
BA_ "UserSigValidity" SG_ 920 ITBC_Brk_FnctWarnSta 3;
BA_ "GenSigSendType" SG_ 920 ITBC_Brk_FnctWarnSta 4;
BA_ "Description" SG_ 920 ITBC_Brk_FnctWarnSta "Request for cluster to provide audible warning & pop up on Trailer Brake out Fail situation (conditions TBD eg fault)";
BA_ "Version" SG_ 920 ITBC_LampWarnSta "24.07.06";
BA_ "RoutingFactor" SG_ 920 ITBC_LampWarnSta 0;
BA_ "UserSigValidity" SG_ 920 ITBC_LampWarnSta 3;
BA_ "GenSigSendType" SG_ 920 ITBC_LampWarnSta 4;
BA_ "Description" SG_ 920 ITBC_LampWarnSta "Request for cluster to provide audible warning & pop up on Trailer Lamp Fail situation (conditions TBD eg fault).";
BA_ "Version" SG_ 920 ITBC_Brk_DisconnWarnSta "24.07.06";
BA_ "RoutingFactor" SG_ 920 ITBC_Brk_DisconnWarnSta 0;
BA_ "UserSigValidity" SG_ 920 ITBC_Brk_DisconnWarnSta 3;
BA_ "GenSigSendType" SG_ 920 ITBC_Brk_DisconnWarnSta 4;
BA_ "Description" SG_ 920 ITBC_Brk_DisconnWarnSta "Occurs when the Trailer is not connected and the ITBC switch is operated";
BA_ "Version" SG_ 920 ITBC_TrailerBrkOut "24.07.06";
BA_ "RoutingFactor" SG_ 920 ITBC_TrailerBrkOut 0;
BA_ "UserSigValidity" SG_ 920 ITBC_TrailerBrkOut 3;
BA_ "GenSigSendType" SG_ 920 ITBC_TrailerBrkOut 4;
BA_ "Description" SG_ 920 ITBC_TrailerBrkOut "Trailer Brake Output sent to cluster. PWM duty cycle 0 - 100%.";
BA_ "Version" SG_ 920 ITBC_TrailerBrkGainVal "24.02.00";
BA_ "RoutingFactor" SG_ 920 ITBC_TrailerBrkGainVal 0;
BA_ "UserSigValidity" SG_ 920 ITBC_TrailerBrkGainVal 3;
BA_ "GenSigSendType" SG_ 920 ITBC_TrailerBrkGainVal 4;
BA_ "Description" SG_ 920 ITBC_TrailerBrkGainVal "Gain setting 0 - 10 in steps of 0.5 on cluster.";
BA_ "Version" SG_ 920 ITBC_SysWarn "24.04.06";
BA_ "RoutingFactor" SG_ 920 ITBC_SysWarn 0;
BA_ "UserSigValidity" SG_ 920 ITBC_SysWarn 3;
BA_ "GenSigSendType" SG_ 920 ITBC_SysWarn 4;
BA_ "Description" SG_ 920 ITBC_SysWarn "Request for cluster to provide audible warning & pop up (conditions TBD eg fault).";
BA_ "Version" SG_ 920 ITBC_ResetOpSta "24.05.02";
BA_ "RoutingFactor" SG_ 920 ITBC_ResetOpSta 0;
BA_ "UserSigValidity" SG_ 920 ITBC_ResetOpSta 0;
BA_ "GenSigSendType" SG_ 920 ITBC_ResetOpSta 4;
BA_ "Description" SG_ 920 ITBC_ResetOpSta "This signal indicates whether the reset operation has been completed or not";
BA_ "Version" SG_ 920 ITBC_BrkWarn "24.04.06";
BA_ "RoutingFactor" SG_ 920 ITBC_BrkWarn 0;
BA_ "UserSigValidity" SG_ 920 ITBC_BrkWarn 3;
BA_ "GenSigSendType" SG_ 920 ITBC_BrkWarn 4;
BA_ "Description" SG_ 920 ITBC_BrkWarn "Request for cluster to provide audible warning & pop up on Trailer Brake out Fail situation (conditions TBD eg fault).";
BA_ "Version" SG_ 920 ITBC_TrnSigLmpWarn "24.08.00";
BA_ "RoutingFactor" SG_ 920 ITBC_TrnSigLmpWarn 0;
BA_ "UserSigValidity" SG_ 920 ITBC_TrnSigLmpWarn 3;
BA_ "GenSigSendType" SG_ 920 ITBC_TrnSigLmpWarn 4;
BA_ "Description" SG_ 920 ITBC_TrnSigLmpWarn "Request for cluster to provide audible warning & pop up about Trailer Trun Signal Error (conditions TBD eg fault).";
BA_ "Version" SG_ 920 ITBC_StpLmpWarn "24.04.06";
BA_ "RoutingFactor" SG_ 920 ITBC_StpLmpWarn 0;
BA_ "UserSigValidity" SG_ 920 ITBC_StpLmpWarn 3;
BA_ "GenSigSendType" SG_ 920 ITBC_StpLmpWarn 4;
BA_ "Description" SG_ 920 ITBC_StpLmpWarn "Request for cluster to provide audible warning & pop up about Trailer Stop Lamp ERROR(conditions TBD eg fault).";
BA_ "Version" SG_ 920 CTM_TrailerAct "24.04.07";
BA_ "RoutingFactor" SG_ 920 CTM_TrailerAct 0;
BA_ "UserSigValidity" SG_ 920 CTM_TrailerAct 3;
BA_ "GenSigSendType" SG_ 920 CTM_TrailerAct 4;
BA_ "Description" SG_ 920 CTM_TrailerAct "This signal is used for control the Trailer Act function.";
BA_ "Version" SG_ 920 CTM_RearfogAct "18.10.07";
BA_ "RoutingFactor" SG_ 920 CTM_RearfogAct 0;
BA_ "NetworkRequest" SG_ 920 CTM_RearfogAct 0;
BA_ "UserSigValidity" SG_ 920 CTM_RearfogAct 3;
BA_ "GenSigSendType" SG_ 920 CTM_RearfogAct 4;
BA_ "Description" SG_ 920 CTM_RearfogAct "This signal is used for display the rear fog lamp mounted on the trailer.";
BA_ "Version" SG_ 920 CTM_StpLmpOpnSta "18.10.07";
BA_ "RoutingFactor" SG_ 920 CTM_StpLmpOpnSta 0;
BA_ "NetworkRequest" SG_ 920 CTM_StpLmpOpnSta 0;
BA_ "UserSigValidity" SG_ 920 CTM_StpLmpOpnSta 3;
BA_ "GenSigSendType" SG_ 920 CTM_StpLmpOpnSta 4;
BA_ "Description" SG_ 920 CTM_StpLmpOpnSta "Trailer Stop Lamp OpenStatus";
BA_ "Version" SG_ 920 CTM_TrnSigLmpLftOpnSta "18.10.07";
BA_ "RoutingFactor" SG_ 920 CTM_TrnSigLmpLftOpnSta 0;
BA_ "NetworkRequest" SG_ 920 CTM_TrnSigLmpLftOpnSta 0;
BA_ "UserSigValidity" SG_ 920 CTM_TrnSigLmpLftOpnSta 3;
BA_ "GenSigSendType" SG_ 920 CTM_TrnSigLmpLftOpnSta 4;
BA_ "Description" SG_ 920 CTM_TrnSigLmpLftOpnSta "Trailer T/SIG Lamp Left OpenStatus";
BA_ "Version" SG_ 920 CTM_TrnSigLmpRtOpnSta "18.10.07";
BA_ "RoutingFactor" SG_ 920 CTM_TrnSigLmpRtOpnSta 0;
BA_ "NetworkRequest" SG_ 920 CTM_TrnSigLmpRtOpnSta 0;
BA_ "UserSigValidity" SG_ 920 CTM_TrnSigLmpRtOpnSta 3;
BA_ "GenSigSendType" SG_ 920 CTM_TrnSigLmpRtOpnSta 4;
BA_ "Description" SG_ 920 CTM_TrnSigLmpRtOpnSta "Trailer T/SIG Lamp Right OpenStatus";
BA_ "Version" SG_ 920 CTM_ExtTailLmpLftOpnSta "18.10.07";
BA_ "RoutingFactor" SG_ 920 CTM_ExtTailLmpLftOpnSta 0;
BA_ "NetworkRequest" SG_ 920 CTM_ExtTailLmpLftOpnSta 0;
BA_ "UserSigValidity" SG_ 920 CTM_ExtTailLmpLftOpnSta 3;
BA_ "GenSigSendType" SG_ 920 CTM_ExtTailLmpLftOpnSta 4;
BA_ "Description" SG_ 920 CTM_ExtTailLmpLftOpnSta "Trailer Exterior Tail Lamp Left OpenStatus";
BA_ "Version" SG_ 920 CTM_ExtTailLmpRtOpnSta "18.10.07";
BA_ "RoutingFactor" SG_ 920 CTM_ExtTailLmpRtOpnSta 0;
BA_ "NetworkRequest" SG_ 920 CTM_ExtTailLmpRtOpnSta 0;
BA_ "UserSigValidity" SG_ 920 CTM_ExtTailLmpRtOpnSta 3;
BA_ "GenSigSendType" SG_ 920 CTM_ExtTailLmpRtOpnSta 4;
BA_ "Description" SG_ 920 CTM_ExtTailLmpRtOpnSta "Trailer Exterior Tail Lamp Right OpenStatus";
BA_ "Version" SG_ 920 CTM_Exra_EbrakSta "21.06.10";
BA_ "RoutingFactor" SG_ 920 CTM_Exra_EbrakSta 0;
BA_ "UserSigValidity" SG_ 920 CTM_Exra_EbrakSta 0;
BA_ "GenSigSendType" SG_ 920 CTM_Exra_EbrakSta 4;
BA_ "Description" SG_ 920 CTM_Exra_EbrakSta "Trailer Ebrake Controller ActiveStatus";
BA_ "Version" SG_ 920 CTM_TrlAngl_200ms "22.07.06";
BA_ "RoutingFactor" SG_ 920 CTM_TrlAngl_200ms 0;
BA_ "UserSigValidity" SG_ 920 CTM_TrlAngl_200ms 3;
BA_ "GenSigSendType" SG_ 920 CTM_TrlAngl_200ms 4;
BA_ "Description" SG_ 920 CTM_TrlAngl_200ms "This signal is used to provide the Trailer Angle(Kink Angle) between vehicle and trailer(200ms).";
BA_ "Version" SG_ 160 WHL_Crc1Val "21.09.03";
BA_ "RoutingFactor" SG_ 160 WHL_Crc1Val 5;
BA_ "UserSigValidity" SG_ 160 WHL_Crc1Val 3;
BA_ "GenSigStartValue" SG_ 160 WHL_Crc1Val 65535;
BA_ "Description" SG_ 160 WHL_Crc1Val "The data area for CRC calculation is based on the data length (DLC) of the message DB.

The CRC shall be calculated over the entire data block (excluding the CRC bytes) including the user data, alive counter and Data ID



- CRC Polynomial (0x1021) , Ini";
BA_ "Version" SG_ 160 WHL_SpdRRVal "17.12.00";
BA_ "RoutingFactor" SG_ 160 WHL_SpdRRVal 5;
BA_ "UserSigValidity" SG_ 160 WHL_SpdRRVal 3;
BA_ "Description" SG_ 160 WHL_SpdRRVal "This signal provides the wheel velocity of each wheel and have 14 bits length and a resolution of 0.03125 km^h.(This resolution is higher than that of signal in TCS5).

In case of failure of one wheel speed sensor, the value 3FFFH is used as error identi";
BA_ "Version" SG_ 160 WHL_SpdCalParmtr "19.05.02";
BA_ "RoutingFactor" SG_ 160 WHL_SpdCalParmtr 5;
BA_ "UserSigValidity" SG_ 160 WHL_SpdCalParmtr 3;
BA_ "Description" SG_ 160 WHL_SpdCalParmtr "이 신호는 ABS/ESC 내부에서 휠 펄스 값을 휠 스피드로 변환하는데 사용하는 ESC 내부 파라미터를 의미함.

본 신호는 실제 타이어 동반경과 다를 수 있으며, ABS/ESC의 제어를 위한 차속 추정을 위해 개발 과정 중에 임의로 변경이 가능한 Calibration Value 임.

신호 사�";
BA_ "Version" SG_ 160 WHL_AlvCnt1Val "21.09.03";
BA_ "RoutingFactor" SG_ 160 WHL_AlvCnt1Val 5;
BA_ "UserSigValidity" SG_ 160 WHL_AlvCnt1Val 3;
BA_ "Description" SG_ 160 WHL_AlvCnt1Val "For the first transmission request for a data element the counter shall be initialized with 0 and shall be incremented by 1 for every subsequent send request. 

When the counter reaches the maximum value(0xFF), then it shall restart with 0 for the next s";
BA_ "Version" SG_ 160 WHL_PlsFLVal "17.12.00";
BA_ "RoutingFactor" SG_ 160 WHL_PlsFLVal 5;
BA_ "UserSigValidity" SG_ 160 WHL_PlsFLVal 3;
BA_ "Description" SG_ 160 WHL_PlsFLVal "This signal indicates accumulated pulse counter of ABS^ESC wheel speed sensor (FL^FR^RL^RR)

Receiver unit uses this signal for calculation of vehicle movement distance.

Requested resolution of this signal is 0.5 pulses and refer to below (wheel sensor ";
BA_ "Version" SG_ 160 WHL_PlsFRVal "17.12.00";
BA_ "RoutingFactor" SG_ 160 WHL_PlsFRVal 5;
BA_ "UserSigValidity" SG_ 160 WHL_PlsFRVal 3;
BA_ "Description" SG_ 160 WHL_PlsFRVal "This signal indicates accumulated pulse counter of ABS^ESC wheel speed sensor (FL^FR^RL^RR)

Receiver unit uses this signal for calculation of vehicle movement distance.

Requested resolution of this signal is 0.5 pulses and refer to below (wheel sensor ";
BA_ "Version" SG_ 160 WHL_PlsRLVal "17.12.00";
BA_ "RoutingFactor" SG_ 160 WHL_PlsRLVal 5;
BA_ "UserSigValidity" SG_ 160 WHL_PlsRLVal 3;
BA_ "Description" SG_ 160 WHL_PlsRLVal "This signal indicates accumulated pulse counter of ABS^ESC wheel speed sensor (FL^FR^RL^RR)

Receiver unit uses this signal for calculation of vehicle movement distance.

Requested resolution of this signal is 0.5 pulses and refer to below (wheel sensor ";
BA_ "Version" SG_ 160 WHL_PlsRRVal "17.12.00";
BA_ "RoutingFactor" SG_ 160 WHL_PlsRRVal 5;
BA_ "UserSigValidity" SG_ 160 WHL_PlsRRVal 3;
BA_ "Description" SG_ 160 WHL_PlsRRVal "This signal indicates accumulated pulse counter of ABS^ESC wheel speed sensor (FL^FR^RL^RR)

Receiver unit uses this signal for calculation of vehicle movement distance.

Requested resolution of this signal is 0.5 pulses and refer to below (wheel sensor ";
BA_ "Version" SG_ 160 WHL_DirFLVal "17.12.00";
BA_ "RoutingFactor" SG_ 160 WHL_DirFLVal 5;
BA_ "UserSigValidity" SG_ 160 WHL_DirFLVal 3;
BA_ "Description" SG_ 160 WHL_DirFLVal "This signal is used to check the moving direction of WHL_PUL_FL signal.";
BA_ "Version" SG_ 160 WHL_DirFRVal "17.12.00";
BA_ "RoutingFactor" SG_ 160 WHL_DirFRVal 5;
BA_ "UserSigValidity" SG_ 160 WHL_DirFRVal 3;
BA_ "Description" SG_ 160 WHL_DirFRVal "This signal is used to check the moving direction of WHL_PUL_FR signal.";
BA_ "Version" SG_ 160 WHL_DirRLVal "17.12.00";
BA_ "RoutingFactor" SG_ 160 WHL_DirRLVal 5;
BA_ "UserSigValidity" SG_ 160 WHL_DirRLVal 3;
BA_ "Description" SG_ 160 WHL_DirRLVal "This signal is used to check the moving direction of WHL_PUL_RL signal.";
BA_ "Version" SG_ 160 WHL_DirRRVal "17.12.00";
BA_ "RoutingFactor" SG_ 160 WHL_DirRRVal 5;
BA_ "UserSigValidity" SG_ 160 WHL_DirRRVal 3;
BA_ "Description" SG_ 160 WHL_DirRRVal "This signal is used to check the moving direction of WHL_PUL_RR signal.";
BA_ "Version" SG_ 160 WHL_SpdFLVal "17.12.00";
BA_ "RoutingFactor" SG_ 160 WHL_SpdFLVal 5;
BA_ "UserSigValidity" SG_ 160 WHL_SpdFLVal 3;
BA_ "Description" SG_ 160 WHL_SpdFLVal "This signal provides the wheel velocity of each wheel and have 14 bits length and a resolution of 0.03125 km^h.(This resolution is higher than that of signal in TCS5).

In case of failure of one wheel speed sensor, the value 3FFFH is used as error identi";
BA_ "Version" SG_ 160 WHL_SpdFRVal "17.12.00";
BA_ "RoutingFactor" SG_ 160 WHL_SpdFRVal 5;
BA_ "UserSigValidity" SG_ 160 WHL_SpdFRVal 3;
BA_ "Description" SG_ 160 WHL_SpdFRVal "This signal provides the wheel velocity of each wheel and have 14 bits length and a resolution of 0.03125 km^h.(This resolution is higher than that of signal in TCS5).

In case of failure of one wheel speed sensor, the value 3FFFH is used as error identi";
BA_ "Version" SG_ 160 WHL_SpdRLVal "17.12.00";
BA_ "RoutingFactor" SG_ 160 WHL_SpdRLVal 5;
BA_ "UserSigValidity" SG_ 160 WHL_SpdRLVal 3;
BA_ "Description" SG_ 160 WHL_SpdRLVal "This signal provides the wheel velocity of each wheel and have 14 bits length and a resolution of 0.03125 km^h.(This resolution is higher than that of signal in TCS5).

In case of failure of one wheel speed sensor, the value 3FFFH is used as error identi";
BA_ "Version" SG_ 426 CLU_Crc1Val "21.09.03";
BA_ "RoutingFactor" SG_ 426 CLU_Crc1Val 0;
BA_ "UserSigValidity" SG_ 426 CLU_Crc1Val 3;
BA_ "GenSigStartValue" SG_ 426 CLU_Crc1Val 65535;
BA_ "Description" SG_ 426 CLU_Crc1Val "The data area for CRC calculation is based on the data length (DLC) of the message DB.

The CRC shall be calculated over the entire data block (excluding the CRC bytes) including the user data, alive counter and Data ID



- CRC Polynomial (0x1021) , Ini";
BA_ "Version" SG_ 426 CLU_FuelSenderRstReq "23.05.05";
BA_ "RoutingFactor" SG_ 426 CLU_FuelSenderRstReq 0;
BA_ "UserSigValidity" SG_ 426 CLU_FuelSenderRstReq 0;
BA_ "Description" SG_ 426 CLU_FuelSenderRstReq "This signal is transmitted when initailzing request occur";
BA_ "Version" SG_ 426 CLU_PRKDispRdy "24.10.01";
BA_ "RoutingFactor" SG_ 426 CLU_PRKDispRdy 0;
BA_ "UserSigValidity" SG_ 426 CLU_PRKDispRdy 3;
BA_ "Description" SG_ 426 CLU_PRKDispRdy "If the cluster is not operating normally, 'Impossible to display' signal(0x1) is transmitted to ADAS_PRK";
BA_ "Version" SG_ 426 CLU_AlvCnt1Val "21.09.03";
BA_ "RoutingFactor" SG_ 426 CLU_AlvCnt1Val 0;
BA_ "UserSigValidity" SG_ 426 CLU_AlvCnt1Val 3;
BA_ "Description" SG_ 426 CLU_AlvCnt1Val "For the first transmission request for a data element the counter shall be initialized with 0 and shall be incremented by 1 for every subsequent send request. 

When the counter reaches the maximum value(0xFF), then it shall restart with 0 for the next s";
BA_ "Version" SG_ 426 CLU_DtntOutSta "17.11.00";
BA_ "RoutingFactor" SG_ 426 CLU_DtntOutSta 0;
BA_ "UserSigValidity" SG_ 426 CLU_DtntOutSta 0;
BA_ "Description" SG_ 426 CLU_DtntOutSta "This signal indicates the status of detent illumination. Cluster sends the detent information for a Unified Illumination system.";
BA_ "Version" SG_ 426 CLU_SpdUnitTyp "17.11.00";
BA_ "RoutingFactor" SG_ 426 CLU_SpdUnitTyp 0;
BA_ "UserSigValidity" SG_ 426 CLU_SpdUnitTyp 3;
BA_ "Description" SG_ 426 CLU_SpdUnitTyp "This signal indicates the unit of the speed displayed in the speedometer.";
BA_ "Version" SG_ 426 CLU_DisSpdDcmlVal "17.11.00";
BA_ "RoutingFactor" SG_ 426 CLU_DisSpdDcmlVal 0;
BA_ "UserSigValidity" SG_ 426 CLU_DisSpdDcmlVal 3;
BA_ "Description" SG_ 426 CLU_DisSpdDcmlVal "The signal 'CF_Clu_VanzDecimal' means the extra value of the signal 'CF_Clu_Vanz' (vehicle speed which is indicated in the speedometer)

Also, This signal should be sent in km/h or MPH according to the 'CF_Clu_SPEED_UNIT' signal.

CF_Clu_SPEED_UNIT = 0 :";
BA_ "Version" SG_ 426 CLU_SWRCCrsMainSwSta "18.04.00";
BA_ "RoutingFactor" SG_ 426 CLU_SWRCCrsMainSwSta 0;
BA_ "UserSigValidity" SG_ 426 CLU_SWRCCrsMainSwSta 3;
BA_ "Description" SG_ 426 CLU_SWRCCrsMainSwSta "Cruise on/off switch";
BA_ "Version" SG_ 426 CLU_SWRCCrsSwSta "18.07.01";
BA_ "RoutingFactor" SG_ 426 CLU_SWRCCrsSwSta 0;
BA_ "UserSigValidity" SG_ 426 CLU_SWRCCrsSwSta 3;
BA_ "Description" SG_ 426 CLU_SWRCCrsSwSta "Depending on whether One-touch logic is applied, the meaning of each signal value is divided into two cases as shown below



Case1) Not applied

0x0:Idle Position

0x1:Resume/Plus

0x2:Set/Minus

0x3:Time gap (Distance, SCC only)

0x4:ACC/SCC cancel



";
BA_ "Version" SG_ 426 CLU_SWRCLFASwSta "18.04.00";
BA_ "RoutingFactor" SG_ 426 CLU_SWRCLFASwSta 0;
BA_ "UserSigValidity" SG_ 426 CLU_SWRCLFASwSta 3;
BA_ "Description" SG_ 426 CLU_SWRCLFASwSta "LFA/HDA on/off switch";
BA_ "Version" SG_ 426 CLU_SWRCSldMainSwSta "18.04.00";
BA_ "RoutingFactor" SG_ 426 CLU_SWRCSldMainSwSta 0;
BA_ "UserSigValidity" SG_ 426 CLU_SWRCSldMainSwSta 3;
BA_ "Description" SG_ 426 CLU_SWRCSldMainSwSta "Speedlimiter on/off switch";
BA_ "Version" SG_ 426 CLU_RhstaLvlSta "17.11.00";
BA_ "RoutingFactor" SG_ 426 CLU_RhstaLvlSta 0;
BA_ "UserSigValidity" SG_ 426 CLU_RhstaLvlSta 0;
BA_ "Description" SG_ 426 CLU_RhstaLvlSta "This signal is used for a rheostat level of CLUSTER from 1 to 21 level (21 level : Detent) for a Unified Illumination system.



※ Start Value : Current value";
BA_ "Version" SG_ 426 CLU_DisSpdVal "17.12.03";
BA_ "RoutingFactor" SG_ 426 CLU_DisSpdVal 0;
BA_ "UserSigValidity" SG_ 426 CLU_DisSpdVal 3;
BA_ "Description" SG_ 426 CLU_DisSpdVal "The vehicle speed which is indicated in the speedmeter has to be sent to SCC. This value is used for evalution of SCC command values instead of the vehicle velocity in order to avoid significant difference between the speedmeter indicator and the set spe";
BA_ "Version" SG_ 426 CLU_OKSwSta "19.03.06";
BA_ "RoutingFactor" SG_ 426 CLU_OKSwSta 0;
BA_ "UserSigValidity" SG_ 426 CLU_OKSwSta 3;
BA_ "Description" SG_ 426 CLU_OKSwSta "This signal represents operating status of Ok Switch in Steering Wheel. Default value of this signal is 0 and the value is set to 1 only while a driver is pressing the OK Switch.";
BA_ "Version" SG_ 426 CLU_DisSpdVal_KPH "17.12.09";
BA_ "RoutingFactor" SG_ 426 CLU_DisSpdVal_KPH 0;
BA_ "UserSigValidity" SG_ 426 CLU_DisSpdVal_KPH 3;
BA_ "Description" SG_ 426 CLU_DisSpdVal_KPH "The vehicle speed which is indicated in the speedmeter.

This signal should be sent in km/h only.";
BA_ "Version" SG_ 426 CLU_PwrAutoOffResetReq_HCU "19.10.03";
BA_ "RoutingFactor" SG_ 426 CLU_PwrAutoOffResetReq_HCU 0;
BA_ "UserSigValidity" SG_ 426 CLU_PwrAutoOffResetReq_HCU 3;
BA_ "Description" SG_ 426 CLU_PwrAutoOffResetReq_HCU "This signal is used for a request to reset power auto off time

when OK sw on, this signal 0x1 for 3 period times,and send 0x0 

It is signal for HCU";
BA_ "Version" SG_ 426 CLU_CUSTOMSta_NEW "20.08.07";
BA_ "RoutingFactor" SG_ 426 CLU_CUSTOMSta_NEW 0;
BA_ "UserSigValidity" SG_ 426 CLU_CUSTOMSta_NEW 3;
BA_ "Description" SG_ 426 CLU_CUSTOMSta_NEW "This is a signal for New concept CUSTOM mode in AVN USM

This is a confirm signal for selecting CUSTOM mode in AVN USM

And Other units refer this signal when CUSTOM mode (CLU_DrvngModSwSta=0x6

). Other unit decided the Detailed CUSTOM Mode with this si";
BA_ "Version" SG_ 426 CLU_AutoBrightSta "20.12.05";
BA_ "RoutingFactor" SG_ 426 CLU_AutoBrightSta 0;
BA_ "UserSigValidity" SG_ 426 CLU_AutoBrightSta 0;
BA_ "Description" SG_ 426 CLU_AutoBrightSta "This signal is used for a auto bright level of CLUSTER from 1step to 200step for a Unified Illumination system.



※ Start Value : Current value";
BA_ "Version" SG_ 426 CLU_NotMinModeBrightSta "22.07.06";
BA_ "RoutingFactor" SG_ 426 CLU_NotMinModeBrightSta 0;
BA_ "UserSigValidity" SG_ 426 CLU_NotMinModeBrightSta 0;
BA_ "Description" SG_ 426 CLU_NotMinModeBrightSta "This signal is used for a Cluster brightness level when not in minimum brightness mode.



※ Start Value : Current value";
BA_ "Version" SG_ 426 CLU_FuelSenderResistVal "23.06.00";
BA_ "RoutingFactor" SG_ 426 CLU_FuelSenderResistVal 0;
BA_ "UserSigValidity" SG_ 426 CLU_FuelSenderResistVal 0;
BA_ "Description" SG_ 426 CLU_FuelSenderResistVal "This is the resistance data come from fuel sender.

If fuel sender is open,short condition, Invalid value will be transmitted.

data is valid after cluser waked-up";
BA_ "Version" SG_ 293 SAS_Crc1Val "18.11.08";
BA_ "RoutingFactor" SG_ 293 SAS_Crc1Val 5;
BA_ "UserSigValidity" SG_ 293 SAS_Crc1Val 3;
BA_ "GenSigStartValue" SG_ 293 SAS_Crc1Val 65535;
BA_ "Description" SG_ 293 SAS_Crc1Val "The data area for CRC calculation is based on the data length (DLC) of the message DB.

The CRC shall be calculated over the entire data block (excluding the CRC bytes) including the user data, alive counter and Data ID

 

- CRC Polynomial (0x1021) , In";
BA_ "Version" SG_ 293 SAS_AlvCnt1Val "18.11.08";
BA_ "RoutingFactor" SG_ 293 SAS_AlvCnt1Val 5;
BA_ "UserSigValidity" SG_ 293 SAS_AlvCnt1Val 3;
BA_ "Description" SG_ 293 SAS_AlvCnt1Val "For the first transmission request for a data element the counter shall be initialized with 0 and shall be incremented by 1 for every subsequent send request. 

When the counter reaches the maximum value(0xFF), then it shall restart with 0 for the next s";
BA_ "Version" SG_ 293 SAS_AnglVal "21.07.05";
BA_ "RoutingFactor" SG_ 293 SAS_AnglVal 5;
BA_ "UserSigValidity" SG_ 293 SAS_AnglVal 3;
BA_ "GenSigStartValue" SG_ 293 SAS_AnglVal 32767;
BA_ "Description" SG_ 293 SAS_AnglVal "Information regarding the steering wheel angle.  (PH) = (HEX) * 0.1 (0 <  HEX < 7FFFH) or (PH) = (HEX - 65536) * 0.1 (HEX > 7FFFH)



this signal has direction information.

'+' Value means Counter clock wise rotation.

'-' value means Clock wise rotatio";
BA_ "Version" SG_ 293 SAS_SpdVal "21.07.05";
BA_ "RoutingFactor" SG_ 293 SAS_SpdVal 5;
BA_ "UserSigValidity" SG_ 293 SAS_SpdVal 3;
BA_ "GenSigStartValue" SG_ 293 SAS_SpdVal 255;
BA_ "Description" SG_ 293 SAS_SpdVal "Information regarding the steering wheel rotation speed 

(PH) = (HEX) * 4 (0 ≤ HEX < 254)";
BA_ "Version" SG_ 293 SAS_IntSta "21.07.05";
BA_ "RoutingFactor" SG_ 293 SAS_IntSta 5;
BA_ "UserSigValidity" SG_ 293 SAS_IntSta 3;
BA_ "GenSigStartValue" SG_ 293 SAS_IntSta 14;
BA_ "Description" SG_ 293 SAS_IntSta "Information regarding the steering angle sensor’s internal state. If SAS_AnglVal value is O.K., SAS_OK flag is set and otherwise SAS_OK flag is cleared. If steering angle sensor has been calibrated, SAS_CAL flag is set and otherwise cleared.

SF1 - SF5 ";
BA_ "Version" SG_ 53 VCU_Crc1Val "21.09.03";
BA_ "RoutingFactor" SG_ 53 VCU_Crc1Val 5;
BA_ "UserSigValidity" SG_ 53 VCU_Crc1Val 7;
BA_ "GenSigStartValue" SG_ 53 VCU_Crc1Val 65535;
BA_ "Description" SG_ 53 VCU_Crc1Val "The data area for CRC calculation is based on the data length (DLC) of the message DB.

The CRC shall be calculated over the entire data block (excluding the CRC bytes) including the user data, alive counter and Data ID



- CRC Polynomial (0x1021) , Ini";
BA_ "Version" SG_ 53 VCU_ScuKeepWakeReq "20.04.05";
BA_ "RoutingFactor" SG_ 53 VCU_ScuKeepWakeReq 5;
BA_ "UserSigValidity" SG_ 53 VCU_ScuKeepWakeReq 7;
BA_ "Description" SG_ 53 VCU_ScuKeepWakeReq "SCU Keep Wake Request";
BA_ "Version" SG_ 53 VCU_MotTqCmdRearVal "20.04.05";
BA_ "RoutingFactor" SG_ 53 VCU_MotTqCmdRearVal 5;
BA_ "UserSigValidity" SG_ 53 VCU_MotTqCmdRearVal 7;
BA_ "Description" SG_ 53 VCU_MotTqCmdRearVal "Torque Command for Rear Motor";
BA_ "Version" SG_ 53 VCU_FmcuZeroTqOfsReq "20.04.05";
BA_ "RoutingFactor" SG_ 53 VCU_FmcuZeroTqOfsReq 5;
BA_ "UserSigValidity" SG_ 53 VCU_FmcuZeroTqOfsReq 7;
BA_ "Description" SG_ 53 VCU_FmcuZeroTqOfsReq "Fmcu Zero Torque Offset Request";
BA_ "Version" SG_ 53 VCU_EcmSeqSta "20.04.05";
BA_ "RoutingFactor" SG_ 53 VCU_EcmSeqSta 5;
BA_ "UserSigValidity" SG_ 53 VCU_EcmSeqSta 7;
BA_ "Description" SG_ 53 VCU_EcmSeqSta "This signal is VCU System Status Information.";
BA_ "Version" SG_ 53 VCU_EcmDiagSta "20.04.05";
BA_ "RoutingFactor" SG_ 53 VCU_EcmDiagSta 5;
BA_ "UserSigValidity" SG_ 53 VCU_EcmDiagSta 7;
BA_ "Version" SG_ 53 VCU_CltActDiagSta "20.04.05";
BA_ "RoutingFactor" SG_ 53 VCU_CltActDiagSta 5;
BA_ "UserSigValidity" SG_ 53 VCU_CltActDiagSta 7;
BA_ "Description" SG_ 53 VCU_CltActDiagSta "Clutch Actuator Diag Code";
BA_ "Version" SG_ 53 VCU_CltActDrvCrntVal "20.04.05";
BA_ "RoutingFactor" SG_ 53 VCU_CltActDrvCrntVal 5;
BA_ "UserSigValidity" SG_ 53 VCU_CltActDrvCrntVal 7;
BA_ "Description" SG_ 53 VCU_CltActDrvCrntVal "Clutch Actuator Drive Current";
BA_ "Version" SG_ 53 VCU_AlvCnt1Val "21.09.03";
BA_ "RoutingFactor" SG_ 53 VCU_AlvCnt1Val 5;
BA_ "UserSigValidity" SG_ 53 VCU_AlvCnt1Val 7;
BA_ "Description" SG_ 53 VCU_AlvCnt1Val "For the first transmission request for a data element the counter shall be initialized with 0 and shall be incremented by 1 for every subsequent send request. 

When the counter reaches the maximum value(0xFF), then it shall restart with 0 for the next s";
BA_ "Version" SG_ 53 VCU_CltActPosStrokeVal "20.04.05";
BA_ "RoutingFactor" SG_ 53 VCU_CltActPosStrokeVal 5;
BA_ "UserSigValidity" SG_ 53 VCU_CltActPosStrokeVal 7;
BA_ "Description" SG_ 53 VCU_CltActPosStrokeVal "Clutch Actuator Position Stroke";
BA_ "Version" SG_ 53 VCU_MainBattTypeSta "20.08.07";
BA_ "RoutingFactor" SG_ 53 VCU_MainBattTypeSta 5;
BA_ "UserSigValidity" SG_ 53 VCU_MainBattTypeSta 7;
BA_ "Description" SG_ 53 VCU_MainBattTypeSta "Main Battery Type";
BA_ "Version" SG_ 53 VCU_MainBattTypeLrnSta "20.04.05";
BA_ "RoutingFactor" SG_ 53 VCU_MainBattTypeLrnSta 5;
BA_ "UserSigValidity" SG_ 53 VCU_MainBattTypeLrnSta 7;
BA_ "Description" SG_ 53 VCU_MainBattTypeLrnSta "Learn Status of Main Batt. Type";
BA_ "Version" SG_ 53 VCU_WarmupCycSta "20.04.05";
BA_ "RoutingFactor" SG_ 53 VCU_WarmupCycSta 5;
BA_ "UserSigValidity" SG_ 53 VCU_WarmupCycSta 7;
BA_ "Description" SG_ 53 VCU_WarmupCycSta "Warm-up Cycle Status Flag for FRF output to other ECU's";
BA_ "Version" SG_ 53 VCU_FatcPermPwrVal "20.04.05";
BA_ "RoutingFactor" SG_ 53 VCU_FatcPermPwrVal 5;
BA_ "UserSigValidity" SG_ 53 VCU_FatcPermPwrVal 7;
BA_ "Description" SG_ 53 VCU_FatcPermPwrVal "Climate Permission Power";
BA_ "Version" SG_ 53 VCU_GearPosStaDisp "20.12.04";
BA_ "RoutingFactor" SG_ 53 VCU_GearPosStaDisp 5;
BA_ "UserSigValidity" SG_ 53 VCU_GearPosStaDisp 7;
BA_ "GenSigStartValue" SG_ 53 VCU_GearPosStaDisp 9;
BA_ "Description" SG_ 53 VCU_GearPosStaDisp "Gear Position Status for CLU display";
BA_ "Version" SG_ 53 VCU_PdlStopCtrlSta "21.08.08";
BA_ "RoutingFactor" SG_ 53 VCU_PdlStopCtrlSta 5;
BA_ "UserSigValidity" SG_ 53 VCU_PdlStopCtrlSta 7;
BA_ "Description" SG_ 53 VCU_PdlStopCtrlSta "Cooperative control state of VCU for stop assist control with IEB";
BA_ "Version" SG_ 53 VCU_PdlStopReqTqNmVal "21.08.08";
BA_ "RoutingFactor" SG_ 53 VCU_PdlStopReqTqNmVal 5;
BA_ "UserSigValidity" SG_ 53 VCU_PdlStopReqTqNmVal 7;
BA_ "Description" SG_ 53 VCU_PdlStopReqTqNmVal "Requested brake torque for cooperative stop assist control";
BA_ "Version" SG_ 53 VCU_PMPDActSta "23.06.01";
BA_ "RoutingFactor" SG_ 53 VCU_PMPDActSta 5;
BA_ "UserSigValidity" SG_ 53 VCU_PMPDActSta 7;
BA_ "Description" SG_ 53 VCU_PMPDActSta "PMPD Function Active State";
BA_ "Version" SG_ 53 VCU_PMPDWarnSta "24.09.01";
BA_ "RoutingFactor" SG_ 53 VCU_PMPDWarnSta 5;
BA_ "UserSigValidity" SG_ 53 VCU_PMPDWarnSta 7;
BA_ "Description" SG_ 53 VCU_PMPDWarnSta "PMPD Function Warning State";
BA_ "Version" SG_ 53 VCU_VgsVirSoundBackFireIndex "21.12.02";
BA_ "RoutingFactor" SG_ 53 VCU_VgsVirSoundBackFireIndex 5;
BA_ "UserSigValidity" SG_ 53 VCU_VgsVirSoundBackFireIndex 7;
BA_ "Description" SG_ 53 VCU_VgsVirSoundBackFireIndex "Virtual sound back fire noise index for VGS mode";
BA_ "Version" SG_ 53 VCU_VgsVirEngSpdRpmVal "21.12.02";
BA_ "RoutingFactor" SG_ 53 VCU_VgsVirEngSpdRpmVal 5;
BA_ "UserSigValidity" SG_ 53 VCU_VgsVirEngSpdRpmVal 7;
BA_ "Description" SG_ 53 VCU_VgsVirEngSpdRpmVal "Virtual engine speed for VGS mode";
BA_ "Version" SG_ 53 VCU_RdySta "20.04.05";
BA_ "RoutingFactor" SG_ 53 VCU_RdySta 5;
BA_ "UserSigValidity" SG_ 53 VCU_RdySta 7;
BA_ "Description" SG_ 53 VCU_RdySta "VCU Ready";
BA_ "Version" SG_ 53 VCU_VgsVirSoundVolume "21.12.02";
BA_ "RoutingFactor" SG_ 53 VCU_VgsVirSoundVolume 5;
BA_ "UserSigValidity" SG_ 53 VCU_VgsVirSoundVolume 7;
BA_ "Description" SG_ 53 VCU_VgsVirSoundVolume "Virtual engine sound volume for VGS mode[%]";
BA_ "Version" SG_ 53 VCU_VgsVirGearStep "21.12.02";
BA_ "RoutingFactor" SG_ 53 VCU_VgsVirGearStep 5;
BA_ "UserSigValidity" SG_ 53 VCU_VgsVirGearStep 7;
BA_ "Description" SG_ 53 VCU_VgsVirGearStep "Shift gear when entering VGS mode";
BA_ "Version" SG_ 53 VCU_StandbyModSta "22.05.04";
BA_ "RoutingFactor" SG_ 53 VCU_StandbyModSta 5;
BA_ "UserSigValidity" SG_ 53 VCU_StandbyModSta 7;
BA_ "Description" SG_ 53 VCU_StandbyModSta "Stand by Mode Status";
BA_ "Version" SG_ 53 VCU_HVIntLkDischrgReq "22.11.02";
BA_ "RoutingFactor" SG_ 53 VCU_HVIntLkDischrgReq 5;
BA_ "UserSigValidity" SG_ 53 VCU_HVIntLkDischrgReq 7;
BA_ "Description" SG_ 53 VCU_HVIntLkDischrgReq "High Voltage Parts Discharge Request from VCU";
BA_ "Version" SG_ 53 VCU_StartKeyHoldSta "20.04.05";
BA_ "RoutingFactor" SG_ 53 VCU_StartKeyHoldSta 5;
BA_ "UserSigValidity" SG_ 53 VCU_StartKeyHoldSta 7;
BA_ "Description" SG_ 53 VCU_StartKeyHoldSta "Start Key Hold Signal";
BA_ "Version" SG_ 53 VCU_EvDrvRdySta "20.04.05";
BA_ "RoutingFactor" SG_ 53 VCU_EvDrvRdySta 5;
BA_ "UserSigValidity" SG_ 53 VCU_EvDrvRdySta 7;
BA_ "Description" SG_ 53 VCU_EvDrvRdySta "EV Ready";
BA_ "Version" SG_ 53 VCU_MotPwrEnReq "20.04.05";
BA_ "RoutingFactor" SG_ 53 VCU_MotPwrEnReq 5;
BA_ "UserSigValidity" SG_ 53 VCU_MotPwrEnReq 7;
BA_ "Description" SG_ 53 VCU_MotPwrEnReq "Motor Power Enable";
BA_ "Version" SG_ 53 VCU_GearPosSta "21.05.01";
BA_ "RoutingFactor" SG_ 53 VCU_GearPosSta 5;
BA_ "UserSigValidity" SG_ 53 VCU_GearPosSta 7;
BA_ "GenSigStartValue" SG_ 53 VCU_GearPosSta 9;
BA_ "Description" SG_ 53 VCU_GearPosSta "Gear Position Status";
BA_ "Version" SG_ 53 VCU_LdcInhReq "20.04.05";
BA_ "RoutingFactor" SG_ 53 VCU_LdcInhReq 5;
BA_ "UserSigValidity" SG_ 53 VCU_LdcInhReq 7;
BA_ "GenSigStartValue" SG_ 53 VCU_LdcInhReq 1;
BA_ "Description" SG_ 53 VCU_LdcInhReq "LDC Output Inhibit Request";
BA_ "Version" SG_ 53 VCU_MainRlyOffReq "20.04.05";
BA_ "RoutingFactor" SG_ 53 VCU_MainRlyOffReq 5;
BA_ "UserSigValidity" SG_ 53 VCU_MainRlyOffReq 7;
BA_ "Description" SG_ 53 VCU_MainRlyOffReq "Main Relay Cut off Request";
BA_ "Version" SG_ 53 VCU_AccPedDepVal "20.04.05";
BA_ "RoutingFactor" SG_ 53 VCU_AccPedDepVal 5;
BA_ "UserSigValidity" SG_ 53 VCU_AccPedDepVal 7;
BA_ "Description" SG_ 53 VCU_AccPedDepVal "Accelerator Pedal Depth Value";
BA_ "Version" SG_ 53 VCU_FatcOperPermSta "20.04.05";
BA_ "RoutingFactor" SG_ 53 VCU_FatcOperPermSta 5;
BA_ "UserSigValidity" SG_ 53 VCU_FatcOperPermSta 7;
BA_ "Description" SG_ 53 VCU_FatcOperPermSta "Climate Operating Permission";
BA_ "Version" SG_ 53 VCU_DrvCycSta "20.04.05";
BA_ "RoutingFactor" SG_ 53 VCU_DrvCycSta 5;
BA_ "UserSigValidity" SG_ 53 VCU_DrvCycSta 7;
BA_ "Description" SG_ 53 VCU_DrvCycSta "Driving Cycle Status";
BA_ "Version" SG_ 53 VCU_CltActOpSta "20.04.05";
BA_ "RoutingFactor" SG_ 53 VCU_CltActOpSta 5;
BA_ "UserSigValidity" SG_ 53 VCU_CltActOpSta 7;
BA_ "Description" SG_ 53 VCU_CltActOpSta "Clutch Actuator Operating Status";
BA_ "Version" SG_ 53 VCU_WhlSpdSnsrAlvReq "20.04.05";
BA_ "RoutingFactor" SG_ 53 VCU_WhlSpdSnsrAlvReq 5;
BA_ "UserSigValidity" SG_ 53 VCU_WhlSpdSnsrAlvReq 7;
BA_ "Description" SG_ 53 VCU_WhlSpdSnsrAlvReq "Alive Request for Wheel Speed Sensors";
BA_ "Version" SG_ 53 VCU_DrvModOpSta "24.10.03";
BA_ "RoutingFactor" SG_ 53 VCU_DrvModOpSta 5;
BA_ "UserSigValidity" SG_ 53 VCU_DrvModOpSta 7;
BA_ "Description" SG_ 53 VCU_DrvModOpSta "VCU's operating drive mode according to CLU and DMIC signals";
BA_ "Version" SG_ 53 VCU_HydBrkFcHoldRq "22.03.02";
BA_ "RoutingFactor" SG_ 53 VCU_HydBrkFcHoldRq 5;
BA_ "UserSigValidity" SG_ 53 VCU_HydBrkFcHoldRq 7;
BA_ "Description" SG_ 53 VCU_HydBrkFcHoldRq "Hydraulic brake force holding request from VCU";
BA_ "Version" SG_ 53 VCU_FatcPwrUseVal "20.04.05";
BA_ "RoutingFactor" SG_ 53 VCU_FatcPwrUseVal 5;
BA_ "UserSigValidity" SG_ 53 VCU_FatcPwrUseVal 7;
BA_ "Description" SG_ 53 VCU_FatcPwrUseVal "Predicted HVAC Power Consumption";
BA_ "Version" SG_ 53 VCU_WhlDemTqVal "20.04.05";
BA_ "RoutingFactor" SG_ 53 VCU_WhlDemTqVal 5;
BA_ "UserSigValidity" SG_ 53 VCU_WhlDemTqVal 7;
BA_ "Description" SG_ 53 VCU_WhlDemTqVal "Driver's Demand Torque Restricted by Battery Limit and HHT Temperature";
BA_ "Version" SG_ 53 VCU_McuAntiJerkInhFrntSta "20.04.05";
BA_ "RoutingFactor" SG_ 53 VCU_McuAntiJerkInhFrntSta 5;
BA_ "UserSigValidity" SG_ 53 VCU_McuAntiJerkInhFrntSta 7;
BA_ "GenSigStartValue" SG_ 53 VCU_McuAntiJerkInhFrntSta 1;
BA_ "Description" SG_ 53 VCU_McuAntiJerkInhFrntSta "Anti-jerk Inhibition";
BA_ "Version" SG_ 53 VCU_McuAntiJerkInhRearSta "20.04.05";
BA_ "RoutingFactor" SG_ 53 VCU_McuAntiJerkInhRearSta 5;
BA_ "UserSigValidity" SG_ 53 VCU_McuAntiJerkInhRearSta 7;
BA_ "GenSigStartValue" SG_ 53 VCU_McuAntiJerkInhRearSta 1;
BA_ "Description" SG_ 53 VCU_McuAntiJerkInhRearSta "Anti-jerk Inhibition";
BA_ "Version" SG_ 53 VCU_McuPwrLatchHoldReq "20.04.05";
BA_ "RoutingFactor" SG_ 53 VCU_McuPwrLatchHoldReq 5;
BA_ "UserSigValidity" SG_ 53 VCU_McuPwrLatchHoldReq 7;
BA_ "Description" SG_ 53 VCU_McuPwrLatchHoldReq "Mcu Power Latch Hold Request";
BA_ "Version" SG_ 53 VCU_ScuParkReq "20.04.05";
BA_ "RoutingFactor" SG_ 53 VCU_ScuParkReq 5;
BA_ "UserSigValidity" SG_ 53 VCU_ScuParkReq 7;
BA_ "Description" SG_ 53 VCU_ScuParkReq "Parking Command Request";
BA_ "Version" SG_ 53 VCU_MotTqCmdFrntVal "20.04.05";
BA_ "RoutingFactor" SG_ 53 VCU_MotTqCmdFrntVal 5;
BA_ "UserSigValidity" SG_ 53 VCU_MotTqCmdFrntVal 7;
BA_ "Description" SG_ 53 VCU_MotTqCmdFrntVal "Torque Command for Front Motor";
BA_REL_ "GenSigTimeoutTime" BU_SG_REL_ GW_PSU_DRV_FD SG_ 813 SBCM_DRV_FD_Crc1Val 1500;
BA_REL_ "GenSigTimeoutTime" BU_SG_REL_ RWPC_FD SG_ 813 Latch_TypeOption_DRV 1500;
BA_REL_ "GenSigTimeoutTime" BU_SG_REL_ WPC2_FD SG_ 813 Latch_TypeOption_DRV 1500;
BA_REL_ "GenSigTimeoutTime" BU_SG_REL_ WPC_FD SG_ 813 Latch_TypeOption_DRV 1500;
BA_REL_ "GenSigTimeoutTime" BU_SG_REL_ ATS_FD SG_ 813 DRV_SWFailAlarm 1500;
BA_REL_ "GenSigTimeoutTime" BU_SG_REL_ ATS_FD SG_ 813 PDS_TypeOption_DRV 1500;
BA_REL_ "GenSigTimeoutTime" BU_SG_REL_ GW_PSU_DRV_FD SG_ 813 SBCM_DRV_FD_AlvCnt1Val 1500;
BA_REL_ "GenSigTimeoutTime" BU_SG_REL_ GW_PSU_DRV_FD SG_ 813 IMS_OSMirPlayBackSta_LH 1500;
BA_REL_ "GenSigTimeoutTime" BU_SG_REL_ GW_PSU_DRV_FD SG_ 813 IMS_OSMirPlayBackSta_LH_New 1500;
BA_REL_ "GenSigTimeoutTime" BU_SG_REL_ BLTN_CAM_FD SG_ 813 Warn_HoodSwSta_SBCM 1500;
BA_REL_ "GenSigTimeoutTime" BU_SG_REL_ BLTN_CAM_FD SG_ 813 Hood_TypeOption 1500;
BA_REL_ "GenSigTimeoutTime" BU_SG_REL_ ATS_FD SG_ 813 PwrDRClosingDRVDrSta 1500;
BA_REL_ "GenSigTimeoutTime" BU_SG_REL_ ATS_FD SG_ 813 DRV_DetectObj_warn_LH 1500;
BA_REL_ "GenSigTimeoutTime" BU_SG_REL_ ATS_FD SG_ 813 PwrDROpenClosingDdvSdDRSta 1500;
BA_REL_ "GenSigTimeoutTime" BU_SG_REL_ ATS_FD SG_ 813 Coach_TypeOption_DRV 1500;
BA_REL_ "GenSigTimeoutTime" BU_SG_REL_ GW_PSU_RL_FD SG_ 813 Coach_TypeOption_DRV 1500;
BA_REL_ "GenSigTimeoutTime" BU_SG_REL_ GW_PSU_RR_FD SG_ 813 Coach_TypeOption_DRV 1500;
BA_REL_ "GenSigTimeoutTime" BU_SG_REL_ ATS_FD SG_ 813 PwrDrSta_Drv 1500;
BA_REL_ "GenSigTimeoutTime" BU_SG_REL_ ATS_FD SG_ 813 PwrDrSta_DrvSd 1500;
BA_REL_ "GenSigTimeoutTime" BU_SG_REL_ ATS_FD SG_ 813 SBCM_FL_DoorAngle 1500;
BA_REL_ "GenSigTimeoutTime" BU_SG_REL_ BLTN_CAM_FD SG_ 813 DRV_CrashUnlockCmd 1500;
BA_REL_ "GenSigTimeoutTime" BU_SG_REL_ ATS_FD SG_ 813 Warn_DrvDrSwSta_SBCM 1500;
BA_REL_ "GenSigTimeoutTime" BU_SG_REL_ BLTN_CAM_FD SG_ 813 Warn_DrvDrSwSta_SBCM 1500;
BA_REL_ "GenSigTimeoutTime" BU_SG_REL_ DCM_FD SG_ 813 Warn_DrvDrSwSta_SBCM 1500;
BA_REL_ "GenSigTimeoutTime" BU_SG_REL_ GW_PSU_DRV_FD SG_ 813 Warn_DrvDrSwSta_SBCM 1500;
BA_REL_ "GenSigTimeoutTime" BU_SG_REL_ PSB_FD SG_ 813 Warn_DrvDrSwSta_SBCM 1500;
BA_REL_ "GenSigTimeoutTime" BU_SG_REL_ RWPC_FD SG_ 813 Warn_DrvDrSwSta_SBCM 1500;
BA_REL_ "GenSigTimeoutTime" BU_SG_REL_ WPC2_FD SG_ 813 Warn_DrvDrSwSta_SBCM 1500;
BA_REL_ "GenSigTimeoutTime" BU_SG_REL_ WPC_FD SG_ 813 Warn_DrvDrSwSta_SBCM 1500;
BA_REL_ "GenSigTimeoutTime" BU_SG_REL_ ATS_FD SG_ 813 DoorLock_DrvDrUnLkSta_SBCM 1500;
BA_REL_ "GenSigTimeoutTime" BU_SG_REL_ FCS_FD SG_ 813 DoorLock_DrvDrUnLkSta_SBCM 1500;
BA_REL_ "GenSigTimeoutTime" BU_SG_REL_ GW_PSU_DRV_FD SG_ 813 DoorLock_DrvDrUnLkSta_SBCM 1500;
BA_REL_ "GenSigTimeoutTime" BU_SG_REL_ ATS_FD SG_ 813 DRV_SEAWarn_LH 1500;
BA_REL_ "GenSigTimeoutTime" BU_SG_REL_ GW_PSU_DRV_FD SG_ 811 SBCM_AST_FD_Crc1Val 1500;
BA_REL_ "GenSigTimeoutTime" BU_SG_REL_ ATS_FD SG_ 811 AST_SWFailAlarm 1500;
BA_REL_ "GenSigTimeoutTime" BU_SG_REL_ GW_PSU_DRV_FD SG_ 811 SBCM_AST_FD_AlvCnt1Val 1500;
BA_REL_ "GenSigTimeoutTime" BU_SG_REL_ GW_PSU_DRV_FD SG_ 811 IMS_OSMirPlayBackSta_RH 1500;
BA_REL_ "GenSigTimeoutTime" BU_SG_REL_ ATS_FD SG_ 811 PwrDRClosingASTDrSta 1500;
BA_REL_ "GenSigTimeoutTime" BU_SG_REL_ GW_PSU_DRV_FD SG_ 811 IMS_OSMirPlayBackSta_RH_New 1500;
BA_REL_ "GenSigTimeoutTime" BU_SG_REL_ ATS_FD SG_ 811 PwrDrSta_Ast 1500;
BA_REL_ "GenSigTimeoutTime" BU_SG_REL_ ATS_FD SG_ 811 PwrDrSta_AstSd 1500;
BA_REL_ "GenSigTimeoutTime" BU_SG_REL_ ATS_FD SG_ 811 AST_DetectObj_warn_LH 1500;
BA_REL_ "GenSigTimeoutTime" BU_SG_REL_ ATS_FD SG_ 811 PwrDROpenClosingAstSdDRSta 1500;
BA_REL_ "GenSigTimeoutTime" BU_SG_REL_ ATS_FD SG_ 811 SBCM_FR_DoorAngle 1500;
BA_REL_ "GenSigTimeoutTime" BU_SG_REL_ BLTN_CAM_FD SG_ 811 AST_CrashUnlockCmd 1500;
BA_REL_ "GenSigTimeoutTime" BU_SG_REL_ ATS_FD SG_ 811 Warn_AsstDrSwSta_SBCM 1500;
BA_REL_ "GenSigTimeoutTime" BU_SG_REL_ BLTN_CAM_FD SG_ 811 Warn_AsstDrSwSta_SBCM 1500;
BA_REL_ "GenSigTimeoutTime" BU_SG_REL_ DCM_FD SG_ 811 Warn_AsstDrSwSta_SBCM 1500;
BA_REL_ "GenSigTimeoutTime" BU_SG_REL_ GW_PSU_AST_FD SG_ 811 Warn_AsstDrSwSta_SBCM 1500;
BA_REL_ "GenSigTimeoutTime" BU_SG_REL_ GW_SAU_DRV_FD SG_ 811 Warn_AsstDrSwSta_SBCM 1500;
BA_REL_ "GenSigTimeoutTime" BU_SG_REL_ PSB_FD SG_ 811 Warn_AsstDrSwSta_SBCM 1500;
BA_REL_ "GenSigTimeoutTime" BU_SG_REL_ RWPC_FD SG_ 811 Warn_AsstDrSwSta_SBCM 1500;
BA_REL_ "GenSigTimeoutTime" BU_SG_REL_ WPC2_FD SG_ 811 Warn_AsstDrSwSta_SBCM 1500;
BA_REL_ "GenSigTimeoutTime" BU_SG_REL_ WPC_FD SG_ 811 Warn_AsstDrSwSta_SBCM 1500;
BA_REL_ "GenSigTimeoutTime" BU_SG_REL_ ATS_FD SG_ 811 DoorLock_AsstDrUnLkSta_SBCM 1500;
BA_REL_ "GenSigTimeoutTime" BU_SG_REL_ FCS_FD SG_ 811 DoorLock_AsstDrUnLkSta_SBCM 1500;
BA_REL_ "GenSigTimeoutTime" BU_SG_REL_ ATS_FD SG_ 811 AST_SEAWarn_LH 1500;
BA_REL_ "GenSigTimeoutTime" BU_SG_REL_ BLTN_CAM_FD SG_ 930 CLU_LapTimer_LapNumber_MM 1500;
BA_REL_ "GenSigTimeoutTime" BU_SG_REL_ BLTN_CAM_FD SG_ 930 CLU_LapTimer_Hour_MM 1500;
BA_REL_ "GenSigTimeoutTime" BU_SG_REL_ BLTN_CAM_FD SG_ 930 CLU_LapTimer_Minute_MM 1500;
BA_REL_ "GenSigTimeoutTime" BU_SG_REL_ BLTN_CAM_FD SG_ 930 CLU_LapTimer_Second_MM 1500;
BA_REL_ "GenSigTimeoutTime" BU_SG_REL_ BLTN_CAM_FD SG_ 930 CLU_LapTimer_MeasuringStatus_MM 1500;
BA_REL_ "GenSigTimeoutTime" BU_SG_REL_ BLTN_CAM_FD SG_ 930 CLU_LapTimer_milisecond_MM 1500;
BA_REL_ "GenSigTimeoutTime" BU_SG_REL_ BLTN_CAM_FD SG_ 930 USM_LapTimerAutoMsreSetSta_MM 1500;
BA_REL_ "GenSigTimeoutTime" BU_SG_REL_ BLTN_CAM_FD SG_ 930 USM_LapTimerTimeGapSetSta_MM 1500;
BA_REL_ "GenSigTimeoutTime" BU_SG_REL_ BLTN_CAM_FD SG_ 518 HU_DR_Latitude 1500;
BA_REL_ "GenSigTimeoutTime" BU_SG_REL_ BLTN_CAM_FD SG_ 518 HU_DR_Longitude 1500;
BA_REL_ "GenSigTimeoutTime" BU_SG_REL_ BLTN_CAM_FD SG_ 518 HU_DR_Heading 1500;
BA_REL_ "GenSigTimeoutTime" BU_SG_REL_ BLTN_CAM_FD SG_ 518 HU_DR_Altitude 1500;
BA_REL_ "GenSigTimeoutTime" BU_SG_REL_ BLTN_CAM_FD SG_ 920 CTM_TrailerAct 1500;
BA_REL_ "GenSigTimeoutTime" BU_SG_REL_ ATS_FD SG_ 426 CLU_Crc1Val 1500;
BA_REL_ "GenSigTimeoutTime" BU_SG_REL_ GW_PSU_DRV_FD SG_ 426 CLU_Crc1Val 1500;
BA_REL_ "GenSigTimeoutTime" BU_SG_REL_ RCM_FD SG_ 426 CLU_Crc1Val 1500;
BA_REL_ "GenSigTimeoutTime" BU_SG_REL_ SHVU_3RD_FD SG_ 426 CLU_Crc1Val 1500;
BA_REL_ "GenSigTimeoutTime" BU_SG_REL_ SHVU_REAR_FD SG_ 426 CLU_Crc1Val 1500;
BA_REL_ "GenSigTimeoutTime" BU_SG_REL_ ATS_FD SG_ 426 CLU_AlvCnt1Val 1500;
BA_REL_ "GenSigTimeoutTime" BU_SG_REL_ GW_PSU_DRV_FD SG_ 426 CLU_AlvCnt1Val 1500;
BA_REL_ "GenSigTimeoutTime" BU_SG_REL_ RCM_FD SG_ 426 CLU_AlvCnt1Val 1500;
BA_REL_ "GenSigTimeoutTime" BU_SG_REL_ SHVU_3RD_FD SG_ 426 CLU_AlvCnt1Val 1500;
BA_REL_ "GenSigTimeoutTime" BU_SG_REL_ SHVU_REAR_FD SG_ 426 CLU_AlvCnt1Val 1500;
BA_REL_ "GenSigTimeoutTime" BU_SG_REL_ ARS_FD SG_ 426 CLU_DtntOutSta 1500;
BA_REL_ "GenSigTimeoutTime" BU_SG_REL_ ATS_FD SG_ 426 CLU_DtntOutSta 1500;
BA_REL_ "GenSigTimeoutTime" BU_SG_REL_ FCS_FD SG_ 426 CLU_DtntOutSta 1500;
BA_REL_ "GenSigTimeoutTime" BU_SG_REL_ GW_PSU_3RD_FD SG_ 426 CLU_DtntOutSta 1500;
BA_REL_ "GenSigTimeoutTime" BU_SG_REL_ GW_PSU_AST_FD SG_ 426 CLU_DtntOutSta 1500;
BA_REL_ "GenSigTimeoutTime" BU_SG_REL_ GW_PSU_DRV_FD SG_ 426 CLU_DtntOutSta 1500;
BA_REL_ "GenSigTimeoutTime" BU_SG_REL_ GW_PSU_RL_FD SG_ 426 CLU_DtntOutSta 1500;
BA_REL_ "GenSigTimeoutTime" BU_SG_REL_ GW_PSU_RR_FD SG_ 426 CLU_DtntOutSta 1500;
BA_REL_ "GenSigTimeoutTime" BU_SG_REL_ GW_SAU_DRV_FD SG_ 426 CLU_DtntOutSta 1500;
BA_REL_ "GenSigTimeoutTime" BU_SG_REL_ OHCL_FD SG_ 426 CLU_DtntOutSta 1500;
BA_REL_ "GenSigTimeoutTime" BU_SG_REL_ RCS_FD SG_ 426 CLU_DtntOutSta 1500;
BA_REL_ "GenSigTimeoutTime" BU_SG_REL_ RWPC_FD SG_ 426 CLU_DtntOutSta 1500;
BA_REL_ "GenSigTimeoutTime" BU_SG_REL_ SHVU_3RD_FD SG_ 426 CLU_DtntOutSta 1500;
BA_REL_ "GenSigTimeoutTime" BU_SG_REL_ SHVU_FRNT_FD SG_ 426 CLU_DtntOutSta 1500;
BA_REL_ "GenSigTimeoutTime" BU_SG_REL_ SHVU_REAR_FD SG_ 426 CLU_DtntOutSta 1500;
BA_REL_ "GenSigTimeoutTime" BU_SG_REL_ SHVU_RL_FD SG_ 426 CLU_DtntOutSta 1500;
BA_REL_ "GenSigTimeoutTime" BU_SG_REL_ SHVU_RR_FD SG_ 426 CLU_DtntOutSta 1500;
BA_REL_ "GenSigTimeoutTime" BU_SG_REL_ WPC2_FD SG_ 426 CLU_DtntOutSta 1500;
BA_REL_ "GenSigTimeoutTime" BU_SG_REL_ WPC_FD SG_ 426 CLU_DtntOutSta 1500;
BA_REL_ "GenSigTimeoutTime" BU_SG_REL_ BLTN_CAM_FD SG_ 426 CLU_SpdUnitTyp 1500;
BA_REL_ "GenSigTimeoutTime" BU_SG_REL_ GW_PSU_DRV_FD SG_ 426 CLU_SpdUnitTyp 1500;
BA_REL_ "GenSigTimeoutTime" BU_SG_REL_ WPC2_FD SG_ 426 CLU_SpdUnitTyp 1500;
BA_REL_ "GenSigTimeoutTime" BU_SG_REL_ ARS_FD SG_ 426 CLU_RhstaLvlSta 1500;
BA_REL_ "GenSigTimeoutTime" BU_SG_REL_ ATS_FD SG_ 426 CLU_RhstaLvlSta 1500;
BA_REL_ "GenSigTimeoutTime" BU_SG_REL_ FCS_FD SG_ 426 CLU_RhstaLvlSta 1500;
BA_REL_ "GenSigTimeoutTime" BU_SG_REL_ GW_PSU_3RD_FD SG_ 426 CLU_RhstaLvlSta 1500;
BA_REL_ "GenSigTimeoutTime" BU_SG_REL_ GW_PSU_AST_FD SG_ 426 CLU_RhstaLvlSta 1500;
BA_REL_ "GenSigTimeoutTime" BU_SG_REL_ GW_PSU_DRV_FD SG_ 426 CLU_RhstaLvlSta 1500;
BA_REL_ "GenSigTimeoutTime" BU_SG_REL_ GW_PSU_RL_FD SG_ 426 CLU_RhstaLvlSta 1500;
BA_REL_ "GenSigTimeoutTime" BU_SG_REL_ GW_PSU_RR_FD SG_ 426 CLU_RhstaLvlSta 1500;
BA_REL_ "GenSigTimeoutTime" BU_SG_REL_ GW_SAU_DRV_FD SG_ 426 CLU_RhstaLvlSta 1500;
BA_REL_ "GenSigTimeoutTime" BU_SG_REL_ OHCL_FD SG_ 426 CLU_RhstaLvlSta 1500;
BA_REL_ "GenSigTimeoutTime" BU_SG_REL_ RCS_FD SG_ 426 CLU_RhstaLvlSta 1500;
BA_REL_ "GenSigTimeoutTime" BU_SG_REL_ RWPC_FD SG_ 426 CLU_RhstaLvlSta 1500;
BA_REL_ "GenSigTimeoutTime" BU_SG_REL_ SHVU_3RD_FD SG_ 426 CLU_RhstaLvlSta 1500;
BA_REL_ "GenSigTimeoutTime" BU_SG_REL_ SHVU_FRNT_FD SG_ 426 CLU_RhstaLvlSta 1500;
BA_REL_ "GenSigTimeoutTime" BU_SG_REL_ SHVU_REAR_FD SG_ 426 CLU_RhstaLvlSta 1500;
BA_REL_ "GenSigTimeoutTime" BU_SG_REL_ SHVU_RL_FD SG_ 426 CLU_RhstaLvlSta 1500;
BA_REL_ "GenSigTimeoutTime" BU_SG_REL_ SHVU_RR_FD SG_ 426 CLU_RhstaLvlSta 1500;
BA_REL_ "GenSigTimeoutTime" BU_SG_REL_ WPC2_FD SG_ 426 CLU_RhstaLvlSta 1500;
BA_REL_ "GenSigTimeoutTime" BU_SG_REL_ WPC_FD SG_ 426 CLU_RhstaLvlSta 1500;
BA_REL_ "GenSigTimeoutTime" BU_SG_REL_ BLTN_CAM_FD SG_ 426 CLU_DisSpdVal 1500;
BA_REL_ "GenSigTimeoutTime" BU_SG_REL_ GW_PSU_AST_FD SG_ 426 CLU_DisSpdVal 1500;
BA_REL_ "GenSigTimeoutTime" BU_SG_REL_ GW_PSU_DRV_FD SG_ 426 CLU_DisSpdVal 1500;
BA_REL_ "GenSigTimeoutTime" BU_SG_REL_ WPC2_FD SG_ 426 CLU_DisSpdVal 1500;
BA_REL_ "GenSigTimeoutTime" BU_SG_REL_ ATS_FD SG_ 426 CLU_DisSpdVal_KPH 1500;
BA_REL_ "GenSigTimeoutTime" BU_SG_REL_ DCM_FD SG_ 426 CLU_DisSpdVal_KPH 1500;
BA_REL_ "GenSigTimeoutTime" BU_SG_REL_ GW_PSU_3RD_FD SG_ 426 CLU_DisSpdVal_KPH 1500;
BA_REL_ "GenSigTimeoutTime" BU_SG_REL_ GW_PSU_AST_FD SG_ 426 CLU_DisSpdVal_KPH 1500;
BA_REL_ "GenSigTimeoutTime" BU_SG_REL_ GW_PSU_DRV_FD SG_ 426 CLU_DisSpdVal_KPH 1500;
BA_REL_ "GenSigTimeoutTime" BU_SG_REL_ GW_PSU_RL_FD SG_ 426 CLU_DisSpdVal_KPH 1500;
BA_REL_ "GenSigTimeoutTime" BU_SG_REL_ GW_PSU_RR_FD SG_ 426 CLU_DisSpdVal_KPH 1500;
BA_REL_ "GenSigTimeoutTime" BU_SG_REL_ GW_SAU_DRV_FD SG_ 426 CLU_DisSpdVal_KPH 1500;
BA_REL_ "GenSigTimeoutTime" BU_SG_REL_ RCM_FD SG_ 426 CLU_DisSpdVal_KPH 1500;
BA_REL_ "GenSigTimeoutTime" BU_SG_REL_ RWPC_FD SG_ 426 CLU_DisSpdVal_KPH 1500;
BA_REL_ "GenSigTimeoutTime" BU_SG_REL_ SHVU_3RD_FD SG_ 426 CLU_DisSpdVal_KPH 1500;
BA_REL_ "GenSigTimeoutTime" BU_SG_REL_ SHVU_FRNT_FD SG_ 426 CLU_DisSpdVal_KPH 1500;
BA_REL_ "GenSigTimeoutTime" BU_SG_REL_ SHVU_REAR_FD SG_ 426 CLU_DisSpdVal_KPH 1500;
BA_REL_ "GenSigTimeoutTime" BU_SG_REL_ SHVU_RL_FD SG_ 426 CLU_DisSpdVal_KPH 1500;
BA_REL_ "GenSigTimeoutTime" BU_SG_REL_ SHVU_RR_FD SG_ 426 CLU_DisSpdVal_KPH 1500;
BA_REL_ "GenSigTimeoutTime" BU_SG_REL_ WPC2_FD SG_ 426 CLU_DisSpdVal_KPH 1500;
BA_REL_ "GenSigTimeoutTime" BU_SG_REL_ WPC_FD SG_ 426 CLU_DisSpdVal_KPH 1500;
BA_REL_ "GenSigTimeoutTime" BU_SG_REL_ ATS_FD SG_ 426 CLU_AutoBrightSta 1500;
BA_REL_ "GenSigTimeoutTime" BU_SG_REL_ BLTN_CAM_FD SG_ 426 CLU_AutoBrightSta 1500;
BA_REL_ "GenSigTimeoutTime" BU_SG_REL_ FCS_FD SG_ 426 CLU_AutoBrightSta 1500;
BA_REL_ "GenSigTimeoutTime" BU_SG_REL_ GW_PSU_3RD_FD SG_ 426 CLU_AutoBrightSta 1500;
BA_REL_ "GenSigTimeoutTime" BU_SG_REL_ GW_PSU_AST_FD SG_ 426 CLU_AutoBrightSta 1500;
BA_REL_ "GenSigTimeoutTime" BU_SG_REL_ GW_PSU_DRV_FD SG_ 426 CLU_AutoBrightSta 1500;
BA_REL_ "GenSigTimeoutTime" BU_SG_REL_ GW_PSU_RL_FD SG_ 426 CLU_AutoBrightSta 1500;
BA_REL_ "GenSigTimeoutTime" BU_SG_REL_ GW_PSU_RR_FD SG_ 426 CLU_AutoBrightSta 1500;
BA_REL_ "GenSigTimeoutTime" BU_SG_REL_ GW_SAU_DRV_FD SG_ 426 CLU_AutoBrightSta 1500;
BA_REL_ "GenSigTimeoutTime" BU_SG_REL_ OHCL_FD SG_ 426 CLU_AutoBrightSta 1500;
BA_REL_ "GenSigTimeoutTime" BU_SG_REL_ RCS_FD SG_ 426 CLU_AutoBrightSta 1500;
BA_REL_ "GenSigTimeoutTime" BU_SG_REL_ RWPC_FD SG_ 426 CLU_AutoBrightSta 1500;
BA_REL_ "GenSigTimeoutTime" BU_SG_REL_ SHVU_3RD_FD SG_ 426 CLU_AutoBrightSta 1500;
BA_REL_ "GenSigTimeoutTime" BU_SG_REL_ SHVU_FRNT_FD SG_ 426 CLU_AutoBrightSta 1500;
BA_REL_ "GenSigTimeoutTime" BU_SG_REL_ SHVU_REAR_FD SG_ 426 CLU_AutoBrightSta 1500;
BA_REL_ "GenSigTimeoutTime" BU_SG_REL_ SHVU_RL_FD SG_ 426 CLU_AutoBrightSta 1500;
BA_REL_ "GenSigTimeoutTime" BU_SG_REL_ SHVU_RR_FD SG_ 426 CLU_AutoBrightSta 1500;
BA_REL_ "GenSigTimeoutTime" BU_SG_REL_ WPC2_FD SG_ 426 CLU_AutoBrightSta 1500;
BA_REL_ "GenSigTimeoutTime" BU_SG_REL_ WPC_FD SG_ 426 CLU_AutoBrightSta 1500;
VAL_ 813 SBCM_DRV_FD_Crc1Val 0 "0x0x0~0xFFFF:CRCValue" 65535 "0x0x0~0xFFFF:CRCValue" ;
VAL_ 813 Latch_TypeOption_DRV 0 "Off" 1 "On" 2 "RESERVED" 3 "Error Indicator" ;
VAL_ 813 DRV_SWFailAlarm 0 "Off" 1 "On" 2 "RESERVED" 3 "Error Indicator" ;
VAL_ 813 USM_PwrDRApprOpnSetSta 0 "Default" 1 "Off" 2 "On" 3 "RESERVED" ;
VAL_ 813 USM_PwrDRApprOpnSetOpt 0 "Default" 1 "Off" 2 "On" 3 "RESERVED" ;
VAL_ 813 USM_PwrDRCloseByRKELockSta 0 "Default" 1 "Off" 2 "On" 3 "RESERVED" ;
VAL_ 813 USM_PwrDRCloseByRKELockOpt 0 "Default" 1 "Off" 2 "On" 3 "RESERVED" ;
VAL_ 813 USM_PwrDRCloseByBrakeSta 0 "Default" 1 "Off" 2 "On" 3 "RESERVED" ;
VAL_ 813 USM_PwrDRCloseByBrakeOpt 0 "Default" 1 "Off" 2 "On" 3 "RESERVED" ;
VAL_ 813 USM_PwrDRBuzzerSta 0 "Default" 1 "Off" 2 "On" 3 "RESERVED" ;
VAL_ 813 USM_PwrDRBuzzerOpt 0 "Default" 1 "Off" 2 "On" 3 "RESERVED" ;
VAL_ 813 PDS_TypeOption_DRV 0 "Off" 1 "All Door" 2 "Front Only" 3 "Rear Only" ;
VAL_ 813 C_DrvDoorApproachOpen 0 "Default" 1 "Approach Open Request" 2 "Approach Open Stop" 3 "RESERVED" ;
VAL_ 813 C_DrvDoorApproachClose 0 "Default" 1 "Approach Close Request" 2 "Approach Close Stop" 3 "RESERVED" ;
VAL_ 813 DoorLock_PDSLkSwSta_DRV 0 "Default" 1 "Lock" 2 "RESERVED" 3 "Error Indicator" ;
VAL_ 813 SBCM_DRV_DiagSta 0 "Default" 1 "Normal Operation" 2 "DRV Indicator Circuit Failure" 3 "RESERVED" ;
VAL_ 813 DoorLock_CtrlDrLkUnLkSwSta_SBCM 0 "Off" 1 "On" 2 "RESERVED" 3 "Error Indicator" ;
VAL_ 813 SBCM_PsvDrLkReq 0 "None" 1 "Lock" 2 "Passive Trunk Lock" 3 "RESERVED" ;
VAL_ 813 CDMAutoWashModeSet_SBCM 0 "Default" 1 "CDM Auto Wash Mode Off" 2 "CDM Auto Wash Mode On" 3 "RESERVED" 4 "RESERVED" 5 "RESERVED" 6 "RESERVED" 7 "Invalid" ;
VAL_ 813 USM_DrvGhostDoorSta 0 "Default" 1 "Off" 2 "On" 3 "RESERVED" ;
VAL_ 813 Mirror_LH_FoldingSta 0 "Off" 1 "Folding" 2 "RESERVED" 3 "Error Indicator" ;
VAL_ 813 Mirror_LH_UnfoldingSta 0 "Off" 1 "Unfolding" 2 "RESERVED" 3 "Error Indicator" ;
VAL_ 813 DRV_CrashMRActAlarm 0 "Off" 1 "On" 2 "RESERVED" 3 "Error Indicator" ;
VAL_ 813 AFH_DRV_FldUnFldSta 0 "Invalid" 1 "Fold" 2 "Unfold" 3 "Inprogress" ;
VAL_ 813 SBCM_DRV_FD_AlvCnt1Val 0 "0x0x0~0xFF:AlvCntValue" 255 "0x0x0~0xFF:AlvCntValue" ;
VAL_ 813 MirrorFldReq 0 "Default" 1 "Folding Request" 2 "Unfolding Request" 3 "RESERVED" ;
VAL_ 813 OMU_TypeOption_DRV 0 "Off" 1 "On" 2 "RESERVED" 3 "Error Indicator" ;
VAL_ 813 IMS_OSMirPlayBackSta_LH 0 "Stop" 1 "Play 1" 2 "Play 2" 3 "Play 3" 4 "SmartIMS" 5 "Profile 1" 6 "Profile 2" 7 "Guest" 8 "RESERVED" 9 "RESERVED" 10 "RESERVED" 11 "RESERVED" 12 "RESERVED" 13 "RESERVED" 14 "RESERVED" 15 "Error Indicator" ;
VAL_ 813 ECMMRR_PLUS 0 "0x0x0~0x7D:0~1.25 V" 125 "0x0x0~0x7D:0~1.25 V" 126 "0x7E~0xFE:RESERVED" 254 "0x7E~0xFE:RESERVED" 255 "RESERVED" ;
VAL_ 813 EHL_TxInfo_SBCM_DRV 0 "Default" 1 "EHL_DRV_Close" 2 "EHL_DRV_Half" 3 "EHL_DRV_Open" 4 "EHL_DRV_RetryFlag" 5 "EHL_DRV_ErrorIndicator" 6 "EHL_DRV_Opening" 7 "Invalid" ;
VAL_ 813 IMS_OSMirPlayBackSta_LH_New 0 "Stop" 1 "Play 1" 2 "Play 2" 3 "Play 3" 4 "Smart IMS" 5 "Profile 1" 6 "Profile 2" 7 "Profile 3" 8 "Profile 4" 9 "Profile 5" 10 "Profile 6" 11 "Profile 7" 12 "Profile 8" 13 "Profile 9" 14 "Guest" 15 "Error Indicator" ;
VAL_ 813 CDM_InsideOpnSwSta 0 "Off" 1 "On" 2 "RESERVED" 3 "Error Indicator" ;
VAL_ 813 CDM_TypeOption 0 "Off" 1 "On" 2 "On_2EA" 3 "Error Indicator" ;
VAL_ 813 CDM_ImmeChgSw_SBCM 0 "Default" 1 "Off" 2 "On" 3 "RESERVED" ;
VAL_ 813 CDM_FobSrchReq_DRV 0 "Off" 1 "On" 2 "RESERVED" 3 "Error Indicator" ;
VAL_ 813 CDM_OpnClsState_SBCM 0 "Default" 1 "Open" 2 "Close" 3 "RESERVED" ;
VAL_ 813 CDM_WarnMsg_SBCM 0 "Default" 1 "Normal" 2 "ChargeDoorErrorState" 3 "RESERVED" ;
VAL_ 813 CDM_AutoWashModeSta 0 "Default" 1 "CDM Auto Wash Mode Off (Ready)" 2 "CDM Auto Wash Mode Off (Error)" 3 "CDM Auto Wash Mode On" 4 "RESERVED" 5 "RESERVED" 6 "RESERVED" 7 "Invalid" ;
VAL_ 813 CDM_CmdStatus_SBCM 0 "Open (AVN)" 1 "Open (SMK)" 2 "Open (Sensor Switch)" 3 "Open (Command Hard Switch)" 4 "Open (Anti - Pinch)" 5 "Close (AVN)" 6 "Close (SMK)" 7 "Close (Assist Mode)" 8 "Close (Command Hard Switch)" 9 "Close (Connector)" 10 "Close (Gear Position)" 11 "Close (Time Over)" 12 "Close (Anti - Pinch)" 13 "Close (Sensor Switch)" 14 "Stall (Stop)" 15 "Invalid" ;
VAL_ 813 CDM_OutsideOpnSwSta 0 "Default" 1 "Push" 2 "RESERVED" 3 "Invalid" ;
VAL_ 813 PwrDRBuzzerOut_DRV 0 "OFF" 1 "Open" 2 "Close" 3 "Warning" ;
VAL_ 813 Warn_HoodSwSta_SBCM 0 "Off" 1 "On" 2 "RESERVED" 3 "Error Indicator" ;
VAL_ 813 Hood_TypeOption 0 "Off (Mechanical hood latch is applied)" 1 "On (E-Hood latch is applied)" 2 "RESERVED" 3 "Error Indicator" ;
VAL_ 813 SBCM_FrunkSta 0 "Default" 1 "Valid" 2 "RESERVED" 3 "Error Indicator" ;
VAL_ 813 Warn_HoodSwFullSta_SBCM 0 "Off" 1 "On" 2 "RESERVED" 3 "Error Indicator" ;
VAL_ 813 FrunkWarning_SBCM 0 "Off" 1 "On" 2 "RESERVED" 3 "Error Indicator" ;
VAL_ 813 SBCM_Longkey_DRVDrAtClsSwSta 0 "Default" 1 "Off" 2 "On" 3 "Error Indicator" ;
VAL_ 813 FrunkReleaseSwSta_SBCM 0 "Off" 1 "HalfRelease" 2 "FullRelease" 3 "SwitchError" ;
VAL_ 813 PwrDRClosingDRVDrSta 0 "Default" 1 "Close" 2 "Open" 3 "Stop(during Close)" 4 "Stop(during Open)" 5 "RESERVED" 6 "RESERVED" 7 "Invalid" ;
VAL_ 813 Drv_DrLkRetryFail_SBCM 0 "Normal" 1 "Fail" 2 "RESERVED" 3 "RESERVED" ;
VAL_ 813 CDM_GbtImmeChgSw_SBCM 0 "Default" 1 "Off" 2 "On" 3 "RESERVED" ;
VAL_ 813 CDM_GbtOpnClsState_SBCM 0 "Default" 1 "Open" 2 "Close" 3 "RESERVED" ;
VAL_ 813 CDM_GbtWarnMsg_SBCM 0 "Default" 1 "Normal" 2 "ChargeDoorErrorState" 3 "RESERVED" ;
VAL_ 813 CDM_GbtOutsideOpnSwSta 0 "Default" 1 "Push" 2 "RESERVED" 3 "Invalid" ;
VAL_ 813 DoorLock_DrvLkOutSta_SBCM 0 "Off" 1 "On" 2 "Not Used" 3 "Error Indicator" ;
VAL_ 813 FrunkEmergencySwSta_SBCM 0 "Off" 1 "On" 2 "Not Used" 3 "Error Indicator" ;
VAL_ 813 DRV_DetectObj_warn_LH 0 "Detect Left Warning OFF" 1 "Detect Left Warning ON" 2 "RESERVED" 3 "RESERVED" ;
VAL_ 813 PwrDROpenClosingDdvSdDRSta 0 "Default" 1 "Close" 2 "Open" 3 "Stop(during Close)" 4 "Stop(during Open)" 5 "RESERVED" 6 "RESERVED" 7 "Invalid" ;
VAL_ 813 PwrDRBuzzerOut_DRV_New 0 "OFF" 1 "Open" 2 "Close" 3 "Warning1" 4 "Warning2" ;
VAL_ 813 Coach_TypeOption_DRV 0 "Off" 1 "On" 2 "Not Used" 3 "Error Indicator" ;
VAL_ 813 PwrDrSta_Drv 0 "Unavailable" 1 "Available" 2 "RESERVED" 3 "Error Indicator" ;
VAL_ 813 PwrDrSta_DrvSd 0 "Unavailable" 1 "Available" 2 "RESERVED" 3 "Error Indicator" ;
VAL_ 813 USM_PwrDrOpnTypSta 0 "Default" 1 "Pop-up" 2 "Full Open" 3 "RESERVED" ;
VAL_ 813 DischrgDr_OpnClsState_SBCM 0 "Default" 1 "Open" 2 "Close" 3 "Invalid" ;
VAL_ 813 SBCM_FL_DoorAngle 0 "0° - 90°" 1 "0° - 90°" 2 "0° - 90°" 3 "0° - 90°" 4 "0° - 90°" 5 "0° - 90°" 6 "0° - 90°" 7 "0° - 90°" 8 "0° - 90°" 9 "0° - 90°" 10 "0° - 90°" 11 "0° - 90°" 12 "0° - 90°" 13 "0° - 90°" 14 "0° - 90°" 15 "0° - 90°" 16 "0° - 90°" 17 "0° - 90°" 18 "0° - 90°" 19 "0° - 90°" 20 "0° - 90°" 21 "0° - 90°" 22 "0° - 90°" 23 "0° - 90°" 24 "0° - 90°" 25 "0° - 90°" 26 "0° - 90°" 27 "0° - 90°" 28 "0° - 90°" 29 "0° - 90°" 30 "0° - 90°" 31 "0° - 90°" 32 "0° - 90°" 33 "0° - 90°" 34 "0° - 90°" 35 "0° - 90°" 36 "0° - 90°" 37 "0° - 90°" 38 "0° - 90°" 39 "0° - 90°" 40 "0° - 90°" 41 "0° - 90°" 42 "0° - 90°" 43 "0° - 90°" 44 "0° - 90°" 45 "0° - 90°" 46 "0° - 90°" 47 "0° - 90°" 48 "0° - 90°" 49 "0° - 90°" 50 "0° - 90°" 51 "0° - 90°" 52 "0° - 90°" 53 "0° - 90°" 54 "0° - 90°" 55 "0° - 90°" 56 "0° - 90°" 57 "0° - 90°" 58 "0° - 90°" 59 "0° - 90°" 60 "0° - 90°" 61 "0° - 90°" 62 "0° - 90°" 63 "0° - 90°" 64 "0° - 90°" 65 "0° - 90°" 66 "0° - 90°" 67 "0° - 90°" 68 "0° - 90°" 69 "0° - 90°" 70 "0° - 90°" 71 "0° - 90°" 72 "0° - 90°" 73 "0° - 90°" 74 "0° - 90°" 75 "0° - 90°" 76 "0° - 90°" 77 "0° - 90°" 78 "0° - 90°" 79 "0° - 90°" 80 "0° - 90°" 81 "0° - 90°" 82 "0° - 90°" 83 "0° - 90°" 84 "0° - 90°" 85 "0° - 90°" 86 "0° - 90°" 87 "0° - 90°" 88 "0° - 90°" 89 "0° - 90°" 90 "0° - 90°" 91 "Invalid" 92 "Invalid" 93 "Invalid" 94 "Invalid" 95 "Invalid" 96 "Invalid" 97 "Invalid" 98 "Invalid" 99 "Invalid" 100 "Unknown" 101 "Invalid" 102 "Invalid" 103 "Invalid" 104 "Invalid" 105 "Invalid" 106 "Invalid" 107 "Invalid" 108 "Invalid" 109 "Invalid" 110 "Invalid" 111 "Invalid" 112 "Invalid" 113 "Invalid" 114 "Invalid" 115 "Invalid" 116 "Invalid" 117 "Invalid" 118 "Invalid" 119 "Invalid" 120 "Invalid" 121 "Invalid" 122 "Invalid" 123 "Invalid" 124 "Invalid" 125 "Invalid" 126 "Invalid" 127 "Invalid" ;
VAL_ 813 SBCM_DoorType_DRV 0 "Two Door" 1 "Four Door" 2 "Not Used" 3 "Error Indicator" ;
VAL_ 813 CDM_DrType_DRV 0 "None" 1 "Electric" 2 "Manual" 3 "RESERVED" ;
VAL_ 813 DRVDoorPushAlarm 0 "Off" 1 "On" 2 "RESERVED" 3 "Error Indicator" ;
VAL_ 813 DRV_CrashUnlockCmd 0 "Off" 1 "Unlock(Crash)" ;
VAL_ 813 C_ApprOpenStatus 0 "Approach Open Off" 1 "Approach Open On" ;
VAL_ 813 DoorLock_DrvKeyLkSwSta_SBCM 0 "Off" 1 "Lock" 2 "RESERVED" 3 "Error Indicator" ;
VAL_ 813 DoorLock_DrvKeyUnLkSwSta_SBCM 0 "Off" 1 "Unlock" 2 "RESERVED" 3 "Error Indicator" ;
VAL_ 813 Warn_DrvDrSwSta_SBCM 0 "Close" 1 "Open" 2 "RESERVED" 3 "Error Indicator" ;
VAL_ 813 DoorLock_DrvDrUnLkSta_SBCM 0 "Lock" 1 "Unlock" 2 "RESERVED" 3 "Error Indicator" ;
VAL_ 813 DRV_SEAWarn_LH 0 "SEA Left Warning OFF" 1 "SEA Left Warning ON" 2 "RESERVED" 3 "RESERVED" ;
VAL_ 813 DRV_SEAWarn_RH 0 "SEA Right Warning OFF" 1 "SEA Right  Warning ON" 2 "RESERVED" 3 "RESERVED" ;
VAL_ 813 DRV_SEWWarn_LH 0 "SEW Left Warning OFF" 1 "SEW Left Warning ON" 2 "RESERVED" 3 "RESERVED" ;
VAL_ 813 DRV_SEWWarn_RH 0 "SEW Right Warning OFF" 1 "SEW Right Warning ON" 2 "RESERVED" 3 "RESERVED" ;
VAL_ 813 DRV_MRActivationAlarm 0 "Off" 1 "On" 2 "RESERVED" 3 "Error Indicator" ;
VAL_ 813 DRV_ReleaseWarn 0 "Release Warning OFF" 1 "Release Warning ON" 2 "RESERVED" 3 "RESERVED" ;
VAL_ 811 SBCM_AST_FD_Crc1Val 0 "0x0x0~0xFFFF:CRCValue" 65535 "0x0x0~0xFFFF:CRCValue" ;
VAL_ 811 USM_AstGhostDoorSta 0 "Default" 1 "Off" 2 "On" 3 "RESERVED" ;
VAL_ 811 AST_SWFailAlarm 0 "Off" 1 "On" 2 "RESERVED" 3 "Error Indicator" ;
VAL_ 811 DoorLock_PDSLkSwSta_AST 0 "Lock" 1 "Unlock" 2 "RESERVED" 3 "Error Indicator" ;
VAL_ 811 PDS_TypeOption_AST 0 "Off" 1 "On" 2 "RESERVED" 3 "Error Indicator" ;
VAL_ 811 AFCU_AutoWashModeSta_SBCM_AST 0 "Default" 1 "AFCU Auto Wash Mode Off (Ready)" 2 "AFCU Auto Wash Mode Off (Error)" 3 "AFCU Auto Wash Mode On" 4 "RESERVED" 5 "RESERVED" 6 "RESERVED" 7 "Invalid" ;
VAL_ 811 CDM_AutoWashModeSta_SBCM_AST 0 "Default" 1 "CDM Auto Wash Mode Off (Ready)" 2 "CDM Auto Wash Mode Off (Error)" 3 "CDM Auto Wash Mode On" 4 "RESERVED" 5 "RESERVED" 6 "RESERVED" 7 "Invalid" ;
VAL_ 811 AFH_AST_FldUnFldSta 0 "Invalid" 1 "Fold" 2 "Unfold" 3 "Inprogress" ;
VAL_ 811 SBCM_AST_DiagSta 0 "Default" 1 "Normal Operation" 2 "AST Indicator Circuit Failure" 3 "RESERVED" ;
VAL_ 811 CDM_TypeOption_AST 0 "Off" 1 "On" 2 "On_2EA" 3 "Error Indicator" ;
VAL_ 811 CDM_ImmeChgSw_AST 0 "Default" 1 "Off" 2 "On" 3 "RESERVED" ;
VAL_ 811 CDM_FobSrchReq_AST 0 "Off" 1 "On" 2 "RESERVED" 3 "Error Indicator" ;
VAL_ 811 CDM_OpnClsState_AST 0 "Default" 1 "Open" 2 "Close" 3 "RESERVED" ;
VAL_ 811 CDM_WarnMsg_AST 0 "Default" 1 "Normal" 2 "ChargeDoorErrorState" 3 "RESERVED" ;
VAL_ 811 Mirror_RH_FoldingSta 0 "Off" 1 "Folding" 2 "RESERVED" 3 "Error Indicator" ;
VAL_ 811 Mirror_RH_UnfoldingSta 0 "Off" 1 "Unfolding" 2 "RESERVED" 3 "Error Indicator" ;
VAL_ 811 CDM_CmdStatus_AST 0 "Open (AVN)" 1 "Open (SMK)" 2 "Open (Sensor Switch)" 3 "Open (Command Hard Switch)" 4 "Open (Anti - Pinch)" 5 "Close (AVN)" 6 "Close (SMK)" 7 "Close (Assist Mode)" 8 "Close (Command Hard Switch)" 9 "Close (Connector)" 10 "Close (Gear Position)" 11 "Close (Time Over)" 12 "Close (Anti - Pinch)" 13 "Close (Sensor Switch)" 14 "Stall (Stop)" 15 "Invalid" ;
VAL_ 811 SBCM_AST_FD_AlvCnt1Val 0 "0x0x0~0xFF:AlvCntValue" 255 "0x0x0~0xFF:AlvCntValue" ;
VAL_ 811 AST_CrashMRActAlarm 0 "Off" 1 "On" 2 "RESERVED" 3 "Error Indicator" ;
VAL_ 811 PwrDRBuzzerOut_AST 0 "OFF" 1 "Open" 2 "Close" 3 "Warning" ;
VAL_ 811 IMS_OSMirPlayBackSta_RH 0 "Stop" 1 "Play 1" 2 "Play 2" 3 "Play 3" 4 "Smart IMS" 5 "Profile 1" 6 "Profile 2" 7 "Guest" 8 "RESERVED" 9 "RESERVED" 10 "RESERVED" 11 "RESERVED" 12 "RESERVED" 13 "RESERVED" 14 "RESERVED" 15 "Error Indicator" ;
VAL_ 811 PwrDRClosingASTDrSta 0 "Default" 1 "Close" 2 "Open" 3 "Stop(during Close)" 4 "Stop(during Open)" 5 "RESERVED" 6 "RESERVED" 7 "Invalid" ;
VAL_ 811 CDM_OutsideOpnSwSta_AST 0 "Default" 1 "Push" 2 "RESERVED" 3 "Invalid" ;
VAL_ 811 SBCM_Longkey_ASTDrAtClsSwSta 0 "Default" 1 "Off" 2 "On" 3 "Error Indicator" ;
VAL_ 811 Hood_TypeOption_AST 0 "Off (Mechanical hood latch is applied)" 1 "On (E-Hood latch is applied)" 2 "RESERVED" 3 "Error Indicator" ;
VAL_ 811 Warn_HoodSwSta_AST 0 "Off" 1 "On" 2 "RESERVED" 3 "Error Indicator" ;
VAL_ 811 FrunkWarning_AST 0 "Off" 1 "On" 2 "RESERVED" 3 "Error Indicator" ;
VAL_ 811 SBCM_FrunkSta_AST 0 "Default" 1 "Valid" 2 "RESERVED" 3 "Error Indicator" ;
VAL_ 811 IMS_OSMirPlayBackSta_RH_New 0 "Stop" 1 "Play 1" 2 "Play 2" 3 "Play 3" 4 "Smart IMS" 5 "Profile 1" 6 "Profile 2" 7 "Profile 3" 8 "Profile 4" 9 "Profile 5" 10 "Profile 6" 11 "Profile 7" 12 "Profile 8" 13 "Profile 9" 14 "Guest" 15 "Error Indicator" ;
VAL_ 811 Ast_DrLkRetryFail_SBCM 0 "Normal" 1 "Fail" 2 "RESERVED" 3 "RESERVED" ;
VAL_ 811 DoorLock_AstLkOutSta_SBCM 0 "Off" 1 "On" 2 "Not Used" 3 "Error Indicator" ;
VAL_ 811 FrunkReleaseSwSta_SBCM_AST 0 "Off" 1 "HalfRelease" 2 "FullRelease" 3 "SwitchError" ;
VAL_ 811 FrunkInsideRelSwSta_SBCM_AST 0 "Off" 1 "On" 2 "Not Used" 3 "Error Indicator" ;
VAL_ 811 FrunkEmergencySwSta_SBCM_AST 0 "Off" 1 "On" 2 "Not Used" 3 "Error Indicator" ;
VAL_ 811 PwrDrSta_Ast 0 "Unavailable" 1 "Available" 2 "RESERVED" 3 "Error Indicator" ;
VAL_ 811 PwrDrSta_AstSd 0 "Unavailable" 1 "Available" 2 "RESERVED" 3 "Error Indicator" ;
VAL_ 811 DischrgDr_OpnClsState_SBCM_AST 0 "Default" 1 "Open" 2 "Close" 3 "Invalid" ;
VAL_ 811 AST_DetectObj_warn_LH 0 "Detect Left Warning OFF" 1 "Detect Left Warning ON" 2 "RESERVED" 3 "RESERVED" ;
VAL_ 811 PwrDROpenClosingAstSdDRSta 0 "Default" 1 "Close" 2 "Open" 3 "Stop(during Close)" 4 "Stop(during Open)" 5 "RESERVED" 6 "RESERVED" 7 "Invalid" ;
VAL_ 811 PwrDRBuzzerOut_AST_New 0 "OFF" 1 "Open" 2 "Close" 3 "Warning1" 4 "Warning2" ;
VAL_ 811 SBCM_FR_DoorAngle 0 "0° - 90°" 1 "0° - 90°" 2 "0° - 90°" 3 "0° - 90°" 4 "0° - 90°" 5 "0° - 90°" 6 "0° - 90°" 7 "0° - 90°" 8 "0° - 90°" 9 "0° - 90°" 10 "0° - 90°" 11 "0° - 90°" 12 "0° - 90°" 13 "0° - 90°" 14 "0° - 90°" 15 "0° - 90°" 16 "0° - 90°" 17 "0° - 90°" 18 "0° - 90°" 19 "0° - 90°" 20 "0° - 90°" 21 "0° - 90°" 22 "0° - 90°" 23 "0° - 90°" 24 "0° - 90°" 25 "0° - 90°" 26 "0° - 90°" 27 "0° - 90°" 28 "0° - 90°" 29 "0° - 90°" 30 "0° - 90°" 31 "0° - 90°" 32 "0° - 90°" 33 "0° - 90°" 34 "0° - 90°" 35 "0° - 90°" 36 "0° - 90°" 37 "0° - 90°" 38 "0° - 90°" 39 "0° - 90°" 40 "0° - 90°" 41 "0° - 90°" 42 "0° - 90°" 43 "0° - 90°" 44 "0° - 90°" 45 "0° - 90°" 46 "0° - 90°" 47 "0° - 90°" 48 "0° - 90°" 49 "0° - 90°" 50 "0° - 90°" 51 "0° - 90°" 52 "0° - 90°" 53 "0° - 90°" 54 "0° - 90°" 55 "0° - 90°" 56 "0° - 90°" 57 "0° - 90°" 58 "0° - 90°" 59 "0° - 90°" 60 "0° - 90°" 61 "0° - 90°" 62 "0° - 90°" 63 "0° - 90°" 64 "0° - 90°" 65 "0° - 90°" 66 "0° - 90°" 67 "0° - 90°" 68 "0° - 90°" 69 "0° - 90°" 70 "0° - 90°" 71 "0° - 90°" 72 "0° - 90°" 73 "0° - 90°" 74 "0° - 90°" 75 "0° - 90°" 76 "0° - 90°" 77 "0° - 90°" 78 "0° - 90°" 79 "0° - 90°" 80 "0° - 90°" 81 "0° - 90°" 82 "0° - 90°" 83 "0° - 90°" 84 "0° - 90°" 85 "0° - 90°" 86 "0° - 90°" 87 "0° - 90°" 88 "0° - 90°" 89 "0° - 90°" 90 "0° - 90°" 91 "Invalid" 92 "Invalid" 93 "Invalid" 94 "Invalid" 95 "Invalid" 96 "Invalid" 97 "Invalid" 98 "Invalid" 99 "Invalid" 100 "Unknown" 101 "Invalid" 102 "Invalid" 103 "Invalid" 104 "Invalid" 105 "Invalid" 106 "Invalid" 107 "Invalid" 108 "Invalid" 109 "Invalid" 110 "Invalid" 111 "Invalid" 112 "Invalid" 113 "Invalid" 114 "Invalid" 115 "Invalid" 116 "Invalid" 117 "Invalid" 118 "Invalid" 119 "Invalid" 120 "Invalid" 121 "Invalid" 122 "Invalid" 123 "Invalid" 124 "Invalid" 125 "Invalid" 126 "Invalid" 127 "Invalid" ;
VAL_ 811 EHL_TxInfo_SBCM_AST 0 "Default" 1 "EHL_AST_Close" 2 "EHL_AST_Half" 3 "EHL_AST_Open" 4 "EHL_AST_RetryFlag" 5 "EHL_AST_ErrorIndicator" 6 "EHL_AST_Opening" 7 "Invalid" ;
VAL_ 811 CDM_DrType_AST 0 "None" 1 "Electric" 2 "Manual" 3 "RESERVED" ;
VAL_ 811 ASTDoorPushAlarm 0 "Off" 1 "On" 2 "RESERVED" 3 "Error Indicator" ;
VAL_ 811 AST_CrashUnlockCmd 0 "Off" 1 "Unlock (Crash)" ;
VAL_ 811 DoorLock_CtrlDrLkSwSta_SBCM 0 "Off" 1 "On (Lock On)" 2 "RESERVED" 3 "Error Indicator" ;
VAL_ 811 DoorLock_CtrlDrUnLkSwSta_SBCM 0 "Off" 1 "On (Unlock On)" 2 "RESERVED" 3 "Error Indicator" ;
VAL_ 811 Warn_AsstDrSwSta_SBCM 0 "Close" 1 "Open" 2 "RESERVED" 3 "Error Indicator" ;
VAL_ 811 DoorLock_AsstDrUnLkSta_SBCM 0 "Lock" 1 "Unlock" 2 "RESERVED" 3 "Error Indicator" ;
VAL_ 811 AST_SEAWarn_RH 0 "SEA Right Warning OFF" 1 "SEA Right Warning ON" 2 "RESERVED" 3 "RESERVED" ;
VAL_ 811 AST_SEAWarn_LH 0 "SEA Left Warning OFF" 1 "SEA Left Warning ON" 2 "RESERVED" 3 "RESERVED" ;
VAL_ 811 AST_SEWWarn_LH 0 "SEW Left Warning OFF" 1 "SEW Left Warning ON" 2 "RESERVED" 3 "RESERVED" ;
VAL_ 811 AST_SEWWarn_RH 0 "SEW Right Warning OFF" 1 "SEW Right Warning ON" 2 "RESERVED" 3 "RESERVED" ;
VAL_ 811 AST_MRActivationAlarm 0 "Off" 1 "On" 2 "RESERVED" 3 "Error Indicator" ;
VAL_ 811 AST_ReleaseWarn 0 "Release Warning OFF" 1 "Release Warning ON" 2 "RESERVED" 3 "RESERVED" ;
VAL_ 930 CLU_HU_Crc3Val 0 "0x0x0~0xFFFF:CRCValue" 65535 "0x0x0~0xFFFF:CRCValue" ;
VAL_ 930 CLU_TermAvgSync_MM 0 "During the first 2.5 minutes" 1 "During another 2.5 minutes" 2 "During another 2.5 minutes" 3 "During another 2.5 minutes" ;
VAL_ 930 CLU_TermAvgFCL_Digit_MM 0 "2 Digit" 1 "3 Digit" 2 "RESERVED" 3 "Invalid" ;
VAL_ 930 CLU_TermAvgFuelCnsmptnVal_MM 0 "0x0x0~0x3E7:00.0~99.9(PH)=0.1*HEX or 100~999(PH)=HEX" 999 "0x0x0~0x3E7:00.0~99.9(PH)=0.1*HEX or 100~999(PH)=HEX" 1000 "RESERVED" 1001 "RESERVED" 1002 "RESERVED" 1003 "RESERVED" 1004 "RESERVED" 1005 "RESERVED" 1006 "RESERVED" 1007 "RESERVED" 1008 "RESERVED" 1009 "RESERVED" 1010 "RESERVED" 1011 "RESERVED" 1012 "RESERVED" 1013 "RESERVED" 1014 "RESERVED" 1015 "RESERVED" 1016 "RESERVED" 1017 "RESERVED" 1018 "RESERVED" 1019 "RESERVED" 1020 "RESERVED" 1021 "RESERVED" 1022 "RESERVED" 1023 "Error" ;
VAL_ 930 CLU_DispThmSetRdy 0 "Default" 1 "Not Ready" 2 "Ready" 3 "Invalid" ;
VAL_ 930 CLU_DispThmMemSta 0 "0x0x00~0x7F:Valid" 127 "0x0x00~0x7F:Valid" 128 "0x80~0xFF:Invalid" 255 "0x80~0xFF:Invalid" ;
VAL_ 930 CLU_HU_AlvCnt3Val 0 "0x0x0~0xFF:AlvCntValue" 255 "0x0x0~0xFF:AlvCntValue" ;
VAL_ 930 CLU_DispThmDeleteSta 0 "Default" 1 "Deleting" 2 "Delete Complete (Min. 600ms on)" 3 "Delete Fail (Min. 600ms on)" 4 "RESERVED" 5 "RESERVED" 6 "RESERVED" 7 "Invalid" ;
VAL_ 930 CLU_DispThmCopySta 0 "Default" 1 "Copying" 2 "Copy Complete (Min. 600ms on)" 3 "Copy Fail (Min. 600ms on)" 4 "RESERVED" 5 "RESERVED" 6 "RESERVED" 7 "Invalid" ;
VAL_ 930 CLU_DispThmSetStaMem 0 "Default" 1 "Original" 2 "Memory1" 3 "Memory2" 4 "Memory3" 5 "RESERVED" 6 "RESERVED" 7 "Invalid" ;
VAL_ 930 CLU_LapTimer_LapNumber_MM 0 "Default" 1 "Lap Number" 2 "Lap Number" 3 "Lap Number" 4 "Lap Number" 5 "Lap Number" 6 "Lap Number" 7 "Lap Number" 8 "Lap Number" 9 "Lap Number" 10 "Lap Number" 11 "Lap Number" 12 "Lap Number" 13 "Lap Number" 14 "Lap Number" 15 "Lap Number" 16 "Lap Number" 17 "Lap Number" 18 "Lap Number" 19 "Lap Number" 20 "Lap Number" 21 "Lap Number" 22 "Lap Number" 23 "Lap Number" 24 "Lap Number" 25 "Lap Number" 26 "Lap Number" 27 "Lap Number" 28 "Lap Number" 29 "Lap Number" 30 "Lap Number" 31 "Lap Number" 32 "Lap Number" 33 "Lap Number" 34 "Lap Number" 35 "Lap Number" 36 "Lap Number" 37 "Lap Number" 38 "Lap Number" 39 "Lap Number" 40 "Lap Number" 41 "Lap Number" 42 "Lap Number" 43 "Lap Number" 44 "Lap Number" 45 "Lap Number" 46 "Lap Number" 47 "Lap Number" 48 "Lap Number" 49 "Lap Number" 50 "Lap Number" 51 "Lap Number" 52 "Lap Number" 53 "Lap Number" 54 "Lap Number" 55 "Lap Number" 56 "Lap Number" 57 "Lap Number" 58 "Lap Number" 59 "Lap Number" 60 "Lap Number" 61 "Lap Number" 62 "Lap Number" 63 "Lap Number" 64 "Lap Number" 65 "Lap Number" 66 "Lap Number" 67 "Lap Number" 68 "Lap Number" 69 "Lap Number" 70 "Lap Number" 71 "Lap Number" 72 "Lap Number" 73 "Lap Number" 74 "Lap Number" 75 "Lap Number" 76 "Lap Number" 77 "Lap Number" 78 "Lap Number" 79 "Lap Number" 80 "Lap Number" 81 "Lap Number" 82 "Lap Number" 83 "Lap Number" 84 "Lap Number" 85 "Lap Number" 86 "Lap Number" 87 "Lap Number" 88 "Lap Number" 89 "Lap Number" 90 "Lap Number" 91 "Lap Number" 92 "Lap Number" 93 "Lap Number" 94 "Lap Number" 95 "Lap Number" 96 "Lap Number" 97 "Lap Number" 98 "Lap Number" 99 "Lap Number" 100 "RESERVED" 101 "RESERVED" 102 "RESERVED" 103 "RESERVED" 104 "RESERVED" 105 "RESERVED" 106 "RESERVED" 107 "RESERVED" 108 "RESERVED" 109 "RESERVED" 110 "RESERVED" 111 "RESERVED" 112 "RESERVED" 113 "RESERVED" 114 "RESERVED" 115 "RESERVED" 116 "RESERVED" 117 "RESERVED" 118 "RESERVED" 119 "RESERVED" 120 "RESERVED" 121 "RESERVED" 122 "RESERVED" 123 "RESERVED" 124 "RESERVED" 125 "RESERVED" 126 "RESERVED" 127 "RESERVED" ;
VAL_ 930 CLU_LapTimer_Hour_MM 0 "0x0x00~0x7F:Values(refer to Signal Description)" 127 "0x0x00~0x7F:Values(refer to Signal Description)" ;
VAL_ 930 CLU_LapTimer_Minute_MM 0 "Values(refer to Signal Description)" 1 "Values(refer to Signal Description)" 2 "Values(refer to Signal Description)" 3 "Values(refer to Signal Description)" 4 "Values(refer to Signal Description)" 5 "Values(refer to Signal Description)" 6 "Values(refer to Signal Description)" 7 "Values(refer to Signal Description)" 8 "Values(refer to Signal Description)" 9 "Values(refer to Signal Description)" 10 "Values(refer to Signal Description)" 11 "Values(refer to Signal Description)" 12 "Values(refer to Signal Description)" 13 "Values(refer to Signal Description)" 14 "Values(refer to Signal Description)" 15 "Values(refer to Signal Description)" 16 "Values(refer to Signal Description)" 17 "Values(refer to Signal Description)" 18 "Values(refer to Signal Description)" 19 "Values(refer to Signal Description)" 20 "Values(refer to Signal Description)" 21 "Values(refer to Signal Description)" 22 "Values(refer to Signal Description)" 23 "Values(refer to Signal Description)" 24 "Values(refer to Signal Description)" 25 "Values(refer to Signal Description)" 26 "Values(refer to Signal Description)" 27 "Values(refer to Signal Description)" 28 "Values(refer to Signal Description)" 29 "Values(refer to Signal Description)" 30 "Values(refer to Signal Description)" 31 "Values(refer to Signal Description)" 32 "Values(refer to Signal Description)" 33 "Values(refer to Signal Description)" 34 "Values(refer to Signal Description)" 35 "Values(refer to Signal Description)" 36 "Values(refer to Signal Description)" 37 "Values(refer to Signal Description)" 38 "Values(refer to Signal Description)" 39 "Values(refer to Signal Description)" 40 "Values(refer to Signal Description)" 41 "Values(refer to Signal Description)" 42 "Values(refer to Signal Description)" 43 "Values(refer to Signal Description)" 44 "Values(refer to Signal Description)" 45 "Values(refer to Signal Description)" 46 "Values(refer to Signal Description)" 47 "Values(refer to Signal Description)" 48 "Values(refer to Signal Description)" 49 "Values(refer to Signal Description)" 50 "Values(refer to Signal Description)" 51 "Values(refer to Signal Description)" 52 "Values(refer to Signal Description)" 53 "Values(refer to Signal Description)" 54 "Values(refer to Signal Description)" 55 "Values(refer to Signal Description)" 56 "Values(refer to Signal Description)" 57 "Values(refer to Signal Description)" 58 "Values(refer to Signal Description)" 59 "Values(refer to Signal Description)" 60 "Values(refer to Signal Description)" 61 "Values(refer to Signal Description)" 62 "Values(refer to Signal Description)" 63 "Values(refer to Signal Description)" ;
VAL_ 930 CLU_LapTimer_Second_MM 0 "Values(refer to Signal Description)" 1 "Values(refer to Signal Description)" 2 "Values(refer to Signal Description)" 3 "Values(refer to Signal Description)" 4 "Values(refer to Signal Description)" 5 "Values(refer to Signal Description)" 6 "Values(refer to Signal Description)" 7 "Values(refer to Signal Description)" 8 "Values(refer to Signal Description)" 9 "Values(refer to Signal Description)" 10 "Values(refer to Signal Description)" 11 "Values(refer to Signal Description)" 12 "Values(refer to Signal Description)" 13 "Values(refer to Signal Description)" 14 "Values(refer to Signal Description)" 15 "Values(refer to Signal Description)" 16 "Values(refer to Signal Description)" 17 "Values(refer to Signal Description)" 18 "Values(refer to Signal Description)" 19 "Values(refer to Signal Description)" 20 "Values(refer to Signal Description)" 21 "Values(refer to Signal Description)" 22 "Values(refer to Signal Description)" 23 "Values(refer to Signal Description)" 24 "Values(refer to Signal Description)" 25 "Values(refer to Signal Description)" 26 "Values(refer to Signal Description)" 27 "Values(refer to Signal Description)" 28 "Values(refer to Signal Description)" 29 "Values(refer to Signal Description)" 30 "Values(refer to Signal Description)" 31 "Values(refer to Signal Description)" 32 "Values(refer to Signal Description)" 33 "Values(refer to Signal Description)" 34 "Values(refer to Signal Description)" 35 "Values(refer to Signal Description)" 36 "Values(refer to Signal Description)" 37 "Values(refer to Signal Description)" 38 "Values(refer to Signal Description)" 39 "Values(refer to Signal Description)" 40 "Values(refer to Signal Description)" 41 "Values(refer to Signal Description)" 42 "Values(refer to Signal Description)" 43 "Values(refer to Signal Description)" 44 "Values(refer to Signal Description)" 45 "Values(refer to Signal Description)" 46 "Values(refer to Signal Description)" 47 "Values(refer to Signal Description)" 48 "Values(refer to Signal Description)" 49 "Values(refer to Signal Description)" 50 "Values(refer to Signal Description)" 51 "Values(refer to Signal Description)" 52 "Values(refer to Signal Description)" 53 "Values(refer to Signal Description)" 54 "Values(refer to Signal Description)" 55 "Values(refer to Signal Description)" 56 "Values(refer to Signal Description)" 57 "Values(refer to Signal Description)" 58 "Values(refer to Signal Description)" 59 "Values(refer to Signal Description)" 60 "Values(refer to Signal Description)" 61 "Values(refer to Signal Description)" 62 "Values(refer to Signal Description)" 63 "Values(refer to Signal Description)" ;
VAL_ 930 CLU_LapTimer_MeasuringStatus_MM 0 "Stop Lap Timer" 1 "Under Lap Timer measurement" 2 "Reser Lap Time" 3 "RESERVED" ;
VAL_ 930 CLU_LapTimer_milisecond_MM 0 "0x0x00~0x7F:Values(refer to Signal Description)" 127 "0x0x00~0x7F:Values(refer to Signal Description)" ;
VAL_ 930 CLU_N1SetVal_MM 0 "None" 1 "N" 2 "CUSTOM1" 3 "CUSTOM2" 4 "N-CUSTOM1" 5 "N-CUSTOM2" 6 "Drive mode" 7 "LapTimer Start/Lap" 8 "LapTimer Stop" 9 "RESERVED" 10 "RESERVED" 11 "RESERVED" 12 "RESERVED" 13 "RESERVED" 14 "Unselected" 15 "Invalid" ;
VAL_ 930 CLU_N2SetVal_MM 0 "None" 1 "N" 2 "CUSTOM1" 3 "CUSTOM2" 4 "N-CUSTOM1" 5 "N-CUSTOM2" 6 "Drive mode" 7 "LapTimer Start/Lap" 8 "LapTimer Stop" 9 "RESERVED" 10 "RESERVED" 11 "RESERVED" 12 "RESERVED" 13 "RESERVED" 14 "Unselected" 15 "Invalid" ;
VAL_ 930 Usm_TorqueUnitSetSta_MM 0 "Default" 1 "Nm" 2 "lb_ft" 3 "RESERVED" ;
VAL_ 930 Usm_TurboPressureUnitSetSta_MM 0 "Default" 1 "Psi" 2 "kPa" 3 "bar" 4 "RESERVED" 5 "RESERVED" 6 "RESERVED" 7 "Invalid" ;
VAL_ 930 USM_ShiftLightNmodeSetSta_MM 0 "Default" 1 "Off" 2 "On" 3 "Invalid" ;
VAL_ 930 USM_ShiftLightCustomSetSta_MM 0 "Default" 1 "Off" 2 "On" 3 "Invalid" ;
VAL_ 930 USM_ShiftLightSportSetSta_MM 0 "Default" 1 "Off" 2 "On" 3 "Invalid" ;
VAL_ 930 USM_ShiftLightNormalSetSta_MM 0 "Default" 1 "Off" 2 "On" 3 "Invalid" ;
VAL_ 930 USM_ShiftLightEcoSetSta_MM 0 "Default" 1 "Off" 2 "On" 3 "Invalid" ;
VAL_ 930 USM_ShiftLightBeepSndSetSta_MM 0 "Default" 1 "Off" 2 "On" 3 "Invalid" ;
VAL_ 930 USM_ShiftLightCustom2SetSta_MM 0 "Default" 1 "Off" 2 "On" 3 "Invalid" ;
VAL_ 930 USM_LapTimerAutoMsreSetSta_MM 0 "Default(Not Applied)" 1 "Off" 2 "On(Auto Measure)" 3 "Invalid" ;
VAL_ 930 USM_LapTimerTimeGapSetSta_MM 0 "Default(Not Applied)" 1 "Compare with Best Lap" 2 "Compare with Last Lap" 3 "Invalid" ;
VAL_ 518 GNSS_Crc7Val 0 "0x0x0~0xFFFF:CRCValue" 65535 "0x0x0~0xFFFF:CRCValue" ;
VAL_ 518 GNSS_AlvCnt7Val 0 "0x0x0~0xFF:AlvCntValue" 255 "0x0x0~0xFF:AlvCntValue" ;
VAL_ 518 HU_DR_Position_Status 1 "Valid" ;
VAL_ 518 HU_DR_Altitude_Status 1 "valid" ;
VAL_ 518 HU_DR_Heading_Status 1 "Valid" ;
VAL_ 518 HU_DR_Speed_Status 1 "Valid" ;
VAL_ 518 HU_DR_DirectionSwitch_Sta 1 "Valid" ;
VAL_ 518 HU_DR_Direction 1 "Backward" ;
VAL_ 518 HU_DR_GyroCalib_Sta 1 "Calibrated" ;
VAL_ 518 HU_DR_TachoCalib_Sta 1 "Calibrated" ;
VAL_ 518 HU_DR_Solution_Sta 0 "invalid" 1 "DR valid" ;
VAL_ 518 HU_DR_GNSS_Fix_Age 1 "0x0x1~0xFE:time since last GNSS fix" 254 "0x0x1~0xFE:time since last GNSS fix" 255 "No GNSS fix yet" ;
VAL_ 309 BAT_Crc1Val 0 "0x0x0~0xFFFF:CRCValue" 65535 "0x0x0~0xFFFF:CRCValue" ;
VAL_ 309 BAT_AlvCnt1Val 0 "0x0x0~0xFF:AlvCntValue" 255 "0x0x0~0xFF:AlvCntValue" ;
VAL_ 309 BAT_CurrVal 65535 "Error indicator" ;
VAL_ 309 BAT_SocVal 255 "Error indicator" ;
VAL_ 309 BAT_VoltVal 16383 "Error indicator" ;
VAL_ 309 BAT_AuxBattOpt 0 "Not used" 1 "12V LFP Battery is applied" 2 "12V LFP Battery is not applied" 3 "Error indicator" ;
VAL_ 309 BAT_TempVal 511 "Error indicator" ;
VAL_ 309 BAT_SocErrSta 0 "Nomal State" 1 "Implausible State" 2 "Not used" 3 "Error indicator" ;
VAL_ 309 BAT_SohVal 127 "Error indicator" ;
VAL_ 309 BAT_SnsrInvldSta 0 "Valid Condition" 1 "Invalid Condition" 2 "Not used" 3 "Error indicator" ;
VAL_ 309 BAT_SofVal 127 "Error indicator" ;
VAL_ 309 BAT_RspErrSta 0 "Operating correctly" 1 "Response error" 2 "Not used" 3 "Error indicator" ;
VAL_ 309 BAT_CapacityVal 255 "Error" ;
VAL_ 920 CTM_FD_Crc2Val 0 "0x0x0~0xFFFF:CRCValue" 65535 "0x0x0~0xFFFF:CRCValue" ;
VAL_ 920 CTM_FD_AlvCnt2Val 0 "0x0x0~0xFF:AlvCntValue" 255 "0x0x0~0xFF:AlvCntValue" ;
VAL_ 920 ITBC_Brk_FaultWarnSta 0 "off" 1 "Wiring Fault" 2 "Module Fault" 3 "System Fault" 4 "RESERVED" 5 "RESERVED" 6 "RESERVED" 7 "Invalid" ;
VAL_ 920 USM_TrailerTypSta 0 "off" 1 "Electric Light" 2 "Electric Heavy" 3 "EOH Light" 4 "EOH Heavy" 5 "Invalid" ;
VAL_ 920 ITBC_TrailerDisplayAppliedSta 0 "Default" 1 "ITBC Applied" 2 "TCM Applied" 3 "Invalid" ;
VAL_ 920 ITBC_Brk_FnctWarnSta 0 "Off" 1 "Auto Disabled" 2 "Manual Disabled" 3 "All Disabled" 4 "RESERVED" 5 "RESERVED" 6 "RESERVED" 7 "Invalid" ;
VAL_ 920 ITBC_LampWarnSta 0 "off" 1 "Tail Lamp Fault" 2 "Rear Fog Fault" 3 "Backup Lamp Fault" ;
VAL_ 920 ITBC_Brk_DisconnWarnSta 0 "off" 1 "Connection Check" 2 "RESERVED" 3 "Invalid" ;
VAL_ 920 ITBC_TrailerBrkOut 0 "0x0x0~0x64:0 ~ 100%" 100 "0x0x0~0x64:0 ~ 100%" 101 "RESERVED" 102 "RESERVED" 103 "RESERVED" 104 "RESERVED" 105 "RESERVED" 106 "RESERVED" 107 "RESERVED" 108 "RESERVED" 109 "RESERVED" 110 "RESERVED" 111 "RESERVED" 112 "RESERVED" 113 "RESERVED" 114 "RESERVED" 115 "RESERVED" 116 "RESERVED" 117 "RESERVED" 118 "RESERVED" 119 "RESERVED" 120 "RESERVED" 121 "RESERVED" 122 "RESERVED" 123 "RESERVED" 124 "RESERVED" 125 "RESERVED" 126 "RESERVED" 127 "Invalid" ;
VAL_ 920 ITBC_TrailerBrkGainVal 0 "0 ~20" 1 "0 ~20" 2 "0 ~20" 3 "0 ~20" 4 "0 ~20" 5 "0 ~20" 6 "0 ~20" 7 "0 ~20" 8 "0 ~20" 9 "0 ~20" 10 "0 ~20" 11 "0 ~20" 12 "0 ~20" 13 "0 ~20" 14 "0 ~20" 15 "0 ~20" 16 "0 ~20" 17 "0 ~20" 18 "0 ~20" 19 "0 ~20" 20 "0 ~20" 31 "Invalid" ;
VAL_ 920 ITBC_SysWarn 0 "Default" 1 "TBC Switch Error" 2 "TBC Connection Check" 3 "TBC Lamp Error" 4 "RESERVED" 5 "RESERVED" 6 "RESERVED" 7 "RESERVED" ;
VAL_ 920 ITBC_ResetOpSta 0 "Normal" 1 "Reset Complete" 2 "Reset Fail" 3 "RESERVED" ;
VAL_ 920 ITBC_BrkWarn 0 "off" 1 "Warning" 2 "RESERVED" 3 "Invalid" ;
VAL_ 920 ITBC_TrnSigLmpWarn 0 "off" 1 "Left Turn Signal warning" 2 "Right Turn Signal warning" 3 "Turn Signal warning" ;
VAL_ 920 ITBC_StpLmpWarn 0 "off" 1 "Warning" 2 "RESERVE" 3 "Invalid" ;
VAL_ 920 CTM_TrailerAct 0 "Not Connected" 1 "Connected" 2 "Disconnect" 3 "Invaild" ;
VAL_ 920 CTM_RearfogAct 0 "Off" 1 "On" 2 "RESERVED" 3 "Invaild" ;
VAL_ 920 CTM_StpLmpOpnSta 0 "Normal" 1 "Open Status" 2 "Not Used" 3 "Error Indicator" ;
VAL_ 920 CTM_TrnSigLmpLftOpnSta 0 "Normal" 1 "Open Status" 2 "Not Used" 3 "Error Indicator" ;
VAL_ 920 CTM_TrnSigLmpRtOpnSta 0 "Normal" 1 "Open Status" 2 "Not Used" 3 "Error Indicator" ;
VAL_ 920 CTM_ExtTailLmpLftOpnSta 0 "Normal" 1 "Open Status" 2 "Not Used" 3 "Error Indicator" ;
VAL_ 920 CTM_ExtTailLmpRtOpnSta 0 "Normal" 1 "Open Status" 2 "Not Used" 3 "Error Indicator" ;
VAL_ 920 CTM_Exra_EbrakSta 0 "Off" 1 "On" 2 "Not Used" 3 "Error Indicator" ;
VAL_ 920 CTM_TrlAngl_200ms 65535 "Error Indicator" ;
VAL_ 160 WHL_Crc1Val 0 "0x0x0~0xFFFF:CRCValue" 65535 "0x0x0~0xFFFF:CRCValue" ;
VAL_ 160 WHL_SpdRRVal 16383 "Error" ;
VAL_ 160 WHL_AlvCnt1Val 0 "0x0x0~0xFF:AlvCntValue" 255 "0x0x0~0xFF:AlvCntValue" ;
VAL_ 160 WHL_PlsFLVal 255 "Error" ;
VAL_ 160 WHL_PlsFRVal 255 "Error" ;
VAL_ 160 WHL_PlsRLVal 255 "Error" ;
VAL_ 160 WHL_PlsRRVal 255 "Error" ;
VAL_ 160 WHL_DirFLVal 0 "Unknown (Wheel moving stop state or Not applied wheel sensor for direction)" 1 "Forward direction" 2 "Backward direction" 3 "Error identifier" ;
VAL_ 160 WHL_DirFRVal 0 "Unknown (Wheel moving stop state or Not applied wheel sensor for direction)" 1 "Forward direction" 2 "Backward direction" 3 "Error identifier" ;
VAL_ 160 WHL_DirRLVal 0 "Unknown (Wheel moving stop state or Not applied wheel sensor for direction)" 1 "Forward direction" 2 "Backward direction" 3 "Error identifier" ;
VAL_ 160 WHL_DirRRVal 0 "Unknown (Wheel moving stop state or Not applied wheel sensor for direction)" 1 "Forward direction" 2 "Backward direction" 3 "Error identifier" ;
VAL_ 160 WHL_SpdFLVal 16383 "Error" ;
VAL_ 160 WHL_SpdFRVal 16383 "Error" ;
VAL_ 160 WHL_SpdRLVal 16383 "Error" ;
VAL_ 426 CLU_Crc1Val 0 "0x0x0~0xFFFF:CRCValue" 65535 "0x0x0~0xFFFF:CRCValue" ;
VAL_ 426 CLU_FuelSenderRstReq 0 "Default" 1 "Initialization" 2 "RESERVED" 3 "Invalid" ;
VAL_ 426 CLU_PRKDispRdy 0 "Init" 1 "Impossible to display" 2 "RESERVED" 3 "Invalid" ;
VAL_ 426 CLU_AlvCnt1Val 0 "0x0x0~0xFF:AlvCntValue" 255 "0x0x0~0xFF:AlvCntValue" ;
VAL_ 426 CLU_DtntOutSta 0 "Detent Off" 1 "Detent On" 2 "Not used" 3 "Error Indicator" ;
VAL_ 426 CLU_SpdUnitTyp 0 "km/h" 1 "MPH" 2 "Not used" 3 "Error Indicator" ;
VAL_ 426 CLU_DisSpdDcmlVal 0 "0" 1 "0.125" 2 "0.250" 3 "0.375" ;
VAL_ 426 CLU_SWRCCrsMainSwSta 0 "Off" 1 "Key On" 2 "Reserved" 3 "Invalid" ;
VAL_ 426 CLU_SWRCCrsSwSta 0 "Idle Position" 1 "Plus" 2 "Minus" 3 "Headway" 4 "Cancel/Pause" 5 "Reserved" 6 "Reserved" 7 "Reserved" ;
VAL_ 426 CLU_SWRCLFASwSta 0 "Off" 1 "Key On" 2 "Reserved" 3 "Invalid" ;
VAL_ 426 CLU_SWRCSldMainSwSta 0 "Off" 1 "Key On" 2 "Reserved" 3 "Invalid" ;
VAL_ 426 CLU_RhstaLvlSta 0 "Reserved" 1 "Step 1" 2 "Step 2" 3 "Step 3" 4 "Step 4" 5 "Step 5" 6 "Step 6" 7 "Step 7" 8 "Step 8" 9 "Step 9" 10 "Step 10" 11 "Step 11" 12 "Step 12" 13 "Step 13" 14 "Step 14" 15 "Step 15" 16 "Step 16" 17 "Step 17" 18 "Step 18" 19 "Step 19" 20 "Step 20 (Reset Value)" 21 "Step 21 (Detent)" ;
VAL_ 426 CLU_DisSpdVal 1023 "Error" ;
VAL_ 426 CLU_OKSwSta 0 "Off" 1 "Key On" 2 "Reserved" 3 "Invalid" ;
VAL_ 426 CLU_DisSpdVal_KPH 511 "Error" ;
VAL_ 426 CLU_PwrAutoOffResetReq_HCU 0 "Default" 1 "Reset Request" 2 "Reserved" 3 "Invalid" ;
VAL_ 426 CLU_CUSTOMSta_NEW 0 "Default" 1 "MY DRIVE MODE(CUSTOM)" 2 "SMART(CUSTOM)" 3 "BABY(CUSTOM)" 4 "RETRO(CUSTOM)" 5 "SNOW(CUSTOM)-Not Terrain" 6 "COMFORT(REAR)(CUSTOM)" 7 "" 8 "" 9 "" 10 "" 11 "" 12 "" 13 "" 14 "Off(CUSTOM)" 15 "Invalid" ;
VAL_ 426 CLU_AutoBrightSta 0 "Reserved (Not Used)" 1 "0x01~0xC8:Bright State (1~200 Step)" 200 "0x01~0xC8:Bright State (1~200 Step)" ;
VAL_ 426 CLU_NotMinModeBrightSta 0 "RESERVED" 1 "0x01~0xC8:CLU Bright State (1~200 Step)" 200 "0x01~0xC8:CLU Bright State (1~200 Step)" 201 "RESERVED" 202 "RESERVED" 203 "RESERVED" 204 "RESERVED" 205 "RESERVED" 206 "RESERVED" 207 "RESERVED" 208 "RESERVED" 209 "RESERVED" 210 "RESERVED" 211 "RESERVED" 212 "RESERVED" 213 "RESERVED" 214 "RESERVED" 215 "RESERVED" 216 "RESERVED" 217 "RESERVED" 218 "RESERVED" 219 "RESERVED" 220 "RESERVED" 221 "RESERVED" 222 "RESERVED" 223 "RESERVED" 224 "RESERVED" 225 "RESERVED" 226 "RESERVED" 227 "RESERVED" 228 "RESERVED" 229 "RESERVED" 230 "RESERVED" 231 "RESERVED" 232 "RESERVED" 233 "RESERVED" 234 "RESERVED" 235 "RESERVED" 236 "RESERVED" 237 "RESERVED" 238 "RESERVED" 239 "RESERVED" 240 "RESERVED" 241 "RESERVED" 242 "RESERVED" 243 "RESERVED" 244 "RESERVED" 245 "RESERVED" 246 "RESERVED" 247 "RESERVED" 248 "RESERVED" 249 "RESERVED" 250 "RESERVED" 251 "RESERVED" 252 "RESERVED" 253 "RESERVED" 254 "RESERVED" 255 "RESERVED" ;
VAL_ 426 CLU_FuelSenderResistVal 0 "Default(no data)" 1 "0x1~0x1FFE:0.1~819.0(Ω)" 8190 "0x1~0x1FFE:0.1~819.0(Ω)" 8191 "Invalid" ;
VAL_ 293 SAS_AnglVal 0 "0x0x0000~0x7FFE:real value" 32766 "0x0x0000~0x7FFE:real value" 32767 "Error Indicator" 32768 "0x8000~0xFFFF:real value" 65535 "0x8000~0xFFFF:real value" ;
VAL_ 293 SAS_SpdVal 0 "0x0x00~0xFE:real value" 254 "0x0x00~0xFE:real value" 255 "Error Indicator" ;
VAL_ 293 SAS_IntSta 0 "real vaule" 1 "real vaule" 2 "real vaule" 3 "real vaule" 4 "real vaule" 5 "real vaule" 6 "real vaule" 7 "real vaule" 8 "real vaule" 9 "real vaule" 10 "real vaule" 11 "real vaule" 12 "real vaule" 13 "real vaule" 14 "real vaule" 15 "real vaule" 16 "0x10~0xFF:RESERVED" 255 "0x10~0xFF:RESERVED" ;
VAL_ 53 VCU_Crc1Val 0 "0x0x0~0xFFFF:CRCValue" 65535 "0x0x0~0xFFFF:CRCValue" ;
VAL_ 53 VCU_ScuKeepWakeReq 0 "None" 1 "Keep Wake Request" 2 "Not used" 3 "Error Indicator" ;
VAL_ 53 VCU_FmcuZeroTqOfsReq 0 "No Request" 1 "Request" 2 "Not used" 3 "Error Indicator" ;
VAL_ 53 VCU_EcmSeqSta 0 "IG Off" 1 "IG On_PowerLatch" 2 "IG On Init" 3 "IG On_Rdy" 4 "IG On_Drivalble" 5 "IG On_PD" 6 "IGON_NonDrivable" ;
VAL_ 53 VCU_AlvCnt1Val 0 "0x0x0~0xFF:AlvCntValue" 255 "0x0x0~0xFF:AlvCntValue" ;
VAL_ 53 VCU_MainBattTypeSta 0 "Short Range Type" 1 "Standard Range Type" 2 "Long Range Type" 3 "Not Used" ;
VAL_ 53 VCU_MainBattTypeLrnSta 0 "Unlearnt" 1 "Learnt" 2 "Not used" 3 "Error Indicator" ;
VAL_ 53 VCU_WarmupCycSta 0 "None" 1 "Warm-up Cycle Completed" 2 "Not used" 3 "Error Indicator" ;
VAL_ 53 VCU_GearPosStaDisp 0 "P" 1 "B" 2 "Not Used" 3 "Not Used" 4 "Not Used" 5 "D" 6 "N" 7 "R" 8 "Not Used" 9 "Not Display at Cluster" 10 "Reserved" 11 "Reserved" 12 "Manual Shift Mode on Retromode" 13 "Reserved" 14 "Intermediate Position" 15 "Fault" ;
VAL_ 53 VCU_PdlStopCtrlSta 0 "No Request" 1 "Target brake torque control request" 2 "AVH request" 3 "AVH working" ;
VAL_ 53 VCU_PdlStopReqTqNmVal 0 "0x0x0~0xFFFF:Request brake torque for stop assist control" 65535 "0x0x0~0xFFFF:Request brake torque for stop assist control" ;
VAL_ 53 VCU_PMPDActSta 0 "Off" 1 "PMPD ON - Torque Limitation" 2 "PMPD ON - Brake Act" 3 "PMPD Inactive" ;
VAL_ 53 VCU_PMPDWarnSta 0 "default" 1 "reactivate" 2 "temporary off" 3 "off by system fault" ;
VAL_ 53 VCU_VgsVirSoundBackFireIndex 0 "No Action Status" 1 "Tip-Out Back Fire Lv1 ~ Lv8" 2 "Tip-Out Back Fire Lv1 ~ Lv8" 3 "Tip-Out Back Fire Lv1 ~ Lv8" 4 "Tip-Out Back Fire Lv1 ~ Lv8" 5 "Tip-Out Back Fire Lv1 ~ Lv8" 6 "Tip-Out Back Fire Lv1 ~ Lv8" 7 "Tip-Out Back Fire Lv1 ~ Lv8" 8 "Tip-Out Back Fire Lv1 ~ Lv8" 17 "Bubbling Sound Lv1 ~ Lv8" 18 "Bubbling Sound Lv1 ~ Lv8" 19 "Bubbling Sound Lv1 ~ Lv8" 20 "Bubbling Sound Lv1 ~ Lv8" 21 "Bubbling Sound Lv1 ~ Lv8" 22 "Bubbling Sound Lv1 ~ Lv8" 23 "Bubbling Sound Lv1 ~ Lv8" 24 "Bubbling Sound Lv1 ~ Lv8" 9 "Upshift BANG Sound Lv1 ~ Lv8" 10 "Upshift BANG Sound Lv1 ~ Lv8" 11 "Upshift BANG Sound Lv1 ~ Lv8" 12 "Upshift BANG Sound Lv1 ~ Lv8" 13 "Upshift BANG Sound Lv1 ~ Lv8" 14 "Upshift BANG Sound Lv1 ~ Lv8" 15 "Upshift BANG Sound Lv1 ~ Lv8" 16 "Upshift BANG Sound Lv1 ~ Lv8" ;
VAL_ 53 VCU_VgsVirEngSpdRpmVal 0 "0x0x0~0x7FFE:RPM" 32766 "0x0x0~0x7FFE:RPM" 32767 "Error Indicator" ;
VAL_ 53 VCU_RdySta 0 "None" 1 "VCU Control Board Ready" 2 "Not used" 3 "Error Indicator" ;
VAL_ 53 VCU_VgsVirSoundVolume 0 "0x0x0~0xFE:0~100%" 254 "0x0x0~0xFE:0~100%" 0 "0x0~0xFF:Invalid Error" 255 "0x0~0xFF:Invalid Error" ;
VAL_ 53 VCU_VgsVirGearStep 0 "Not Used" 1 "1gear" 2 "2gear" 3 "3gear" 4 "4gear" 5 "5gear" 6 "6gear" 7 "7gear" 8 "8gear" 9 "Reserved" 10 "Reserved" 11 "Reserved" 12 "Reserved" 13 "Reserved" 14 "Reserved" 15 "Reserved" ;
VAL_ 53 VCU_StandbyModSta 0 "Standby Mode Off" 1 "Standby Mode without HV Request" 2 "Standby Mode with HV Request" 3 "RESERVED" ;
VAL_ 53 VCU_HVIntLkDischrgReq 0 "Not Request(Default)" 1 "Request" 2 "RESERVED" 3 "Error Indicator" ;
VAL_ 53 VCU_StartKeyHoldSta 0 "None" 1 "Start" 2 "Not used" 3 "Error Indicator" ;
VAL_ 53 VCU_EvDrvRdySta 0 "None" 1 "EV Drivable" 2 "Not used" 3 "Error Indicator" ;
VAL_ 53 VCU_MotPwrEnReq 0 "None" 1 "Allow Motor System to Control" 2 "Not used" 3 "Error Indicator" ;
VAL_ 53 VCU_GearPosSta 0 "P" 1 "B" 2 "Not Used" 3 "Not Used" 4 "Not Used" 5 "D" 6 "N" 7 "R" 8 "Not Used" 9 "Not Display at Cluster" 10 "Reserved" 11 "Reserved" 12 "Reserved" 13 "Reserved" 14 "Intermediate Position" 15 "Fault" ;
VAL_ 53 VCU_LdcInhReq 0 "None" 1 "LDC Off Request" 2 "Not used" 3 "Error Indicator" ;
VAL_ 53 VCU_MainRlyOffReq 0 "None" 1 "Relay Cut Off" 2 "Not used" 3 "Error Indicator" ;
VAL_ 53 VCU_AccPedDepVal 255 "Error Indicator" ;
VAL_ 53 VCU_FatcOperPermSta 0 "Not Permiited" 1 "Permitted" 2 "Not used" 3 "Error Indicator" ;
VAL_ 53 VCU_DrvCycSta 0 "No Driving Cycle Active" 1 "Driving Cycle Active" 2 "Not used" 3 "Error Indicator" ;
VAL_ 53 VCU_CltActOpSta 0 "Neutral" 1 "Actuating" 2 "In Gear" 3 "Referencing" 4 "Fault" ;
VAL_ 53 VCU_WhlSpdSnsrAlvReq 0 "No Request" 1 "Alive Request" 2 "Not used" 3 "Error Indicator" ;
VAL_ 53 VCU_DrvModOpSta 0 "Eco" 1 "Normal" 2 "Sport" 3 "Sport+" 4 "RESERVED" 5 "Snow" 6 "Sand" 7 "Mud" 8 "Chauffeur" 9 "Easy" 10 "RESERVED" 11 "RESERVED" 12 "RESERVED" 13 "RESERVED" 14 "RESERVED" 15 "RESERVED" ;
VAL_ 53 VCU_HydBrkFcHoldRq 0 "None" 1 "Hold Request" 2 "Reserved" 3 "Error" ;
VAL_ 53 VCU_McuAntiJerkInhFrntSta 0 "Anti-jerk Not Inhibit" 1 "Anti-jerk Inhibit" 2 "Not used" 3 "Error Indicator" ;
VAL_ 53 VCU_McuAntiJerkInhRearSta 0 "Anti-jerk Not Inhibit" 1 "Anti-jerk Inhibit" 2 "Not used" 3 "Error Indicator" ;
VAL_ 53 VCU_McuPwrLatchHoldReq 0 "No Request" 1 "Power Latch Hold Request" 2 "Not used" 3 "Error Indicator" ;
VAL_ 53 VCU_ScuParkReq 0 "Wait Command" 1 "Not used" 2 "Parking Command" 3 "Not Parking Command" ;
