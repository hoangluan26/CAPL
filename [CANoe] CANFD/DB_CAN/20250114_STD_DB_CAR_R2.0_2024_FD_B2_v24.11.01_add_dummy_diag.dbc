VERSION ""

NS_ :

BS_:

BU_: SHVU_CCS_FD ARS_FD WPC_FD WPC2_FD SCM_FD SHVU_FRNT_FD GW_SAU_DRV_FD ATS_FD PSB_FD GW_PSU_RR_FD SHVU_RL_FD RWPC_FD CGW_CCU SHVU_REAR_FD OHCL_FD BLTN_CAM_FD GW_PSU_DRV_FD FCS_FD GW_PSU_AST_FD GW_PSU_3RD_FD RCS_FD SHVU_3RD_FD GW_PSU_RL_FD SHVU_RR_FD RCM_FD SGU_FD DCM_FD

BO_ 996 PDC_FD_10_200ms: 16 CGW_CCU
 SG_ PDC_FD_Crc10Val : 0|16@1+ (1,0) [0|0] ""  GW_PSU_DRV_FD
 SG_ PDC_PwrOnModePowerReq : 107|2@1+ (1,0) [0|0] "" Vector__XXX
 SG_ PDC_LeadAcidBatType : 109|5@1+ (1,0) [0|0] "" Vector__XXX
 SG_ PDC_BatPwrClassOpt : 114|2@1+ (1,0) [0|0] "" Vector__XXX
 SG_ PDC_MainLBMOpt : 116|2@1+ (1,0) [0|0] ""  BLTN_CAM_FD
 SG_ PDC_FD_AlvCnt10Val : 16|8@1+ (1,0) [0|0] ""  GW_PSU_DRV_FD
 SG_ ICU_PowerAutoCutModSta : 64|2@1+ (1,0) [0|0] ""  BLTN_CAM_FD,GW_PSU_3RD_FD,GW_PSU_AST_FD,GW_PSU_DRV_FD,GW_PSU_RL_FD,GW_PSU_RR_FD,SHVU_3RD_FD,SHVU_CCS_FD,SHVU_FRNT_FD,SHVU_REAR_FD,SHVU_RL_FD,SHVU_RR_FD
 SG_ Autocut_DlvryModSta : 66|2@1+ (1,0) [0|0] "" Vector__XXX
 SG_ ICU_SoCBattStaMsgReq : 68|2@1+ (1,0) [0|0] "" Vector__XXX
 SG_ Batt_SoCWarningValue : 70|8@1+ (1,0) [0|0] "%" Vector__XXX
 SG_ ICU_BattAutoCutPreWrng : 78|2@1+ (1,0) [0|0] ""  BLTN_CAM_FD
 SG_ OTAModeACCOffReq : 80|2@1+ (1,0) [0|0] "" Vector__XXX
 SG_ C_ICUIGNOffReq : 82|2@1+ (1,0) [0|0] "" Vector__XXX
 SG_ IGN_AutoOff_WarnSta : 84|2@1+ (1,0) [0|0] "" Vector__XXX
 SG_ IGN_AutoOff_WarnSta_CLU : 86|2@1+ (1,0) [0|0] "" Vector__XXX
 SG_ PDC_BatPwrStateClassA : 88|2@1+ (1,0) [0|0] "" Vector__XXX
 SG_ PDC_BatPwrStateClassB : 90|2@1+ (1,0) [0|0] "" Vector__XXX
 SG_ PDC_BatPwrStateClassC : 92|2@1+ (1,0) [0|0] "" Vector__XXX
 SG_ PLBMAvailableState : 94|1@1+ (1,0) [0|0] "" Vector__XXX
 SG_ Bat_dischrg : 95|2@1+ (1,0) [0|0] "" Vector__XXX
 SG_ Bat12V_Chr_Req : 97|2@1+ (1,0) [0|0] ""  BLTN_CAM_FD
 SG_ ICU_BattMngAlert : 99|8@1+ (1,0) [0|0] "" Vector__XXX

BO_ 1047 GNSS_05_1000ms: 32 CGW_CCU
 SG_ GNSS_Crc5Val : 0|16@1+ (1,0) [0|0] "" Vector__XXX
 SG_ HU_GNSS_UTC_min : 104|8@1+ (1,0) [0|0] ""  BLTN_CAM_FD
 SG_ HU_GNSS_UTC_sec : 112|8@1+ (1,0) [0|0] ""  BLTN_CAM_FD
 SG_ HU_GNSS_UTC_offset : 120|8@1+ (1,0) [0|0] "Sec"  BLTN_CAM_FD
 SG_ HU_GNSS_PDOP : 128|16@1+ (0.00390625,0) [0|0] "" Vector__XXX
 SG_ HU_GNSS_HDOP : 144|16@1+ (0.00390625,0) [0|0] "" Vector__XXX
 SG_ GNSS_AlvCnt5Val : 16|8@1+ (1,0) [0|0] "" Vector__XXX
 SG_ HU_GNSS_VDOP : 160|16@1+ (0.00390625,0) [0|0] "" Vector__XXX
 SG_ HU_GNSS_DGPS_age : 192|8@1+ (1,0) [0|0] "Sec" Vector__XXX
 SG_ HU_GNSS_Fix_status : 200|4@1+ (1,0) [0|0] "" Vector__XXX
 SG_ HU_GNSS_TimeSource : 204|2@1+ (1,0) [0|0] "" Vector__XXX
 SG_ HU_GNSS_search : 206|2@1+ (1,0) [0|0] "" Vector__XXX
 SG_ HU_GNSS_DST : 208|2@1+ (1,0) [0|0] ""  BLTN_CAM_FD
 SG_ HU_GNSS_SV_count : 210|8@1+ (1,0) [0|0] "" Vector__XXX
 SG_ HU_GNSS_TimezoneOffset : 218|8@1- (15,0) [0|0] "minute"  BLTN_CAM_FD
 SG_ HU_GNSS_UTC_year : 64|16@1+ (1,0) [0|0] ""  BLTN_CAM_FD
 SG_ HU_GNSS_UTC_month : 80|8@1+ (1,0) [0|0] ""  BLTN_CAM_FD
 SG_ HU_GNSS_UTC_day : 88|8@1+ (1,0) [0|0] ""  BLTN_CAM_FD
 SG_ HU_GNSS_UTC_hour : 96|8@1+ (1,0) [0|0] ""  BLTN_CAM_FD

BO_ 849 IAU_FD_04_200ms: 32 CGW_CCU
 SG_ IAU_FD_Crc4Val : 0|16@1+ (1,0) [0|0] "0"  GW_PSU_DRV_FD
 SG_ IAU_DISPWrng : 104|4@1+ (1,0) [0|0] "" Vector__XXX
 SG_ IAU_DigitalKey2Opt : 120|3@1+ (1,0) [0|0] ""  WPC2_FD,WPC_FD
 SG_ IAUwFRULearnState : 124|2@1+ (1,0) [0|0] "" Vector__XXX
 SG_ IAUwFPMLearnState : 126|2@1+ (1,0) [0|0] "" Vector__XXX
 SG_ IAU_ValetDigitalkey : 128|2@1+ (1,0) [0|0] "" Vector__XXX
 SG_ IAU_DigitalKeyNumberOpt : 130|3@1+ (1,0) [0|0] "" Vector__XXX
 SG_ IAU_eSEReprogramSta : 133|2@1+ (1,0) [0|0] "" Vector__XXX
 SG_ IAU_DKOwnerSwapOption : 136|2@1+ (1,0) [0|0] "" Vector__XXX
 SG_ IAU_DgtKeyGrpPrflRval2 : 139|5@1+ (1,0) [0|0] "" Vector__XXX
 SG_ IAU_StartIdentifiedProfile : 144|3@1+ (1,0) [0|0] "" Vector__XXX
 SG_ IAU_DigitalKeyProfileRval2 : 147|5@1+ (1,0) [0|0] "" Vector__XXX
 SG_ IAU_NFCCard1SN : 152|32@1+ (1,0) [0|0] "" Vector__XXX
 SG_ IAU_FD_AlvCnt4Val : 16|8@1+ (1,0) [0|0] "0"  GW_PSU_DRV_FD
 SG_ IAU_UWBOnOffOpt : 200|2@1+ (1,0) [0|0] "" Vector__XXX
 SG_ IAU_UWBOnOffRVal : 202|2@1+ (1,0) [0|0] "" Vector__XXX
 SG_ IAU_StartIdentifiedProfile_Ext : 24|4@1+ (1,0) [0|0] "" Vector__XXX
 SG_ RSPA_UWBRspaExtRngSta : 246|2@1+ (1,0) [0|0] "" Vector__XXX
 SG_ RSPA_CanFltSta : 250|2@1+ (1,0) [0|0] "" Vector__XXX
 SG_ RSPA_BLESigErrSta : 252|2@1+ (1,0) [0|0] "" Vector__XXX
 SG_ RSPA_ConStat : 254|2@1+ (1,0) [0|0] "" Vector__XXX
 SG_ IAU_ProfileIDRVal : 74|4@1+ (1,0) [0|0] ""  BLTN_CAM_FD,GW_PSU_DRV_FD,GW_SAU_DRV_FD,RCM_FD,RWPC_FD,SGU_FD,WPC2_FD,WPC_FD
 SG_ IAU_DigitalKeyProcessingSta : 80|4@1+ (1,0) [0|0] "" Vector__XXX
 SG_ IAU_DigitalKeyExit : 84|4@1+ (1,0) [0|0] "" Vector__XXX
 SG_ IAU_DigitalKeyEnblRVal : 88|2@1+ (1,0) [0|0] "" Vector__XXX
 SG_ IAU_OwnerPhnRegRVal : 90|2@1+ (1,0) [0|0] "" Vector__XXX
 SG_ IAU_NFCCard1RegRVal : 92|2@1+ (1,0) [0|0] "" Vector__XXX
 SG_ IAU_NFCCard2RegRVal : 94|2@1+ (1,0) [0|0] "" Vector__XXX

BO_ 101 IEB_01_10ms: 32 CGW_CCU
 SG_ IEB_Crc1Val : 0|16@1+ (1,0) [0|0] "" Vector__XXX
 SG_ IEB_StrkDpthPcVal : 104|8@1+ (0.39215,0) [0|0] "%"  BLTN_CAM_FD
 SG_ IEB_EstDpthPcVal : 112|8@1+ (0.390625,0) [0|0] "%" Vector__XXX
 SG_ IEB_AbsNGearReq : 120|2@1+ (1,0) [0|0] "" Vector__XXX
 SG_ IEB_EstBrkPdlValVldSta : 122|2@1+ (1,0) [0|0] "" Vector__XXX
 SG_ IEB_FRAmode_Req : 124|2@1+ (1,0) [0|0] "" Vector__XXX
 SG_ IEB_DriftEscModSta_VDC : 126|2@1+ (1,0) [0|0] "" Vector__XXX
 SG_ IEB_RegenTqLimitNmVal_Rear : 128|16@1+ (1,0) [0|0] "Nm" Vector__XXX
 SG_ IEB_DrvWhlSlipFlg_Frnt : 144|1@1+ (1,0) [0|0] "" Vector__XXX
 SG_ IEB_IndDriftMode : 145|3@1+ (1,0) [0|0] "" Vector__XXX
 SG_ IEB_IndDriftEcsModSta : 148|2@1+ (1,0) [0|0] "" Vector__XXX
 SG_ IEB_IndDriftElsdModSta : 150|2@1+ (1,0) [0|0] "" Vector__XXX
 SG_ IEB_TCS_Req : 152|2@1+ (1,0) [0|0] "" Vector__XXX
 SG_ IEB_RSC_Req : 154|2@1+ (1,0) [0|0] "" Vector__XXX
 SG_ TCS_TqFlag_Frnt : 156|1@1+ (1,0) [0|0] "" Vector__XXX
 SG_ TCS_TqFlag_Rear : 157|1@1+ (1,0) [0|0] "" Vector__XXX
 SG_ RSC_TqFlag_Frnt : 158|1@1+ (1,0) [0|0] "" Vector__XXX
 SG_ RSC_TqFlag_Rear : 159|1@1+ (1,0) [0|0] "" Vector__XXX
 SG_ IEB_AlvCnt1Val : 16|8@1+ (1,0) [0|0] "" Vector__XXX
 SG_ TCS_TqIntrvntnVal_Frnt : 160|8@1+ (0.390625,0) [0|0] "%" Vector__XXX
 SG_ TCS_TqIntrvntnVal_Rear : 168|8@1+ (0.390625,0) [0|0] "%" Vector__XXX
 SG_ RSC_TqIntrvntnVal_Frnt : 176|8@1+ (0.390625,0) [0|0] "%" Vector__XXX
 SG_ RSC_TqIntrvntnVal_Rear : 184|8@1+ (0.390625,0) [0|0] "%" Vector__XXX
 SG_ TCS_MtrTrgtRpm_Flag_Frnt : 192|1@1+ (1,0) [0|0] "" Vector__XXX
 SG_ TCS_MtrTrgtRpm_Flag_Rear : 193|1@1+ (1,0) [0|0] "" Vector__XXX
 SG_ IEB_DriftElsdModSta : 194|2@1+ (1,0) [0|0] "" Vector__XXX
 SG_ IEB_DriftEcsModSta : 196|2@1+ (1,0) [0|0] "" Vector__XXX
 SG_ IEB_DriftMdpsModSta : 198|2@1+ (1,0) [0|0] "" Vector__XXX
 SG_ TCS_MtrTrgtRpm_Frnt : 200|12@1+ (8,0) [0|0] "rpm" Vector__XXX
 SG_ TCS_MtrTrgtRpm_Rear : 212|12@1+ (8,0) [0|0] "rpm" Vector__XXX
 SG_ IEB_DriftModeSta : 224|2@1+ (1,0) [0|0] "" Vector__XXX
 SG_ IEB_DriftModeActSta : 226|2@1+ (1,0) [0|0] "" Vector__XXX
 SG_ MCU_AntiJerk_Inhbtsta : 230|1@1+ (1,0) [0|0] "" Vector__XXX
 SG_ IEB_Motor_ProtectModSta : 231|1@1+ (1,0) [0|0] "" Vector__XXX
 SG_ IEB_EstBrkSacFrcNmVal : 232|16@1+ (1,0) [0|0] "" Vector__XXX
 SG_ IEB_SrvLmpDis : 24|2@1+ (1,0) [0|0] "" Vector__XXX
 SG_ IEB_IndDriftEscModSta_TCS : 248|4@1+ (1,0) [0|0] "" Vector__XXX
 SG_ IEB_IndDriftEscModSta_VDC : 252|4@1+ (1,0) [0|0] "" Vector__XXX
 SG_ IEB_DfctvSta : 26|2@1+ (1,0) [0|0] "" Vector__XXX
 SG_ IEB_ActvSta : 28|2@1+ (1,0) [0|0] "" Vector__XXX
 SG_ IEB_DiagSta : 30|2@1+ (1,0) [0|0] "" Vector__XXX
 SG_ IEB_WrngLmpDis : 32|2@1+ (1,0) [0|0] "" Vector__XXX
 SG_ IEB_MILReq : 34|2@1+ (1,0) [0|0] "" Vector__XXX
 SG_ IEB_DriftModeStaDis : 36|3@1+ (1,0) [0|0] "" Vector__XXX
 SG_ RSC_Sta : 39|1@1+ (1,0) [0|0] "" Vector__XXX
 SG_ IEB_StrkDpthmmVal : 40|16@1- (0.1,0) [0|0] "mm" Vector__XXX
 SG_ IEB_BrkActvSta : 56|2@1+ (1,0) [0|0] ""  BLTN_CAM_FD
 SG_ IEB_PdlTrvlSnsrFailSta : 58|2@1+ (1,0) [0|0] "" Vector__XXX
 SG_ IEB_PdlCalibSta : 60|2@1+ (1,0) [0|0] "" Vector__XXX
 SG_ IEB_BzrSta : 62|2@1+ (1,0) [0|0] "" Vector__XXX
 SG_ IEB_Sta : 64|2@1+ (1,0) [0|0] "" Vector__XXX
 SG_ IEB_SnsrFailSta : 66|2@1+ (1,0) [0|0] "" Vector__XXX
 SG_ IEB_RbsWrngLmpSta : 68|2@1+ (1,0) [0|0] "" Vector__XXX
 SG_ IEB_VacSysDfctvSta : 70|2@1+ (1,0) [0|0] "" Vector__XXX
 SG_ IEB_RegenTqLimitNmVal_Frnt : 72|16@1+ (1,0) [0|0] "Nm" Vector__XXX
 SG_ IEB_EstTtlBrkFrcNmVal : 88|16@1+ (1,0) [0|0] "Nm" Vector__XXX

BO_ 704 VCU_06_200ms: 32 CGW_CCU
 SG_ VCU_Crc6Val : 0|16@1+ (1,0) [0|0] ""  GW_PSU_DRV_FD
 SG_ VCU_BstWarnMsg : 105|2@1+ (1,0) [0|0] ""  GW_PSU_DRV_FD,GW_SAU_DRV_FD,PSB_FD
 SG_ VCU_BstAvailSta : 107|2@1+ (1,0) [0|0] ""  BLTN_CAM_FD,GW_SAU_DRV_FD
 SG_ VCU_BstAplySta : 109|2@1+ (1,0) [0|0] ""  BLTN_CAM_FD,GW_SAU_DRV_FD
 SG_ VCU_MxPwrMdSta : 112|2@1+ (1,0) [0|0] "" Vector__XXX
 SG_ VCU_MxPwrMdSegVal : 114|5@1+ (5,0) [0|0] "" Vector__XXX
 SG_ VCU_MxPwrMdOSD : 119|3@1+ (1,0) [0|0] "" Vector__XXX
 SG_ VCU_PwrDnByHoodOpenSta : 122|2@1+ (1,0) [0|0] "" Vector__XXX
 SG_ VCU_FlatTowModeConIndSta : 124|4@1+ (1,0) [0|0] "" Vector__XXX
 SG_ VCU_VgsVirAGIUpGear : 128|4@1+ (1,0) [0|0] "" Vector__XXX
 SG_ VCU_VgsVirAGIDnGear : 132|4@1+ (1,0) [0|0] "" Vector__XXX
 SG_ VCU_NCstmBrkOvrSta : 136|2@1+ (1,0) [0|0] "" Vector__XXX
 SG_ VCU_NCondDragSta : 138|2@1+ (1,0) [0|0] ""  BLTN_CAM_FD
 SG_ VCU_NCondDragSegVal : 140|5@1+ (5,0) [0|0] ""  BLTN_CAM_FD
 SG_ VCU_NCondTrackSta : 145|2@1+ (1,0) [0|0] ""  BLTN_CAM_FD
 SG_ VCU_NCondTrackTimeVal : 147|6@1+ (1,0) [0|0] ""  BLTN_CAM_FD
 SG_ VCU_NCondOSD : 153|3@1+ (1,0) [0|0] ""  BLTN_CAM_FD
 SG_ VCU_ExpUnitEnrgCnsmptnVal : 156|8@1+ (10,0) [0|0] "" Vector__XXX
 SG_ VCU_AlvCnt6Val : 16|8@1+ (1,0) [0|0] ""  GW_PSU_DRV_FD
 SG_ VCU_FlatTowModeChgPwrUsmSta : 164|3@1+ (1,0) [0|0] "" Vector__XXX
 SG_ VCU_NCstmHighPefMdWarnMsg : 167|4@1+ (1,0) [0|0] "" Vector__XXX
 SG_ VCU_NCstmNtdUsmSta : 171|2@1+ (1,0) [0|0] "" Vector__XXX
 SG_ VCU_EstRoadSlopeValue : 173|8@1- (1,0) [0|0] "%" Vector__XXX
 SG_ VCU_DteV2LVal : 181|11@1+ (1,0) [0|2047] "km" Vector__XXX
 SG_ VCU_TrgFuelEcoVal_PerkWh : 192|8@1+ (0.1,0) [0|0] "km/kWh" Vector__XXX
 SG_ VCU_FlatTowModeUsmSta : 200|3@1+ (1,0) [0|0] "" Vector__XXX
 SG_ VCU_FlatTowModeEquip : 203|2@1+ (1,0) [0|0] "" Vector__XXX
 SG_ VCU_MaintenanceSrvMd : 205|2@1+ (1,0) [0|0] "" Vector__XXX
 SG_ VCU_DteQcChrgStsVal : 207|11@1+ (1,0) [0|2047] "km" Vector__XXX
 SG_ VCU_CnvrtPermPwrVal : 218|10@1+ (20,0) [0|12700] "W" Vector__XXX
 SG_ VCU_CnvrtOpPermSta : 228|2@1+ (1,0) [0|3] "" Vector__XXX
 SG_ VCU_ARSPosition : 230|3@1+ (1,0) [0|0] "flag" Vector__XXX
 SG_ VCU_AccelBoostOnOffSta : 233|2@1+ (1,0) [0|0] "" Vector__XXX
 SG_ VCU_DteGuideVal : 235|11@1+ (1,0) [0|2047] "km" Vector__XXX
 SG_ VCU_Required_ADASMapMsg : 24|16@1+ (1,0) [0|0] "" Vector__XXX
 SG_ VCU_HvBatAutoDchOpSta : 246|2@1+ (1,0) [0|0] "" Vector__XXX
 SG_ VCU_UtilModeWarnAddMsgSta : 248|3@1+ (1,0) [0|0] ""  ATS_FD
 SG_ VCU_TowModSta : 251|2@1+ (1,0) [0|0] "" Vector__XXX
 SG_ VCU_TowLvlSta : 253|3@1+ (1,0) [0|0] "" Vector__XXX
 SG_ VCU_SwVer : 40|8@1+ (1,0) [0|0] "" Vector__XXX
 SG_ VCU_PwrAutoOffInfo : 48|2@1+ (1,0) [0|0] "" Vector__XXX
 SG_ VCU_PwrAutoOffTimerSta : 50|3@1+ (1,0) [0|0] "" Vector__XXX
 SG_ VCU_FlatTowModeTargetSocUsmSta : 53|3@1+ (1,0) [0|0] "" Vector__XXX
 SG_ VCU_AutoShutOffTimerMin : 56|8@1+ (1,0) [0|0] "" Vector__XXX
 SG_ VCU_AutoShutOffTimerSec : 64|6@1+ (1,0) [0|0] "" Vector__XXX
 SG_ VCU_PwrAutoOffTimerReset : 70|2@1+ (1,0) [0|0] "" Vector__XXX
 SG_ VCU_AutoShutOffReq : 72|4@1+ (1,0) [0|0] "" Vector__XXX
 SG_ VCU_DrvInfoPageOptSta : 76|2@1+ (1,0) [0|0] "" Vector__XXX
 SG_ VCU_TireSizeWrnMsgSta : 78|2@1+ (1,0) [0|0] "" Vector__XXX
 SG_ VCU_FrntTqDispPcVal : 80|8@1- (1,0) [0|0] ""  BLTN_CAM_FD
 SG_ VCU_RearTqDispPcVal : 88|8@1- (1,0) [0|0] ""  BLTN_CAM_FD
 SG_ VCU_BstOpSta : 96|3@1+ (1,0) [0|0] ""  BLTN_CAM_FD,GW_SAU_DRV_FD,PSB_FD
 SG_ VCU_BstTimerVal : 99|6@1+ (1,0) [0|0] ""  GW_SAU_DRV_FD,PSB_FD

BO_ 979 BDC_FD_04_200ms: 32 CGW_CCU
 SG_ BDC_FD_Crc4Val : 0|16@1+ (1,0) [0|0] "" Vector__XXX
 SG_ BDC_FD_AlvCnt4Val : 16|8@1+ (1,0) [0|0] "" Vector__XXX
 SG_ BAlarm_BglrAlrm_CurrentSta : 24|4@1+ (1,0) [0|0] ""  BLTN_CAM_FD
 SG_ BAlarm_BglrAlrm_Sta : 28|2@1+ (1,0) [0|0] "" Vector__XXX
 SG_ BAlarm_PncAlrmSta : 30|2@1+ (1,0) [0|0] "" Vector__XXX
 SG_ SBR_StBltStpWrngBzrSta : 34|3@1+ (1,0) [0|0] "" Vector__XXX
 SG_ SBR_StBltWrngBzrSta : 37|3@1+ (1,0) [0|0] "" Vector__XXX
 SG_ BAlarm_BrglrHrnRlySta : 40|2@1+ (1,0) [0|0] "" Vector__XXX
 SG_ SBR_DrvStBltIndSta : 42|2@1+ (1,0) [0|0] ""  PSB_FD
 SG_ SBR_RrLftStBltWrngIndSta : 44|2@1+ (1,0) [0|0] ""  PSB_FD
 SG_ SBR_RrRtStBltWrngIndSta : 46|2@1+ (1,0) [0|0] ""  PSB_FD
 SG_ SBR_RrCtrStBltIndSta : 48|2@1+ (1,0) [0|0] ""  PSB_FD
 SG_ SBR_3rdLftStBltWrngIndSta : 50|2@1+ (1,0) [0|0] ""  PSB_FD
 SG_ SBR_3rdRtStBltWrngIndSta : 52|2@1+ (1,0) [0|0] ""  PSB_FD
 SG_ SBR_3rdCtrStBltWrngIndSta : 54|2@1+ (1,0) [0|0] ""  PSB_FD
 SG_ Warn_BzrWrngSta : 56|4@1+ (1,0) [0|0] "" Vector__XXX
 SG_ Warn_BCMWrngSta : 60|4@1+ (1,0) [0|0] "" Vector__XXX
 SG_ ROA_RrBlwAutoOffReq : 64|2@1+ (1,0) [0|0] "" Vector__XXX
 SG_ ROA_RegionOpt : 66|2@1+ (1,0) [0|0] "" Vector__XXX
 SG_ Warn_RrStRmndOpt : 68|2@1+ (1,0) [0|0] "" Vector__XXX
 SG_ Warn_RrStRmndAlrmOnReq : 70|2@1+ (1,0) [0|0] "" Vector__XXX
 SG_ Warn_RrStRmndSysSta : 72|2@1+ (1,0) [0|0] "" Vector__XXX
 SG_ Warn_RrStRmndAlrmInfo : 74|3@1+ (1,0) [0|0] "" Vector__XXX
 SG_ Warn_RoaErr : 77|3@1+ (1,0) [0|0] "" Vector__XXX
 SG_ Warn_RrStRmndDelay : 80|2@1+ (1,0) [0|0] "" Vector__XXX
 SG_ Warn_RrStRmndSysAct : 82|2@1+ (1,0) [0|0] "" Vector__XXX
 SG_ WAL_FobSearching : 84|2@1+ (1,0) [0|0] "" Vector__XXX
 SG_ Warn_RrStRmndSysOffIND : 86|2@1+ (1,0) [0|0] "" Vector__XXX
 SG_ Warn_VehNotPWrngSta : 88|3@1+ (1,0) [0|0] "" Vector__XXX
 SG_ Warn_RrStRmndAlrmInfo_1 : 91|3@1+ (1,0) [0|0] "" Vector__XXX

BO_ 1059 HU_GW_04_1000ms: 16 CGW_CCU
 SG_ HU_GW_Crc4Val : 0|16@1+ (1,0) [0|0] "" Vector__XXX
 SG_ CF_AVN_AutoWashModeSta : 101|3@1+ (1,0) [0|0] "" Vector__XXX
 SG_ HU_ResetOpSta : 104|2@1+ (1,0) [0|0] "" Vector__XXX
 SG_ OMUOSMirCtrl_Vr : 110|2@1+ (1,0) [0|0] "" Vector__XXX
 SG_ HU_GW_AlvCnt4Val : 16|8@1+ (1,0) [0|0] "" Vector__XXX
 SG_ HU_Customer_Action_Ind : 24|1@1+ (1,0) [0|0] "" Vector__XXX
 SG_ HU_IG3_Request : 76|2@1+ (1,0) [0|0] "" Vector__XXX
 SG_ HU_DigitalKeyGroupingSupport : 80|2@1+ (1,0) [0|0] "" Vector__XXX
 SG_ HU_Background : 82|3@1+ (1,0) [0|0] ""  ATS_FD,BLTN_CAM_FD
 SG_ HU_BackgroundFadeInOut : 88|10@1+ (0.1,0) [0|0] "%"  ATS_FD,BLTN_CAM_FD

BO_ 983 BDC_FD_08_200ms: 24 CGW_CCU
 SG_ BDC_FD_Crc8Val : 0|16@1+ (1,0) [0|0] "" Vector__XXX
 SG_ Mirror_MnlFldModSta : 102|2@1+ (1,0) [0|0] "" Vector__XXX
 SG_ Mirror_SelSwSta : 112|3@1+ (1,0) [0|0] "" Vector__XXX
 SG_ Mirror_LHPosMnlReq : 115|3@1+ (1,0) [0|0] "" Vector__XXX
 SG_ Mirror_AutoWashModeSta_TypeC : 118|2@1+ (1,0) [0|0] "" Vector__XXX
 SG_ Mirror_RHPosMnlReq : 120|3@1+ (1,0) [0|0] "" Vector__XXX
 SG_ Mirror_LHPosMnlCmd : 124|3@1+ (1,0) [0|0] "" Vector__XXX
 SG_ Mirror_RHPosMnlCmd : 128|3@1+ (1,0) [0|0] "" Vector__XXX
 SG_ Wiper_FrWiperLowAct : 132|2@1+ (1,0) [0|0] "" Vector__XXX
 SG_ Wiper_FrWiperHighAct : 134|2@1+ (1,0) [0|0] "" Vector__XXX
 SG_ Wiper_FrtWiperLowCmd : 136|2@1+ (1,0) [0|0] "" Vector__XXX
 SG_ Wiper_FrtWiperHighCmd : 138|2@1+ (1,0) [0|0] "" Vector__XXX
 SG_ Wiper_RrWiperCmd : 140|2@1+ (1,0) [0|0] "" Vector__XXX
 SG_ Wiper_PowerEnableCmd : 142|2@1+ (1,0) [0|0] "" Vector__XXX
 SG_ Wiper_FrtWasherCmd : 144|2@1+ (1,0) [0|0] "" Vector__XXX
 SG_ Wiper_RrWasherCmd : 146|2@1+ (1,0) [0|0] "" Vector__XXX
 SG_ Wiper_HeadLampWasherCmd : 148|2@1+ (1,0) [0|0] "" Vector__XXX
 SG_ Wiper_AutoWashModeSta_TypeC : 150|2@1+ (1,0) [0|0] "" Vector__XXX
 SG_ Mirror_LHPosMnlPlyCmd : 152|3@1+ (1,0) [0|0] "" Vector__XXX
 SG_ Mirror_RHPosMnlPlyCmd : 155|3@1+ (1,0) [0|0] "" Vector__XXX
 SG_ BDC_FD_AlvCnt8Val : 16|8@1+ (1,0) [0|0] "" Vector__XXX
 SG_ Mirror_LHPosAutoPlyCmd : 160|4@1+ (1,0) [0|0] "" Vector__XXX
 SG_ Mirror_RHPosAutoPlyCmd : 164|4@1+ (1,0) [0|0] "" Vector__XXX
 SG_ Mirror_IMSMemoryCmd : 168|3@1+ (1,0) [0|0] "" Vector__XXX
 SG_ ECW_Overload2 : 171|3@1+ (1,0) [0|0] "" Vector__XXX
 SG_ Mirror_AutoRevModSetSta : 174|2@1+ (1,0) [0|0] "" Vector__XXX
 SG_ Wiper_RainAmount : 24|8@1+ (0.1,0) [0|0] "" Vector__XXX
 SG_ Wiper_AutoWashModeSta : 32|2@1+ (1,0) [0|0] "" Vector__XXX
 SG_ Wiper_PrkngPosSta : 34|2@1+ (1,0) [0|0] ""  BLTN_CAM_FD
 SG_ Wiper_RainSnsrOptionTyp : 36|2@1+ (1,0) [0|0] "" Vector__XXX
 SG_ Wiper_HtWshNzzlCmd : 38|2@1+ (1,0) [0|0] "" Vector__XXX
 SG_ Wiper_RainSnsrSta : 40|4@1+ (1,0) [0|0] ""  BLTN_CAM_FD
 SG_ Wiper_RainSnsrPartNum : 44|4@1+ (1,0) [0|0] "" Vector__XXX
 SG_ ECW_Fault : 48|2@1+ (1,0) [0|0] "" Vector__XXX
 SG_ ECW_FaultActv : 50|2@1+ (1,0) [0|0] "" Vector__XXX
 SG_ ECW_HiVolt : 52|2@1+ (1,0) [0|0] "" Vector__XXX
 SG_ ECW_HiVoltActv : 54|2@1+ (1,0) [0|0] "" Vector__XXX
 SG_ ECW_LoVolt : 56|2@1+ (1,0) [0|0] "" Vector__XXX
 SG_ ECW_LoVoltActv : 58|2@1+ (1,0) [0|0] "" Vector__XXX
 SG_ ECW_Overload : 60|2@1+ (1,0) [0|0] "" Vector__XXX
 SG_ ECW_OverloadActv : 62|2@1+ (1,0) [0|0] "" Vector__XXX
 SG_ ECW_CommErr : 64|2@1+ (1,0) [0|0] "" Vector__XXX
 SG_ BCM_SolSnsrRt : 72|8@1+ (4.72441,0) [0|0] "W/m2" Vector__XXX
 SG_ BCM_SolSnsrLft : 80|8@1+ (4.72441,0) [0|0] "W/m2" Vector__XXX
 SG_ Mirror_MirFldOpt : 88|2@1+ (1,0) [0|0] "" Vector__XXX
 SG_ Mirror_FldUnfldCmd : 90|2@1+ (1,0) [0|0] "" Vector__XXX
 SG_ Mirror_FldCtrlSta : 92|2@1+ (1,0) [0|0] "" Vector__XXX
 SG_ Mirror_UnFldCtrlSta : 94|2@1+ (1,0) [0|0] "" Vector__XXX
 SG_ Mirror_PosMnlCmd : 96|3@1+ (1,0) [0|0] "" Vector__XXX
 SG_ Mirror_SelSwIndCmd : 99|3@1+ (1,0) [0|0] "" Vector__XXX

CM_ BO_ 996 "[PE] Periodic and On Event";
CM_ SG_ 996 PDC_FD_Crc10Val "PDC_FD_CyclicRedundancyCheck10Value";
CM_ SG_ 996 PDC_PwrOnModePowerReq "This is for high voltage battery discharge request at Power On mode of EV";
CM_ SG_ 996 PDC_LeadAcidBatType "Lead Acid Battery Type Information";
CM_ SG_ 996 PDC_MainLBMOpt "M-LBM(Main LBM) Option";
CM_ SG_ 996 PDC_FD_AlvCnt10Val "PDC_FD_AliveCounter10Value";
CM_ SG_ 996 ICU_PowerAutoCutModSta "##2G## -  - CF_Gway_ICUPowerAutoCutMode";
CM_ SG_ 996 Autocut_DlvryModSta "Autocut_DeliveryModeStatus ##2G## -  - C_SJBDeliveryMode,CF_Gway_SJBDeliveryMode";
CM_ SG_ 996 ICU_SoCBattStaMsgReq "##2G## -  - Batt_SoCWarningAlertMsgReq";
CM_ SG_ 996 Batt_SoCWarningValue "Value of SoC warning level. ##2G## -  - Batt_SoCWarningValue";
CM_ SG_ 996 ICU_BattAutoCutPreWrng "This is a warning signal before blocking the dark current of the ICU by the battery SOC.";
CM_ SG_ 996 OTAModeACCOffReq "ACC off request during OTA mode for battery saver";
CM_ SG_ 996 C_ICUIGNOffReq "IGN off request(Not engine running state only) for battery saver";
CM_ SG_ 996 IGN_AutoOff_WarnSta "this signal is defined as the warning signal related with battery discharge";
CM_ SG_ 996 IGN_AutoOff_WarnSta_CLU "this signal is defined as the warning signal related with battery discharge";
CM_ SG_ 996 PDC_BatPwrStateClassA "Vehicle Low-Voltage Power State Class A";
CM_ SG_ 996 PDC_BatPwrStateClassB "Vehicle Low-Voltage Power State Class  B";
CM_ SG_ 996 PDC_BatPwrStateClassC "Vehicle Low-Voltage Power State Class  C";
CM_ SG_ 996 Bat_dischrg "Battery discharge notification flag #2G# Bat_dischrg";
CM_ SG_ 996 Bat12V_Chr_Req "12V lead acid battery charging request signal";
CM_ SG_ 996 ICU_BattMngAlert "This signal is for battery discharge warning.";
CM_ BO_ 1047 "[P] Periodic";
CM_ SG_ 1047 GNSS_Crc5Val "GNSS_CyclicRedundancyCheck5Value";
CM_ SG_ 1047 GNSS_AlvCnt5Val "GNSS_AliveCounter5Value";
CM_ SG_ 1047 HU_GNSS_Fix_status "GNSS fix status";
CM_ SG_ 1047 HU_GNSS_TimeSource "Time Source란 일종의 Module이 출력할 수 있는 시간정보의 유효성레벨을 타나내며, User는 RTC  or GPS(<1ms)  일때만 시간 정보 사용 가능";
CM_ SG_ 1047 HU_GNSS_DST "DST setting";
CM_ SG_ 1047 HU_GNSS_TimezoneOffset "Timezone Offset";
CM_ SG_ 1047 HU_GNSS_UTC_year "UTC year";
CM_ SG_ 1047 HU_GNSS_UTC_hour "UTC_HOUR";
CM_ BO_ 849 "[PE] Periodic and On Event";
CM_ SG_ 849 IAU_FD_Crc4Val "IAU_FD_CyclicRedundancyCheck4Value";
CM_ SG_ 849 IAU_DigitalKey2Opt "Digital Key2 Option Signal";
CM_ SG_ 849 IAU_ValetDigitalkey "Digital Key Valet Mode";
CM_ SG_ 849 IAU_DigitalKeyNumberOpt "This signal is for the digital key number type.";
CM_ SG_ 849 IAU_eSEReprogramSta "this signal is to mornitor the state of eSE reprograming.";
CM_ SG_ 849 IAU_DgtKeyGrpPrflRval2 "This signal indiactes digital key group number paired with selected profile";
CM_ SG_ 849 IAU_StartIdentifiedProfile "This signal Indicate Profile of vehicle start Identified";
CM_ SG_ 849 IAU_DigitalKeyProfileRval2 "This signal indiactes digital key number paired with selected profile";
CM_ SG_ 849 IAU_FD_AlvCnt4Val "IAU_FD_AliveCounter4Value";
CM_ SG_ 849 IAU_StartIdentifiedProfile_Ext "This signal indicate Profile of vehicle start Identified";
CM_ SG_ 849 RSPA_UWBRspaExtRngSta "RSPA remote control range of UWB";
CM_ SG_ 849 RSPA_CanFltSta "RSPA_CANErrorState";
CM_ SG_ 849 RSPA_BLESigErrSta "RSPA_RFSignalErrorState";
CM_ SG_ 849 IAU_ProfileIDRVal "This signal Indicate the Current detected Profile ID by IAU.";
CM_ SG_ 849 IAU_DigitalKeyProcessingSta "Digital Key USM settitng Process State";
CM_ SG_ 849 IAU_DigitalKeyExit "Digital Key USM setting Exit Condition";
CM_ SG_ 849 IAU_DigitalKeyEnblRVal "Digital Key Function Enable / Disable flag (Fob is required for changing flag)";
CM_ SG_ 849 IAU_OwnerPhnRegRVal "Vehicle Owner's Phone is Registered for Digital Key function";
CM_ SG_ 849 IAU_NFCCard1RegRVal "NFC Card 1 is Registered for Digital Key function";
CM_ SG_ 849 IAU_NFCCard2RegRVal "NFC Card 2 is Registered for Digital Key function";
CM_ BO_ 101 "[P] Periodic";
CM_ SG_ 101 IEB_Crc1Val "IEB_CyclicRedundancyCheck1Value";
CM_ SG_ 101 IEB_StrkDpthPcVal "IEB_StrokeDepthPcValue ##2G##ESC - EBS2 - CR_Brk_StkDep_Pc";
CM_ SG_ 101 IEB_EstDpthPcVal "IEB_EstimatedPedalDepthValue ##2G##ESC - EBS2 - CR_Brk_Est_StkDep_Pc";
CM_ SG_ 101 IEB_AbsNGearReq "IEB_AbsNGearRequest ##2G##ESC - TCS11 - CF_Brk_AbsNReq";
CM_ SG_ 101 IEB_EstBrkPdlValVldSta "IEB_EstimatedBrakePedalValueValidityStatus ##2G##ESC - EBS2 - CF_Brk_Est_StkValid";
CM_ SG_ 101 IEB_DriftEscModSta_VDC "ESC/VDC mode command from DMIC by AVNT custom mode select";
CM_ SG_ 101 IEB_RegenTqLimitNmVal_Rear "IEB_RegenTorqueLimitValue Rear";
CM_ SG_ 101 IEB_DrvWhlSlipFlg_Frnt "Slip status of driving wheel ##2G##ESC ? EBS2 ? CF_Brk_DrvWhlSlipFlg";
CM_ SG_ 101 IEB_IndDriftMode "Signal for feedback from AVNT drift mode ON/OFF command";
CM_ SG_ 101 IEB_IndDriftEcsModSta "Signal for feed back of  ECS mode command from DMIC by AVNT custom mode select";
CM_ SG_ 101 IEB_IndDriftElsdModSta "Signal for feed back of ELSD mode command from DMIC by AVNT custom mode select";
CM_ SG_ 101 IEB_TCS_Req "IEB_TCS_Request";
CM_ SG_ 101 IEB_RSC_Req "IEB_RSC_Request";
CM_ SG_ 101 TCS_TqFlag_Frnt "TCS_TorqueFlag_Front";
CM_ SG_ 101 TCS_TqFlag_Rear "TCS_TorqueFlag_Rear";
CM_ SG_ 101 RSC_TqFlag_Frnt "RSC_TorqueFlag_Front";
CM_ SG_ 101 RSC_TqFlag_Rear "RSC_TorqueFlag_Rear";
CM_ SG_ 101 IEB_AlvCnt1Val "IEB_AliveCounter1Value";
CM_ SG_ 101 TCS_TqIntrvntnVal_Frnt "TCS_TorqueInterventionValue_Front";
CM_ SG_ 101 TCS_TqIntrvntnVal_Rear "TCS_TorqueInterventionValue_Rear";
CM_ SG_ 101 RSC_TqIntrvntnVal_Frnt "RSC_TorqueInterventionValue_Front";
CM_ SG_ 101 RSC_TqIntrvntnVal_Rear "RSC_TorqueInterventionValue_Rear";
CM_ SG_ 101 TCS_MtrTrgtRpm_Flag_Frnt "TCS_MotorTargetRPM_Flag_Front";
CM_ SG_ 101 TCS_MtrTrgtRpm_Flag_Rear "TCS_MotorTargetRPM_Flag_Rear";
CM_ SG_ 101 IEB_DriftElsdModSta "ELSD mode command from DMIC by AVNT custom mode select";
CM_ SG_ 101 IEB_DriftEcsModSta "ECS mode command from DMIC by AVNT custom mode select";
CM_ SG_ 101 IEB_DriftMdpsModSta "MDPS mode command from DMIC by AVNT custom mode select";
CM_ SG_ 101 TCS_MtrTrgtRpm_Frnt "TCS_MotorTargetRPM_Front";
CM_ SG_ 101 TCS_MtrTrgtRpm_Rear "TCS_MotorTargetRPM_Rear";
CM_ SG_ 101 IEB_DriftModeSta "Display";
CM_ SG_ 101 IEB_DriftModeActSta "ON/OFF status, Symbol";
CM_ SG_ 101 MCU_AntiJerk_Inhbtsta "MCU_AntiJerk_Inhbtsta is a signal to inform the MCU of anti-jerk control prohibition in order to prevent side effects caused by intervention in the IEB when ABS control and MCU anti-jerk control overlap.";
CM_ SG_ 101 IEB_Motor_ProtectModSta "It is a signal to notify when the internal motor protection mode of the electric integrated booster is activated.";
CM_ SG_ 101 IEB_EstBrkSacFrcNmVal "Estimated brake force value for stop assist control";
CM_ SG_ 101 IEB_SrvLmpDis "IEB_ServiceLampDisplay ##2G##ESC - AHB1 - CF_Ahb_SLmp";
CM_ SG_ 101 IEB_IndDriftEscModSta_TCS "Signal for feed back of TCS mode change from DMIC by AVNT custom mode select";
CM_ SG_ 101 IEB_IndDriftEscModSta_VDC "Signal for feed back of ESC/VDC mode command from DMIC by AVNT custom mode select";
CM_ SG_ 101 IEB_DfctvSta "IEB_DefectiveStatus ##2G##ESC - AHB1 - CF_Ahb_Def";
CM_ SG_ 101 IEB_ActvSta "IEB_ActiveStatus ##2G##ESC - AHB1 - CF_Ahb_Act";
CM_ SG_ 101 IEB_DiagSta "IEB_DiagnosticStatus ##2G##ESC - AHB1 - CF_Ahb_Diag";
CM_ SG_ 101 IEB_WrngLmpDis "IEB_WarningLampDisplay ##2G##ESC - AHB1 - CF_Ahb_WLmp";
CM_ SG_ 101 IEB_MILReq "MIL Requeset";
CM_ SG_ 101 IEB_DriftModeStaDis "This signal is for a pop-up display on restriction status of drift mode activation";
CM_ SG_ 101 RSC_Sta "RSC Ready Status";
CM_ SG_ 101 IEB_StrkDpthmmVal "IEB_StrokeDepthmmValue ##2G##ESC - AHB1 - CR_Ahb_StDep_mm";
CM_ SG_ 101 IEB_BrkActvSta "IEB_BrakeActiveStatus ##2G##ESC - AHB1 - CF_Esc_BrakeAct";
CM_ SG_ 101 IEB_PdlTrvlSnsrFailSta "IEB_PedalTravelSensorFailStatus ##2G##ESC - AHB1 - CF_Ahb_SnsFail";
CM_ SG_ 101 IEB_PdlCalibSta "IEB_PedalCalibrationStatus ##2G##ESC - AHB1 - CF_Ahb_PedalCalStat";
CM_ SG_ 101 IEB_BzrSta "IEB_BuzzerStatus ##2G##ESC - AHB1 - CF_Ahb_Bzzr";
CM_ SG_ 101 IEB_Sta "IEB_Status ##2G##ESC - EBS1 - CF_Brk_EBSStat";
CM_ SG_ 101 IEB_SnsrFailSta "IEB_SensorFailStatus ##2G##ESC - EBS1 - CF_Brk_SnsFail";
CM_ SG_ 101 IEB_RbsWrngLmpSta "IEB_RbsWarningLamp ##2G##ESC - EBS1 - CF_Brk_RBSWLamp";
CM_ SG_ 101 IEB_VacSysDfctvSta "IEB_VacuumSystemDefectiveStatus ##2G##ESC - EBS1 - CF_Brk_VacuumSysDef";
CM_ SG_ 101 IEB_RegenTqLimitNmVal_Frnt "IEB_RegenTorqueLimitValue ##2G##ESC - EBS1 - CR_Brk_RegenTqLimit_Nm";
CM_ SG_ 101 IEB_EstTtlBrkFrcNmVal "IEB_EstimatedTotalBrakeForceValue ##2G##ESC - EBS1 - CR_Brk_EstTot_Nm";
CM_ BO_ 704 "[P] Periodic";
CM_ SG_ 704 VCU_Crc6Val "VCU_CyclicRedundancyCheck6Value";
CM_ SG_ 704 VCU_BstWarnMsg "VCU_Boost Warning Message";
CM_ SG_ 704 VCU_BstAvailSta "VCU Boost Available Status";
CM_ SG_ 704 VCU_BstAplySta "VCU Boost Apply Status";
CM_ SG_ 704 VCU_MxPwrMdSta "Max Power Mode State";
CM_ SG_ 704 VCU_MxPwrMdSegVal "Max Power Mode Segement Value";
CM_ SG_ 704 VCU_MxPwrMdOSD "Max Power Mode Related SS OSD Pop-up request";
CM_ SG_ 704 VCU_PwrDnByHoodOpenSta "Power Down Status By Hood Open";
CM_ SG_ 704 VCU_FlatTowModeConIndSta "FlatTowMode Condition State";
CM_ SG_ 704 VCU_VgsVirAGIUpGear "AGI)Available Gear Indicator) Gear capable of upshifting";
CM_ SG_ 704 VCU_VgsVirAGIDnGear "AGI)Available Gear Indicator) Gear capable of downshifting";
CM_ SG_ 704 VCU_NCstmBrkOvrSta "The Brake override system could be deactivated by a driver(for High performance vehicle USM)";
CM_ SG_ 704 VCU_NCondDragSta "N-Conditioning Drag Mode State";
CM_ SG_ 704 VCU_NCondDragSegVal "NConditioning Drag Mode Segement Value";
CM_ SG_ 704 VCU_NCondTrackSta "N Conditioning Track Mode State";
CM_ SG_ 704 VCU_NCondTrackTimeVal "N Conditioning Track Mode Estimated Time Value";
CM_ SG_ 704 VCU_NCondOSD "N Conditioning Related SS OSD Pop-up request";
CM_ SG_ 704 VCU_ExpUnitEnrgCnsmptnVal "Expected energy consumption per km";
CM_ SG_ 704 VCU_AlvCnt6Val "VCU_AliveCounter6Value";
CM_ SG_ 704 VCU_FlatTowModeChgPwrUsmSta "Charging Power for FlatTow";
CM_ SG_ 704 VCU_NCstmHighPefMdWarnMsg "High Performance mode Warning Message";
CM_ SG_ 704 VCU_NCstmNtdUsmSta "N Torque Distribition mode activation State(for High Performance vehicle USM)";
CM_ SG_ 704 VCU_EstRoadSlopeValue "Estmation Road Slope value for MCU";
CM_ SG_ 704 VCU_DteV2LVal "This signal is the V2L DTE when V2L SOC value is limited";
CM_ SG_ 704 VCU_TrgFuelEcoVal_PerkWh "Target Fuel Economy Value for Cluster Display (EV)";
CM_ SG_ 704 VCU_FlatTowModeUsmSta "FlatTowMode Usm State (acknowledge)";
CM_ SG_ 704 VCU_FlatTowModeEquip "FlatTow Equipment State";
CM_ SG_ 704 VCU_MaintenanceSrvMd "VCU to BMS M/Rly OFF request status for Maintanance mode";
CM_ SG_ 704 VCU_DteQcChrgStsVal "This signal is the DTE for Quick charging state";
CM_ SG_ 704 VCU_CnvrtPermPwrVal "48V Convert Permission Power";
CM_ SG_ 704 VCU_CnvrtOpPermSta "48V Convert Operating Permission";
CM_ SG_ 704 VCU_ARSPosition "Active Rear Spoiler Position Information";
CM_ SG_ 704 VCU_AccelBoostOnOffSta "Accel Boost on off status";
CM_ SG_ 704 VCU_DteGuideVal "This signal is Guide DTE";
CM_ SG_ 704 VCU_Required_ADASMapMsg "VCU_Required_ADASMapMessage";
CM_ SG_ 704 VCU_HvBatAutoDchOpSta "VCU HighVOltage DischargeOperating Status";
CM_ SG_ 704 VCU_UtilModeWarnAddMsgSta "Rest Mode warning message including request controller information";
CM_ SG_ 704 VCU_SwVer "VCU_SWVersion";
CM_ SG_ 704 VCU_PwrAutoOffInfo "VCU_PowerAutoOffInformation";
CM_ SG_ 704 VCU_PwrAutoOffTimerSta "VCU_PowerAutoOffTimerStatus";
CM_ SG_ 704 VCU_FlatTowModeTargetSocUsmSta "Charging Target SOC for FlatTowMode";
CM_ SG_ 704 VCU_AutoShutOffTimerMin "VCU_AutoShutOffTimerMinute";
CM_ SG_ 704 VCU_AutoShutOffTimerSec "VCU_AutoShutOffTimerSecond";
CM_ SG_ 704 VCU_PwrAutoOffTimerReset "VCU_PowerAutoOffTimerReset";
CM_ SG_ 704 VCU_AutoShutOffReq "VCU_AutoShutOffRequest";
CM_ SG_ 704 VCU_DrvInfoPageOptSta "AVN Driving information page option state";
CM_ SG_ 704 VCU_TireSizeWrnMsgSta "VCU_TireSizeWarningMessageStatus";
CM_ SG_ 704 VCU_FrntTqDispPcVal "VCU_FrontTorqueDisplayPercentValue";
CM_ SG_ 704 VCU_RearTqDispPcVal "VCU_RearTorqueDisplayPercentValue";
CM_ SG_ 704 VCU_BstOpSta "VCU_Boost Operating Status";
CM_ SG_ 704 VCU_BstTimerVal "VCU_Boost Timer Value";
CM_ BO_ 979 "[PE] Periodic and On Event";
CM_ SG_ 979 BDC_FD_Crc4Val "BDC_FD_CyclicRedundancyCheck4Value";
CM_ SG_ 979 BDC_FD_AlvCnt4Val "BDC_FD_AliveCounter4Value";
CM_ SG_ 979 BAlarm_BglrAlrm_CurrentSta "Only for CAN FD (SV~)";
CM_ SG_ 979 BAlarm_BglrAlrm_Sta "Only for CAN FD (SV~)";
CM_ SG_ 979 BAlarm_PncAlrmSta "BAlarm_PanicAlarmStatus ##2G##BCM - BCMmsg17 - C_PanicState";
CM_ SG_ 979 SBR_StBltStpWrngBzrSta "SBR_SeatBeltStepWarningBuzzerStatus ##2G##BCM - BCMmsg32 - C_SeatBeltWngBuzStep";
CM_ SG_ 979 SBR_StBltWrngBzrSta "SBR_SeatBeltWarningBuzzerStatus ##2G##BCM - BCMmsg32 - C_SeatBeltWngBuz";
CM_ SG_ 979 BAlarm_BrglrHrnRlySta "BAlarm_BurglarHornRelayStatus ##2G##BCM - BCMmsg19 - C_BurglarHornRly";
CM_ SG_ 979 SBR_DrvStBltIndSta "SBR_DriverSeatBeltIndicatorStatus ##2G##BCM - BCMmsg32 - C_DrvSeatBeltInd";
CM_ SG_ 979 SBR_RrLftStBltWrngIndSta "SBR_RearLeftSeatBeltWarningIndicatorStatus ##2G##BCM - BCMmsg32 - C_RLSeatBeltInd";
CM_ SG_ 979 SBR_RrRtStBltWrngIndSta "SBR_RearRightSeatBeltWarningIndicatorStatus ##2G##BCM - BCMmsg32 - C_RRSeatBeltInd";
CM_ SG_ 979 SBR_RrCtrStBltIndSta "SBR_RearCenterSeatBeltIndicatorStatus ##2G##BCM - BCMmsg32 - C_RCSeatBeltInd";
CM_ SG_ 979 SBR_3rdLftStBltWrngIndSta "SBR_3rdLeftSeatBeltWarningIndicatorStatus ##2G##BCM - BCMmsg32 - C_3LSeatBeltInd";
CM_ SG_ 979 SBR_3rdRtStBltWrngIndSta "SBR_3rdRightSeatBeltWarningIndicatorStatus ##2G##BCM - BCMmsg32 - C_3RSeatBeltInd";
CM_ SG_ 979 SBR_3rdCtrStBltWrngIndSta "SBR_3rdCeterSeatBeltWarningIndicatorStatus ##2G##BCM - BCMmsg32 - C_3CSeatBeltInd";
CM_ SG_ 979 Warn_BzrWrngSta "Warn_BuzzerWarningStatus ##2G##BCM - BCMmsg18 - C_WngBuz";
CM_ SG_ 979 Warn_BCMWrngSta "Warn_BCMWarningStatus ##2G##BCM - BCMmsg19 - C_BCMWarning";
CM_ SG_ 979 ROA_RegionOpt "A Euro NCAP Option signal (BDC only)";
CM_ SG_ 979 Warn_RrStRmndOpt "Warn_RearSeatReminderOption ##2G##BCM - BCMmsg22 - C_RrSeatRemindOpt";
CM_ SG_ 979 Warn_RrStRmndAlrmOnReq "Warn_RearSeatReminderAlarmOnRequest ##2G##BCM - BCMmsg22 - C_RrSeatRemindAlarm";
CM_ SG_ 979 Warn_RrStRmndSysSta "Warn_RearSeatReminderSystemStatus ##2G##BCM - BCMmsg22 - C_RrSeatRemindState";
CM_ SG_ 979 Warn_RrStRmndAlrmInfo "Warn_RearSeatReminderAlarmInformaion ##2G##BCM - BCMmsg22 - C_RrSeatRemindInfo";
CM_ SG_ 979 Warn_RoaErr "Warn_RoaError##2G##BCM - BCMmsg22 - C_RoaError";
CM_ SG_ 979 Warn_RrStRmndDelay "Warn_RStRmndDelay";
CM_ SG_ 979 Warn_RrStRmndSysAct "Warn_RrStRmndSysAct";
CM_ SG_ 979 WAL_FobSearching "IBU Walk Away Lock Fob Searching State for Radar ROA";
CM_ SG_ 979 Warn_RrStRmndSysOffIND "Warning_RearSeatRemindSystemOffIND";
CM_ SG_ 979 Warn_VehNotPWrngSta "Vehicle Not P Warning";
CM_ SG_ 979 Warn_RrStRmndAlrmInfo_1 "Warn_RearSeatReminderAlarmInformaion";
CM_ BO_ 1059 "[PE] Periodic and On Event";
CM_ SG_ 1059 HU_GW_Crc4Val "HU_GW_CyclicRedundancyCheck4Value";
CM_ SG_ 1059 HU_ResetOpSta "This signal indicates whether the reset operation has been completed or not";
CM_ SG_ 1059 OMUOSMirCtrl_Vr "This signal is for the OutSide Mirror Control (Fold or Unfold)";
CM_ SG_ 1059 HU_GW_AlvCnt4Val "HU_GW_AliveCounter4Value";
CM_ SG_ 1059 HU_IG3_Request "IG3 wake up and sleep request for EV/PHEV";
CM_ SG_ 1059 HU_DigitalKeyGroupingSupport "Digital Key Grouping Support";
CM_ SG_ 1059 HU_Background "HU Backgound image info";
CM_ SG_ 1059 HU_BackgroundFadeInOut "HU Background Fade in/out info - (HEX * Factor) %";
CM_ BO_ 983 "[PE] Periodic and On Event";
CM_ SG_ 983 BDC_FD_Crc8Val "BDC_FD_CyclicRedundancyCheck8Value";
CM_ SG_ 983 Mirror_MnlFldModSta "Mirror Manual Fold State";
CM_ SG_ 983 Mirror_SelSwSta "Outside Mirror Select Button Status";
CM_ SG_ 983 Mirror_LHPosMnlReq "Left Outside Mirror Positioning Request";
CM_ SG_ 983 Mirror_RHPosMnlReq "Right Outside Mirror Positioning Request";
CM_ SG_ 983 Mirror_LHPosMnlCmd "Left Outside Mirror Positioning Command";
CM_ SG_ 983 Mirror_RHPosMnlCmd "Right Outside Mirror Positioning Command";
CM_ SG_ 983 Wiper_FrtWiperLowCmd "Front Wiper Low Output";
CM_ SG_ 983 Wiper_FrtWiperHighCmd "Front Wiper High Output";
CM_ SG_ 983 Wiper_RrWiperCmd "Rear Wiper Output";
CM_ SG_ 983 Wiper_PowerEnableCmd "Wiper Power Enable Output";
CM_ SG_ 983 Wiper_FrtWasherCmd "Front Washer Output";
CM_ SG_ 983 Wiper_RrWasherCmd "Rear Washer Output";
CM_ SG_ 983 Wiper_HeadLampWasherCmd "Head Lamp Washer Output";
CM_ SG_ 983 BDC_FD_AlvCnt8Val "BDC_FD_AliveCounter8Value";
CM_ SG_ 983 Mirror_AutoRevModSetSta "Mirror_AutoModSetSta";
CM_ SG_ 983 Wiper_AutoWashModeSta "Auto Wash Mode Wiper State";
CM_ SG_ 983 Wiper_PrkngPosSta "Wiper_ParkingPositionStatus ##2G##BCM - BCMmsg22 - C_WiperParkPosition";
CM_ SG_ 983 Wiper_RainSnsrOptionTyp "Wiper_RainSensorOptionType ##2G##BCM - BCMmsg24 - C_RainSnsOption";
CM_ SG_ 983 Wiper_RainSnsrSta "Wiper_RainSensorStatus ##2G##BCM - BCMmsg24 - C_RainSnsState";
CM_ SG_ 983 BCM_SolSnsrRt "BCM_SolarSensorRightOutputVoltageValue ##2G##BCM - BCMmsg24 - C_PhotosensorRH";
CM_ SG_ 983 BCM_SolSnsrLft "BCM_SolarSensorLeftOutputVoltageValue ##2G##BCM - BCMmsg24 - C_PhotosensorLH";
CM_ SG_ 983 Mirror_MirFldOpt "Outside Mirror Electric Fold Option Signal";
CM_ SG_ 983 Mirror_FldUnfldCmd "Mirror Folding Unfolding Command";
CM_ SG_ 983 Mirror_FldCtrlSta "Mirror Fold and Folding Control State";
CM_ SG_ 983 Mirror_UnFldCtrlSta "Mirror Unfold and Unfolding Control State";
CM_ SG_ 983 Mirror_PosMnlCmd "Mirror Positioning Command";
CM_ SG_ 983 Mirror_SelSwIndCmd "Mirror Select Switch Indicator Command";
BA_DEF_ BO_  "GenMsgEVName" STRING ;
BA_DEF_ BO_  "NmAsrMessage" ENUM  "No","Yes";
BA_DEF_ BO_  "DiagState" ENUM  "No","Yes";
BA_DEF_ BO_  "DiagRequest" ENUM  "No","Yes";
BA_DEF_ BO_  "TpMessage" ENUM  "No","Yes";
BA_DEF_ BO_  "UsrMsgIDSforwardDeviation" INT 0 100;
BA_DEF_ BO_  "UsrMsgIDSbackwardDeviation" INT 50 1000;
BA_DEF_ BO_  "GenMsgCycleTime" INT 0 2000;
BA_DEF_ BO_  "GenMsgStartDelayTime" INT 0 2000;
BA_DEF_ BO_  "GenMsgSendType" ENUM  "Cyclic","NoMsgSendType";
BA_DEF_ BO_  "GenMsgCycleTimeFast" INT 0 500;
BA_DEF_ BO_  "GenMsgDelayTime" INT 0 20;
BA_DEF_ BO_  "GenMsgILSupport" ENUM  "No","Yes";
BA_DEF_ BO_  "GenMsgNrOfRepetition" INT 0 3;
BA_DEF_ BO_  "VFrameFormat" ENUM  "StandardCAN","ExtendedCAN","reserved","reserved","reserved","reserved","reserved","reserved","reserved","reserved","reserved","reserved","reserved","reserved","StandardCAN_FD","ExtendedCAN_FD";
BA_DEF_ SG_  "UserSigValidity" ENUM  "B+","ACC","IG","IG1","IG2","IG3","IG1 or IG2","IG1 or IG3","Undef";
BA_DEF_ SG_  "TimeoutValue" STRING ;
BA_DEF_ SG_  "UsrSigPurpose" ENUM  "Undef","FN","DIAG","DIAG(Req)","DIAG(Res)","DIAG(Func)","DEV","CCP","NM","TP";
BA_DEF_ SG_  "GenSigStartValue" INT 0 1215752192;
BA_DEF_ SG_  "NetworkRequest" ENUM  "Yes","No";
BA_DEF_ SG_  "NetworkRequestHoldingTime" INT 0 65535;
BA_DEF_ SG_  "Description" STRING ;
BA_DEF_ SG_  "Version" STRING ;
BA_DEF_ SG_  "GenSigEnvVarType" ENUM  "Int","Float","Undef";
BA_DEF_ SG_  "GenSigSendType" ENUM  "Cyclic","OnWrite","OnWriteWithRepetition","OnChange","OnChangeWithRepetition","IfActive","IfActiveWithRepetition","NoSigSendType","OnChangeAndIfActive","OnChangeAndIfActiveWithRepetition";
BA_DEF_ SG_  "GwSigLatencyTime" INT 0 65536;
BA_DEF_ SG_  "GwSigMissingSourceType" ENUM  "Undef","OldValue","DefaultValue","InitialValue";
BA_DEF_ SG_  "NWM-WakeupAllowed" ENUM  "<n.a.>";
BA_DEF_ SG_  "RoutingFactor" INT 1 1215752192;
BA_DEF_ SG_  "SystemSignalLongSymbol" STRING ;
BA_DEF_REL_ BU_SG_REL_  "GenSigTimeoutTime" INT 0 7000;
BA_DEF_DEF_  "GenMsgEVName" "@Signame";
BA_DEF_DEF_  "NmAsrMessage" "No";
BA_DEF_DEF_  "DiagState" "No";
BA_DEF_DEF_  "DiagRequest" "No";
BA_DEF_DEF_  "TpMessage" "No";
BA_DEF_DEF_  "UsrMsgIDSforwardDeviation" 10;
BA_DEF_DEF_  "UsrMsgIDSbackwardDeviation" 100;
BA_DEF_DEF_  "GenMsgCycleTime" 200;
BA_DEF_DEF_  "GenMsgStartDelayTime" 0;
BA_DEF_DEF_  "GenMsgSendType" "NoMsgSendType";
BA_DEF_DEF_  "GenMsgCycleTimeFast" 40;
BA_DEF_DEF_  "GenMsgDelayTime" 20;
BA_DEF_DEF_  "GenMsgILSupport" "Yes";
BA_DEF_DEF_  "GenMsgNrOfRepetition" 3;
BA_DEF_DEF_  "VFrameFormat" "StandardCAN";
BA_DEF_DEF_  "UserSigValidity" "IG";
BA_DEF_DEF_  "TimeoutValue" "";
BA_DEF_DEF_  "UsrSigPurpose" "FN";
BA_DEF_DEF_  "GenSigStartValue" 0;
BA_DEF_DEF_  "NetworkRequest" "No";
BA_DEF_DEF_  "NetworkRequestHoldingTime" 0;
BA_DEF_DEF_  "Description" "";
BA_DEF_DEF_  "Version" "";
BA_DEF_DEF_  "GenSigEnvVarType" "Undef";
BA_DEF_DEF_  "GenSigSendType" "NoSigSendType";
BA_DEF_DEF_  "GwSigLatencyTime" 40;
BA_DEF_DEF_  "GwSigMissingSourceType" "Undef";
BA_DEF_DEF_  "NWM-WakeupAllowed" "<n.a.>";
BA_DEF_DEF_  "RoutingFactor" 1;
BA_DEF_DEF_REL_ "GenSigTimeoutTime" 500;
BA_DEF_DEF_  "SystemSignalLongSymbol" "";
BA_ "GenMsgStartDelayTime" BO_ 996 10;
BA_ "GenMsgSendType" BO_ 996 0;
BA_ "VFrameFormat" BO_ 996 14;
BA_ "GenMsgNrOfRepetition" BO_ 1047 0;
BA_ "GenMsgCycleTimeFast" BO_ 1047 0;
BA_ "GenMsgCycleTime" BO_ 1047 1000;
BA_ "GenMsgSendType" BO_ 1047 0;
BA_ "VFrameFormat" BO_ 1047 14;
BA_ "GenMsgStartDelayTime" BO_ 849 40;
BA_ "GenMsgSendType" BO_ 849 0;
BA_ "VFrameFormat" BO_ 849 14;
BA_ "GenMsgNrOfRepetition" BO_ 101 0;
BA_ "GenMsgCycleTimeFast" BO_ 101 0;
BA_ "GenMsgCycleTime" BO_ 101 50;
BA_ "GenMsgSendType" BO_ 101 0;
BA_ "VFrameFormat" BO_ 101 14;
BA_ "GenMsgNrOfRepetition" BO_ 704 0;
BA_ "GenMsgCycleTimeFast" BO_ 704 0;
BA_ "GenMsgSendType" BO_ 704 0;
BA_ "VFrameFormat" BO_ 704 14;
BA_ "GenMsgSendType" BO_ 979 0;
BA_ "VFrameFormat" BO_ 979 14;
BA_ "GenMsgStartDelayTime" BO_ 1059 20;
BA_ "GenMsgCycleTime" BO_ 1059 1000;
BA_ "GenMsgSendType" BO_ 1059 0;
BA_ "VFrameFormat" BO_ 1059 14;
BA_ "GenMsgStartDelayTime" BO_ 983 20;
BA_ "GenMsgSendType" BO_ 983 0;
BA_ "VFrameFormat" BO_ 983 14;
BA_ "Version" SG_ 996 PDC_FD_Crc10Val "22.10.20";
BA_ "UserSigValidity" SG_ 996 PDC_FD_Crc10Val 3;
BA_ "GenSigStartValue" SG_ 996 PDC_FD_Crc10Val 65535;
BA_ "GenSigSendType" SG_ 996 PDC_FD_Crc10Val 4;
BA_ "Description" SG_ 996 PDC_FD_Crc10Val "The data area for CRC calculation is based on the data length (DLC) of the message DB.

The CRC shall be calculated over the entire data block (excluding the CRC bytes) including the user data, alive counter and Data ID



- CRC Polynomial (0x1021) , Ini";
BA_ "Version" SG_ 996 PDC_PwrOnModePowerReq "23.07.05";
BA_ "UserSigValidity" SG_ 996 PDC_PwrOnModePowerReq 0;
BA_ "TimeoutValue" SG_ 996 PDC_PwrOnModePowerReq "0x0";
BA_ "GenSigSendType" SG_ 996 PDC_PwrOnModePowerReq 4;
BA_ "Description" SG_ 996 PDC_PwrOnModePowerReq "This is for high voltage battery discharge request at Power On mode of EV";
BA_ "Version" SG_ 996 PDC_LeadAcidBatType "23.06.02";
BA_ "UserSigValidity" SG_ 996 PDC_LeadAcidBatType 0;
BA_ "GenSigSendType" SG_ 996 PDC_LeadAcidBatType 4;
BA_ "Description" SG_ 996 PDC_LeadAcidBatType "Lead Acid Battery Type Information

 - Validity

After EOL coding

 - Value Table

0x00:Not Applied

0x01:CMF 35Ah

0x02:CMF 40Ah

0x03:CMF 45Ah

0x04:CMF 50Ah

0x05:CMF 60Ah

0x06:CMF 68Ah

0x07:CMF 70Ah

0x08:CMF 80Ah

0x09:CMF 90Ah

0x0A:CMF 110Ah

0x";
BA_ "Version" SG_ 996 PDC_BatPwrClassOpt "23.07.05";
BA_ "UserSigValidity" SG_ 996 PDC_BatPwrClassOpt 0;
BA_ "GenSigSendType" SG_ 996 PDC_BatPwrClassOpt 4;
BA_ "Description" SG_ 996 PDC_BatPwrClassOpt "This signal informs which signal among soc and batpwrstateclass is regarded as the state of power.";
BA_ "Version" SG_ 996 PDC_MainLBMOpt "24.04.03";
BA_ "UserSigValidity" SG_ 996 PDC_MainLBMOpt 0;
BA_ "GenSigSendType" SG_ 996 PDC_MainLBMOpt 4;
BA_ "Description" SG_ 996 PDC_MainLBMOpt "This signal is always sended if PDC2 is appiled

it indicate whether MLBM is applied or not";
BA_ "Version" SG_ 996 PDC_FD_AlvCnt10Val "22.10.20";
BA_ "UserSigValidity" SG_ 996 PDC_FD_AlvCnt10Val 3;
BA_ "GenSigSendType" SG_ 996 PDC_FD_AlvCnt10Val 4;
BA_ "Description" SG_ 996 PDC_FD_AlvCnt10Val "For the first transmission request for a data element the counter shall be initialized with 0 and shall be incremented by 1 for every subsequent send request. 

When the counter reaches the maximum value(0xFF), then it shall restart with 0 for the next s";
BA_ "Version" SG_ 996 ICU_PowerAutoCutModSta "22.06.05";
BA_ "UserSigValidity" SG_ 996 ICU_PowerAutoCutModSta 0;
BA_ "GenSigSendType" SG_ 996 ICU_PowerAutoCutModSta 4;
BA_ "Description" SG_ 996 ICU_PowerAutoCutModSta "ICU Delivery Mode State";
BA_ "Version" SG_ 996 Autocut_DlvryModSta "17.12.00";
BA_ "NetworkRequestHoldingTime" SG_ 996 Autocut_DlvryModSta 5000;
BA_ "NetworkRequest" SG_ 996 Autocut_DlvryModSta 0;
BA_ "UserSigValidity" SG_ 996 Autocut_DlvryModSta 0;
BA_ "GenSigStartValue" SG_ 996 Autocut_DlvryModSta 1;
BA_ "GenSigSendType" SG_ 996 Autocut_DlvryModSta 4;
BA_ "Description" SG_ 996 Autocut_DlvryModSta "-(Old)C_SJB_DeliveryMode

-Initial value: 1";
BA_ "Version" SG_ 996 ICU_SoCBattStaMsgReq "17.12.00";
BA_ "UserSigValidity" SG_ 996 ICU_SoCBattStaMsgReq 0;
BA_ "GenSigStartValue" SG_ 996 ICU_SoCBattStaMsgReq 3;
BA_ "GenSigSendType" SG_ 996 ICU_SoCBattStaMsgReq 4;
BA_ "Description" SG_ 996 ICU_SoCBattStaMsgReq "Determine if soc level is warning or alert.";
BA_ "Version" SG_ 996 Batt_SoCWarningValue "21.11.00";
BA_ "UserSigValidity" SG_ 996 Batt_SoCWarningValue 0;
BA_ "GenSigStartValue" SG_ 996 Batt_SoCWarningValue 255;
BA_ "GenSigSendType" SG_ 996 Batt_SoCWarningValue 4;
BA_ "Description" SG_ 996 Batt_SoCWarningValue "This signal is Battery SOC from battery sensor.";
BA_ "Version" SG_ 996 ICU_BattAutoCutPreWrng "20.04.06";
BA_ "UserSigValidity" SG_ 996 ICU_BattAutoCutPreWrng 0;
BA_ "GenSigStartValue" SG_ 996 ICU_BattAutoCutPreWrng 3;
BA_ "GenSigSendType" SG_ 996 ICU_BattAutoCutPreWrng 4;
BA_ "Description" SG_ 996 ICU_BattAutoCutPreWrng "This is a warning signal before blocking the dark current of the ICU by the battery SOC.";
BA_ "Version" SG_ 996 OTAModeACCOffReq "21.11.00";
BA_ "NetworkRequest" SG_ 996 OTAModeACCOffReq 0;
BA_ "UserSigValidity" SG_ 996 OTAModeACCOffReq 0;
BA_ "TimeoutValue" SG_ 996 OTAModeACCOffReq "0x0";
BA_ "GenSigSendType" SG_ 996 OTAModeACCOffReq 4;
BA_ "Description" SG_ 996 OTAModeACCOffReq "ACC off request during OTA mode for battery saver";
BA_ "Version" SG_ 996 C_ICUIGNOffReq "21.11.00";
BA_ "NetworkRequest" SG_ 996 C_ICUIGNOffReq 0;
BA_ "UserSigValidity" SG_ 996 C_ICUIGNOffReq 0;
BA_ "TimeoutValue" SG_ 996 C_ICUIGNOffReq "0x0";
BA_ "GenSigSendType" SG_ 996 C_ICUIGNOffReq 4;
BA_ "Description" SG_ 996 C_ICUIGNOffReq "IGN off request(Not engine running state only) for battery saver";
BA_ "Version" SG_ 996 IGN_AutoOff_WarnSta "21.11.00";
BA_ "UserSigValidity" SG_ 996 IGN_AutoOff_WarnSta 3;
BA_ "GenSigSendType" SG_ 996 IGN_AutoOff_WarnSta 4;
BA_ "Description" SG_ 996 IGN_AutoOff_WarnSta "This signal is for battery discharge warning (engine not running && IGN/ACC on)

To prevent battery discharge, ICU requests the head unit to display warning and requests IBU to turn IGN/ACC off.";
BA_ "Version" SG_ 996 IGN_AutoOff_WarnSta_CLU "21.11.00";
BA_ "UserSigValidity" SG_ 996 IGN_AutoOff_WarnSta_CLU 3;
BA_ "GenSigSendType" SG_ 996 IGN_AutoOff_WarnSta_CLU 4;
BA_ "Description" SG_ 996 IGN_AutoOff_WarnSta_CLU "This signal is for battery discharge warning (engine not running && IGN/ACC on)

To prevent battery discharge, ICU requests the Cluster to display warning and requests IBU to turn IGN/ACC off.";
BA_ "Version" SG_ 996 PDC_BatPwrStateClassA "23.07.06";
BA_ "UserSigValidity" SG_ 996 PDC_BatPwrStateClassA 0;
BA_ "GenSigSendType" SG_ 996 PDC_BatPwrStateClassA 4;
BA_ "Description" SG_ 996 PDC_BatPwrStateClassA "This signal is used to inform whether the power state is good for the operation of the function using the low voltage.

0x1 : power state level is low

0x2: power staest level is good(high)";
BA_ "Version" SG_ 996 PDC_BatPwrStateClassB "23.07.06";
BA_ "UserSigValidity" SG_ 996 PDC_BatPwrStateClassB 0;
BA_ "GenSigSendType" SG_ 996 PDC_BatPwrStateClassB 4;
BA_ "Description" SG_ 996 PDC_BatPwrStateClassB "This signal is used to inform whether the power state is good for the operation of the function using the low voltage.

0x1 : power state level is low

0x2: power staest level is good(high)";
BA_ "Version" SG_ 996 PDC_BatPwrStateClassC "23.07.06";
BA_ "UserSigValidity" SG_ 996 PDC_BatPwrStateClassC 0;
BA_ "GenSigSendType" SG_ 996 PDC_BatPwrStateClassC 4;
BA_ "Description" SG_ 996 PDC_BatPwrStateClassC "This signal is used to inform whether the power state is good for the operation of the function using the low voltage.

0x1 : power state level is low

0x2: power staest level is good(high)";
BA_ "Version" SG_ 996 PLBMAvailableState "21.06.11";
BA_ "UserSigValidity" SG_ 996 PLBMAvailableState 0;
BA_ "GenSigSendType" SG_ 996 PLBMAvailableState 4;
BA_ "Description" SG_ 996 PLBMAvailableState "Power supply Available status notification at PLBM. If this value is Set, BMS can request Discharge-request to PDC during parking mode";
BA_ "Version" SG_ 996 Bat_dischrg "21.11.00";
BA_ "UserSigValidity" SG_ 996 Bat_dischrg 3;
BA_ "GenSigSendType" SG_ 996 Bat_dischrg 4;
BA_ "Description" SG_ 996 Bat_dischrg "Battery discharge notification flag";
BA_ "Version" SG_ 996 Bat12V_Chr_Req "22.02.04";
BA_ "UserSigValidity" SG_ 996 Bat12V_Chr_Req 0;
BA_ "TimeoutValue" SG_ 996 Bat12V_Chr_Req "0x0";
BA_ "GenSigSendType" SG_ 996 Bat12V_Chr_Req 4;
BA_ "Description" SG_ 996 Bat12V_Chr_Req "12V lead acid battery charging request signal 

0x0:Off (Default)

0x1:On_IBS

0x2:On_OTA

0x3:On_Load";
BA_ "Version" SG_ 996 ICU_BattMngAlert "21.07.05";
BA_ "UserSigValidity" SG_ 996 ICU_BattMngAlert 0;
BA_ "GenSigSendType" SG_ 996 ICU_BattMngAlert 4;
BA_ "Description" SG_ 996 ICU_BattMngAlert "This signal is for battery discharge warning.

1bit : Hazard

2bit : Tail

3bit~8bit : Reserved";
BA_ "Version" SG_ 1047 GNSS_Crc5Val "22.10.20";
BA_ "UserSigValidity" SG_ 1047 GNSS_Crc5Val 3;
BA_ "GenSigStartValue" SG_ 1047 GNSS_Crc5Val 65535;
BA_ "Description" SG_ 1047 GNSS_Crc5Val "The data area for CRC calculation is based on the data length (DLC) of the message DB.

The CRC shall be calculated over the entire data block (excluding the CRC bytes) including the user data, alive counter and Data ID



- CRC Polynomial (0x1021) , Ini";
BA_ "Version" SG_ 1047 HU_GNSS_UTC_min "22.07.05";
BA_ "UserSigValidity" SG_ 1047 HU_GNSS_UTC_min 1;
BA_ "Description" SG_ 1047 HU_GNSS_UTC_min "range : [0,59]";
BA_ "Version" SG_ 1047 HU_GNSS_UTC_sec "22.07.05";
BA_ "UserSigValidity" SG_ 1047 HU_GNSS_UTC_sec 1;
BA_ "Description" SG_ 1047 HU_GNSS_UTC_sec "ragne : [0, 60]  /  60 only for the leap second";
BA_ "Version" SG_ 1047 HU_GNSS_UTC_offset "22.07.05";
BA_ "UserSigValidity" SG_ 1047 HU_GNSS_UTC_offset 1;
BA_ "Description" SG_ 1047 HU_GNSS_UTC_offset "GPS = UTC + offset";
BA_ "Version" SG_ 1047 HU_GNSS_PDOP "22.07.05";
BA_ "UserSigValidity" SG_ 1047 HU_GNSS_PDOP 1;
BA_ "Description" SG_ 1047 HU_GNSS_PDOP "unit : 2^-8";
BA_ "Version" SG_ 1047 HU_GNSS_HDOP "22.07.05";
BA_ "UserSigValidity" SG_ 1047 HU_GNSS_HDOP 1;
BA_ "Description" SG_ 1047 HU_GNSS_HDOP "unit : 2^-8";
BA_ "Version" SG_ 1047 GNSS_AlvCnt5Val "22.10.20";
BA_ "UserSigValidity" SG_ 1047 GNSS_AlvCnt5Val 3;
BA_ "Description" SG_ 1047 GNSS_AlvCnt5Val "For the first transmission request for a data element the counter shall be initialized with 0 and shall be incremented by 1 for every subsequent send request. 

When the counter reaches the maximum value(0xFF), then it shall restart with 0 for the next s";
BA_ "Version" SG_ 1047 HU_GNSS_VDOP "22.07.05";
BA_ "UserSigValidity" SG_ 1047 HU_GNSS_VDOP 1;
BA_ "Description" SG_ 1047 HU_GNSS_VDOP "unit : 2^-8";
BA_ "Version" SG_ 1047 HU_GNSS_DGPS_age "22.07.05";
BA_ "UserSigValidity" SG_ 1047 HU_GNSS_DGPS_age 1;
BA_ "Description" SG_ 1047 HU_GNSS_DGPS_age "whed using DGPS, (DGPS time - current time.)";
BA_ "Version" SG_ 1047 HU_GNSS_Fix_status "22.07.05";
BA_ "UserSigValidity" SG_ 1047 HU_GNSS_Fix_status 1;
BA_ "Version" SG_ 1047 HU_GNSS_TimeSource "22.07.05";
BA_ "UserSigValidity" SG_ 1047 HU_GNSS_TimeSource 1;
BA_ "Version" SG_ 1047 HU_GNSS_search "22.07.05";
BA_ "UserSigValidity" SG_ 1047 HU_GNSS_search 1;
BA_ "Version" SG_ 1047 HU_GNSS_DST "22.07.05";
BA_ "UserSigValidity" SG_ 1047 HU_GNSS_DST 1;
BA_ "GenSigStartValue" SG_ 1047 HU_GNSS_DST 3;
BA_ "Description" SG_ 1047 HU_GNSS_DST "DST setting";
BA_ "Version" SG_ 1047 HU_GNSS_SV_count "22.07.05";
BA_ "UserSigValidity" SG_ 1047 HU_GNSS_SV_count 1;
BA_ "Version" SG_ 1047 HU_GNSS_TimezoneOffset "22.07.05";
BA_ "UserSigValidity" SG_ 1047 HU_GNSS_TimezoneOffset 1;
BA_ "Description" SG_ 1047 HU_GNSS_TimezoneOffset "offset = [ value * factor(15) ] min.";
BA_ "Version" SG_ 1047 HU_GNSS_UTC_year "23.08.10";
BA_ "UserSigValidity" SG_ 1047 HU_GNSS_UTC_year 1;
BA_ "Version" SG_ 1047 HU_GNSS_UTC_month "22.07.05";
BA_ "UserSigValidity" SG_ 1047 HU_GNSS_UTC_month 1;
BA_ "Description" SG_ 1047 HU_GNSS_UTC_month "range : [1, 12]";
BA_ "Version" SG_ 1047 HU_GNSS_UTC_day "22.07.05";
BA_ "UserSigValidity" SG_ 1047 HU_GNSS_UTC_day 1;
BA_ "Description" SG_ 1047 HU_GNSS_UTC_day "range : [1, 31]";
BA_ "Version" SG_ 1047 HU_GNSS_UTC_hour "22.07.05";
BA_ "UserSigValidity" SG_ 1047 HU_GNSS_UTC_hour 1;
BA_ "Description" SG_ 1047 HU_GNSS_UTC_hour "range : [0, 23]";
BA_ "Version" SG_ 849 IAU_FD_Crc4Val "22.11.04";
BA_ "UserSigValidity" SG_ 849 IAU_FD_Crc4Val 0;
BA_ "GenSigStartValue" SG_ 849 IAU_FD_Crc4Val 65535;
BA_ "GenSigSendType" SG_ 849 IAU_FD_Crc4Val 4;
BA_ "Description" SG_ 849 IAU_FD_Crc4Val "The data area for CRC calculation is based on the data length (DLC) of the message DB.

The CRC shall be calculated over the entire data block (excluding the CRC bytes) including the user data, alive counter and Data ID



- CRC Polynomial (0x1021) , Ini";
BA_ "Version" SG_ 849 IAU_DISPWrng "22.06.04";
BA_ "NetworkRequestHoldingTime" SG_ 849 IAU_DISPWrng 5000;
BA_ "NetworkRequest" SG_ 849 IAU_DISPWrng 0;
BA_ "UserSigValidity" SG_ 849 IAU_DISPWrng 0;
BA_ "GenSigSendType" SG_ 849 IAU_DISPWrng 4;
BA_ "Description" SG_ 849 IAU_DISPWrng "This siganl warning from IAU

- 0x9 (WPCNFC_PreStartAuth_Success) : CLU display when workaround or LPCD Start Auth succeeded (before SSB pressed).";
BA_ "Version" SG_ 849 IAU_DigitalKey2Opt "20.08.00";
BA_ "NetworkRequestHoldingTime" SG_ 849 IAU_DigitalKey2Opt 5000;
BA_ "NetworkRequest" SG_ 849 IAU_DigitalKey2Opt 0;
BA_ "UserSigValidity" SG_ 849 IAU_DigitalKey2Opt 0;
BA_ "GenSigSendType" SG_ 849 IAU_DigitalKey2Opt 4;
BA_ "Description" SG_ 849 IAU_DigitalKey2Opt "This signal describe Digital Key capability";
BA_ "Version" SG_ 849 IAUwFRULearnState "20.04.05";
BA_ "NetworkRequestHoldingTime" SG_ 849 IAUwFRULearnState 5000;
BA_ "NetworkRequest" SG_ 849 IAUwFRULearnState 0;
BA_ "UserSigValidity" SG_ 849 IAUwFRULearnState 0;
BA_ "GenSigSendType" SG_ 849 IAUwFRULearnState 4;
BA_ "Description" SG_ 849 IAUwFRULearnState "This signal indicates learning process stste between IAU and FRU";
BA_ "Version" SG_ 849 IAUwFPMLearnState "20.04.05";
BA_ "NetworkRequestHoldingTime" SG_ 849 IAUwFPMLearnState 5000;
BA_ "NetworkRequest" SG_ 849 IAUwFPMLearnState 0;
BA_ "UserSigValidity" SG_ 849 IAUwFPMLearnState 0;
BA_ "GenSigSendType" SG_ 849 IAUwFPMLearnState 4;
BA_ "Description" SG_ 849 IAUwFPMLearnState "This signal indicates learning process stste between IAU and FPM";
BA_ "Version" SG_ 849 IAU_ValetDigitalkey "20.08.05";
BA_ "NetworkRequestHoldingTime" SG_ 849 IAU_ValetDigitalkey 5000;
BA_ "NetworkRequest" SG_ 849 IAU_ValetDigitalkey 0;
BA_ "UserSigValidity" SG_ 849 IAU_ValetDigitalkey 0;
BA_ "GenSigSendType" SG_ 849 IAU_ValetDigitalkey 4;
BA_ "Version" SG_ 849 IAU_DigitalKeyNumberOpt "23.04.04";
BA_ "NetworkRequestHoldingTime" SG_ 849 IAU_DigitalKeyNumberOpt 5000;
BA_ "NetworkRequest" SG_ 849 IAU_DigitalKeyNumberOpt 0;
BA_ "UserSigValidity" SG_ 849 IAU_DigitalKeyNumberOpt 0;
BA_ "GenSigSendType" SG_ 849 IAU_DigitalKeyNumberOpt 4;
BA_ "Description" SG_ 849 IAU_DigitalKeyNumberOpt "This signal is for the digital key number type. 

(Ex. Max 16 of digital keys in total can be saved and shared)";
BA_ "Version" SG_ 849 IAU_eSEReprogramSta "22.07.04";
BA_ "NetworkRequestHoldingTime" SG_ 849 IAU_eSEReprogramSta 5000;
BA_ "NetworkRequest" SG_ 849 IAU_eSEReprogramSta 0;
BA_ "UserSigValidity" SG_ 849 IAU_eSEReprogramSta 0;
BA_ "TimeoutValue" SG_ 849 IAU_eSEReprogramSta "0";
BA_ "GenSigSendType" SG_ 849 IAU_eSEReprogramSta 4;
BA_ "Description" SG_ 849 IAU_eSEReprogramSta "eSE Reprograming Status";
BA_ "Version" SG_ 849 IAU_DKOwnerSwapOption "24.01.04";
BA_ "UserSigValidity" SG_ 849 IAU_DKOwnerSwapOption 0;
BA_ "GenSigSendType" SG_ 849 IAU_DKOwnerSwapOption 4;
BA_ "Description" SG_ 849 IAU_DKOwnerSwapOption "Digital key owner swap option signal";
BA_ "Version" SG_ 849 IAU_DgtKeyGrpPrflRval2 "23.02.13";
BA_ "NetworkRequestHoldingTime" SG_ 849 IAU_DgtKeyGrpPrflRval2 5000;
BA_ "NetworkRequest" SG_ 849 IAU_DgtKeyGrpPrflRval2 0;
BA_ "UserSigValidity" SG_ 849 IAU_DgtKeyGrpPrflRval2 0;
BA_ "GenSigSendType" SG_ 849 IAU_DgtKeyGrpPrflRval2 4;
BA_ "Description" SG_ 849 IAU_DgtKeyGrpPrflRval2 "Digital Key Group number(max : 16 )";
BA_ "Version" SG_ 849 IAU_StartIdentifiedProfile "20.05.02";
BA_ "NetworkRequestHoldingTime" SG_ 849 IAU_StartIdentifiedProfile 5000;
BA_ "NetworkRequest" SG_ 849 IAU_StartIdentifiedProfile 0;
BA_ "UserSigValidity" SG_ 849 IAU_StartIdentifiedProfile 0;
BA_ "TimeoutValue" SG_ 849 IAU_StartIdentifiedProfile "0x0";
BA_ "GenSigSendType" SG_ 849 IAU_StartIdentifiedProfile 4;
BA_ "Version" SG_ 849 IAU_DigitalKeyProfileRval2 "22.05.04";
BA_ "NetworkRequestHoldingTime" SG_ 849 IAU_DigitalKeyProfileRval2 5000;
BA_ "NetworkRequest" SG_ 849 IAU_DigitalKeyProfileRval2 0;
BA_ "UserSigValidity" SG_ 849 IAU_DigitalKeyProfileRval2 0;
BA_ "GenSigSendType" SG_ 849 IAU_DigitalKeyProfileRval2 4;
BA_ "Description" SG_ 849 IAU_DigitalKeyProfileRval2 "digital key number : max. 16";
BA_ "Version" SG_ 849 IAU_NFCCard1SN "21.07.05";
BA_ "NetworkRequestHoldingTime" SG_ 849 IAU_NFCCard1SN 5000;
BA_ "NetworkRequest" SG_ 849 IAU_NFCCard1SN 0;
BA_ "UserSigValidity" SG_ 849 IAU_NFCCard1SN 0;
BA_ "GenSigSendType" SG_ 849 IAU_NFCCard1SN 4;
BA_ "Version" SG_ 849 IAU_FD_AlvCnt4Val "22.11.04";
BA_ "UserSigValidity" SG_ 849 IAU_FD_AlvCnt4Val 0;
BA_ "GenSigSendType" SG_ 849 IAU_FD_AlvCnt4Val 4;
BA_ "Description" SG_ 849 IAU_FD_AlvCnt4Val "For the first transmission request for a data element the counter shall be initialized with 0 and shall be incremented by 1 for every subsequent send request. 

When the counter reaches the maximum value(0xFF), then it shall restart with 0 for the next s";
BA_ "Version" SG_ 849 IAU_UWBOnOffOpt "24.10.01";
BA_ "UserSigValidity" SG_ 849 IAU_UWBOnOffOpt 0;
BA_ "GenSigSendType" SG_ 849 IAU_UWBOnOffOpt 4;
BA_ "Description" SG_ 849 IAU_UWBOnOffOpt "Digital key UWB on off option signal";
BA_ "Version" SG_ 849 IAU_UWBOnOffRVal "24.10.01";
BA_ "UserSigValidity" SG_ 849 IAU_UWBOnOffRVal 0;
BA_ "GenSigSendType" SG_ 849 IAU_UWBOnOffRVal 4;
BA_ "Description" SG_ 849 IAU_UWBOnOffRVal "Digital key UWB on off set feedback signal";
BA_ "Version" SG_ 849 IAU_StartIdentifiedProfile_Ext "23.04.04";
BA_ "NetworkRequestHoldingTime" SG_ 849 IAU_StartIdentifiedProfile_Ext 5000;
BA_ "NetworkRequest" SG_ 849 IAU_StartIdentifiedProfile_Ext 0;
BA_ "UserSigValidity" SG_ 849 IAU_StartIdentifiedProfile_Ext 0;
BA_ "GenSigSendType" SG_ 849 IAU_StartIdentifiedProfile_Ext 4;
BA_ "Version" SG_ 849 RSPA_UWBRspaExtRngSta "20.03.05";
BA_ "NetworkRequestHoldingTime" SG_ 849 RSPA_UWBRspaExtRngSta 5000;
BA_ "NetworkRequest" SG_ 849 RSPA_UWBRspaExtRngSta 0;
BA_ "UserSigValidity" SG_ 849 RSPA_UWBRspaExtRngSta 0;
BA_ "GenSigSendType" SG_ 849 RSPA_UWBRspaExtRngSta 4;
BA_ "Version" SG_ 849 RSPA_CanFltSta "20.02.00";
BA_ "UserSigValidity" SG_ 849 RSPA_CanFltSta 0;
BA_ "GenSigSendType" SG_ 849 RSPA_CanFltSta 4;
BA_ "Description" SG_ 849 RSPA_CanFltSta "Error status of RSPA control signals.";
BA_ "Version" SG_ 849 RSPA_BLESigErrSta "20.02.00";
BA_ "NetworkRequestHoldingTime" SG_ 849 RSPA_BLESigErrSta 5000;
BA_ "NetworkRequest" SG_ 849 RSPA_BLESigErrSta 0;
BA_ "UserSigValidity" SG_ 849 RSPA_BLESigErrSta 0;
BA_ "GenSigSendType" SG_ 849 RSPA_BLESigErrSta 4;
BA_ "Description" SG_ 849 RSPA_BLESigErrSta "Error status of Digital Key BLE_BtnReq signal.



If BLE frame data from Digital Key defferent with CAN signal data, 

RSPA_BLESigErrSta signal send 0x1 Signal Invalid.";
BA_ "Version" SG_ 849 RSPA_ConStat "20.02.00";
BA_ "NetworkRequestHoldingTime" SG_ 849 RSPA_ConStat 5000;
BA_ "NetworkRequest" SG_ 849 RSPA_ConStat 0;
BA_ "UserSigValidity" SG_ 849 RSPA_ConStat 0;
BA_ "GenSigSendType" SG_ 849 RSPA_ConStat 4;
BA_ "Description" SG_ 849 RSPA_ConStat "Connection Status among RSPA, IAU, BLE and SmartPhone";
BA_ "Version" SG_ 849 IAU_ProfileIDRVal "23.02.02";
BA_ "NetworkRequestHoldingTime" SG_ 849 IAU_ProfileIDRVal 5000;
BA_ "NetworkRequest" SG_ 849 IAU_ProfileIDRVal 0;
BA_ "UserSigValidity" SG_ 849 IAU_ProfileIDRVal 0;
BA_ "GenSigSendType" SG_ 849 IAU_ProfileIDRVal 4;
BA_ "Version" SG_ 849 IAU_DigitalKeyProcessingSta "23.02.13";
BA_ "NetworkRequestHoldingTime" SG_ 849 IAU_DigitalKeyProcessingSta 5000;
BA_ "NetworkRequest" SG_ 849 IAU_DigitalKeyProcessingSta 0;
BA_ "UserSigValidity" SG_ 849 IAU_DigitalKeyProcessingSta 3;
BA_ "GenSigSendType" SG_ 849 IAU_DigitalKeyProcessingSta 4;
BA_ "Version" SG_ 849 IAU_DigitalKeyExit "23.07.03";
BA_ "NetworkRequestHoldingTime" SG_ 849 IAU_DigitalKeyExit 5000;
BA_ "NetworkRequest" SG_ 849 IAU_DigitalKeyExit 0;
BA_ "UserSigValidity" SG_ 849 IAU_DigitalKeyExit 3;
BA_ "GenSigSendType" SG_ 849 IAU_DigitalKeyExit 4;
BA_ "Description" SG_ 849 IAU_DigitalKeyExit "Digital Key USM setting Exit Condition";
BA_ "Version" SG_ 849 IAU_DigitalKeyEnblRVal "20.05.02";
BA_ "NetworkRequestHoldingTime" SG_ 849 IAU_DigitalKeyEnblRVal 5000;
BA_ "NetworkRequest" SG_ 849 IAU_DigitalKeyEnblRVal 0;
BA_ "UserSigValidity" SG_ 849 IAU_DigitalKeyEnblRVal 0;
BA_ "GenSigSendType" SG_ 849 IAU_DigitalKeyEnblRVal 4;
BA_ "Version" SG_ 849 IAU_OwnerPhnRegRVal "20.05.02";
BA_ "NetworkRequestHoldingTime" SG_ 849 IAU_OwnerPhnRegRVal 5000;
BA_ "NetworkRequest" SG_ 849 IAU_OwnerPhnRegRVal 0;
BA_ "UserSigValidity" SG_ 849 IAU_OwnerPhnRegRVal 0;
BA_ "GenSigSendType" SG_ 849 IAU_OwnerPhnRegRVal 4;
BA_ "Version" SG_ 849 IAU_NFCCard1RegRVal "17.12.08";
BA_ "NetworkRequestHoldingTime" SG_ 849 IAU_NFCCard1RegRVal 5000;
BA_ "NetworkRequest" SG_ 849 IAU_NFCCard1RegRVal 0;
BA_ "UserSigValidity" SG_ 849 IAU_NFCCard1RegRVal 0;
BA_ "GenSigSendType" SG_ 849 IAU_NFCCard1RegRVal 4;
BA_ "Version" SG_ 849 IAU_NFCCard2RegRVal "17.12.08";
BA_ "NetworkRequestHoldingTime" SG_ 849 IAU_NFCCard2RegRVal 5000;
BA_ "NetworkRequest" SG_ 849 IAU_NFCCard2RegRVal 0;
BA_ "UserSigValidity" SG_ 849 IAU_NFCCard2RegRVal 0;
BA_ "GenSigSendType" SG_ 849 IAU_NFCCard2RegRVal 4;
BA_ "Version" SG_ 101 IEB_Crc1Val "21.09.03";
BA_ "RoutingFactor" SG_ 101 IEB_Crc1Val 5;
BA_ "UserSigValidity" SG_ 101 IEB_Crc1Val 3;
BA_ "GenSigStartValue" SG_ 101 IEB_Crc1Val 65535;
BA_ "Description" SG_ 101 IEB_Crc1Val "The data area for CRC calculation is based on the data length (DLC) of the message DB.

The CRC shall be calculated over the entire data block (excluding the CRC bytes) including the user data, alive counter and Data ID



- CRC Polynomial (0x1021) , Ini";
BA_ "Version" SG_ 101 IEB_StrkDpthPcVal "19.05.02";
BA_ "RoutingFactor" SG_ 101 IEB_StrkDpthPcVal 5;
BA_ "UserSigValidity" SG_ 101 IEB_StrkDpthPcVal 3;
BA_ "Description" SG_ 101 IEB_StrkDpthPcVal "Brake Pedal Stroke Depth";
BA_ "Version" SG_ 101 IEB_EstDpthPcVal "19.05.02";
BA_ "RoutingFactor" SG_ 101 IEB_EstDpthPcVal 5;
BA_ "UserSigValidity" SG_ 101 IEB_EstDpthPcVal 3;
BA_ "Description" SG_ 101 IEB_EstDpthPcVal "Estimated Brake Pedal Depth for SCC";
BA_ "Version" SG_ 101 IEB_AbsNGearReq "19.05.02";
BA_ "RoutingFactor" SG_ 101 IEB_AbsNGearReq 5;
BA_ "UserSigValidity" SG_ 101 IEB_AbsNGearReq 3;
BA_ "Description" SG_ 101 IEB_AbsNGearReq "indigates N gear position request while ABS activation";
BA_ "Version" SG_ 101 IEB_EstBrkPdlValVldSta "19.05.02";
BA_ "RoutingFactor" SG_ 101 IEB_EstBrkPdlValVldSta 5;
BA_ "UserSigValidity" SG_ 101 IEB_EstBrkPdlValVldSta 3;
BA_ "GenSigStartValue" SG_ 101 IEB_EstBrkPdlValVldSta 1;
BA_ "Description" SG_ 101 IEB_EstBrkPdlValVldSta "Estimated Brake pedal value Validity";
BA_ "Version" SG_ 101 IEB_FRAmode_Req "22.10.20";
BA_ "RoutingFactor" SG_ 101 IEB_FRAmode_Req 5;
BA_ "UserSigValidity" SG_ 101 IEB_FRAmode_Req 3;
BA_ "Description" SG_ 101 IEB_FRAmode_Req "This signal requests braking load reduction logic when braking the ABS based on an electric vehicle";
BA_ "Version" SG_ 101 IEB_DriftEscModSta_VDC "22.07.06";
BA_ "RoutingFactor" SG_ 101 IEB_DriftEscModSta_VDC 5;
BA_ "UserSigValidity" SG_ 101 IEB_DriftEscModSta_VDC 3;
BA_ "Description" SG_ 101 IEB_DriftEscModSta_VDC "ESC/VDC mode command from DMIC by AVNT custom mode select";
BA_ "Version" SG_ 101 IEB_RegenTqLimitNmVal_Rear "19.05.03";
BA_ "RoutingFactor" SG_ 101 IEB_RegenTqLimitNmVal_Rear 5;
BA_ "UserSigValidity" SG_ 101 IEB_RegenTqLimitNmVal_Rear 3;
BA_ "Description" SG_ 101 IEB_RegenTqLimitNmVal_Rear "Regen Brake Torque limit at rear wheel";
BA_ "Version" SG_ 101 IEB_DrvWhlSlipFlg_Frnt "20.10.02";
BA_ "RoutingFactor" SG_ 101 IEB_DrvWhlSlipFlg_Frnt 5;
BA_ "UserSigValidity" SG_ 101 IEB_DrvWhlSlipFlg_Frnt 3;
BA_ "Description" SG_ 101 IEB_DrvWhlSlipFlg_Frnt "This signal is to indicate the slip status of the driving wheels.";
BA_ "Version" SG_ 101 IEB_IndDriftMode "22.02.04";
BA_ "RoutingFactor" SG_ 101 IEB_IndDriftMode 5;
BA_ "UserSigValidity" SG_ 101 IEB_IndDriftMode 3;
BA_ "Description" SG_ 101 IEB_IndDriftMode "Signal for feedback from AVNT drift mode ON/OFF command";
BA_ "Version" SG_ 101 IEB_IndDriftEcsModSta "22.07.06";
BA_ "RoutingFactor" SG_ 101 IEB_IndDriftEcsModSta 5;
BA_ "UserSigValidity" SG_ 101 IEB_IndDriftEcsModSta 3;
BA_ "Description" SG_ 101 IEB_IndDriftEcsModSta "Signal for feed back of  ECS mode command from DMIC by AVNT custom mode select";
BA_ "Version" SG_ 101 IEB_IndDriftElsdModSta "22.07.06";
BA_ "RoutingFactor" SG_ 101 IEB_IndDriftElsdModSta 5;
BA_ "UserSigValidity" SG_ 101 IEB_IndDriftElsdModSta 3;
BA_ "Description" SG_ 101 IEB_IndDriftElsdModSta "Signal for feed back of ELSD mode command from DMIC by AVNT custom mode select";
BA_ "Version" SG_ 101 IEB_TCS_Req "20.04.05";
BA_ "RoutingFactor" SG_ 101 IEB_TCS_Req 5;
BA_ "UserSigValidity" SG_ 101 IEB_TCS_Req 3;
BA_ "Description" SG_ 101 IEB_TCS_Req "이 신호는 IEB_01_10ms 메시지의 TCS 토크 신호에 대한 Validity를 의미한다.



0x1 : TCS_TqIntrvntnVal_Frnt, TCS_TqIntrvntnVal_Rear 신호에 의한 TCS 제어

0x2 : TCS_MtrTrgtRpm_Frnt, TCS_MtrTrgtRpm_Rear 신호에 의한 TCS 제어";
BA_ "Version" SG_ 101 IEB_RSC_Req "22.01.02";
BA_ "RoutingFactor" SG_ 101 IEB_RSC_Req 5;
BA_ "UserSigValidity" SG_ 101 IEB_RSC_Req 3;
BA_ "Description" SG_ 101 IEB_RSC_Req "Validity of RSC torque signal from IEB_01_10ms";
BA_ "Version" SG_ 101 TCS_TqFlag_Frnt "19.05.03";
BA_ "RoutingFactor" SG_ 101 TCS_TqFlag_Frnt 5;
BA_ "UserSigValidity" SG_ 101 TCS_TqFlag_Frnt 3;
BA_ "Description" SG_ 101 TCS_TqFlag_Frnt "이 신호는 IEB_01_10ms 메시지의 TCS 전륜 토크 신호에 대한 부호를 의미한다.";
BA_ "Version" SG_ 101 TCS_TqFlag_Rear "19.05.03";
BA_ "RoutingFactor" SG_ 101 TCS_TqFlag_Rear 5;
BA_ "UserSigValidity" SG_ 101 TCS_TqFlag_Rear 3;
BA_ "Description" SG_ 101 TCS_TqFlag_Rear "이 신호는 IEB_01_10ms 메시지의 TCS 후륜 토크 신호에 대한 부호를 의미한다.";
BA_ "Version" SG_ 101 RSC_TqFlag_Frnt "19.05.03";
BA_ "RoutingFactor" SG_ 101 RSC_TqFlag_Frnt 5;
BA_ "UserSigValidity" SG_ 101 RSC_TqFlag_Frnt 3;
BA_ "Description" SG_ 101 RSC_TqFlag_Frnt "이 신호는 IEB_01_10ms 메시지의 RSC 전륜 토크 신호에 대한 부호를 의미한다.";
BA_ "Version" SG_ 101 RSC_TqFlag_Rear "19.05.03";
BA_ "RoutingFactor" SG_ 101 RSC_TqFlag_Rear 5;
BA_ "UserSigValidity" SG_ 101 RSC_TqFlag_Rear 3;
BA_ "Description" SG_ 101 RSC_TqFlag_Rear "이 신호는 IEB_01_10ms 메시지의 RSC 후륜 토크 신호에 대한 부호를 의미한다.";
BA_ "Version" SG_ 101 IEB_AlvCnt1Val "21.09.03";
BA_ "RoutingFactor" SG_ 101 IEB_AlvCnt1Val 5;
BA_ "UserSigValidity" SG_ 101 IEB_AlvCnt1Val 3;
BA_ "Description" SG_ 101 IEB_AlvCnt1Val "For the first transmission request for a data element the counter shall be initialized with 0 and shall be incremented by 1 for every subsequent send request. 

When the counter reaches the maximum value(0xFF), then it shall restart with 0 for the next s";
BA_ "Version" SG_ 101 TCS_TqIntrvntnVal_Frnt "19.05.03";
BA_ "RoutingFactor" SG_ 101 TCS_TqIntrvntnVal_Frnt 5;
BA_ "UserSigValidity" SG_ 101 TCS_TqIntrvntnVal_Frnt 3;
BA_ "Description" SG_ 101 TCS_TqIntrvntnVal_Frnt "TCS 제어를 위한 전륜 구동토크의 요구값을 의미.

부호는 TCS_TqFlag_Frnt 신호를 참조.";
BA_ "Version" SG_ 101 TCS_TqIntrvntnVal_Rear "19.05.03";
BA_ "RoutingFactor" SG_ 101 TCS_TqIntrvntnVal_Rear 5;
BA_ "UserSigValidity" SG_ 101 TCS_TqIntrvntnVal_Rear 3;
BA_ "Description" SG_ 101 TCS_TqIntrvntnVal_Rear "TCS 제어를 위한 후륜 구동토크의 요구값을 의미.

부호는 TCS_TqFlag_Rear 신호를 참조.";
BA_ "Version" SG_ 101 RSC_TqIntrvntnVal_Frnt "19.05.03";
BA_ "RoutingFactor" SG_ 101 RSC_TqIntrvntnVal_Frnt 5;
BA_ "UserSigValidity" SG_ 101 RSC_TqIntrvntnVal_Frnt 3;
BA_ "Description" SG_ 101 RSC_TqIntrvntnVal_Frnt "RSC 제어를 위한 전륜 구동토크의 요구값을 의미.

부호는 RSC_TqFlag_Frnt 신호를 참조.";
BA_ "Version" SG_ 101 RSC_TqIntrvntnVal_Rear "19.05.03";
BA_ "RoutingFactor" SG_ 101 RSC_TqIntrvntnVal_Rear 5;
BA_ "UserSigValidity" SG_ 101 RSC_TqIntrvntnVal_Rear 3;
BA_ "Description" SG_ 101 RSC_TqIntrvntnVal_Rear "RSC 제어를 위한 후륜 구동토크의 요구값을 의미.

부호는 RSC_TqFlag_Rear 신호를 참조.";
BA_ "Version" SG_ 101 TCS_MtrTrgtRpm_Flag_Frnt "20.04.05";
BA_ "RoutingFactor" SG_ 101 TCS_MtrTrgtRpm_Flag_Frnt 5;
BA_ "UserSigValidity" SG_ 101 TCS_MtrTrgtRpm_Flag_Frnt 3;
BA_ "Description" SG_ 101 TCS_MtrTrgtRpm_Flag_Frnt "이 신호는 IEB_01_10ms 메시지의 TCS 작동시 전륜 모터의 타겟 RPM 신호(TCS_MtrTrgtRpm_Frnt)에 대한 부호를 의미한다.";
BA_ "Version" SG_ 101 TCS_MtrTrgtRpm_Flag_Rear "20.04.05";
BA_ "RoutingFactor" SG_ 101 TCS_MtrTrgtRpm_Flag_Rear 5;
BA_ "UserSigValidity" SG_ 101 TCS_MtrTrgtRpm_Flag_Rear 3;
BA_ "Description" SG_ 101 TCS_MtrTrgtRpm_Flag_Rear "이 신호는 IEB_01_10ms 메시지의 TCS 작동시 후륜 모터의 타겟 RPM 신호(TCS_MtrTrgtRpm_Rear)에 대한 부호를 의미한다.";
BA_ "Version" SG_ 101 IEB_DriftElsdModSta "24.05.01";
BA_ "RoutingFactor" SG_ 101 IEB_DriftElsdModSta 5;
BA_ "UserSigValidity" SG_ 101 IEB_DriftElsdModSta 3;
BA_ "Description" SG_ 101 IEB_DriftElsdModSta "ELSD mode command from DMIC by AVNT custom mode select";
BA_ "Version" SG_ 101 IEB_DriftEcsModSta "22.07.06";
BA_ "RoutingFactor" SG_ 101 IEB_DriftEcsModSta 5;
BA_ "UserSigValidity" SG_ 101 IEB_DriftEcsModSta 3;
BA_ "Description" SG_ 101 IEB_DriftEcsModSta "ECS mode command from DMIC by AVNT custom mode select";
BA_ "Version" SG_ 101 IEB_DriftMdpsModSta "22.07.06";
BA_ "RoutingFactor" SG_ 101 IEB_DriftMdpsModSta 5;
BA_ "UserSigValidity" SG_ 101 IEB_DriftMdpsModSta 3;
BA_ "Description" SG_ 101 IEB_DriftMdpsModSta "MDPS mode command from DMIC by AVNT custom mode select";
BA_ "Version" SG_ 101 TCS_MtrTrgtRpm_Frnt "20.04.05";
BA_ "RoutingFactor" SG_ 101 TCS_MtrTrgtRpm_Frnt 5;
BA_ "UserSigValidity" SG_ 101 TCS_MtrTrgtRpm_Frnt 3;
BA_ "Description" SG_ 101 TCS_MtrTrgtRpm_Frnt "TCS 제어를 위한 전륜 모터의 RPM 요구값을 의미.

부호는 TCS_MtrTrgtRpm_Flag_Frnt 신호를 참조.";
BA_ "Version" SG_ 101 TCS_MtrTrgtRpm_Rear "20.04.05";
BA_ "RoutingFactor" SG_ 101 TCS_MtrTrgtRpm_Rear 5;
BA_ "UserSigValidity" SG_ 101 TCS_MtrTrgtRpm_Rear 3;
BA_ "Description" SG_ 101 TCS_MtrTrgtRpm_Rear "TCS 제어를 위한 후륜 모터의 RPM 요구값을 의미.

부호는 TCS_MtrTrgtRpm_Flag_Rear 신호를 참조.";
BA_ "Version" SG_ 101 IEB_DriftModeSta "20.12.02";
BA_ "RoutingFactor" SG_ 101 IEB_DriftModeSta 5;
BA_ "UserSigValidity" SG_ 101 IEB_DriftModeSta 3;
BA_ "Description" SG_ 101 IEB_DriftModeSta "This signal is for a pop-up display on drift mode.";
BA_ "Version" SG_ 101 IEB_DriftModeActSta "20.12.02";
BA_ "RoutingFactor" SG_ 101 IEB_DriftModeActSta 5;
BA_ "UserSigValidity" SG_ 101 IEB_DriftModeActSta 3;
BA_ "Description" SG_ 101 IEB_DriftModeActSta "This signal is for drift mode ON/OFF status";
BA_ "Version" SG_ 101 MCU_AntiJerk_Inhbtsta "22.11.03";
BA_ "RoutingFactor" SG_ 101 MCU_AntiJerk_Inhbtsta 5;
BA_ "UserSigValidity" SG_ 101 MCU_AntiJerk_Inhbtsta 3;
BA_ "Description" SG_ 101 MCU_AntiJerk_Inhbtsta "MCU_AntiJerk_Inhbtsta is a signal to inform the MCU of anti-jerk control prohibition in order to prevent side effects caused by intervention in the IEB when ABS control and MCU anti-jerk control overlap.";
BA_ "Version" SG_ 101 IEB_Motor_ProtectModSta "22.08.03";
BA_ "RoutingFactor" SG_ 101 IEB_Motor_ProtectModSta 5;
BA_ "UserSigValidity" SG_ 101 IEB_Motor_ProtectModSta 3;
BA_ "Description" SG_ 101 IEB_Motor_ProtectModSta "It is a signal to notify when the internal motor protection mode of the electric integrated booster is activated.

When the corresponding signal becomes a flag (0x1), the braking pressure is limited to a maximum of 60bar in the stop state.

It is not aff";
BA_ "Version" SG_ 101 IEB_EstBrkSacFrcNmVal "21.11.00";
BA_ "RoutingFactor" SG_ 101 IEB_EstBrkSacFrcNmVal 5;
BA_ "UserSigValidity" SG_ 101 IEB_EstBrkSacFrcNmVal 3;
BA_ "Description" SG_ 101 IEB_EstBrkSacFrcNmVal "Estimated brake force value for stop assist control";
BA_ "Version" SG_ 101 IEB_SrvLmpDis "19.05.02";
BA_ "RoutingFactor" SG_ 101 IEB_SrvLmpDis 5;
BA_ "UserSigValidity" SG_ 101 IEB_SrvLmpDis 3;
BA_ "Description" SG_ 101 IEB_SrvLmpDis "The signal indicates the status of the “AHB Service lamp”";
BA_ "Version" SG_ 101 IEB_IndDriftEscModSta_TCS "22.07.06";
BA_ "RoutingFactor" SG_ 101 IEB_IndDriftEscModSta_TCS 5;
BA_ "UserSigValidity" SG_ 101 IEB_IndDriftEscModSta_TCS 3;
BA_ "Description" SG_ 101 IEB_IndDriftEscModSta_TCS "Signal for feed back of TCS mode change from DMIC by AVNT custom mode select";
BA_ "Version" SG_ 101 IEB_IndDriftEscModSta_VDC "24.04.06";
BA_ "RoutingFactor" SG_ 101 IEB_IndDriftEscModSta_VDC 5;
BA_ "UserSigValidity" SG_ 101 IEB_IndDriftEscModSta_VDC 3;
BA_ "Description" SG_ 101 IEB_IndDriftEscModSta_VDC "Signal for feed back of ESC/VDC mode command from DMIC by AVNT custom mode select";
BA_ "Version" SG_ 101 IEB_DfctvSta "19.05.02";
BA_ "RoutingFactor" SG_ 101 IEB_DfctvSta 5;
BA_ "UserSigValidity" SG_ 101 IEB_DfctvSta 3;
BA_ "Description" SG_ 101 IEB_DfctvSta "Information regarding the AHB 'defective' indication.";
BA_ "Version" SG_ 101 IEB_ActvSta "19.05.02";
BA_ "RoutingFactor" SG_ 101 IEB_ActvSta 5;
BA_ "UserSigValidity" SG_ 101 IEB_ActvSta 3;
BA_ "Description" SG_ 101 IEB_ActvSta "Information regarding AHB “Control Active” signal";
BA_ "Version" SG_ 101 IEB_DiagSta "19.05.02";
BA_ "RoutingFactor" SG_ 101 IEB_DiagSta 5;
BA_ "UserSigValidity" SG_ 101 IEB_DiagSta 3;
BA_ "Description" SG_ 101 IEB_DiagSta "Information regarding the AHB “diagnostic mode” indication.";
BA_ "Version" SG_ 101 IEB_WrngLmpDis "19.05.02";
BA_ "RoutingFactor" SG_ 101 IEB_WrngLmpDis 5;
BA_ "UserSigValidity" SG_ 101 IEB_WrngLmpDis 3;
BA_ "Description" SG_ 101 IEB_WrngLmpDis "The signal indicates the status of the “AHB Warning lamp”";
BA_ "Version" SG_ 101 IEB_MILReq "19.05.02";
BA_ "RoutingFactor" SG_ 101 IEB_MILReq 5;
BA_ "UserSigValidity" SG_ 101 IEB_MILReq 3;
BA_ "Description" SG_ 101 IEB_MILReq "IEB sends this signal to turn on the Malfunction Indicator Lamp (MIL).";
BA_ "Version" SG_ 101 IEB_DriftModeStaDis "22.11.03";
BA_ "RoutingFactor" SG_ 101 IEB_DriftModeStaDis 5;
BA_ "UserSigValidity" SG_ 101 IEB_DriftModeStaDis 3;
BA_ "Description" SG_ 101 IEB_DriftModeStaDis "This signal is for a pop-up display on restriction status of drift mode activation";
BA_ "Version" SG_ 101 RSC_Sta "23.04.06";
BA_ "RoutingFactor" SG_ 101 RSC_Sta 5;
BA_ "UserSigValidity" SG_ 101 RSC_Sta 3;
BA_ "Description" SG_ 101 RSC_Sta "RSC Ready Status";
BA_ "Version" SG_ 101 IEB_StrkDpthmmVal "19.05.02";
BA_ "RoutingFactor" SG_ 101 IEB_StrkDpthmmVal 5;
BA_ "UserSigValidity" SG_ 101 IEB_StrkDpthmmVal 3;
BA_ "Description" SG_ 101 IEB_StrkDpthmmVal "The signal indicates the depth of brake pedal";
BA_ "Version" SG_ 101 IEB_BrkActvSta "19.05.05";
BA_ "RoutingFactor" SG_ 101 IEB_BrkActvSta 5;
BA_ "UserSigValidity" SG_ 101 IEB_BrkActvSta 3;
BA_ "Description" SG_ 101 IEB_BrkActvSta "This signal indicates that a brake switch is activated or not. When the brake switch is activated(pressed) its value is 02H otherwise its value is 01H.

If the ECU does not support this signal the value is 00H.



이 신호는 EV, FCEV 에서만 사용될 수 있음";
BA_ "Version" SG_ 101 IEB_PdlTrvlSnsrFailSta "19.05.02";
BA_ "RoutingFactor" SG_ 101 IEB_PdlTrvlSnsrFailSta 5;
BA_ "UserSigValidity" SG_ 101 IEB_PdlTrvlSnsrFailSta 3;
BA_ "Description" SG_ 101 IEB_PdlTrvlSnsrFailSta "Information regarding the pedal travel sensor fail status";
BA_ "Version" SG_ 101 IEB_PdlCalibSta "19.05.02";
BA_ "RoutingFactor" SG_ 101 IEB_PdlCalibSta 5;
BA_ "UserSigValidity" SG_ 101 IEB_PdlCalibSta 3;
BA_ "Description" SG_ 101 IEB_PdlCalibSta "Information regarding the pedal travel sensor’s calibration status";
BA_ "Version" SG_ 101 IEB_BzrSta "19.05.02";
BA_ "RoutingFactor" SG_ 101 IEB_BzrSta 5;
BA_ "UserSigValidity" SG_ 101 IEB_BzrSta 3;
BA_ "Description" SG_ 101 IEB_BzrSta "The signal indicates the status of the “Buzzer”";
BA_ "Version" SG_ 101 IEB_Sta "19.06.01";
BA_ "RoutingFactor" SG_ 101 IEB_Sta 5;
BA_ "UserSigValidity" SG_ 101 IEB_Sta 3;
BA_ "Description" SG_ 101 IEB_Sta "EBS Ready Status

※ 전/후륜에 대한 구분이 없는 경우에는 0x0 (Not Ready) / 0x1(Ready) 만 사용한다.

     : 전륜 구동 회생제동 차량의 경우, 0x0 는 Front not Ready / 0x1은 Front only Ready를 의미함.";
BA_ "Version" SG_ 101 IEB_SnsrFailSta "19.05.02";
BA_ "RoutingFactor" SG_ 101 IEB_SnsrFailSta 5;
BA_ "UserSigValidity" SG_ 101 IEB_SnsrFailSta 3;
BA_ "Version" SG_ 101 IEB_RbsWrngLmpSta "19.05.02";
BA_ "RoutingFactor" SG_ 101 IEB_RbsWrngLmpSta 5;
BA_ "UserSigValidity" SG_ 101 IEB_RbsWrngLmpSta 3;
BA_ "Description" SG_ 101 IEB_RbsWrngLmpSta "This signal indicates RBS warning lamp status.";
BA_ "Version" SG_ 101 IEB_VacSysDfctvSta "19.05.02";
BA_ "RoutingFactor" SG_ 101 IEB_VacSysDfctvSta 5;
BA_ "UserSigValidity" SG_ 101 IEB_VacSysDfctvSta 3;
BA_ "Description" SG_ 101 IEB_VacSysDfctvSta "This signal indicates Vacuum pump “defective”.";
BA_ "Version" SG_ 101 IEB_RegenTqLimitNmVal_Frnt "19.05.03";
BA_ "RoutingFactor" SG_ 101 IEB_RegenTqLimitNmVal_Frnt 5;
BA_ "UserSigValidity" SG_ 101 IEB_RegenTqLimitNmVal_Frnt 3;
BA_ "Description" SG_ 101 IEB_RegenTqLimitNmVal_Frnt "Regen Brake Torque limit at front wheel";
BA_ "Version" SG_ 101 IEB_EstTtlBrkFrcNmVal "19.05.02";
BA_ "RoutingFactor" SG_ 101 IEB_EstTtlBrkFrcNmVal 5;
BA_ "UserSigValidity" SG_ 101 IEB_EstTtlBrkFrcNmVal 3;
BA_ "Description" SG_ 101 IEB_EstTtlBrkFrcNmVal "Estimated Total Brake Force";
BA_ "Version" SG_ 704 VCU_Crc6Val "19.07.01";
BA_ "UserSigValidity" SG_ 704 VCU_Crc6Val 3;
BA_ "GenSigStartValue" SG_ 704 VCU_Crc6Val 65535;
BA_ "Description" SG_ 704 VCU_Crc6Val "The data area for CRC calculation is based on the data length (DLC) of the message DB.

The CRC shall be calculated over the entire data block (excluding the CRC bytes) including the user data, alive counter and Data ID

 

- CRC Polynomial (0x1021) , In";
BA_ "Version" SG_ 704 VCU_BstWarnMsg "22.10.19";
BA_ "UserSigValidity" SG_ 704 VCU_BstWarnMsg 7;
BA_ "TimeoutValue" SG_ 704 VCU_BstWarnMsg "0x0";
BA_ "Description" SG_ 704 VCU_BstWarnMsg "Boost function's warning message";
BA_ "Version" SG_ 704 VCU_BstAvailSta "20.09.00";
BA_ "UserSigValidity" SG_ 704 VCU_BstAvailSta 7;
BA_ "Description" SG_ 704 VCU_BstAvailSta "Boost function's available status";
BA_ "Version" SG_ 704 VCU_BstAplySta "20.10.00";
BA_ "UserSigValidity" SG_ 704 VCU_BstAplySta 7;
BA_ "Description" SG_ 704 VCU_BstAplySta "Boost function's apply status";
BA_ "Version" SG_ 704 VCU_MxPwrMdSta "21.12.05";
BA_ "UserSigValidity" SG_ 704 VCU_MxPwrMdSta 7;
BA_ "Description" SG_ 704 VCU_MxPwrMdSta "Max Power Mode State";
BA_ "Version" SG_ 704 VCU_MxPwrMdSegVal "21.12.05";
BA_ "UserSigValidity" SG_ 704 VCU_MxPwrMdSegVal 7;
BA_ "Description" SG_ 704 VCU_MxPwrMdSegVal "Max Power Mode Segement Value";
BA_ "Version" SG_ 704 VCU_MxPwrMdOSD "22.01.00";
BA_ "UserSigValidity" SG_ 704 VCU_MxPwrMdOSD 7;
BA_ "Description" SG_ 704 VCU_MxPwrMdOSD "Max Power Mode Related SS OSD Pop-up request";
BA_ "Version" SG_ 704 VCU_PwrDnByHoodOpenSta "22.01.06";
BA_ "UserSigValidity" SG_ 704 VCU_PwrDnByHoodOpenSta 7;
BA_ "Description" SG_ 704 VCU_PwrDnByHoodOpenSta "Power Down Status By Hood Open";
BA_ "Version" SG_ 704 VCU_FlatTowModeConIndSta "23.07.05";
BA_ "UserSigValidity" SG_ 704 VCU_FlatTowModeConIndSta 3;
BA_ "Description" SG_ 704 VCU_FlatTowModeConIndSta "FlatTowMode Condition State";
BA_ "Version" SG_ 704 VCU_VgsVirAGIUpGear "22.10.19";
BA_ "UserSigValidity" SG_ 704 VCU_VgsVirAGIUpGear 7;
BA_ "Description" SG_ 704 VCU_VgsVirAGIUpGear "AGI)Available Gear Indicator) Gear capable of upshifting";
BA_ "Version" SG_ 704 VCU_VgsVirAGIDnGear "22.10.19";
BA_ "UserSigValidity" SG_ 704 VCU_VgsVirAGIDnGear 7;
BA_ "Description" SG_ 704 VCU_VgsVirAGIDnGear "AGI)Available Gear Indicator) Gear capable of downshifting";
BA_ "Version" SG_ 704 VCU_NCstmBrkOvrSta "22.08.00";
BA_ "UserSigValidity" SG_ 704 VCU_NCstmBrkOvrSta 7;
BA_ "Description" SG_ 704 VCU_NCstmBrkOvrSta "The Brake override system could be deactivated by a driver";
BA_ "Version" SG_ 704 VCU_NCondDragSta "22.07.06";
BA_ "UserSigValidity" SG_ 704 VCU_NCondDragSta 7;
BA_ "Description" SG_ 704 VCU_NCondDragSta "N-Conditioning/Drag Mode State";
BA_ "Version" SG_ 704 VCU_NCondDragSegVal "22.07.06";
BA_ "UserSigValidity" SG_ 704 VCU_NCondDragSegVal 7;
BA_ "Description" SG_ 704 VCU_NCondDragSegVal "NConditioning Drag Mode Segement Value";
BA_ "Version" SG_ 704 VCU_NCondTrackSta "22.07.06";
BA_ "UserSigValidity" SG_ 704 VCU_NCondTrackSta 7;
BA_ "Description" SG_ 704 VCU_NCondTrackSta "N Conditioning Track Mode State";
BA_ "Version" SG_ 704 VCU_NCondTrackTimeVal "22.07.06";
BA_ "UserSigValidity" SG_ 704 VCU_NCondTrackTimeVal 7;
BA_ "Description" SG_ 704 VCU_NCondTrackTimeVal "N Conditioning Track Mode Estimated Time Value";
BA_ "Version" SG_ 704 VCU_NCondOSD "22.07.06";
BA_ "UserSigValidity" SG_ 704 VCU_NCondOSD 7;
BA_ "Description" SG_ 704 VCU_NCondOSD "N Conditioning Related SS OSD Pop-up request";
BA_ "Version" SG_ 704 VCU_ExpUnitEnrgCnsmptnVal "23.02.09";
BA_ "UserSigValidity" SG_ 704 VCU_ExpUnitEnrgCnsmptnVal 7;
BA_ "Description" SG_ 704 VCU_ExpUnitEnrgCnsmptnVal "Expected energy consumption per km.

The resolution is 10.



- 0xFF:Error indicator

- 0x0~0xFE:0~2540";
BA_ "Version" SG_ 704 VCU_AlvCnt6Val "19.07.01";
BA_ "UserSigValidity" SG_ 704 VCU_AlvCnt6Val 3;
BA_ "Description" SG_ 704 VCU_AlvCnt6Val "For the first transmission request for a data element the counter shall be initialized with 0 and shall be incremented by 1 for every subsequent send request. 

When the counter reaches the maximum value(0xFF), then it shall restart with 0 for the next s";
BA_ "Version" SG_ 704 VCU_FlatTowModeChgPwrUsmSta "23.07.05";
BA_ "UserSigValidity" SG_ 704 VCU_FlatTowModeChgPwrUsmSta 3;
BA_ "Description" SG_ 704 VCU_FlatTowModeChgPwrUsmSta "Charging Power for FlatTow";
BA_ "Version" SG_ 704 VCU_NCstmHighPefMdWarnMsg "23.02.02";
BA_ "UserSigValidity" SG_ 704 VCU_NCstmHighPefMdWarnMsg 7;
BA_ "Description" SG_ 704 VCU_NCstmHighPefMdWarnMsg "High Performance mode Warning Message";
BA_ "Version" SG_ 704 VCU_NCstmNtdUsmSta "23.02.02";
BA_ "UserSigValidity" SG_ 704 VCU_NCstmNtdUsmSta 7;
BA_ "Description" SG_ 704 VCU_NCstmNtdUsmSta "N Torque Distribition mode activation State(for High Performance vehicle USM)";
BA_ "Version" SG_ 704 VCU_EstRoadSlopeValue "22.12.04";
BA_ "UserSigValidity" SG_ 704 VCU_EstRoadSlopeValue 3;
BA_ "Description" SG_ 704 VCU_EstRoadSlopeValue "0x0~0xFE:Slope, 0xFF:Error";
BA_ "Version" SG_ 704 VCU_DteV2LVal "23.01.01";
BA_ "UserSigValidity" SG_ 704 VCU_DteV2LVal 7;
BA_ "Description" SG_ 704 VCU_DteV2LVal "This signal is the V2L DTE when V2L SOC value is limited";
BA_ "Version" SG_ 704 VCU_TrgFuelEcoVal_PerkWh "23.01.01";
BA_ "UserSigValidity" SG_ 704 VCU_TrgFuelEcoVal_PerkWh 7;
BA_ "Description" SG_ 704 VCU_TrgFuelEcoVal_PerkWh "This signal is the target fuel economy value (Unit : km/kWh or mile/kWh).

This signal is approximate and may not match the authorized value.

This signal is used only for cluster display



- 0x00~0x7C : 0~124 (for km/h) / 0x00~0x84 : 0~132 (for mph)

-";
BA_ "Version" SG_ 704 VCU_FlatTowModeUsmSta "23.07.05";
BA_ "UserSigValidity" SG_ 704 VCU_FlatTowModeUsmSta 3;
BA_ "Description" SG_ 704 VCU_FlatTowModeUsmSta "FlatTowMode Usm State (acknowledge)";
BA_ "Version" SG_ 704 VCU_FlatTowModeEquip "23.07.05";
BA_ "UserSigValidity" SG_ 704 VCU_FlatTowModeEquip 3;
BA_ "Description" SG_ 704 VCU_FlatTowModeEquip "FlatTow Equipment State";
BA_ "Version" SG_ 704 VCU_MaintenanceSrvMd "23.07.06";
BA_ "UserSigValidity" SG_ 704 VCU_MaintenanceSrvMd 7;
BA_ "Description" SG_ 704 VCU_MaintenanceSrvMd "VCU to BMS M/Rly OFF request status for Maintanance mode";
BA_ "Version" SG_ 704 VCU_DteQcChrgStsVal "23.10.03";
BA_ "UserSigValidity" SG_ 704 VCU_DteQcChrgStsVal 7;
BA_ "Description" SG_ 704 VCU_DteQcChrgStsVal "This signal is the DTE for Quick charging state

- Physical value min. : 0 (0x0)

- Physical value max. : 2047 (0x7FF)";
BA_ "Version" SG_ 704 VCU_CnvrtPermPwrVal "23.10.05";
BA_ "UserSigValidity" SG_ 704 VCU_CnvrtPermPwrVal 7;
BA_ "Description" SG_ 704 VCU_CnvrtPermPwrVal "48V Convert Permission Power";
BA_ "Version" SG_ 704 VCU_CnvrtOpPermSta "23.10.05";
BA_ "UserSigValidity" SG_ 704 VCU_CnvrtOpPermSta 7;
BA_ "Description" SG_ 704 VCU_CnvrtOpPermSta "48V Convert Operating Permission";
BA_ "Version" SG_ 704 VCU_ARSPosition "23.11.02";
BA_ "UserSigValidity" SG_ 704 VCU_ARSPosition 3;
BA_ "TimeoutValue" SG_ 704 VCU_ARSPosition "0x7";
BA_ "Description" SG_ 704 VCU_ARSPosition "Active Rear Spoiler Position Information";
BA_ "Version" SG_ 704 VCU_AccelBoostOnOffSta "23.11.04";
BA_ "UserSigValidity" SG_ 704 VCU_AccelBoostOnOffSta 6;
BA_ "Description" SG_ 704 VCU_AccelBoostOnOffSta "Accel Boost on off";
BA_ "Version" SG_ 704 VCU_DteGuideVal "24.06.00";
BA_ "UserSigValidity" SG_ 704 VCU_DteGuideVal 7;
BA_ "Description" SG_ 704 VCU_DteGuideVal "This signal is Guide DTE

- Physical value min. : 0 (0x0)

- Physical value max. : 2047 (0x7FF)";
BA_ "Version" SG_ 704 VCU_Required_ADASMapMsg "19.07.01";
BA_ "UserSigValidity" SG_ 704 VCU_Required_ADASMapMsg 7;
BA_ "Description" SG_ 704 VCU_Required_ADASMapMsg "Map based ADAS messages information used in VCU";
BA_ "Version" SG_ 704 VCU_HvBatAutoDchOpSta "23.12.00";
BA_ "UserSigValidity" SG_ 704 VCU_HvBatAutoDchOpSta 7;
BA_ "Description" SG_ 704 VCU_HvBatAutoDchOpSta "High Voltage Battery Auto Discharge's operating status (ENG_HVBAD Gen2)";
BA_ "Version" SG_ 704 VCU_UtilModeWarnAddMsgSta "24.04.03";
BA_ "UserSigValidity" SG_ 704 VCU_UtilModeWarnAddMsgSta 7;
BA_ "Description" SG_ 704 VCU_UtilModeWarnAddMsgSta "Rest Mode warning message including request controller information";
BA_ "Version" SG_ 704 VCU_TowModSta "24.04.03";
BA_ "UserSigValidity" SG_ 704 VCU_TowModSta 3;
BA_ "Description" SG_ 704 VCU_TowModSta "Tow Mode On State";
BA_ "Version" SG_ 704 VCU_TowLvlSta "24.04.03";
BA_ "UserSigValidity" SG_ 704 VCU_TowLvlSta 3;
BA_ "Description" SG_ 704 VCU_TowLvlSta "Calculated Towing Level";
BA_ "Version" SG_ 704 VCU_SwVer "19.07.01";
BA_ "UserSigValidity" SG_ 704 VCU_SwVer 7;
BA_ "Description" SG_ 704 VCU_SwVer "VCU SW Version X.XX (Bit0~3 : Development Step, Bit3~7 : Month)";
BA_ "Version" SG_ 704 VCU_PwrAutoOffInfo "19.12.08";
BA_ "UserSigValidity" SG_ 704 VCU_PwrAutoOffInfo 7;
BA_ "Description" SG_ 704 VCU_PwrAutoOffInfo "Auto Power Off Activation bit";
BA_ "Version" SG_ 704 VCU_PwrAutoOffTimerSta "19.12.08";
BA_ "UserSigValidity" SG_ 704 VCU_PwrAutoOffTimerSta 7;
BA_ "Description" SG_ 704 VCU_PwrAutoOffTimerSta "Auto Power Off Timer Setting Value";
BA_ "Version" SG_ 704 VCU_FlatTowModeTargetSocUsmSta "23.07.05";
BA_ "UserSigValidity" SG_ 704 VCU_FlatTowModeTargetSocUsmSta 3;
BA_ "Description" SG_ 704 VCU_FlatTowModeTargetSocUsmSta "Charging Target SOC for FlatTowMode";
BA_ "Version" SG_ 704 VCU_AutoShutOffTimerMin "19.12.08";
BA_ "UserSigValidity" SG_ 704 VCU_AutoShutOffTimerMin 7;
BA_ "Description" SG_ 704 VCU_AutoShutOffTimerMin "0x0:Default(Timer Stop)/

0x1~0xFA:250min ~ 1min/

0xFB~0xFE:Reserved/

0xFF:Invalid";
BA_ "Version" SG_ 704 VCU_AutoShutOffTimerSec "19.12.08";
BA_ "UserSigValidity" SG_ 704 VCU_AutoShutOffTimerSec 7;
BA_ "Description" SG_ 704 VCU_AutoShutOffTimerSec "0x0:Default(Timer Stop)/

0x1~0x3C:60sec ~ 1sec/

0x3D~0x3E:Reserved/

0x3F:Invalid";
BA_ "Version" SG_ 704 VCU_PwrAutoOffTimerReset "19.12.08";
BA_ "UserSigValidity" SG_ 704 VCU_PwrAutoOffTimerReset 7;
BA_ "Description" SG_ 704 VCU_PwrAutoOffTimerReset "Auto Power Off Timer Reset bit";
BA_ "Version" SG_ 704 VCU_AutoShutOffReq "19.12.08";
BA_ "UserSigValidity" SG_ 704 VCU_AutoShutOffReq 7;
BA_ "Description" SG_ 704 VCU_AutoShutOffReq "0x0~0xE:IG ON/

0xF:IG OFF";
BA_ "Version" SG_ 704 VCU_DrvInfoPageOptSta "23.02.09";
BA_ "UserSigValidity" SG_ 704 VCU_DrvInfoPageOptSta 7;
BA_ "Description" SG_ 704 VCU_DrvInfoPageOptSta "AVN Driving information page option state";
BA_ "Version" SG_ 704 VCU_TireSizeWrnMsgSta "20.02.01";
BA_ "UserSigValidity" SG_ 704 VCU_TireSizeWrnMsgSta 7;
BA_ "Description" SG_ 704 VCU_TireSizeWrnMsgSta "Tire Size Warning Message Popup";
BA_ "Version" SG_ 704 VCU_FrntTqDispPcVal "20.02.01";
BA_ "UserSigValidity" SG_ 704 VCU_FrntTqDispPcVal 7;
BA_ "TimeoutValue" SG_ 704 VCU_FrntTqDispPcVal "0x0";
BA_ "Description" SG_ 704 VCU_FrntTqDispPcVal "Front Torque Display Percent Value";
BA_ "Version" SG_ 704 VCU_RearTqDispPcVal "20.02.01";
BA_ "UserSigValidity" SG_ 704 VCU_RearTqDispPcVal 7;
BA_ "TimeoutValue" SG_ 704 VCU_RearTqDispPcVal "0x0";
BA_ "Description" SG_ 704 VCU_RearTqDispPcVal "Rear Torque Display Percent Value";
BA_ "Version" SG_ 704 VCU_BstOpSta "20.08.05";
BA_ "UserSigValidity" SG_ 704 VCU_BstOpSta 7;
BA_ "Description" SG_ 704 VCU_BstOpSta "Boost function's operating status";
BA_ "Version" SG_ 704 VCU_BstTimerVal "20.08.05";
BA_ "UserSigValidity" SG_ 704 VCU_BstTimerVal 7;
BA_ "Description" SG_ 704 VCU_BstTimerVal "Boost function's timer value";
BA_ "Version" SG_ 979 BDC_FD_Crc4Val "22.11.04";
BA_ "UserSigValidity" SG_ 979 BDC_FD_Crc4Val 0;
BA_ "GenSigStartValue" SG_ 979 BDC_FD_Crc4Val 65535;
BA_ "GenSigSendType" SG_ 979 BDC_FD_Crc4Val 4;
BA_ "Description" SG_ 979 BDC_FD_Crc4Val "The data area for CRC calculation is based on the data length (DLC) of the message DB.

The CRC shall be calculated over the entire data block (excluding the CRC bytes) including the user data, alive counter and Data ID



- CRC Polynomial (0x1021) , Ini";
BA_ "Version" SG_ 979 BDC_FD_AlvCnt4Val "22.11.04";
BA_ "UserSigValidity" SG_ 979 BDC_FD_AlvCnt4Val 0;
BA_ "GenSigSendType" SG_ 979 BDC_FD_AlvCnt4Val 4;
BA_ "Description" SG_ 979 BDC_FD_AlvCnt4Val "For the first transmission request for a data element the counter shall be initialized with 0 and shall be incremented by 1 for every subsequent send request. 

When the counter reaches the maximum value(0xFF), then it shall restart with 0 for the next s";
BA_ "Version" SG_ 979 BAlarm_BglrAlrm_CurrentSta "22.11.02";
BA_ "NetworkRequestHoldingTime" SG_ 979 BAlarm_BglrAlrm_CurrentSta 5000;
BA_ "NetworkRequest" SG_ 979 BAlarm_BglrAlrm_CurrentSta 0;
BA_ "UserSigValidity" SG_ 979 BAlarm_BglrAlrm_CurrentSta 0;
BA_ "GenSigSendType" SG_ 979 BAlarm_BglrAlrm_CurrentSta 4;
BA_ "Version" SG_ 979 BAlarm_BglrAlrm_Sta "22.11.02";
BA_ "NetworkRequestHoldingTime" SG_ 979 BAlarm_BglrAlrm_Sta 5000;
BA_ "NetworkRequest" SG_ 979 BAlarm_BglrAlrm_Sta 0;
BA_ "UserSigValidity" SG_ 979 BAlarm_BglrAlrm_Sta 0;
BA_ "GenSigSendType" SG_ 979 BAlarm_BglrAlrm_Sta 4;
BA_ "Version" SG_ 979 BAlarm_PncAlrmSta "21.09.05";
BA_ "NetworkRequestHoldingTime" SG_ 979 BAlarm_PncAlrmSta 5000;
BA_ "NetworkRequest" SG_ 979 BAlarm_PncAlrmSta 0;
BA_ "UserSigValidity" SG_ 979 BAlarm_PncAlrmSta 0;
BA_ "GenSigSendType" SG_ 979 BAlarm_PncAlrmSta 4;
BA_ "Description" SG_ 979 BAlarm_PncAlrmSta "-For TeleCranking Panic Function

-This signal send to IBOX";
BA_ "Version" SG_ 979 SBR_StBltStpWrngBzrSta "18.07.03";
BA_ "NetworkRequestHoldingTime" SG_ 979 SBR_StBltStpWrngBzrSta 5000;
BA_ "NetworkRequest" SG_ 979 SBR_StBltStpWrngBzrSta 0;
BA_ "UserSigValidity" SG_ 979 SBR_StBltStpWrngBzrSta 0;
BA_ "GenSigSendType" SG_ 979 SBR_StBltStpWrngBzrSta 4;
BA_ "Description" SG_ 979 SBR_StBltStpWrngBzrSta "This signal is used for control the Seatbelt Step Warning Buzzer function with 3 bits.

It provides pre-warning, 1st warning, 2nd warning and 3rd warning.";
BA_ "Version" SG_ 979 SBR_StBltWrngBzrSta "17.12.00";
BA_ "NetworkRequestHoldingTime" SG_ 979 SBR_StBltWrngBzrSta 5000;
BA_ "NetworkRequest" SG_ 979 SBR_StBltWrngBzrSta 0;
BA_ "UserSigValidity" SG_ 979 SBR_StBltWrngBzrSta 0;
BA_ "GenSigSendType" SG_ 979 SBR_StBltWrngBzrSta 4;
BA_ "Description" SG_ 979 SBR_StBltWrngBzrSta "-Seat belt Warning (Reminder) buzzer";
BA_ "Version" SG_ 979 BAlarm_BrglrHrnRlySta "17.12.00";
BA_ "NetworkRequestHoldingTime" SG_ 979 BAlarm_BrglrHrnRlySta 5000;
BA_ "NetworkRequest" SG_ 979 BAlarm_BrglrHrnRlySta 0;
BA_ "UserSigValidity" SG_ 979 BAlarm_BrglrHrnRlySta 0;
BA_ "GenSigSendType" SG_ 979 BAlarm_BrglrHrnRlySta 4;
BA_ "Version" SG_ 979 SBR_DrvStBltIndSta "17.12.00";
BA_ "NetworkRequestHoldingTime" SG_ 979 SBR_DrvStBltIndSta 5000;
BA_ "NetworkRequest" SG_ 979 SBR_DrvStBltIndSta 0;
BA_ "UserSigValidity" SG_ 979 SBR_DrvStBltIndSta 0;
BA_ "GenSigSendType" SG_ 979 SBR_DrvStBltIndSta 4;
BA_ "Version" SG_ 979 SBR_RrLftStBltWrngIndSta "18.06.01";
BA_ "NetworkRequestHoldingTime" SG_ 979 SBR_RrLftStBltWrngIndSta 5000;
BA_ "NetworkRequest" SG_ 979 SBR_RrLftStBltWrngIndSta 0;
BA_ "UserSigValidity" SG_ 979 SBR_RrLftStBltWrngIndSta 0;
BA_ "GenSigSendType" SG_ 979 SBR_RrLftStBltWrngIndSta 4;
BA_ "Version" SG_ 979 SBR_RrRtStBltWrngIndSta "18.06.01";
BA_ "NetworkRequestHoldingTime" SG_ 979 SBR_RrRtStBltWrngIndSta 5000;
BA_ "NetworkRequest" SG_ 979 SBR_RrRtStBltWrngIndSta 0;
BA_ "UserSigValidity" SG_ 979 SBR_RrRtStBltWrngIndSta 0;
BA_ "GenSigSendType" SG_ 979 SBR_RrRtStBltWrngIndSta 4;
BA_ "Version" SG_ 979 SBR_RrCtrStBltIndSta "20.01.01";
BA_ "NetworkRequestHoldingTime" SG_ 979 SBR_RrCtrStBltIndSta 5000;
BA_ "NetworkRequest" SG_ 979 SBR_RrCtrStBltIndSta 0;
BA_ "UserSigValidity" SG_ 979 SBR_RrCtrStBltIndSta 0;
BA_ "GenSigSendType" SG_ 979 SBR_RrCtrStBltIndSta 4;
BA_ "Version" SG_ 979 SBR_3rdLftStBltWrngIndSta "18.06.01";
BA_ "NetworkRequestHoldingTime" SG_ 979 SBR_3rdLftStBltWrngIndSta 5000;
BA_ "NetworkRequest" SG_ 979 SBR_3rdLftStBltWrngIndSta 0;
BA_ "UserSigValidity" SG_ 979 SBR_3rdLftStBltWrngIndSta 0;
BA_ "GenSigSendType" SG_ 979 SBR_3rdLftStBltWrngIndSta 4;
BA_ "Description" SG_ 979 SBR_3rdLftStBltWrngIndSta "This signal is used for control the 3th Row Left Seatbelt indicator function.";
BA_ "Version" SG_ 979 SBR_3rdRtStBltWrngIndSta "18.06.01";
BA_ "NetworkRequestHoldingTime" SG_ 979 SBR_3rdRtStBltWrngIndSta 5000;
BA_ "NetworkRequest" SG_ 979 SBR_3rdRtStBltWrngIndSta 0;
BA_ "UserSigValidity" SG_ 979 SBR_3rdRtStBltWrngIndSta 0;
BA_ "GenSigSendType" SG_ 979 SBR_3rdRtStBltWrngIndSta 4;
BA_ "Description" SG_ 979 SBR_3rdRtStBltWrngIndSta "This signal is used for control the 3th Row Right Seatbelt indicator function.";
BA_ "Version" SG_ 979 SBR_3rdCtrStBltWrngIndSta "20.01.01";
BA_ "NetworkRequestHoldingTime" SG_ 979 SBR_3rdCtrStBltWrngIndSta 5000;
BA_ "NetworkRequest" SG_ 979 SBR_3rdCtrStBltWrngIndSta 0;
BA_ "UserSigValidity" SG_ 979 SBR_3rdCtrStBltWrngIndSta 0;
BA_ "GenSigSendType" SG_ 979 SBR_3rdCtrStBltWrngIndSta 4;
BA_ "Description" SG_ 979 SBR_3rdCtrStBltWrngIndSta "This signal is used for control the 3th Row Center Seatbelt indicator function.";
BA_ "Version" SG_ 979 Warn_BzrWrngSta "17.12.00";
BA_ "NetworkRequestHoldingTime" SG_ 979 Warn_BzrWrngSta 5000;
BA_ "NetworkRequest" SG_ 979 Warn_BzrWrngSta 0;
BA_ "UserSigValidity" SG_ 979 Warn_BzrWrngSta 0;
BA_ "GenSigSendType" SG_ 979 Warn_BzrWrngSta 4;
BA_ "Description" SG_ 979 Warn_BzrWrngSta "-(Old)C_WngBuzzer";
BA_ "Version" SG_ 979 Warn_BCMWrngSta "23.04.04";
BA_ "NetworkRequestHoldingTime" SG_ 979 Warn_BCMWrngSta 5000;
BA_ "NetworkRequest" SG_ 979 Warn_BCMWrngSta 0;
BA_ "UserSigValidity" SG_ 979 Warn_BCMWrngSta 0;
BA_ "GenSigSendType" SG_ 979 Warn_BCMWrngSta 4;
BA_ "Description" SG_ 979 Warn_BCMWrngSta "Warning command og BCM";
BA_ "Version" SG_ 979 ROA_RrBlwAutoOffReq "21.04.00";
BA_ "NetworkRequestHoldingTime" SG_ 979 ROA_RrBlwAutoOffReq 5000;
BA_ "NetworkRequest" SG_ 979 ROA_RrBlwAutoOffReq 0;
BA_ "UserSigValidity" SG_ 979 ROA_RrBlwAutoOffReq 0;
BA_ "GenSigSendType" SG_ 979 ROA_RrBlwAutoOffReq 4;
BA_ "Description" SG_ 979 ROA_RrBlwAutoOffReq "This signal is used for a request to Rear Blow Off (Auto Cut)";
BA_ "Version" SG_ 979 ROA_RegionOpt "21.11.07";
BA_ "NetworkRequestHoldingTime" SG_ 979 ROA_RegionOpt 5000;
BA_ "NetworkRequest" SG_ 979 ROA_RegionOpt 0;
BA_ "UserSigValidity" SG_ 979 ROA_RegionOpt 0;
BA_ "GenSigSendType" SG_ 979 ROA_RegionOpt 4;
BA_ "Description" SG_ 979 ROA_RegionOpt "A Euro NCAP Option signal (BDC only)";
BA_ "Version" SG_ 979 Warn_RrStRmndOpt "21.04.00";
BA_ "NetworkRequestHoldingTime" SG_ 979 Warn_RrStRmndOpt 5000;
BA_ "NetworkRequest" SG_ 979 Warn_RrStRmndOpt 0;
BA_ "UserSigValidity" SG_ 979 Warn_RrStRmndOpt 0;
BA_ "GenSigSendType" SG_ 979 Warn_RrStRmndOpt 4;
BA_ "Description" SG_ 979 Warn_RrStRmndOpt "Rear Seat Reminder System Appled Option

(BDC Only Use 0x0 and 0x2 in Signal Value Table)";
BA_ "Version" SG_ 979 Warn_RrStRmndAlrmOnReq "17.12.00";
BA_ "NetworkRequestHoldingTime" SG_ 979 Warn_RrStRmndAlrmOnReq 5000;
BA_ "NetworkRequest" SG_ 979 Warn_RrStRmndAlrmOnReq 0;
BA_ "UserSigValidity" SG_ 979 Warn_RrStRmndAlrmOnReq 0;
BA_ "GenSigSendType" SG_ 979 Warn_RrStRmndAlrmOnReq 4;
BA_ "Description" SG_ 979 Warn_RrStRmndAlrmOnReq "Rear Seat Reminder Alarm State";
BA_ "Version" SG_ 979 Warn_RrStRmndSysSta "17.12.00";
BA_ "NetworkRequestHoldingTime" SG_ 979 Warn_RrStRmndSysSta 5000;
BA_ "NetworkRequest" SG_ 979 Warn_RrStRmndSysSta 0;
BA_ "UserSigValidity" SG_ 979 Warn_RrStRmndSysSta 0;
BA_ "GenSigSendType" SG_ 979 Warn_RrStRmndSysSta 4;
BA_ "Description" SG_ 979 Warn_RrStRmndSysSta "Rear Seat Reminder Alarm System Enable(On)/Disable(Off) state";
BA_ "Version" SG_ 979 Warn_RrStRmndAlrmInfo "24.03.06";
BA_ "NetworkRequestHoldingTime" SG_ 979 Warn_RrStRmndAlrmInfo 5000;
BA_ "NetworkRequest" SG_ 979 Warn_RrStRmndAlrmInfo 0;
BA_ "UserSigValidity" SG_ 979 Warn_RrStRmndAlrmInfo 0;
BA_ "GenSigSendType" SG_ 979 Warn_RrStRmndAlrmInfo 4;
BA_ "Description" SG_ 979 Warn_RrStRmndAlrmInfo "Rear Seat Reminder Warning request signal";
BA_ "Version" SG_ 979 Warn_RoaErr "18.07.01";
BA_ "NetworkRequestHoldingTime" SG_ 979 Warn_RoaErr 5000;
BA_ "NetworkRequest" SG_ 979 Warn_RoaErr 0;
BA_ "UserSigValidity" SG_ 979 Warn_RoaErr 0;
BA_ "GenSigSendType" SG_ 979 Warn_RoaErr 4;
BA_ "Description" SG_ 979 Warn_RoaErr "ROA SENSOR Error(Malfunction)  signal";
BA_ "Version" SG_ 979 Warn_RrStRmndDelay "22.03.04";
BA_ "NetworkRequestHoldingTime" SG_ 979 Warn_RrStRmndDelay 5000;
BA_ "NetworkRequest" SG_ 979 Warn_RrStRmndDelay 0;
BA_ "UserSigValidity" SG_ 979 Warn_RrStRmndDelay 0;
BA_ "TimeoutValue" SG_ 979 Warn_RrStRmndDelay "0x0";
BA_ "GenSigSendType" SG_ 979 Warn_RrStRmndDelay 4;
BA_ "Version" SG_ 979 Warn_RrStRmndSysAct "22.03.04";
BA_ "NetworkRequestHoldingTime" SG_ 979 Warn_RrStRmndSysAct 5000;
BA_ "NetworkRequest" SG_ 979 Warn_RrStRmndSysAct 0;
BA_ "UserSigValidity" SG_ 979 Warn_RrStRmndSysAct 0;
BA_ "TimeoutValue" SG_ 979 Warn_RrStRmndSysAct "0x0";
BA_ "GenSigSendType" SG_ 979 Warn_RrStRmndSysAct 4;
BA_ "Version" SG_ 979 WAL_FobSearching "19.06.00";
BA_ "NetworkRequestHoldingTime" SG_ 979 WAL_FobSearching 5000;
BA_ "NetworkRequest" SG_ 979 WAL_FobSearching 0;
BA_ "UserSigValidity" SG_ 979 WAL_FobSearching 0;
BA_ "GenSigSendType" SG_ 979 WAL_FobSearching 4;
BA_ "Description" SG_ 979 WAL_FobSearching "IBU Walk Away Lock Fob Searching State for Radar ROA

(LIN_IBU_WAL_FobSearching for UIP ROA)";
BA_ "Version" SG_ 979 Warn_RrStRmndSysOffIND "22.08.01";
BA_ "NetworkRequestHoldingTime" SG_ 979 Warn_RrStRmndSysOffIND 5000;
BA_ "NetworkRequest" SG_ 979 Warn_RrStRmndSysOffIND 0;
BA_ "UserSigValidity" SG_ 979 Warn_RrStRmndSysOffIND 0;
BA_ "TimeoutValue" SG_ 979 Warn_RrStRmndSysOffIND "0x0";
BA_ "GenSigSendType" SG_ 979 Warn_RrStRmndSysOffIND 4;
BA_ "Version" SG_ 979 Warn_VehNotPWrngSta "23.05.01";
BA_ "NetworkRequestHoldingTime" SG_ 979 Warn_VehNotPWrngSta 5000;
BA_ "NetworkRequest" SG_ 979 Warn_VehNotPWrngSta 0;
BA_ "UserSigValidity" SG_ 979 Warn_VehNotPWrngSta 0;
BA_ "GenSigSendType" SG_ 979 Warn_VehNotPWrngSta 4;
BA_ "Description" SG_ 979 Warn_VehNotPWrngSta "Vehicle Not P Warning";
BA_ "Version" SG_ 979 Warn_RrStRmndAlrmInfo_1 "24.04.06";
BA_ "NetworkRequestHoldingTime" SG_ 979 Warn_RrStRmndAlrmInfo_1 5000;
BA_ "NetworkRequest" SG_ 979 Warn_RrStRmndAlrmInfo_1 0;
BA_ "UserSigValidity" SG_ 979 Warn_RrStRmndAlrmInfo_1 0;
BA_ "GenSigSendType" SG_ 979 Warn_RrStRmndAlrmInfo_1 4;
BA_ "Description" SG_ 979 Warn_RrStRmndAlrmInfo_1 "Rear Seat Reminder Warning request signal";
BA_ "Version" SG_ 1059 HU_GW_Crc4Val "22.10.20";
BA_ "UserSigValidity" SG_ 1059 HU_GW_Crc4Val 3;
BA_ "GenSigStartValue" SG_ 1059 HU_GW_Crc4Val 65535;
BA_ "GenSigSendType" SG_ 1059 HU_GW_Crc4Val 4;
BA_ "Description" SG_ 1059 HU_GW_Crc4Val "The data area for CRC calculation is based on the data length (DLC) of the message DB.

The CRC shall be calculated over the entire data block (excluding the CRC bytes) including the user data, alive counter and Data ID



- CRC Polynomial (0x1021) , Ini";
BA_ "Version" SG_ 1059 CF_AVN_AutoWashModeSta "23.04.05";
BA_ "UserSigValidity" SG_ 1059 CF_AVN_AutoWashModeSta 3;
BA_ "GenSigSendType" SG_ 1059 CF_AVN_AutoWashModeSta 4;
BA_ "Description" SG_ 1059 CF_AVN_AutoWashModeSta "Washer Mode status signal";
BA_ "Version" SG_ 1059 HU_ResetOpSta "24.05.01";
BA_ "UserSigValidity" SG_ 1059 HU_ResetOpSta 0;
BA_ "GenSigSendType" SG_ 1059 HU_ResetOpSta 4;
BA_ "Description" SG_ 1059 HU_ResetOpSta "This signal indicates whether the reset operation has been completed or not";
BA_ "Version" SG_ 1059 OMUOSMirCtrl_Vr "22.07.05";
BA_ "UserSigValidity" SG_ 1059 OMUOSMirCtrl_Vr 3;
BA_ "GenSigStartValue" SG_ 1059 OMUOSMirCtrl_Vr 3;
BA_ "GenSigSendType" SG_ 1059 OMUOSMirCtrl_Vr 4;
BA_ "Version" SG_ 1059 HU_GW_AlvCnt4Val "22.10.20";
BA_ "UserSigValidity" SG_ 1059 HU_GW_AlvCnt4Val 3;
BA_ "GenSigSendType" SG_ 1059 HU_GW_AlvCnt4Val 4;
BA_ "Description" SG_ 1059 HU_GW_AlvCnt4Val "For the first transmission request for a data element the counter shall be initialized with 0 and shall be incremented by 1 for every subsequent send request. 

When the counter reaches the maximum value(0xFF), then it shall restart with 0 for the next s";
BA_ "Version" SG_ 1059 HU_Customer_Action_Ind "24.04.09";
BA_ "UserSigValidity" SG_ 1059 HU_Customer_Action_Ind 0;
BA_ "GenSigSendType" SG_ 1059 HU_Customer_Action_Ind 4;
BA_ "Description" SG_ 1059 HU_Customer_Action_Ind "Send indication signal to BCD when a customer uses the service.";
BA_ "Version" SG_ 1059 HU_IG3_Request "22.07.05";
BA_ "UserSigValidity" SG_ 1059 HU_IG3_Request 0;
BA_ "GenSigStartValue" SG_ 1059 HU_IG3_Request 3;
BA_ "GenSigSendType" SG_ 1059 HU_IG3_Request 4;
BA_ "Description" SG_ 1059 HU_IG3_Request "IG3 wake up and sleep Request signal for EV/PHEV/HEV



Please apply this signal after checking ICU on your vehicle.";
BA_ "Version" SG_ 1059 HU_DigitalKeyGroupingSupport "23.05.01";
BA_ "UserSigValidity" SG_ 1059 HU_DigitalKeyGroupingSupport 1;
BA_ "GenSigSendType" SG_ 1059 HU_DigitalKeyGroupingSupport 4;
BA_ "Description" SG_ 1059 HU_DigitalKeyGroupingSupport "This signal indicates whether the H/U can support the grouping specification for digital key.";
BA_ "Version" SG_ 1059 HU_Background "22.11.03";
BA_ "UserSigValidity" SG_ 1059 HU_Background 1;
BA_ "GenSigStartValue" SG_ 1059 HU_Background 7;
BA_ "GenSigSendType" SG_ 1059 HU_Background 4;
BA_ "Description" SG_ 1059 HU_Background "HU Backgound image info";
BA_ "Version" SG_ 1059 HU_BackgroundFadeInOut "22.07.05";
BA_ "UserSigValidity" SG_ 1059 HU_BackgroundFadeInOut 1;
BA_ "GenSigStartValue" SG_ 1059 HU_BackgroundFadeInOut 1023;
BA_ "GenSigSendType" SG_ 1059 HU_BackgroundFadeInOut 4;
BA_ "Description" SG_ 1059 HU_BackgroundFadeInOut "HU Background Fade in/out info

(HEX * Factor) %";
BA_ "Version" SG_ 983 BDC_FD_Crc8Val "22.11.04";
BA_ "UserSigValidity" SG_ 983 BDC_FD_Crc8Val 0;
BA_ "GenSigStartValue" SG_ 983 BDC_FD_Crc8Val 65535;
BA_ "GenSigSendType" SG_ 983 BDC_FD_Crc8Val 4;
BA_ "Description" SG_ 983 BDC_FD_Crc8Val "The data area for CRC calculation is based on the data length (DLC) of the message DB.

The CRC shall be calculated over the entire data block (excluding the CRC bytes) including the user data, alive counter and Data ID



- CRC Polynomial (0x1021) , Ini";
BA_ "Version" SG_ 983 Mirror_MnlFldModSta "23.01.03";
BA_ "NetworkRequestHoldingTime" SG_ 983 Mirror_MnlFldModSta 5000;
BA_ "NetworkRequest" SG_ 983 Mirror_MnlFldModSta 0;
BA_ "UserSigValidity" SG_ 983 Mirror_MnlFldModSta 0;
BA_ "GenSigSendType" SG_ 983 Mirror_MnlFldModSta 4;
BA_ "Description" SG_ 983 Mirror_MnlFldModSta "Mirror Manual Fold State

0x0:None = AutoFold Mode or Unfold Mode

0x1: ManualFold = ManualFold Mode";
BA_ "Version" SG_ 983 Mirror_SelSwSta "20.12.00";
BA_ "NetworkRequestHoldingTime" SG_ 983 Mirror_SelSwSta 5000;
BA_ "NetworkRequest" SG_ 983 Mirror_SelSwSta 0;
BA_ "UserSigValidity" SG_ 983 Mirror_SelSwSta 0;
BA_ "GenSigSendType" SG_ 983 Mirror_SelSwSta 4;
BA_ "Description" SG_ 983 Mirror_SelSwSta "Outside Mirror Select Button Status";
BA_ "Version" SG_ 983 Mirror_LHPosMnlReq "22.01.05";
BA_ "NetworkRequestHoldingTime" SG_ 983 Mirror_LHPosMnlReq 5000;
BA_ "NetworkRequest" SG_ 983 Mirror_LHPosMnlReq 0;
BA_ "UserSigValidity" SG_ 983 Mirror_LHPosMnlReq 0;
BA_ "GenSigSendType" SG_ 983 Mirror_LHPosMnlReq 4;
BA_ "Description" SG_ 983 Mirror_LHPosMnlReq "Left Outside Mirror Positioning Request";
BA_ "Version" SG_ 983 Mirror_AutoWashModeSta_TypeC "23.04.00";
BA_ "NetworkRequestHoldingTime" SG_ 983 Mirror_AutoWashModeSta_TypeC 5000;
BA_ "NetworkRequest" SG_ 983 Mirror_AutoWashModeSta_TypeC 0;
BA_ "UserSigValidity" SG_ 983 Mirror_AutoWashModeSta_TypeC 0;
BA_ "GenSigSendType" SG_ 983 Mirror_AutoWashModeSta_TypeC 4;
BA_ "Version" SG_ 983 Mirror_RHPosMnlReq "22.01.05";
BA_ "NetworkRequestHoldingTime" SG_ 983 Mirror_RHPosMnlReq 5000;
BA_ "NetworkRequest" SG_ 983 Mirror_RHPosMnlReq 0;
BA_ "UserSigValidity" SG_ 983 Mirror_RHPosMnlReq 0;
BA_ "GenSigSendType" SG_ 983 Mirror_RHPosMnlReq 4;
BA_ "Description" SG_ 983 Mirror_RHPosMnlReq "Right Outside Mirror Positioning Request";
BA_ "Version" SG_ 983 Mirror_LHPosMnlCmd "22.11.03";
BA_ "NetworkRequestHoldingTime" SG_ 983 Mirror_LHPosMnlCmd 5000;
BA_ "NetworkRequest" SG_ 983 Mirror_LHPosMnlCmd 0;
BA_ "UserSigValidity" SG_ 983 Mirror_LHPosMnlCmd 0;
BA_ "GenSigSendType" SG_ 983 Mirror_LHPosMnlCmd 4;
BA_ "Description" SG_ 983 Mirror_LHPosMnlCmd "Left Outside Mirror Positioning Command";
BA_ "Version" SG_ 983 Mirror_RHPosMnlCmd "22.11.03";
BA_ "NetworkRequestHoldingTime" SG_ 983 Mirror_RHPosMnlCmd 5000;
BA_ "NetworkRequest" SG_ 983 Mirror_RHPosMnlCmd 0;
BA_ "UserSigValidity" SG_ 983 Mirror_RHPosMnlCmd 0;
BA_ "GenSigSendType" SG_ 983 Mirror_RHPosMnlCmd 4;
BA_ "Description" SG_ 983 Mirror_RHPosMnlCmd "Right Outside Mirror Positioning Command";
BA_ "Version" SG_ 983 Wiper_FrWiperLowAct "22.11.03";
BA_ "NetworkRequestHoldingTime" SG_ 983 Wiper_FrWiperLowAct 5000;
BA_ "NetworkRequest" SG_ 983 Wiper_FrWiperLowAct 0;
BA_ "UserSigValidity" SG_ 983 Wiper_FrWiperLowAct 0;
BA_ "GenSigSendType" SG_ 983 Wiper_FrWiperLowAct 4;
BA_ "Description" SG_ 983 Wiper_FrWiperLowAct "Wiper Low Speed Output";
BA_ "Version" SG_ 983 Wiper_FrWiperHighAct "22.11.03";
BA_ "NetworkRequestHoldingTime" SG_ 983 Wiper_FrWiperHighAct 5000;
BA_ "NetworkRequest" SG_ 983 Wiper_FrWiperHighAct 0;
BA_ "UserSigValidity" SG_ 983 Wiper_FrWiperHighAct 0;
BA_ "GenSigSendType" SG_ 983 Wiper_FrWiperHighAct 4;
BA_ "Description" SG_ 983 Wiper_FrWiperHighAct "Wiper High Speed Output";
BA_ "Version" SG_ 983 Wiper_FrtWiperLowCmd "23.02.02";
BA_ "NetworkRequestHoldingTime" SG_ 983 Wiper_FrtWiperLowCmd 5000;
BA_ "NetworkRequest" SG_ 983 Wiper_FrtWiperLowCmd 0;
BA_ "UserSigValidity" SG_ 983 Wiper_FrtWiperLowCmd 0;
BA_ "GenSigSendType" SG_ 983 Wiper_FrtWiperLowCmd 4;
BA_ "Version" SG_ 983 Wiper_FrtWiperHighCmd "23.02.02";
BA_ "NetworkRequestHoldingTime" SG_ 983 Wiper_FrtWiperHighCmd 5000;
BA_ "NetworkRequest" SG_ 983 Wiper_FrtWiperHighCmd 0;
BA_ "UserSigValidity" SG_ 983 Wiper_FrtWiperHighCmd 0;
BA_ "GenSigSendType" SG_ 983 Wiper_FrtWiperHighCmd 4;
BA_ "Version" SG_ 983 Wiper_RrWiperCmd "23.02.02";
BA_ "NetworkRequestHoldingTime" SG_ 983 Wiper_RrWiperCmd 5000;
BA_ "NetworkRequest" SG_ 983 Wiper_RrWiperCmd 0;
BA_ "UserSigValidity" SG_ 983 Wiper_RrWiperCmd 0;
BA_ "GenSigSendType" SG_ 983 Wiper_RrWiperCmd 4;
BA_ "Version" SG_ 983 Wiper_PowerEnableCmd "23.02.02";
BA_ "NetworkRequestHoldingTime" SG_ 983 Wiper_PowerEnableCmd 5000;
BA_ "NetworkRequest" SG_ 983 Wiper_PowerEnableCmd 0;
BA_ "UserSigValidity" SG_ 983 Wiper_PowerEnableCmd 0;
BA_ "GenSigSendType" SG_ 983 Wiper_PowerEnableCmd 4;
BA_ "Version" SG_ 983 Wiper_FrtWasherCmd "23.02.02";
BA_ "NetworkRequestHoldingTime" SG_ 983 Wiper_FrtWasherCmd 5000;
BA_ "NetworkRequest" SG_ 983 Wiper_FrtWasherCmd 0;
BA_ "UserSigValidity" SG_ 983 Wiper_FrtWasherCmd 0;
BA_ "GenSigSendType" SG_ 983 Wiper_FrtWasherCmd 4;
BA_ "Version" SG_ 983 Wiper_RrWasherCmd "23.02.02";
BA_ "NetworkRequestHoldingTime" SG_ 983 Wiper_RrWasherCmd 5000;
BA_ "NetworkRequest" SG_ 983 Wiper_RrWasherCmd 0;
BA_ "UserSigValidity" SG_ 983 Wiper_RrWasherCmd 0;
BA_ "GenSigSendType" SG_ 983 Wiper_RrWasherCmd 4;
BA_ "Version" SG_ 983 Wiper_HeadLampWasherCmd "23.02.02";
BA_ "NetworkRequestHoldingTime" SG_ 983 Wiper_HeadLampWasherCmd 5000;
BA_ "NetworkRequest" SG_ 983 Wiper_HeadLampWasherCmd 0;
BA_ "UserSigValidity" SG_ 983 Wiper_HeadLampWasherCmd 0;
BA_ "GenSigSendType" SG_ 983 Wiper_HeadLampWasherCmd 4;
BA_ "Version" SG_ 983 Wiper_AutoWashModeSta_TypeC "23.03.01";
BA_ "NetworkRequestHoldingTime" SG_ 983 Wiper_AutoWashModeSta_TypeC 5000;
BA_ "NetworkRequest" SG_ 983 Wiper_AutoWashModeSta_TypeC 0;
BA_ "UserSigValidity" SG_ 983 Wiper_AutoWashModeSta_TypeC 0;
BA_ "GenSigSendType" SG_ 983 Wiper_AutoWashModeSta_TypeC 4;
BA_ "Description" SG_ 983 Wiper_AutoWashModeSta_TypeC "Auto Wash Mode Wiper State";
BA_ "Version" SG_ 983 Mirror_LHPosMnlPlyCmd "23.02.13";
BA_ "NetworkRequestHoldingTime" SG_ 983 Mirror_LHPosMnlPlyCmd 5000;
BA_ "NetworkRequest" SG_ 983 Mirror_LHPosMnlPlyCmd 0;
BA_ "UserSigValidity" SG_ 983 Mirror_LHPosMnlPlyCmd 0;
BA_ "GenSigSendType" SG_ 983 Mirror_LHPosMnlPlyCmd 4;
BA_ "Version" SG_ 983 Mirror_RHPosMnlPlyCmd "23.02.13";
BA_ "NetworkRequestHoldingTime" SG_ 983 Mirror_RHPosMnlPlyCmd 5000;
BA_ "NetworkRequest" SG_ 983 Mirror_RHPosMnlPlyCmd 0;
BA_ "UserSigValidity" SG_ 983 Mirror_RHPosMnlPlyCmd 0;
BA_ "GenSigSendType" SG_ 983 Mirror_RHPosMnlPlyCmd 4;
BA_ "Version" SG_ 983 BDC_FD_AlvCnt8Val "22.11.04";
BA_ "UserSigValidity" SG_ 983 BDC_FD_AlvCnt8Val 0;
BA_ "GenSigSendType" SG_ 983 BDC_FD_AlvCnt8Val 4;
BA_ "Description" SG_ 983 BDC_FD_AlvCnt8Val "For the first transmission request for a data element the counter shall be initialized with 0 and shall be incremented by 1 for every subsequent send request. 

When the counter reaches the maximum value(0xFF), then it shall restart with 0 for the next s";
BA_ "Version" SG_ 983 Mirror_LHPosAutoPlyCmd "23.02.13";
BA_ "NetworkRequestHoldingTime" SG_ 983 Mirror_LHPosAutoPlyCmd 5000;
BA_ "NetworkRequest" SG_ 983 Mirror_LHPosAutoPlyCmd 0;
BA_ "UserSigValidity" SG_ 983 Mirror_LHPosAutoPlyCmd 0;
BA_ "GenSigSendType" SG_ 983 Mirror_LHPosAutoPlyCmd 4;
BA_ "Version" SG_ 983 Mirror_RHPosAutoPlyCmd "23.02.13";
BA_ "NetworkRequestHoldingTime" SG_ 983 Mirror_RHPosAutoPlyCmd 5000;
BA_ "NetworkRequest" SG_ 983 Mirror_RHPosAutoPlyCmd 0;
BA_ "UserSigValidity" SG_ 983 Mirror_RHPosAutoPlyCmd 0;
BA_ "GenSigSendType" SG_ 983 Mirror_RHPosAutoPlyCmd 4;
BA_ "Version" SG_ 983 Mirror_IMSMemoryCmd "23.02.13";
BA_ "NetworkRequestHoldingTime" SG_ 983 Mirror_IMSMemoryCmd 5000;
BA_ "NetworkRequest" SG_ 983 Mirror_IMSMemoryCmd 0;
BA_ "UserSigValidity" SG_ 983 Mirror_IMSMemoryCmd 0;
BA_ "GenSigSendType" SG_ 983 Mirror_IMSMemoryCmd 4;
BA_ "Version" SG_ 983 ECW_Overload2 "24.09.00";
BA_ "NetworkRequestHoldingTime" SG_ 983 ECW_Overload2 5000;
BA_ "NetworkRequest" SG_ 983 ECW_Overload2 0;
BA_ "UserSigValidity" SG_ 983 ECW_Overload2 0;
BA_ "GenSigSendType" SG_ 983 ECW_Overload2 4;
BA_ "Description" SG_ 983 ECW_Overload2 "ECW LIN to CAN Signal

 - SWI Option, OVERLOAD_ECW (2bit)";
BA_ "Version" SG_ 983 Mirror_AutoRevModSetSta "24.10.02";
BA_ "NetworkRequestHoldingTime" SG_ 983 Mirror_AutoRevModSetSta 5000;
BA_ "NetworkRequest" SG_ 983 Mirror_AutoRevModSetSta 0;
BA_ "UserSigValidity" SG_ 983 Mirror_AutoRevModSetSta 0;
BA_ "GenSigSendType" SG_ 983 Mirror_AutoRevModSetSta 4;
BA_ "Description" SG_ 983 Mirror_AutoRevModSetSta "Mirror_AutoRevModSetSta";
BA_ "Version" SG_ 983 Wiper_RainAmount "23.02.01";
BA_ "NetworkRequestHoldingTime" SG_ 983 Wiper_RainAmount 5000;
BA_ "NetworkRequest" SG_ 983 Wiper_RainAmount 0;
BA_ "UserSigValidity" SG_ 983 Wiper_RainAmount 0;
BA_ "GenSigStartValue" SG_ 983 Wiper_RainAmount 255;
BA_ "GenSigSendType" SG_ 983 Wiper_RainAmount 4;
BA_ "Description" SG_ 983 Wiper_RainAmount "Amount of rain on windshield (LIN to CAN Signal)

- LIN Signal Name : VAL_RAIN_AMOUNT

- 0~150 : PH=0.1*HEX(mm/Hr)

- 151~254 : Reserved

- 255 (1111 1111) : Invalid 



RainSnsrPartNum CU000's Factor is 0.5

- 0~150 : PH=0.5*HEX(%)

- 151~254 : Reserved";
BA_ "Version" SG_ 983 Wiper_AutoWashModeSta "21.12.00";
BA_ "NetworkRequestHoldingTime" SG_ 983 Wiper_AutoWashModeSta 5000;
BA_ "NetworkRequest" SG_ 983 Wiper_AutoWashModeSta 0;
BA_ "UserSigValidity" SG_ 983 Wiper_AutoWashModeSta 0;
BA_ "GenSigSendType" SG_ 983 Wiper_AutoWashModeSta 4;
BA_ "Description" SG_ 983 Wiper_AutoWashModeSta "Auto Wash Mode Wiper State";
BA_ "Version" SG_ 983 Wiper_PrkngPosSta "17.12.00";
BA_ "NetworkRequestHoldingTime" SG_ 983 Wiper_PrkngPosSta 5000;
BA_ "NetworkRequest" SG_ 983 Wiper_PrkngPosSta 0;
BA_ "UserSigValidity" SG_ 983 Wiper_PrkngPosSta 0;
BA_ "GenSigSendType" SG_ 983 Wiper_PrkngPosSta 4;
BA_ "Version" SG_ 983 Wiper_RainSnsrOptionTyp "17.12.00";
BA_ "NetworkRequestHoldingTime" SG_ 983 Wiper_RainSnsrOptionTyp 5000;
BA_ "NetworkRequest" SG_ 983 Wiper_RainSnsrOptionTyp 0;
BA_ "UserSigValidity" SG_ 983 Wiper_RainSnsrOptionTyp 0;
BA_ "GenSigSendType" SG_ 983 Wiper_RainSnsrOptionTyp 4;
BA_ "Description" SG_ 983 Wiper_RainSnsrOptionTyp "Rain Sensor Option Information";
BA_ "Version" SG_ 983 Wiper_HtWshNzzlCmd "20.08.07";
BA_ "NetworkRequestHoldingTime" SG_ 983 Wiper_HtWshNzzlCmd 5000;
BA_ "NetworkRequest" SG_ 983 Wiper_HtWshNzzlCmd 0;
BA_ "UserSigValidity" SG_ 983 Wiper_HtWshNzzlCmd 0;
BA_ "GenSigSendType" SG_ 983 Wiper_HtWshNzzlCmd 4;
BA_ "Description" SG_ 983 Wiper_HtWshNzzlCmd "Heated Washer Nozzle Command";
BA_ "Version" SG_ 983 Wiper_RainSnsrSta "20.08.00";
BA_ "NetworkRequestHoldingTime" SG_ 983 Wiper_RainSnsrSta 5000;
BA_ "NetworkRequest" SG_ 983 Wiper_RainSnsrSta 0;
BA_ "UserSigValidity" SG_ 983 Wiper_RainSnsrSta 0;
BA_ "GenSigSendType" SG_ 983 Wiper_RainSnsrSta 4;
BA_ "Description" SG_ 983 Wiper_RainSnsrSta "This signal represents the status of Rain Sensor signal state. 

- '20. 8/3 : Changed value table (0x5, 0x6 : Fault2/3 → Reserved)";
BA_ "Version" SG_ 983 Wiper_RainSnsrPartNum "24.01.00";
BA_ "NetworkRequestHoldingTime" SG_ 983 Wiper_RainSnsrPartNum 5000;
BA_ "NetworkRequest" SG_ 983 Wiper_RainSnsrPartNum 0;
BA_ "UserSigValidity" SG_ 983 Wiper_RainSnsrPartNum 0;
BA_ "GenSigSendType" SG_ 983 Wiper_RainSnsrPartNum 4;
BA_ "Description" SG_ 983 Wiper_RainSnsrPartNum "Rain Sensor PartNumber (LIN to CAN Signal)

- LIN Signal Name : INFO_PARTNUMBER

▶HELLA

 0x00(0000):NI000 / 0x01(0001):EV000 / 0x02(0010):XA000 / 0x03(0011)~0x0E(1110):Reserved / 0x0F(1111):N9000

▶BCS(舊 TRW)

 0x00(0000):T6000 / 0x01(0001):DV000 / 0";
BA_ "Version" SG_ 983 ECW_Fault "20.05.02";
BA_ "NetworkRequestHoldingTime" SG_ 983 ECW_Fault 5000;
BA_ "NetworkRequest" SG_ 983 ECW_Fault 0;
BA_ "UserSigValidity" SG_ 983 ECW_Fault 0;
BA_ "GenSigSendType" SG_ 983 ECW_Fault 4;
BA_ "Description" SG_ 983 ECW_Fault "ECW LIN to CAN Signal 

- LIN Signal Name : FAULT_ECW";
BA_ "Version" SG_ 983 ECW_FaultActv "20.05.02";
BA_ "NetworkRequestHoldingTime" SG_ 983 ECW_FaultActv 5000;
BA_ "NetworkRequest" SG_ 983 ECW_FaultActv 0;
BA_ "UserSigValidity" SG_ 983 ECW_FaultActv 0;
BA_ "GenSigStartValue" SG_ 983 ECW_FaultActv 1;
BA_ "GenSigSendType" SG_ 983 ECW_FaultActv 4;
BA_ "Description" SG_ 983 ECW_FaultActv "ECW LIN to CAN Signal

- LIN Signal Name : FAULT_ACTIVE";
BA_ "Version" SG_ 983 ECW_HiVolt "20.05.02";
BA_ "NetworkRequestHoldingTime" SG_ 983 ECW_HiVolt 5000;
BA_ "NetworkRequest" SG_ 983 ECW_HiVolt 0;
BA_ "UserSigValidity" SG_ 983 ECW_HiVolt 0;
BA_ "GenSigSendType" SG_ 983 ECW_HiVolt 4;
BA_ "Description" SG_ 983 ECW_HiVolt "ECW LIN to CAN Signal

- LIN Signal Name : HIGH_VOLT_ECW";
BA_ "Version" SG_ 983 ECW_HiVoltActv "20.05.02";
BA_ "NetworkRequestHoldingTime" SG_ 983 ECW_HiVoltActv 5000;
BA_ "NetworkRequest" SG_ 983 ECW_HiVoltActv 0;
BA_ "UserSigValidity" SG_ 983 ECW_HiVoltActv 0;
BA_ "GenSigStartValue" SG_ 983 ECW_HiVoltActv 1;
BA_ "GenSigSendType" SG_ 983 ECW_HiVoltActv 4;
BA_ "Description" SG_ 983 ECW_HiVoltActv "ECW LIN to CAN Signal

- LIN Signal Name : HIGH_VOLT_ACTIVE";
BA_ "Version" SG_ 983 ECW_LoVolt "20.05.02";
BA_ "NetworkRequestHoldingTime" SG_ 983 ECW_LoVolt 5000;
BA_ "NetworkRequest" SG_ 983 ECW_LoVolt 0;
BA_ "UserSigValidity" SG_ 983 ECW_LoVolt 0;
BA_ "GenSigSendType" SG_ 983 ECW_LoVolt 4;
BA_ "Description" SG_ 983 ECW_LoVolt "ECW LIN to CAN Signal

- LIN Signal Name : LOW_VOLT_ECW";
BA_ "Version" SG_ 983 ECW_LoVoltActv "20.05.02";
BA_ "NetworkRequestHoldingTime" SG_ 983 ECW_LoVoltActv 5000;
BA_ "NetworkRequest" SG_ 983 ECW_LoVoltActv 0;
BA_ "UserSigValidity" SG_ 983 ECW_LoVoltActv 0;
BA_ "GenSigStartValue" SG_ 983 ECW_LoVoltActv 1;
BA_ "GenSigSendType" SG_ 983 ECW_LoVoltActv 4;
BA_ "Description" SG_ 983 ECW_LoVoltActv "ECW LIN to CAN Signal

- LIN Signal Name : LOW_VOLT_ACTIVE";
BA_ "Version" SG_ 983 ECW_Overload "20.05.02";
BA_ "NetworkRequestHoldingTime" SG_ 983 ECW_Overload 5000;
BA_ "NetworkRequest" SG_ 983 ECW_Overload 0;
BA_ "UserSigValidity" SG_ 983 ECW_Overload 0;
BA_ "GenSigSendType" SG_ 983 ECW_Overload 4;
BA_ "Description" SG_ 983 ECW_Overload "ECW LIN to CAN Signal

- LIN Signal Name : OVERLOAD_ECW";
BA_ "Version" SG_ 983 ECW_OverloadActv "20.05.02";
BA_ "NetworkRequestHoldingTime" SG_ 983 ECW_OverloadActv 5000;
BA_ "NetworkRequest" SG_ 983 ECW_OverloadActv 0;
BA_ "UserSigValidity" SG_ 983 ECW_OverloadActv 0;
BA_ "GenSigStartValue" SG_ 983 ECW_OverloadActv 1;
BA_ "GenSigSendType" SG_ 983 ECW_OverloadActv 4;
BA_ "Description" SG_ 983 ECW_OverloadActv "ECW LIN to CAN Signal

- LIN Signal Name : OVERLOAD_ACTIVE";
BA_ "Version" SG_ 983 ECW_CommErr "20.05.02";
BA_ "NetworkRequestHoldingTime" SG_ 983 ECW_CommErr 5000;
BA_ "NetworkRequest" SG_ 983 ECW_CommErr 0;
BA_ "UserSigValidity" SG_ 983 ECW_CommErr 0;
BA_ "GenSigSendType" SG_ 983 ECW_CommErr 4;
BA_ "Description" SG_ 983 ECW_CommErr "ECW LIN to CAN Signal

- LIN Signal Name : ERR_COMM_ECW";
BA_ "Version" SG_ 983 BCM_SolSnsrRt "24.05.01";
BA_ "NetworkRequestHoldingTime" SG_ 983 BCM_SolSnsrRt 5000;
BA_ "NetworkRequest" SG_ 983 BCM_SolSnsrRt 0;
BA_ "UserSigValidity" SG_ 983 BCM_SolSnsrRt 0;
BA_ "GenSigSendType" SG_ 983 BCM_SolSnsrRt 4;
BA_ "Description" SG_ 983 BCM_SolSnsrRt "This signal indicates solar sensor output W/m^2 - RH";
BA_ "Version" SG_ 983 BCM_SolSnsrLft "24.05.01";
BA_ "NetworkRequestHoldingTime" SG_ 983 BCM_SolSnsrLft 5000;
BA_ "NetworkRequest" SG_ 983 BCM_SolSnsrLft 0;
BA_ "UserSigValidity" SG_ 983 BCM_SolSnsrLft 0;
BA_ "GenSigSendType" SG_ 983 BCM_SolSnsrLft 4;
BA_ "Description" SG_ 983 BCM_SolSnsrLft "This signal indicates solar sensor output W/m^2 - LH";
BA_ "Version" SG_ 983 Mirror_MirFldOpt "21.04.00";
BA_ "NetworkRequestHoldingTime" SG_ 983 Mirror_MirFldOpt 5000;
BA_ "NetworkRequest" SG_ 983 Mirror_MirFldOpt 0;
BA_ "UserSigValidity" SG_ 983 Mirror_MirFldOpt 0;
BA_ "GenSigSendType" SG_ 983 Mirror_MirFldOpt 4;
BA_ "Description" SG_ 983 Mirror_MirFldOpt "Outside Mirror Electric Fold Option Signal";
BA_ "Version" SG_ 983 Mirror_FldUnfldCmd "21.03.00";
BA_ "NetworkRequestHoldingTime" SG_ 983 Mirror_FldUnfldCmd 5000;
BA_ "NetworkRequest" SG_ 983 Mirror_FldUnfldCmd 0;
BA_ "UserSigValidity" SG_ 983 Mirror_FldUnfldCmd 0;
BA_ "GenSigSendType" SG_ 983 Mirror_FldUnfldCmd 4;
BA_ "Description" SG_ 983 Mirror_FldUnfldCmd "Mirror Folding Unfolding Command";
BA_ "Version" SG_ 983 Mirror_FldCtrlSta "21.03.00";
BA_ "NetworkRequestHoldingTime" SG_ 983 Mirror_FldCtrlSta 5000;
BA_ "NetworkRequest" SG_ 983 Mirror_FldCtrlSta 0;
BA_ "UserSigValidity" SG_ 983 Mirror_FldCtrlSta 0;
BA_ "GenSigSendType" SG_ 983 Mirror_FldCtrlSta 4;
BA_ "Description" SG_ 983 Mirror_FldCtrlSta "Mirror Fold and Folding Control State";
BA_ "Version" SG_ 983 Mirror_UnFldCtrlSta "21.03.00";
BA_ "NetworkRequestHoldingTime" SG_ 983 Mirror_UnFldCtrlSta 5000;
BA_ "NetworkRequest" SG_ 983 Mirror_UnFldCtrlSta 0;
BA_ "UserSigValidity" SG_ 983 Mirror_UnFldCtrlSta 0;
BA_ "GenSigSendType" SG_ 983 Mirror_UnFldCtrlSta 4;
BA_ "Description" SG_ 983 Mirror_UnFldCtrlSta "Mirror Unfold and Unfolding Control State";
BA_ "Version" SG_ 983 Mirror_PosMnlCmd "21.10.04";
BA_ "NetworkRequestHoldingTime" SG_ 983 Mirror_PosMnlCmd 5000;
BA_ "NetworkRequest" SG_ 983 Mirror_PosMnlCmd 0;
BA_ "UserSigValidity" SG_ 983 Mirror_PosMnlCmd 0;
BA_ "GenSigSendType" SG_ 983 Mirror_PosMnlCmd 4;
BA_ "Description" SG_ 983 Mirror_PosMnlCmd "Mirror Positioning Command";
BA_ "Version" SG_ 983 Mirror_SelSwIndCmd "21.03.00";
BA_ "NetworkRequestHoldingTime" SG_ 983 Mirror_SelSwIndCmd 5000;
BA_ "NetworkRequest" SG_ 983 Mirror_SelSwIndCmd 0;
BA_ "UserSigValidity" SG_ 983 Mirror_SelSwIndCmd 0;
BA_ "GenSigSendType" SG_ 983 Mirror_SelSwIndCmd 4;
BA_ "Description" SG_ 983 Mirror_SelSwIndCmd "Mirror Select Switch Indicator Command";
BA_REL_ "GenSigTimeoutTime" BU_SG_REL_ GW_PSU_DRV_FD SG_ 996 PDC_FD_Crc10Val 1500;
BA_REL_ "GenSigTimeoutTime" BU_SG_REL_ BLTN_CAM_FD SG_ 996 PDC_MainLBMOpt 1500;
BA_REL_ "GenSigTimeoutTime" BU_SG_REL_ GW_PSU_DRV_FD SG_ 996 PDC_FD_AlvCnt10Val 1500;
BA_REL_ "GenSigTimeoutTime" BU_SG_REL_ BLTN_CAM_FD SG_ 996 ICU_PowerAutoCutModSta 1500;
BA_REL_ "GenSigTimeoutTime" BU_SG_REL_ GW_PSU_3RD_FD SG_ 996 ICU_PowerAutoCutModSta 1500;
BA_REL_ "GenSigTimeoutTime" BU_SG_REL_ GW_PSU_AST_FD SG_ 996 ICU_PowerAutoCutModSta 1500;
BA_REL_ "GenSigTimeoutTime" BU_SG_REL_ GW_PSU_DRV_FD SG_ 996 ICU_PowerAutoCutModSta 1500;
BA_REL_ "GenSigTimeoutTime" BU_SG_REL_ GW_PSU_RL_FD SG_ 996 ICU_PowerAutoCutModSta 1500;
BA_REL_ "GenSigTimeoutTime" BU_SG_REL_ GW_PSU_RR_FD SG_ 996 ICU_PowerAutoCutModSta 1500;
BA_REL_ "GenSigTimeoutTime" BU_SG_REL_ SHVU_3RD_FD SG_ 996 ICU_PowerAutoCutModSta 1500;
BA_REL_ "GenSigTimeoutTime" BU_SG_REL_ SHVU_CCS_FD SG_ 996 ICU_PowerAutoCutModSta 1500;
BA_REL_ "GenSigTimeoutTime" BU_SG_REL_ SHVU_FRNT_FD SG_ 996 ICU_PowerAutoCutModSta 1500;
BA_REL_ "GenSigTimeoutTime" BU_SG_REL_ SHVU_REAR_FD SG_ 996 ICU_PowerAutoCutModSta 1500;
BA_REL_ "GenSigTimeoutTime" BU_SG_REL_ SHVU_RL_FD SG_ 996 ICU_PowerAutoCutModSta 1500;
BA_REL_ "GenSigTimeoutTime" BU_SG_REL_ SHVU_RR_FD SG_ 996 ICU_PowerAutoCutModSta 1500;
BA_REL_ "GenSigTimeoutTime" BU_SG_REL_ BLTN_CAM_FD SG_ 996 ICU_BattAutoCutPreWrng 1500;
BA_REL_ "GenSigTimeoutTime" BU_SG_REL_ BLTN_CAM_FD SG_ 996 Bat12V_Chr_Req 1500;
BA_REL_ "GenSigTimeoutTime" BU_SG_REL_ BLTN_CAM_FD SG_ 1047 HU_GNSS_UTC_min 5000;
BA_REL_ "GenSigTimeoutTime" BU_SG_REL_ BLTN_CAM_FD SG_ 1047 HU_GNSS_UTC_sec 5000;
BA_REL_ "GenSigTimeoutTime" BU_SG_REL_ BLTN_CAM_FD SG_ 1047 HU_GNSS_UTC_offset 5000;
BA_REL_ "GenSigTimeoutTime" BU_SG_REL_ BLTN_CAM_FD SG_ 1047 HU_GNSS_DST 5000;
BA_REL_ "GenSigTimeoutTime" BU_SG_REL_ BLTN_CAM_FD SG_ 1047 HU_GNSS_TimezoneOffset 5000;
BA_REL_ "GenSigTimeoutTime" BU_SG_REL_ BLTN_CAM_FD SG_ 1047 HU_GNSS_UTC_year 5000;
BA_REL_ "GenSigTimeoutTime" BU_SG_REL_ BLTN_CAM_FD SG_ 1047 HU_GNSS_UTC_month 5000;
BA_REL_ "GenSigTimeoutTime" BU_SG_REL_ BLTN_CAM_FD SG_ 1047 HU_GNSS_UTC_day 5000;
BA_REL_ "GenSigTimeoutTime" BU_SG_REL_ BLTN_CAM_FD SG_ 1047 HU_GNSS_UTC_hour 5000;
BA_REL_ "GenSigTimeoutTime" BU_SG_REL_ GW_PSU_DRV_FD SG_ 849 IAU_FD_Crc4Val 1500;
BA_REL_ "GenSigTimeoutTime" BU_SG_REL_ WPC2_FD SG_ 849 IAU_DigitalKey2Opt 1500;
BA_REL_ "GenSigTimeoutTime" BU_SG_REL_ WPC_FD SG_ 849 IAU_DigitalKey2Opt 1500;
BA_REL_ "GenSigTimeoutTime" BU_SG_REL_ GW_PSU_DRV_FD SG_ 849 IAU_FD_AlvCnt4Val 1500;
BA_REL_ "GenSigTimeoutTime" BU_SG_REL_ BLTN_CAM_FD SG_ 849 IAU_ProfileIDRVal 1500;
BA_REL_ "GenSigTimeoutTime" BU_SG_REL_ GW_PSU_DRV_FD SG_ 849 IAU_ProfileIDRVal 1500;
BA_REL_ "GenSigTimeoutTime" BU_SG_REL_ GW_SAU_DRV_FD SG_ 849 IAU_ProfileIDRVal 1500;
BA_REL_ "GenSigTimeoutTime" BU_SG_REL_ RCM_FD SG_ 849 IAU_ProfileIDRVal 1500;
BA_REL_ "GenSigTimeoutTime" BU_SG_REL_ RWPC_FD SG_ 849 IAU_ProfileIDRVal 1500;
BA_REL_ "GenSigTimeoutTime" BU_SG_REL_ SGU_FD SG_ 849 IAU_ProfileIDRVal 1500;
BA_REL_ "GenSigTimeoutTime" BU_SG_REL_ WPC2_FD SG_ 849 IAU_ProfileIDRVal 1500;
BA_REL_ "GenSigTimeoutTime" BU_SG_REL_ WPC_FD SG_ 849 IAU_ProfileIDRVal 1500;
BA_REL_ "GenSigTimeoutTime" BU_SG_REL_ GW_PSU_DRV_FD SG_ 704 VCU_Crc6Val 1500;
BA_REL_ "GenSigTimeoutTime" BU_SG_REL_ GW_PSU_DRV_FD SG_ 704 VCU_BstWarnMsg 1500;
BA_REL_ "GenSigTimeoutTime" BU_SG_REL_ GW_SAU_DRV_FD SG_ 704 VCU_BstWarnMsg 1500;
BA_REL_ "GenSigTimeoutTime" BU_SG_REL_ PSB_FD SG_ 704 VCU_BstWarnMsg 1500;
BA_REL_ "GenSigTimeoutTime" BU_SG_REL_ BLTN_CAM_FD SG_ 704 VCU_BstAvailSta 1500;
BA_REL_ "GenSigTimeoutTime" BU_SG_REL_ GW_SAU_DRV_FD SG_ 704 VCU_BstAvailSta 1500;
BA_REL_ "GenSigTimeoutTime" BU_SG_REL_ BLTN_CAM_FD SG_ 704 VCU_BstAplySta 1500;
BA_REL_ "GenSigTimeoutTime" BU_SG_REL_ GW_SAU_DRV_FD SG_ 704 VCU_BstAplySta 1500;
BA_REL_ "GenSigTimeoutTime" BU_SG_REL_ BLTN_CAM_FD SG_ 704 VCU_NCondDragSta 1500;
BA_REL_ "GenSigTimeoutTime" BU_SG_REL_ BLTN_CAM_FD SG_ 704 VCU_NCondDragSegVal 1500;
BA_REL_ "GenSigTimeoutTime" BU_SG_REL_ BLTN_CAM_FD SG_ 704 VCU_NCondTrackSta 1500;
BA_REL_ "GenSigTimeoutTime" BU_SG_REL_ BLTN_CAM_FD SG_ 704 VCU_NCondTrackTimeVal 1500;
BA_REL_ "GenSigTimeoutTime" BU_SG_REL_ BLTN_CAM_FD SG_ 704 VCU_NCondOSD 1500;
BA_REL_ "GenSigTimeoutTime" BU_SG_REL_ GW_PSU_DRV_FD SG_ 704 VCU_AlvCnt6Val 1500;
BA_REL_ "GenSigTimeoutTime" BU_SG_REL_ ATS_FD SG_ 704 VCU_UtilModeWarnAddMsgSta 1500;
BA_REL_ "GenSigTimeoutTime" BU_SG_REL_ BLTN_CAM_FD SG_ 704 VCU_FrntTqDispPcVal 1500;
BA_REL_ "GenSigTimeoutTime" BU_SG_REL_ BLTN_CAM_FD SG_ 704 VCU_RearTqDispPcVal 1500;
BA_REL_ "GenSigTimeoutTime" BU_SG_REL_ BLTN_CAM_FD SG_ 704 VCU_BstOpSta 1500;
BA_REL_ "GenSigTimeoutTime" BU_SG_REL_ GW_SAU_DRV_FD SG_ 704 VCU_BstOpSta 1500;
BA_REL_ "GenSigTimeoutTime" BU_SG_REL_ PSB_FD SG_ 704 VCU_BstOpSta 1500;
BA_REL_ "GenSigTimeoutTime" BU_SG_REL_ GW_SAU_DRV_FD SG_ 704 VCU_BstTimerVal 1500;
BA_REL_ "GenSigTimeoutTime" BU_SG_REL_ PSB_FD SG_ 704 VCU_BstTimerVal 1500;
BA_REL_ "GenSigTimeoutTime" BU_SG_REL_ BLTN_CAM_FD SG_ 979 BAlarm_BglrAlrm_CurrentSta 1500;
BA_REL_ "GenSigTimeoutTime" BU_SG_REL_ PSB_FD SG_ 979 SBR_DrvStBltIndSta 1500;
BA_REL_ "GenSigTimeoutTime" BU_SG_REL_ PSB_FD SG_ 979 SBR_RrLftStBltWrngIndSta 1500;
BA_REL_ "GenSigTimeoutTime" BU_SG_REL_ PSB_FD SG_ 979 SBR_RrRtStBltWrngIndSta 1500;
BA_REL_ "GenSigTimeoutTime" BU_SG_REL_ PSB_FD SG_ 979 SBR_RrCtrStBltIndSta 1500;
BA_REL_ "GenSigTimeoutTime" BU_SG_REL_ PSB_FD SG_ 979 SBR_3rdLftStBltWrngIndSta 1500;
BA_REL_ "GenSigTimeoutTime" BU_SG_REL_ PSB_FD SG_ 979 SBR_3rdRtStBltWrngIndSta 1500;
BA_REL_ "GenSigTimeoutTime" BU_SG_REL_ PSB_FD SG_ 979 SBR_3rdCtrStBltWrngIndSta 1500;
BA_REL_ "GenSigTimeoutTime" BU_SG_REL_ ATS_FD SG_ 1059 HU_Background 5000;
BA_REL_ "GenSigTimeoutTime" BU_SG_REL_ BLTN_CAM_FD SG_ 1059 HU_Background 5000;
BA_REL_ "GenSigTimeoutTime" BU_SG_REL_ ATS_FD SG_ 1059 HU_BackgroundFadeInOut 5000;
BA_REL_ "GenSigTimeoutTime" BU_SG_REL_ BLTN_CAM_FD SG_ 1059 HU_BackgroundFadeInOut 5000;
BA_REL_ "GenSigTimeoutTime" BU_SG_REL_ BLTN_CAM_FD SG_ 983 Wiper_PrkngPosSta 1500;
BA_REL_ "GenSigTimeoutTime" BU_SG_REL_ BLTN_CAM_FD SG_ 983 Wiper_RainSnsrSta 1500;
VAL_ 996 PDC_FD_Crc10Val 0 "0x0x0~0xFFFF:CRCValue" 65535 "0x0x0~0xFFFF:CRCValue" ;
VAL_ 996 PDC_PwrOnModePowerReq 0 "Default" 1 "Request On" 2 "RESERVED" 3 "Error" ;
VAL_ 996 PDC_LeadAcidBatType 0 "Not Applied" 1 "CMF 35Ah" 2 "CMF 40Ah" 3 "CMF 45Ah" 4 "CMF 50Ah" 5 "CMF 60Ah" 6 "CMF 68Ah" 7 "CMF 70Ah" 8 "CMF 80Ah" 9 "CMF 90Ah" 10 "CMF 110Ah" 11 "MF 40Ah" 12 "MF 45Ah" 13 "MF 60Ah" 14 "MF 68Ah" 15 "MF 80Ah" 16 "MF 90Ah" 17 "MF 110Ah" 18 "AGM 60Ah" 19 "AGM 70Ah" 20 "AGM 80Ah" 21 "AGM 50Ah" 22 "AGM 105Ah" 23 "AGM 90Ah" 24 "EFB 50Ah" 25 "EFB 60Ah" 26 "EFB 70Ah" 27 "RESERVED" 28 "RESERVED" 29 "RESERVED" 30 "RESERVED" 31 "RESERVED" ;
VAL_ 996 PDC_BatPwrClassOpt 0 "Invalid" 1 "SOC type" 2 "Class type" 3 "RESERVED" ;
VAL_ 996 PDC_MainLBMOpt 0 "Not Applied" 1 "Applied" 2 "RESERVED" 3 "Invalid" ;
VAL_ 996 PDC_FD_AlvCnt10Val 0 "0x0x0~0xFF:AlvCntValue" 255 "0x0x0~0xFF:AlvCntValue" ;
VAL_ 996 ICU_PowerAutoCutModSta 0 "Factory Mode (default)" 1 "Dealer Mode" 2 "Customer Mode" 3 "Error Indicator" ;
VAL_ 996 Autocut_DlvryModSta 0 "Before Delivery(Welcome Off)" 1 "After Delivery(Welcome On)" 2 "Not Used" 3 "Error Indicator" ;
VAL_ 996 ICU_SoCBattStaMsgReq 0 "Default" 1 "Alert" 2 "Warning" 3 "Invalid" ;
VAL_ 996 Batt_SoCWarningValue 0 "0x0x0~0x64:0 ~ 100%" 100 "0x0x0~0x64:0 ~ 100%" 101 "0x65~0xFE:RESERVED" 254 "0x65~0xFE:RESERVED" 255 "Invalid" ;
VAL_ 996 ICU_BattAutoCutPreWrng 0 "No Warning" 1 "Warning" 2 "Not Used" 3 "Invalid" ;
VAL_ 996 OTAModeACCOffReq 0 "Default" 1 "Off(ACC Off Request)" 2 "RESERVED" 3 "RESERVED" ;
VAL_ 996 C_ICUIGNOffReq 0 "Default" 1 "Off(IGN Off Request)" 2 "RESERVED" 3 "RESERVED" ;
VAL_ 996 IGN_AutoOff_WarnSta 0 "No Warning" 1 "Power Off Warning" 2 "RESERVED" 3 "Error Indicator" ;
VAL_ 996 IGN_AutoOff_WarnSta_CLU 0 "No Warning" 1 "Power Off Warning" 2 "RESERVED" 3 "Error Indicator" ;
VAL_ 996 PDC_BatPwrStateClassA 0 "Invalid" 1 "Low power condition for ClassA-load operation" 2 "High power condition for ClassA-load operation" 3 "RESERVED" ;
VAL_ 996 PDC_BatPwrStateClassB 0 "Invalid" 1 "Low power condition for ClassB-load operation" 2 "High power condition for ClassB-load operation" 3 "RESERVED" ;
VAL_ 996 PDC_BatPwrStateClassC 0 "Invalid" 1 "Low power condition for ClassC-load operation" 2 "High power condition for ClassC-load operation" 3 "RESERVED" ;
VAL_ 996 PLBMAvailableState 0 "Invaild" 1 "PLBM Power is available" ;
VAL_ 996 Bat_dischrg 0 "Flag OFF" 1 "Flag ON" 2 "RESERVED" 3 "RESERVED" ;
VAL_ 996 Bat12V_Chr_Req 0 "Off (Default)" 1 "On_IBS" 2 "On_OTA" 3 "On_Load" ;
VAL_ 996 ICU_BattMngAlert 0 "No Warning(Default)" 1 "Hazard On" 2 "Tail On" 3 "Hazard/Tail On" 4 "0x4~0xFE:RESERVED" 254 "0x4~0xFE:RESERVED" 255 "Invalid" ;
VAL_ 1047 GNSS_Crc5Val 0 "0x0x0~0xFFFF:CRCValue" 65535 "0x0x0~0xFFFF:CRCValue" ;
VAL_ 1047 GNSS_AlvCnt5Val 0 "0x0x0~0xFF:AlvCntValue" 255 "0x0x0~0xFF:AlvCntValue" ;
VAL_ 1047 HU_GNSS_Fix_status 0 "Doing position fixes" 2 "need time" 3 "PDOP too high" 5 "No usable SVs" 6 "one usable SV" 7 "two usable SVs" 8 "three usable SVs" ;
VAL_ 1047 HU_GNSS_TimeSource 0 "none" 1 "RTC" 2 "GPS(<10ms)" 3 "GPS(<1ms)" ;
VAL_ 1047 HU_GNSS_search 0 "none" 1 "blind" 2 "anywhere" ;
VAL_ 1047 HU_GNSS_DST 0 "DST OFF" 1 "DST ON" 2 "RESERVED" 3 "Invalid" ;
VAL_ 849 IAU_FD_Crc4Val 0 "0x0x0~0xFFFF:CRCValue" 65535 "0x0x0~0xFFFF:CRCValue" ;
VAL_ 849 IAU_DISPWrng 0 "None" 1 "Auth_Fail2 (DigitalKey)" 2 "ReAuth_Warning" 3 "IAU Error" 4 "DigitalKey Saved" 5 "Auth_Fail2 (FP)" 6 "Auth_Fail2 (DigitalKey or FP)" 7 "BiometricKey Saved" 8 "DigitalKey and BiometricKey Saved" 9 "WPCNFC_PreStartAuth_Success" 10 "Reserved" 11 "Reserved" 12 "Reserved" 13 "Reserved" 14 "ReAuth_forRSPA" 15 "Invalid" ;
VAL_ 849 IAU_DigitalKey2Opt 0 "Default (Not applied)" 1 "Digital Key Light (NFC)" 2 "Digital Key Medium (NFC/BLE)" 3 "Digital Key Full (NFC/BLE/UWB)" 4 "Reserved" 5 "Reserved" 6 "Reserved" 7 "invalid" ;
VAL_ 849 IAUwFRULearnState 0 "Default (Normal)" 1 "Learning" 2 "Neutralizing" 3 "Invalid" ;
VAL_ 849 IAUwFPMLearnState 0 "Default(Normal)" 1 "Learning" 2 "Neutralizing" 3 "Invalid" ;
VAL_ 849 IAU_ValetDigitalkey 0 "Default" 1 "Valet Digitalkey" 2 "Resereved" 3 "invalid" ;
VAL_ 849 IAU_DigitalKeyNumberOpt 0 "Max8" 1 "Max16" 2 "Max16 with Grouping" 3 "RESERVED" 4 "RESERVED" 5 "RESERVED" 6 "RESERVED" 7 "Invalid" ;
VAL_ 849 IAU_eSEReprogramSta 0 "Default" 1 "Updating" 2 "RESERVED" 3 "Invalid" ;
VAL_ 849 IAU_DKOwnerSwapOption 0 "Default" 1 "Not applied" 2 "Applied" 3 "Invalid" ;
VAL_ 849 IAU_DgtKeyGrpPrflRval2 0 "Default" 1 "Group index 0x0" 2 "Group index 0x1" 3 "Group index 0x2" 4 "Group index 0x3" 5 "Group index 0x4" 6 "Group index 0x5" 7 "Group index 0x6" 8 "Group index 0x7" 9 "Group index 0x8" 10 "Group index 0x9" 11 "Group index 0xA" 12 "Group index 0xB" 13 "Group index 0xC" 14 "Group index 0xD" 15 "Group index 0xE" 16 "Group index 0xF" 17 "RESERVED" 18 "RESERVED" 19 "RESERVED" 20 "RESERVED" 21 "RESERVED" 22 "RESERVED" 23 "RESERVED" 24 "RESERVED" 25 "RESERVED" 26 "RESERVED" 27 "RESERVED" 28 "RESERVED" 29 "RESERVED" 30 "RESERVED" 31 "Invalid" ;
VAL_ 849 IAU_StartIdentifiedProfile 0 "Default" 1 "Profile 1" 2 "Profile 2" 3 "Reserved" 4 "Reserved" 5 "Reserved" 6 "Reserved" 7 "Invalid" ;
VAL_ 849 IAU_DigitalKeyProfileRval2 0 "Default" 1 "1st digital key (owner)" 2 "2nd digital key" 3 "3rd digital key" 4 "4th digital key" 5 "5th digital key" 6 "6th digital key" 7 "7th digital key" 8 "8th digital key" 9 "9th digital key" 10 "10th digital key" 11 "11th digital key" 12 "12th digital key" 13 "13th digital key" 14 "14th digital key" 15 "15th digital key" 16 "16th digital key" 17 "reserved" 18 "reserved" 19 "reserved" 20 "reserved" 21 "reserved" 22 "reserved" 23 "reserved" 24 "reserved" 25 "reserved" 26 "reserved" 27 "reserved" 28 "reserved" 29 "reserved" 30 "reserved" 31 "Invalid" ;
VAL_ 849 IAU_NFCCard1SN 0 "0x0x00000000~0xFFFFFFFF:" 2147483647 "0x0x00000000~0xFFFFFFFF:" ;
VAL_ 849 IAU_FD_AlvCnt4Val 0 "0x0x0~0xFF:AlvCntValue" 255 "0x0x0~0xFF:AlvCntValue" ;
VAL_ 849 IAU_UWBOnOffOpt 0 "Default" 1 "Not applied" 2 "Applied" 3 "Invalid" ;
VAL_ 849 IAU_UWBOnOffRVal 0 "Default" 1 "Off" 2 "On" 3 "Invalid" ;
VAL_ 849 IAU_StartIdentifiedProfile_Ext 0 "Default" 1 "Profile1" 2 "Profile2" 3 "Profile3" 4 "Profile4" 5 "Profile5" 6 "Profile6" 7 "Profile7" 8 "Profile8" 9 "Profile9" 10 "RESERVED" 11 "RESERVED" 12 "RESERVED" 13 "RESERVED" 14 "RESERVED" 15 "INVALID" ;
VAL_ 849 RSPA_UWBRspaExtRngSta 0 "Initial" 1 "Out of range of RSPA remote control Region" 2 "In the range of RSPA remote control region" 3 "Reserved" ;
VAL_ 849 RSPA_CanFltSta 0 "Default" 1 "RSPA CAN Error" 2 "Not Used" 3 "Error Indicator" ;
VAL_ 849 RSPA_BLESigErrSta 0 "Default" 1 "Signal Invalid" 2 "In Progress" 3 "Error Indicator" ;
VAL_ 849 RSPA_ConStat 0 "Normal Status" 1 "Fail Status" 2 "Reserved" 3 "Reserved" ;
VAL_ 849 IAU_ProfileIDRVal 0 "Default" 1 "Guest" 2 "Profile1" 3 "Profile2" 4 "Profile3" 5 "Profile4" 6 "Profile5" 7 "Profile6" 8 "Profile7" 9 "Profile8" 10 "Profile9" 11 "RESERVED" 12 "RESERVED" 13 "RESERVED" 14 "RESERVED" 15 "INVALID" ;
VAL_ 849 IAU_DigitalKeyProcessingSta 0 "None" 1 "DeviceOnWPC" 2 "DeviceRegistering" 3 "PhoneRegistered" 4 "All Phone Key Deleted" 5 "NFCCard1Registered" 6 "Server Registering" 7 "NFCCard1Deleted" 8 "BLE Searching" 9 "Owner Phone key Deleted" 10 "Valet Off Searching" 11 "Server Registering Fail" 12 "All Digital Keys in group Deleted" 15 "Invalid" ;
VAL_ 849 IAU_DigitalKeyExit 0 "Normal" 1 "Check System" 2 "NFC Not Detected" 3 "Fob Not Detected" 4 "Canceled by User (Timeout)" 5 "Device not Available" 6 "ProcessFail" 7 "Check Card Save" 8 "Certificate Update" 9 "Valet Off Fail" 10 "CardNotAvailable" 11 "DigitalKeyDisabled" 12 "Retry After Parking" 13 "Check Password" 14 "P position fail (not P)" 15 "Invalid" ;
VAL_ 849 IAU_DigitalKeyEnblRVal 0 "Default" 1 "Disable" 2 "Enable" 3 "Invalid" ;
VAL_ 849 IAU_OwnerPhnRegRVal 0 "Default" 1 "Disable" 2 "Enable" 3 "Invalid" ;
VAL_ 849 IAU_NFCCard1RegRVal 0 "Default" 1 "Disable" 2 "Enable" 3 "Invalid" ;
VAL_ 849 IAU_NFCCard2RegRVal 0 "Default" 1 "Disable" 2 "Enable" 3 "Invalid" ;
VAL_ 101 IEB_Crc1Val 0 "0x0x0~0xFFFF:CRCValue" 65535 "0x0x0~0xFFFF:CRCValue" ;
VAL_ 101 IEB_AbsNGearReq 0 "Inactive" 1 "N Gear position Request Active" 2 "Not used" 3 "Error Indicator" ;
VAL_ 101 IEB_EstBrkPdlValVldSta 0 "Invalid" 1 "Valid" 2 "Not used" 3 "Error Indicator" ;
VAL_ 101 IEB_FRAmode_Req 0 "No Request" 1 "Inhibit Transition To 4WD" 2 "Request FRA mode" 3 "Not used" ;
VAL_ 101 IEB_DriftEscModSta_VDC 0 "Default" 1 "Beginner" 2 "Intermediate" 3 "Expert" ;
VAL_ 101 IEB_DrvWhlSlipFlg_Frnt 0 "No slip occurred at the driving wheels" 1 "Slip occurred at the driving wheels" ;
VAL_ 101 IEB_IndDriftMode 0 "Default" 1 "off" 2 "on" 3 "RESERVED" 4 "RESERVED" 5 "RESERVED" 6 "RESERVED" 7 "Invaild" ;
VAL_ 101 IEB_IndDriftEcsModSta 0 "Default" 1 "N-Mode" 2 "Drift Mode" 3 "Reserved" ;
VAL_ 101 IEB_IndDriftElsdModSta 0 "Default" 1 "Drift 1.5 way" 2 "Drift 2.0 way" 3 "Reserved" ;
VAL_ 101 IEB_TCS_Req 0 "TCS control is not active" 1 "TCS control is active by requested TORQUE based" 2 "TCS control is active by requested RPM based" 3 "Not used" ;
VAL_ 101 IEB_RSC_Req 0 "RSC is not active" 1 "RSC is active" 2 "RESERVED" 3 "RESERVED" ;
VAL_ 101 TCS_TqFlag_Frnt 0 "Positive" 1 "Negative" ;
VAL_ 101 TCS_TqFlag_Rear 0 "Positive" 1 "Negative" ;
VAL_ 101 RSC_TqFlag_Frnt 0 "Positive" 1 "Negative" ;
VAL_ 101 RSC_TqFlag_Rear 0 "Positive" 1 "Negative" ;
VAL_ 101 IEB_AlvCnt1Val 0 "0x0x0~0xFF:AlvCntValue" 255 "0x0x0~0xFF:AlvCntValue" ;
VAL_ 101 TCS_MtrTrgtRpm_Flag_Frnt 0 "Positive" 1 "Negative" ;
VAL_ 101 TCS_MtrTrgtRpm_Flag_Rear 0 "Positive" 1 "Negative" ;
VAL_ 101 IEB_DriftElsdModSta 0 "Default" 1 "Drift Mode Base" 2 "Drift Mode" 3 "RESERVED" ;
VAL_ 101 IEB_DriftEcsModSta 0 "Default" 1 "N-Mode" 2 "Drift Mode" 3 "Reserved" ;
VAL_ 101 IEB_DriftMdpsModSta 0 "Default" 1 "N-Mode" 2 "Drift Mode" 3 "Reserved" ;
VAL_ 101 TCS_MtrTrgtRpm_Frnt 0 "0x0x000~0xFFE:Motor RPM Target" 4094 "0x0x000~0xFFE:Motor RPM Target" 4095 "Error Value" ;
VAL_ 101 TCS_MtrTrgtRpm_Rear 0 "0x0x000~0xFFE:Motor RPM Target" 4094 "0x0x000~0xFFE:Motor RPM Target" 4095 "Error Value" ;
VAL_ 101 IEB_DriftModeSta 0 "Default" 1 "Drift Mode Activate (ON)" 2 "Drift Mode Deactivate (OFF)" 3 "Defective" ;
VAL_ 101 IEB_DriftModeActSta 0 "Default" 1 "Drift Mode ON" 2 "Drift Mode OFF" 3 "Reserved" ;
VAL_ 101 MCU_AntiJerk_Inhbtsta 0 "Allow Anti Jerk Control" 1 "Inhibit Anti Jerk control" ;
VAL_ 101 IEB_Motor_ProtectModSta 0 "default" 1 "Protection mode operation" ;
VAL_ 101 IEB_EstBrkSacFrcNmVal 0 "0x0x0~0xFFFF:friction brake torque for stop assist control" 65535 "0x0x0~0xFFFF:friction brake torque for stop assist control" ;
VAL_ 101 IEB_SrvLmpDis 0 "AHB Service Lamp is Off" 1 "AHB Service Lamp is On" 2 "AHB Service Lamp is BLINKING(2HZ)" 3 "Error Indicator" ;
VAL_ 101 IEB_IndDriftEscModSta_TCS 0 "Default" 1 "Slip level_01" 2 "Slip level_02" 3 "Slip level_03" 4 "Slip level_04" 5 "Slip level_05" 6 "Slip level_06" 7 "Slip level_07" 8 "Slip level_08" 9 "Slip level_09" 10 "Slip level_10" 11 "Reserved" 12 "Reserved" 13 "Reserved" 14 "Reserved" 15 "Reserved" ;
VAL_ 101 IEB_IndDriftEscModSta_VDC 0 "Default" 1 "VDC level_01" 2 "VDC level_02" 3 "VDC level_03" 4 "VDC level_04" 5 "VDC level_05" 6 "VDC level_06" 7 "VDC level_07" 8 "VDC level_08" 9 "VDC level_09" 10 "VDC level_10" 11 "RESERVED" 12 "RESERVED" 13 "RESERVED" 14 "RESERVED" 15 "RESERVED" ;
VAL_ 101 IEB_DfctvSta 0 "AHB is normal mode" 1 "AHB is degraded mode" 2 "AHB is defective mode" 3 "Error Indicator" ;
VAL_ 101 IEB_ActvSta 0 "All Control Inactive" 1 "Charging Active" 2 "AHB Control Active" 3 "Chaging Active + AHB Control Active" ;
VAL_ 101 IEB_DiagSta 0 "AHB is not diagnostic mode" 1 "AHB is diagnostic mode" 2 "Not used" 3 "Error Indicator" ;
VAL_ 101 IEB_WrngLmpDis 0 "AHB Warning Lamp is Off" 1 "AHB Warning Lamp is On" 2 "Not used" 3 "Error Indicator" ;
VAL_ 101 IEB_MILReq 0 "No Request" 1 "MIL On Request" 2 "Reserved" 3 "Reserved" ;
VAL_ 101 IEB_DriftModeStaDis 0 "Default" 1 "Restriction state of Drift" 2 "RESERVED" 3 "RESERVED" 4 "RESERVED" 5 "RESERVED" 6 "RESERVED" 7 "RESERVED" ;
VAL_ 101 RSC_Sta 0 "RSC is ready" 1 "RSC is not ready" ;
VAL_ 101 IEB_BrkActvSta 0 "ECU does not support this function." 1 "Brake switch is not pressed (OFF)" 2 "Brake switch is pressed (ON)" 3 "Brake switch failure" ;
VAL_ 101 IEB_PdlTrvlSnsrFailSta 0 "Normal" 1 "Fail" 2 "Not used" 3 "Error Indicator" ;
VAL_ 101 IEB_PdlCalibSta 0 "Not complete" 1 "Complete" 2 "Not used" 3 "Error Indicator" ;
VAL_ 101 IEB_BzrSta 0 "Buzzer is Off" 1 "Buzzer is On" 2 "Not used" 3 "Error Indicator" ;
VAL_ 101 IEB_Sta 0 "Not Ready" 1 "Ready" 2 "Ready (Front only) & Not Ready(Rear)" 3 "Ready (Rear only) & Not Ready(Front)" ;
VAL_ 101 IEB_SnsrFailSta 0 "Normal" 1 "Fail" 2 "Not used" 3 "Error Indicator" ;
VAL_ 101 IEB_RbsWrngLmpSta 0 "RBS Warning Lamp OFF" 1 "RBS Warning Lamp ON" 2 "Not used" 3 "Error Indicator" ;
VAL_ 101 IEB_VacSysDfctvSta 0 "Vacuum pump NOT defective" 1 "Vacuum pump defective (failed)" 2 "Not used" 3 "Error Indicator" ;
VAL_ 704 VCU_BstWarnMsg 0 "None(Default)" 1 "Failed by vehicle condition" 2 "Failed by low battery SOC" 3 "Failed by wait time" ;
VAL_ 704 VCU_BstAvailSta 0 "Not available" 1 "Available" 2 "Reserved" 3 "Reserved" ;
VAL_ 704 VCU_BstAplySta 0 "Not Applied" 1 "Applied" 2 "Reserved" 3 "Reserved" ;
VAL_ 704 VCU_MxPwrMdSta 0 "Not Supported" 1 "In Activate" 2 "Activate" 3 "Activate ON" ;
VAL_ 704 VCU_MxPwrMdSegVal 0 "0~100 %" 1 "0~100 %" 2 "0~100 %" 3 "0~100 %" 4 "0~100 %" 5 "0~100 %" 6 "0~100 %" 7 "0~100 %" 8 "0~100 %" 9 "0~100 %" 10 "0~100 %" 11 "0~100 %" 12 "0~100 %" 13 "0~100 %" 14 "0~100 %" 15 "0~100 %" 16 "0~100 %" 17 "0~100 %" 18 "0~100 %" 19 "0~100 %" 20 "0~100 %" 21 "RESERVED" 22 "RESERVED" 23 "RESERVED" 24 "RESERVED" 25 "RESERVED" 26 "RESERVED" 27 "RESERVED" 28 "RESERVED" 29 "RESERVED" 30 "RESERVED" 31 "Not Display" ;
VAL_ 704 VCU_MxPwrMdOSD 0 "None" 1 "Battery Heating Complete" 2 "Canceled by Low SOC" 3 "Canceled by Fault" 4 "RESERVED" 5 "RESERVED" 6 "RESERVED" 7 "Error" ;
VAL_ 704 VCU_PwrDnByHoodOpenSta 0 "OFF" 1 "ON" 2 "RESERVED" 3 "Error" ;
VAL_ 704 VCU_FlatTowModeConIndSta 0 "OFF" 1 "Ready" 2 "Activation" 3 "SOC High" 4 "Stop Condition" 5 "Gear Shift" 6 "Charging Complete" 7 "Charging Invalid Stop" 8 "Fault" ;
VAL_ 704 VCU_VgsVirAGIUpGear 0 "Default" 1 "1gear" 2 "2gear" 3 "3gear" 4 "4gear" 5 "5gear" 6 "6gear" 7 "7gear" 8 "8gear" 9 "RESERVED" 10 "RESERVED" 11 "RESERVED" 12 "RESERVED" 13 "RESERVED" 14 "RESERVED" 15 "RESERVED" ;
VAL_ 704 VCU_VgsVirAGIDnGear 0 "Default" 1 "1gear" 2 "2gear" 3 "3gear" 4 "4gear" 5 "5gear" 6 "6gear" 7 "7gear" 8 "8gear" 9 "RESERVED" 10 "RESERVED" 11 "RESERVED" 12 "RESERVED" 13 "RESERVED" 14 "RESERVED" 15 "RESERVED" ;
VAL_ 704 VCU_NCstmBrkOvrSta 0 "Default" 1 "Brake override system is activated" 2 "Brake override system is deactivated" 3 "Invalid" ;
VAL_ 704 VCU_NCondDragSta 0 "Not Supported" 1 "Drag Mode Inactivate" 2 "Drag Mode Activate Off" 3 "Drag Mode Activate ON" ;
VAL_ 704 VCU_NCondDragSegVal 0 "0~100 %" 1 "0~100 %" 2 "0~100 %" 3 "0~100 %" 4 "0~100 %" 5 "0~100 %" 6 "0~100 %" 7 "0~100 %" 8 "0~100 %" 9 "0~100 %" 10 "0~100 %" 11 "0~100 %" 12 "0~100 %" 13 "0~100 %" 14 "0~100 %" 15 "0~100 %" 16 "0~100 %" 17 "0~100 %" 18 "0~100 %" 19 "0~100 %" 20 "0~100 %" 21 "RESERVED" 22 "RESERVED" 23 "RESERVED" 24 "RESERVED" 25 "RESERVED" 26 "RESERVED" 27 "RESERVED" 28 "RESERVED" 29 "RESERVED" 30 "RESERVED" 31 "Not Display" ;
VAL_ 704 VCU_NCondTrackSta 0 "Not Supported" 1 "Track Mode Inactivate" 2 "Track Mode ActivateOff" 3 "Track Mode Activate ON" ;
VAL_ 704 VCU_NCondTrackTimeVal 0 "0~62min" 1 "0~62min" 2 "0~62min" 3 "0~62min" 4 "0~62min" 5 "0~62min" 6 "0~62min" 7 "0~62min" 8 "0~62min" 9 "0~62min" 10 "0~62min" 11 "0~62min" 12 "0~62min" 13 "0~62min" 14 "0~62min" 15 "0~62min" 16 "0~62min" 17 "0~62min" 18 "0~62min" 19 "0~62min" 20 "0~62min" 21 "0~62min" 22 "0~62min" 23 "0~62min" 24 "0~62min" 25 "0~62min" 26 "0~62min" 27 "0~62min" 28 "0~62min" 29 "0~62min" 30 "0~62min" 31 "0~62min" 32 "0~62min" 33 "0~62min" 34 "0~62min" 35 "0~62min" 36 "0~62min" 37 "0~62min" 38 "0~62min" 39 "0~62min" 40 "0~62min" 41 "0~62min" 42 "0~62min" 43 "0~62min" 44 "0~62min" 45 "0~62min" 46 "0~62min" 47 "0~62min" 48 "0~62min" 49 "0~62min" 50 "0~62min" 51 "0~62min" 52 "0~62min" 53 "0~62min" 54 "0~62min" 55 "0~62min" 56 "0~62min" 57 "0~62min" 58 "0~62min" 59 "0~62min" 60 "0~62min" 61 "0~62min" 62 "0~62min" 63 "Not Display" ;
VAL_ 704 VCU_NCondOSD 0 "None" 1 "Battery Heating Complete" 2 "Canceled by Low SOC" 3 "Canceled by Fault" 4 "N Conditioning Pop-up after EvRdy Off" 5 "RESERVED" 6 "RESERVED" 7 "Error" ;
VAL_ 704 VCU_ExpUnitEnrgCnsmptnVal 255 "Error indicator" ;
VAL_ 704 VCU_FlatTowModeChgPwrUsmSta 0 "OFF" 1 "Minimum" 2 "Medium" 3 "Maximum" 4 "Invalid" ;
VAL_ 704 VCU_NCstmHighPefMdWarnMsg 0 "Default" 1 "Failed by vehicle condition(Launch Control)" 2 "Failed by vehicle condition(Persistence mode)" 3 "Failed by vehicle condition(VGS)" 4 "RESERVED" 5 "Failed by vehicle condition (N Pedal)" 6 "Failed by vehicle condition (NTC)" 7 "RESERVED" 8 "RESERVED" 9 "RESERVED" 10 "RESERVED" 11 "RESERVED" 12 "RESERVED" 13 "RESERVED" 14 "RESERVED" 15 "RESERVED" ;
VAL_ 704 VCU_NCstmNtdUsmSta 0 "Default" 1 "NTD Off" 2 "NTD On" 3 "Invalid" ;
VAL_ 704 VCU_FlatTowModeUsmSta 0 "OFF (Not Equipment)" 1 "FlatTowMode OFF" 2 "Uncharged Towing (FlatTow without charging)" 3 "Towing Charging (FlatTow with charging)" 4 "Invalid" ;
VAL_ 704 VCU_FlatTowModeEquip 0 "Default" 1 "FlatTowMode not Equipment" 2 "FlatTowMode Equipment" 3 "Invalid" ;
VAL_ 704 VCU_MaintenanceSrvMd 0 "wait" 1 "M/Rly OFF Request" 2 "M/Rly OFF Complete" 3 "M/Rly OFF Prohibited" ;
VAL_ 704 VCU_CnvrtOpPermSta 0 "Not Permiited" 1 "Permitted" 2 "Not used" 3 "Error Indicator" ;
VAL_ 704 VCU_ARSPosition 0 "Closed" 1 "Open (Lv1)" 2 "Reserved (Lv2)" 3 "Reserved (Lv3)" 4 "Reserved (Lv4)" 5 "Reserved (Lv5)" 6 "Reserved (Lv6)" 7 "Invalid" ;
VAL_ 704 VCU_AccelBoostOnOffSta 0 "Accel Boost Fod not apply" 1 "Accel Boost Fod apply : boost off" 2 "Accel Boost Fod apply : boost off" 3 "-" ;
VAL_ 704 VCU_Required_ADASMapMsg 0 "0x0x0~0xFFFE:Required Map based ADAS Messages" 65534 "0x0x0~0xFFFE:Required Map based ADAS Messages" 65535 "Invalid" ;
VAL_ 704 VCU_HvBatAutoDchOpSta 0 "Default/NotReady" 1 "Ready" 2 "Progress" 3 "Complete" ;
VAL_ 704 VCU_UtilModeWarnAddMsgSta 0 "Default" 1 "Fail for AVN" 2 "Fail for CTS" 3 "Fail for BDC" 4 "RESERVED" 5 "RESERVED" 6 "RESERVED" 7 "RESERVED" ;
VAL_ 704 VCU_TowModSta 0 "None" 1 "Tow Mode On" 2 "RESERVED" 3 "RESERVED" ;
VAL_ 704 VCU_TowLvlSta 0 "Towing Level 0" 1 "Towing Level 1" 2 "Towing Level 2" 3 "Towing Level 3" 4 "RESERVED" 5 "RESERVED" 6 "RESERVED" 7 "RESERVED" ;
VAL_ 704 VCU_SwVer 0 "0x0x0~0xFE:VCU SW Version" 254 "0x0x0~0xFE:VCU SW Version" 255 "Invalid" ;
VAL_ 704 VCU_PwrAutoOffInfo 0 "Normal" 1 "AutoPowerOffActived" 2 "TimerActive" 3 "ErrorIndicator" ;
VAL_ 704 VCU_PwrAutoOffTimerSta 0 "Default" 1 "Timer1" 2 "Timer2" 3 "Timer3" 4 "Timer4" 5 "Disable" 6 "Invalid" 7 "ErrorIndicator" ;
VAL_ 704 VCU_FlatTowModeTargetSocUsmSta 0 "Off (Flat Tow Not Equipment)" 1 "40" 2 "50" 3 "60" 4 "70" 5 "80" 6 "90" 7 "Invalid" ;
VAL_ 704 VCU_PwrAutoOffTimerReset 0 "Normal" 1 "AutoPowerTimerResetActived" 2 "NotUsed" 3 "ErrorIndicator" ;
VAL_ 704 VCU_DrvInfoPageOptSta 0 "Off" 1 "On" 2 "RESERVED" 3 "Invalid" ;
VAL_ 704 VCU_TireSizeWrnMsgSta 0 "Not Display" 1 "Popup Req" 2 "Reserved" 3 "Reserved" ;
VAL_ 704 VCU_BstOpSta 0 "Off" 1 "Ready" 2 "Activated" 3 "Wait" 4 "Reserved" 5 "Reserved" 6 "Reserved" 7 "Reserved" ;
VAL_ 979 BDC_FD_Crc4Val 0 "0x0x0~0xFFFF:CRCValue" 65535 "0x0x0~0xFFFF:CRCValue" ;
VAL_ 979 BDC_FD_AlvCnt4Val 0 "0x0x0~0xFF:AlvCntValue" 255 "0x0x0~0xFF:AlvCntValue" ;
VAL_ 979 BAlarm_BglrAlrm_CurrentSta 0 "Off" 1 "DisArm" 2 "Arm" 3 "PreArm" 4 "ArmWait" 5 "ArmHold" 6 "ReArm" 7 "AutoLockTimer (AutoLockTimer1)" 8 "RESERVED" 9 "Alarm" 10 "Default" 11 "TrunkTgTimer (AutoLockTimer3)" 12 "RESERVED" 13 "RESERVED" 14 "Not Used" 15 "Error Indicator" ;
VAL_ 979 BAlarm_BglrAlrm_Sta 0 "DIS-, PRE-, AUTOLOCKTIMER (AutoLockTimer1), TrunkTgTimer (AutoLockTimer3)" 1 "ARM, -WAIT, RE-, ALARM, -HD(Trunk)" 2 "Not Used" 3 "Error Indicator" ;
VAL_ 979 BAlarm_PncAlrmSta 0 "Off" 1 "On (Panic Alarm ON)" 2 "Not Used" 3 "Error Indicator" ;
VAL_ 979 SBR_StBltStpWrngBzrSta 0 "Warning Off" 1 "Buzzer Hold" 2 "1st Warning" 3 "2nd Warning" 4 "3rd Warning" 5 "Reserved" 6 "Pre Warning" 7 "Error Indicator" ;
VAL_ 979 SBR_StBltWrngBzrSta 0 "Warning Off" 1 "Buzzer Hold" 2 "Buzzer On" 3 "Reserved" 4 "Reserved" 5 "Reseved" 6 "Not Used" 7 "Error Indicator" ;
VAL_ 979 BAlarm_BrglrHrnRlySta 0 "Off" 1 "On" 2 "Not Used" 3 "Error Indicator" ;
VAL_ 979 SBR_DrvStBltIndSta 0 "Off" 1 "On" 2 "Not Used" 3 "Error Indicator" ;
VAL_ 979 SBR_RrLftStBltWrngIndSta 0 "Off" 1 "On" 2 "Belted" 3 "Error Indicator" ;
VAL_ 979 SBR_RrRtStBltWrngIndSta 0 "Off" 1 "On" 2 "Belted" 3 "Error Indicator" ;
VAL_ 979 SBR_RrCtrStBltIndSta 0 "Off" 1 "On" 2 "Belted" 3 "Error Indicator" ;
VAL_ 979 SBR_3rdLftStBltWrngIndSta 0 "Off" 1 "On" 2 "Belted" 3 "Error Indicator" ;
VAL_ 979 SBR_3rdRtStBltWrngIndSta 0 "Off" 1 "On" 2 "Belted" 3 "Error Indicator" ;
VAL_ 979 SBR_3rdCtrStBltWrngIndSta 0 "Off" 1 "On" 2 "Belted" 3 "Error Indicator" ;
VAL_ 979 Warn_BzrWrngSta 0 "Off" 1 "SeatBelt Warning" 2 "Key Operated Warning" 3 "Parking Brake Warning" 4 "Sun Roof Open Warning" 5 "Key Learning Sound(NoSMKOption" 6 "ICE Warning" 7 "Rear Fog Warning" 8 "Reserved" 9 "Reserved" 10 "Reserved" 11 "Reserved" 12 "Reserved" 13 "Reserved" 14 "Not Used" 15 "Error Indicator" ;
VAL_ 979 Warn_BCMWrngSta 0 "Off" 1 "Power off request warning" 2 "Shift P request Warning" 3 "Shift P Warning 2 (Pwr Off, Shift Enable)" 4 "Shift P Warning 2 (Pwr Off, Shift Disable)" 5 "Shift P Warning 2 (Pwr On, Shift Enable)" 6 "Shift P Warning 2 (Pwr On, Shift Disable)" 7 "RESERVED" 8 "RESERVED" 9 "RESERVED" 10 "RESERVED" 11 "RESERVED" 12 "RESERVED" 13 "RESERVED" 14 "Not Used" 15 "Error Indicator" ;
VAL_ 979 ROA_RrBlwAutoOffReq 0 "default" 1 "Request of Rear Blow Off (auto Cut)" 2 "Not Used" 3 "Error Indciator" ;
VAL_ 979 ROA_RegionOpt 0 "Non Euro NCAP CPD" 1 "Euro NCAP CPD" 2 "Reserved" 3 "Error Indicator" ;
VAL_ 979 Warn_RrStRmndOpt 0 "Not apply RrSeatRemind" 1 "Apply RrSeatRemind" 2 "Apply Radar ROA sensor" 3 "Error Indicator" ;
VAL_ 979 Warn_RrStRmndAlrmOnReq 0 "Off" 1 "On(Alarm)" 2 "Not Used" 3 "Error Indicator" ;
VAL_ 979 Warn_RrStRmndSysSta 0 "Default" 1 "System ON" 2 "System OFF" 3 "Error Indicator" ;
VAL_ 979 Warn_RrStRmndAlrmInfo 0 "Off" 1 "Rear Seat Reminder" 2 "Rear Seat Reminder 1st Only" 3 "Delayed ROA" 4 "Pre-warning" 5 "Pre-warning 1st Only" 6 "Pre-warning Ncap" 7 "Error Indicator" ;
VAL_ 979 Warn_RoaErr 0 "Off" 1 "SensorError( Malfunction)" 2 "Reserved" 3 "Reserved" 4 "Reserved" 5 "Reseved" 6 "Not Used" 7 "Error Indicator" ;
VAL_ 979 Warn_RrStRmndDelay 0 "Off" 1 "Delayed ROA" 2 "Not Used" 3 "Error Indicator" ;
VAL_ 979 Warn_RrStRmndSysAct 0 "Default" 1 "Deactivation" 2 "Off" 3 "Error Indicator" ;
VAL_ 979 WAL_FobSearching 0 "Not Fob Exist" 1 "Fob Exist" 2 "Reserved" 3 "Error Indicator" ;
VAL_ 979 Warn_RrStRmndSysOffIND 0 "Indicator Off" 1 "Indicator On" 2 "Not Used" 3 "Error Indicator" ;
VAL_ 979 Warn_VehNotPWrngSta 0 "Off" 1 "Not P Warning (Pwr Off, Shift Enable)" 2 "Not P Warning (Pwr Off, Shift Disable)" 3 "Not P Warning (Pwr On, Shift Enable)" 4 "Not P Warning (Pwr On, Shift Disable)" 5 "RESERVED" 6 "RESERVED" 7 "Error Indicator" ;
VAL_ 979 Warn_RrStRmndAlrmInfo_1 0 "Default" 1 "OFF" 2 "Pre-warning" 3 "Pre-warning 1st Only" 4 "Pre-warning Ncap" 5 "RESERVED" 6 "RESERVED" 7 "Error Indicator" ;
VAL_ 1059 HU_GW_Crc4Val 0 "0x0x0~0xFFFF:CRCValue" 65535 "0x0x0~0xFFFF:CRCValue" ;
VAL_ 1059 CF_AVN_AutoWashModeSta 0 "Default" 1 "Not Wash Mode" 2 "Auto Wash Mode" 3 "Self Wash Mode" 4 "RESERVED" 5 "RESERVED" 6 "RESERVED" 7 "Invalid" ;
VAL_ 1059 HU_ResetOpSta 0 "Normal" 1 "Reset Complete" 2 "Reset Fail" 3 "RESERVED" ;
VAL_ 1059 OMUOSMirCtrl_Vr 0 "Off" 1 "Fold" 2 "Unfold" 3 "invalid" ;
VAL_ 1059 HU_GW_AlvCnt4Val 0 "0x0x0~0xFF:AlvCntValue" 255 "0x0x0~0xFF:AlvCntValue" ;
VAL_ 1059 HU_Customer_Action_Ind 0 "NoAction" 1 "Action" ;
VAL_ 1059 HU_IG3_Request 0 "Off" 1 "On" 2 "RESERVED" 3 "Invalid" ;
VAL_ 1059 HU_DigitalKeyGroupingSupport 0 "Default" 1 "Not supported" 2 "Support" 3 "RESERVED" ;
VAL_ 1059 HU_Background 0 "Default" 1 "Day" 2 "Night" 3 "RESERVED" 4 "RESERVED" 5 "RESERVED" 6 "RESERVED" 7 "Invalid" ;
VAL_ 1059 HU_BackgroundFadeInOut 0 "0x0x0~0x3E8:0.0~100.0%" 1000 "0x0x0~0x3E8:0.0~100.0%" 1001 "RESERVED" 1002 "RESERVED" 1003 "RESERVED" 1004 "RESERVED" 1005 "RESERVED" 1006 "RESERVED" 1007 "RESERVED" 1008 "RESERVED" 1009 "RESERVED" 1010 "RESERVED" 1011 "RESERVED" 1012 "RESERVED" 1013 "RESERVED" 1014 "RESERVED" 1015 "RESERVED" 1016 "RESERVED" 1017 "RESERVED" 1018 "RESERVED" 1019 "RESERVED" 1020 "RESERVED" 1021 "RESERVED" 1022 "Default" 1023 "Invalid" ;
VAL_ 983 BDC_FD_Crc8Val 0 "0x0x0~0xFFFF:CRCValue" 65535 "0x0x0~0xFFFF:CRCValue" ;
VAL_ 983 Mirror_MnlFldModSta 0 "None" 1 "ManualFold" 2 "RESERVED" 3 "Error Indicator" ;
VAL_ 983 Mirror_SelSwSta 0 "Off" 1 "Left" 2 "Neutral" 3 "Right" 4 "Not Used" 5 "Not Used" 6 "Not Used" 7 "Error Indicator" ;
VAL_ 983 Mirror_LHPosMnlReq 0 "Off" 1 "Up" 2 "Down" 3 "Left" 4 "Right" 5 "Not Used" 6 "Not Used" 7 "Error Indicator" ;
VAL_ 983 Mirror_AutoWashModeSta_TypeC 0 "Not Completed" 1 "Completed" 2 "RESERVED" 3 "Error Indicator" ;
VAL_ 983 Mirror_RHPosMnlReq 0 "Off" 1 "Up" 2 "Down" 3 "Left" 4 "Right" 5 "Not Used" 6 "Not Used" 7 "Error Indicator" ;
VAL_ 983 Mirror_LHPosMnlCmd 0 "Off" 1 "Up" 2 "Down" 3 "Left" 4 "Right" 5 "Not Used" 6 "Not Used" 7 "Error Indicator" ;
VAL_ 983 Mirror_RHPosMnlCmd 0 "Off" 1 "Up" 2 "Down" 3 "Left" 4 "Right" 5 "Not Used" 6 "Not Used" 7 "Error Indicator" ;
VAL_ 983 Wiper_FrWiperLowAct 0 "Off" 1 "On" 2 "Not Used" 3 "Error Indicator" ;
VAL_ 983 Wiper_FrWiperHighAct 0 "Off" 1 "On" 2 "Not Used" 3 "Error Indicator" ;
VAL_ 983 Wiper_FrtWiperLowCmd 0 "Off" 1 "On" 2 "Not Used" 3 "Error Indicator" ;
VAL_ 983 Wiper_FrtWiperHighCmd 0 "Off" 1 "On" 2 "Not Used" 3 "Error Indicator" ;
VAL_ 983 Wiper_RrWiperCmd 0 "Off" 1 "On" 2 "Not Used" 3 "Error Indicator" ;
VAL_ 983 Wiper_PowerEnableCmd 0 "Off" 1 "On" 2 "Not Used" 3 "Error Indicator" ;
VAL_ 983 Wiper_FrtWasherCmd 0 "Off" 1 "On" 2 "Not Used" 3 "Error Indicator" ;
VAL_ 983 Wiper_RrWasherCmd 0 "Off" 1 "On" 2 "Not Used" 3 "Error Indicator" ;
VAL_ 983 Wiper_HeadLampWasherCmd 0 "Off" 1 "On" 2 "Not Used" 3 "Error Indicator" ;
VAL_ 983 Wiper_AutoWashModeSta_TypeC 0 "Not Completed" 1 "Completed" 2 "RESERVED" 3 "Error Indicator" ;
VAL_ 983 Mirror_LHPosMnlPlyCmd 0 "Off" 1 "Up" 2 "Down" 3 "Left" 4 "Right" 5 "RESERVED" 6 "RESERVED" 7 "Error Indicator" ;
VAL_ 983 Mirror_RHPosMnlPlyCmd 0 "Off" 1 "Up" 2 "Down" 3 "Left" 4 "Right" 5 "RESERVED" 6 "RESERVED" 7 "Error Indicator" ;
VAL_ 983 BDC_FD_AlvCnt8Val 0 "0x0x0~0xFF:AlvCntValue" 255 "0x0x0~0xFF:AlvCntValue" ;
VAL_ 983 Mirror_LHPosAutoPlyCmd 0 "Off" 1 "IMS1" 2 "IMS2" 3 "IMS3" 4 "IMS Stop" 5 "SmartIMS" 6 "SmartIMS Stop" 7 "Personal Service(Profile)" 8 "Default Auto Reverse" 9 "IMS1 Auto Reverse" 10 "IMS2 Auto Reverse" 11 "IMS3 Auto Reverse" 12 "Self Return" 13 "RESERVED" 14 "RESERVED" 15 "Error Indicator" ;
VAL_ 983 Mirror_RHPosAutoPlyCmd 0 "Off" 1 "IMS1" 2 "IMS2" 3 "IMS3" 4 "IMS Stop" 5 "SmartIMS" 6 "SmartIMS Stop" 7 "Personal Service(Profile)" 8 "Default Auto Reverse" 9 "IMS1 Auto Reverse" 10 "IMS2 Auto Reverse" 11 "IMS3 Auto Reverse" 12 "Self Return" 13 "RESERVED" 14 "RESERVED" 15 "Error Indicator" ;
VAL_ 983 Mirror_IMSMemoryCmd 0 "Off" 1 "IMS1" 2 "IMS2" 3 "IMS3" 4 "RESERVED" 5 "RESERVED" 6 "RESERVED" 7 "Error Indicator" ;
VAL_ 983 ECW_Overload2 0 "Else" 1 "Detected Overload" 2 "Detected Block" 3 "Detected Overheat" 4 "RESERVED" 5 "RESERVED" 6 "Not Used" 7 "Error Indicator" ;
VAL_ 983 Mirror_AutoRevModSetSta 0 "Default" 1 "Off" 2 "On" 3 "Error Indicator" ;
VAL_ 983 Wiper_RainAmount 0 "0x0x0~0x96:PH=0.1*HEX(mm/Hr)" 150 "0x0x0~0x96:PH=0.1*HEX(mm/Hr)" 151 "0x97~0xFE:RESERVED" 254 "0x97~0xFE:RESERVED" 255 "Invalid" ;
VAL_ 983 Wiper_AutoWashModeSta 0 "Auto Wash Mode Off" 1 "Auto Wash Mode On" 2 "Not Used" 3 "Error Indicator" ;
VAL_ 983 Wiper_PrkngPosSta 0 "else" 1 "Parking Position" 2 "Not Used" 3 "Error Indicator" ;
VAL_ 983 Wiper_RainSnsrOptionTyp 0 "Non Rain Sensor Option" 1 "Rain Sensor Option" 2 "Not Used" 3 "Error Indicator" ;
VAL_ 983 Wiper_HtWshNzzlCmd 0 "Off" 1 "On" 2 "Not Used" 3 "Error Indicator" ;
VAL_ 983 Wiper_RainSnsrSta 0 "OFF" 1 "Rain Detected" 2 "Low" 3 "High" 4 "Fault 1" 5 "RESERVED" 6 "RESERVED" 7 "RESERVED" 8 "RESERVED" 9 "RESERVED" 10 "RESERVED" 11 "RESERVED" 12 "RESERVED" 13 "RESERVED" 14 "Not Used" 15 "Error Indicator" ;
VAL_ 983 Wiper_RainSnsrPartNum 0 "T6000,NI000" 1 "EV000,DV000" 2 "CU000,XA000" 3 "CV000" 4 "KL000" 5 "DO000" 6 "CU500" 7 "RESERVED" 8 "RESERVED" 9 "RESERVED" 10 "RESERVED" 11 "RESERVED" 12 "RESERVED" 13 "RESERVED" 14 "RESERVED" 15 "L1000,N9000" ;
VAL_ 983 ECW_Fault 0 "Else" 1 "Detected" 2 "Not used" 3 "Error Indicator" ;
VAL_ 983 ECW_FaultActv 0 "Else" 1 "Valid" 2 "Not used" 3 "Error Indicator" ;
VAL_ 983 ECW_HiVolt 0 "Else" 1 "Detected" 2 "Not used" 3 "Error Indicator" ;
VAL_ 983 ECW_HiVoltActv 0 "Else" 1 "Valid" 2 "Not used" 3 "Error Indicator" ;
VAL_ 983 ECW_LoVolt 0 "Else" 1 "Detected" 2 "Not used" 3 "Error Indicator" ;
VAL_ 983 ECW_LoVoltActv 0 "Else" 1 "Valid" 2 "Not used" 3 "Error Indicator" ;
VAL_ 983 ECW_Overload 0 "Else" 1 "Detected" 2 "Not used" 3 "Error Indicator" ;
VAL_ 983 ECW_OverloadActv 0 "Else" 1 "Valid" 2 "Not used" 3 "Error Indicator" ;
VAL_ 983 ECW_CommErr 0 "No error" 1 "Error" 2 "Not used" 3 "Error Indicator" ;
VAL_ 983 BCM_SolSnsrRt 0 "0x0x00~0xFE:w/m2" 254 "0x0x00~0xFE:w/m2" 255 "Invalid" ;
VAL_ 983 BCM_SolSnsrLft 0 "0x0x00~0xFE:w/m2" 254 "0x0x00~0xFE:w/m2" 255 "Invalid" ;
VAL_ 983 Mirror_MirFldOpt 0 "Not Applied" 1 "Applied" 2 "Not Used" 3 "Error Indicator" ;
VAL_ 983 Mirror_FldUnfldCmd 0 "Off" 1 "Fold" 2 "Unfold" 3 "Error Indicator" ;
VAL_ 983 Mirror_FldCtrlSta 0 "Off" 1 "Fldng" 2 "Fld" 3 "Error Indicator" ;
VAL_ 983 Mirror_UnFldCtrlSta 0 "Off" 1 "UnFldng" 2 "UnFld" 3 "Error Indicator" ;
VAL_ 983 Mirror_PosMnlCmd 0 "Off" 1 "Up" 2 "Down" 3 "Left" 4 "Right" 5 "Not Used" 6 "Not Used" 7 "Error Indicator" ;
VAL_ 983 Mirror_SelSwIndCmd 0 "Off" 1 "Left" 2 "Neutral" 3 "Right" 4 "Not Used" 5 "Not Used" 6 "Not Used" 7 "Error Indicator" ;
