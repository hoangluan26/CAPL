VERSION ""

NS_ :

BS_:

BU_: SHVU_CCS_FD ARS_FD WPC_FD WPC2_FD SCM_FD SHVU_FRNT_FD FLLR_FD GW_SAU_DRV_FD ATS_FD PSB_FD GW_PSU_RR_FD SHVU_RL_FD RWPC_FD CGW_CCU OHCL_FD SHVU_REAR_FD BLTN_CAM_FD GW_PSU_DRV_FD FCS_FD GW_PSU_AST_FD GW_PSU_3RD_FD RCS_FD GW_PSU_RL_FD SHVU_3RD_FD SHVU_RR_FD RCM_FD DCM_FD SGU_FD vFD_B2

BO_ 682 VCU_04_100ms: 32 CGW_CCU
 SG_ VCU_Crc4Val : 0|16@1+ (1,0) [0|0] "" Vector__XXX
 SG_ VCU_SchedChgSet_OpModeSta : 104|2@1+ (1,0) [0|3] "" Vector__XXX
 SG_ VCU_SchedChg_EnIndSta : 106|2@1+ (1,0) [0|3] "" Vector__XXX
 SG_ VCU_SchedChg_WaitIndSta : 108|2@1+ (1,0) [0|3] "" Vector__XXX
 SG_ VCU_AcChgInhSta : 110|2@1+ (1,0) [0|3] "" Vector__XXX
 SG_ VCU_ChgCancelReq : 112|2@1+ (1,0) [0|3] "" Vector__XXX
 SG_ VCU_SchedRmtFcn_MainRlyOnReq : 114|2@1+ (1,0) [0|3] "" Vector__XXX
 SG_ VCU_SchedRmtFcn_OpSta : 116|4@1+ (1,0) [0|15] "" Vector__XXX
 SG_ VCU_SchedClimateSet_EnSta : 120|2@1+ (1,0) [0|3] "" Vector__XXX
 SG_ VCU_SchedClimateSet_TempVal : 122|6@1+ (1,0) [0|0] "" Vector__XXX
 SG_ VCU_SchedClimateSet_DefrostEnSta : 128|2@1+ (1,0) [0|3] "" Vector__XXX
 SG_ VCU_AirconCtrReq : 130|2@1+ (1,0) [0|3] ""  GW_PSU_3RD_FD,GW_PSU_AST_FD,GW_PSU_DRV_FD,GW_PSU_RL_FD,GW_PSU_RR_FD,SHVU_3RD_FD,SHVU_FRNT_FD,SHVU_REAR_FD,SHVU_RL_FD,SHVU_RR_FD
 SG_ VCU_SchedRmtClimate_OpSta : 132|2@1+ (1,0) [0|3] "" Vector__XXX
 SG_ VCU_FatcDefrostCtrReq : 134|2@1+ (1,0) [0|3] "" Vector__XXX
 SG_ VCU_AuxBattChgVehCondi : 136|2@1+ (1,0) [0|0] "" Vector__XXX
 SG_ VCU_BattCondHeatReq : 138|2@1+ (1,0) [0|0] "" Vector__XXX
 SG_ VCU_BattCondIndSta : 140|2@1+ (1,0) [0|0] "" Vector__XXX
 SG_ VCU_SchedClimate_EnIndSta : 142|2@1+ (1,0) [0|3] "" Vector__XXX
 SG_ VCU_GpsSched_OpSta : 144|2@1+ (1,0) [0|3] "" Vector__XXX
 SG_ VCU_GpsSched_ChgClimateEnSta : 146|2@1+ (1,0) [0|3] "" Vector__XXX
 SG_ VCU_GpsSched_UpdateReq : 148|2@1+ (1,0) [0|3] "" Vector__XXX
 SG_ VCU_ChgCycSta : 150|2@1+ (1,0) [0|3] "" Vector__XXX
 SG_ VCU_AvnWakeupReq : 152|2@1+ (1,0) [0|3] "" Vector__XXX
 SG_ VCU_SchedRmtFcn_FailCfmSta : 154|2@1+ (1,0) [0|3] "" Vector__XXX
 SG_ VCU_AirconFinishAlmSta : 156|2@1+ (1,0) [0|3] "" Vector__XXX
 SG_ VCU_SchedClimateSet_TempUnitTyp : 158|2@1+ (1,0) [0|0] "" Vector__XXX
 SG_ VCU_AlvCnt4Val : 16|8@1+ (1,0) [0|0] "" Vector__XXX
 SG_ VCU_SchedChg_StDayDispSta : 160|3@1+ (1,0) [0|7] "" Vector__XXX
 SG_ VCU_SchedChg_StHrDispVal : 163|5@1+ (1,0) [0|23] "hour" Vector__XXX
 SG_ VCU_SchedChg_StMinDispVal : 168|6@1+ (1,0) [0|59] "min" Vector__XXX
 SG_ VCU_SchedChg_EndDayDispSta : 174|3@1+ (1,0) [0|7] "" Vector__XXX
 SG_ VCU_SchedChg_EndHrDispVal : 177|5@1+ (1,0) [0|23] "hour" Vector__XXX
 SG_ VCU_SchedChg_EndMinDispVal : 182|6@1+ (1,0) [0|59] "min" Vector__XXX
 SG_ VCU_AuxBattSavUsmSta : 188|2@1+ (1,0) [0|3] "" Vector__XXX
 SG_ VCU_AuxBattSavWakeupSta : 190|2@1+ (1,0) [0|3] "" Vector__XXX
 SG_ VCU_RsChgSeqSta : 192|5@1+ (1,0) [0|0] "" Vector__XXX
 SG_ VCU_NCstmLaunchCtrlGripLvlMxVal : 197|3@1+ (1,0) [0|0] "" Vector__XXX
 SG_ VCU_RsAirconSeqSta : 200|4@1+ (1,0) [0|0] "" Vector__XXX
 SG_ VCU_ChargeInfo : 204|4@1+ (1,0) [0|0] "" Vector__XXX
 SG_ VCU_RsRtcSchedDayVal : 208|3@1+ (1,0) [0|0] "" Vector__XXX
 SG_ VCU_RsRtcSchedHrVal : 211|5@1+ (1,0) [0|0] "" Vector__XXX
 SG_ VCU_RsRtcSchedMinVal : 216|6@1+ (1,0) [0|0] "" Vector__XXX
 SG_ VCU_Ig3DrvSta : 222|2@1+ (1,0) [0|3] "" Vector__XXX
 SG_ VCU_UtilModeUsmSta : 224|2@1+ (1,0) [0|3] ""  ATS_FD,DCM_FD
 SG_ VCU_UtilModeActSta : 226|2@1+ (1,0) [0|3] ""  FCS_FD,SGU_FD
 SG_ VCU_UtilModeWarnMsgSta : 228|2@1+ (1,0) [0|3] ""  ATS_FD
 SG_ VCU_Ig3OnlySta : 230|2@1+ (1,0) [0|3] "" Vector__XXX
 SG_ VCU_BattCondApply : 232|2@1+ (1,0) [0|0] "" Vector__XXX
 SG_ VCU_NCstmLaunchCtrlGripLvlVal : 234|3@1+ (1,0) [0|0] "" Vector__XXX
 SG_ VCU_VgsShfIndledSta : 237|3@1+ (1,0) [0|0] "" Vector__XXX
 SG_ VCU_DepartSet1_HrVal : 24|5@1+ (1,0) [0|23] "hour" Vector__XXX
 SG_ VCU_MainRlyVehCondi : 240|4@1+ (1,0) [0|0] "" Vector__XXX
 SG_ VCU_NCstmNdurRaceSta : 244|2@1+ (1,0) [0|0] "" Vector__XXX
 SG_ VCU_NCstmDriftDfctvSta : 246|2@1+ (1,0) [0|0] "" Vector__XXX
 SG_ VCU_NCstmNpdlLvlVal : 248|3@1+ (1,0) [0|0] ""  BLTN_CAM_FD
 SG_ VCU_NCstmEKDUsmSta : 251|2@1+ (1,0) [0|0] "" Vector__XXX
 SG_ VCU_NCstmLaunchCtrlSta : 253|3@1+ (1,0) [0|0] "" Vector__XXX
 SG_ VCU_DepartSet1_MinVal : 29|3@1+ (10,0) [0|50] "min" Vector__XXX
 SG_ VCU_DepartSet2_HrVal : 32|5@1+ (1,0) [0|23] "hour" Vector__XXX
 SG_ VCU_DepartSet2_MinVal : 37|3@1+ (10,0) [0|50] "min" Vector__XXX
 SG_ VCU_DepartSet1_Mon : 40|2@1+ (1,0) [0|0] "flag" Vector__XXX
 SG_ VCU_DepartSet1_Tue : 42|2@1+ (1,0) [0|0] "flag" Vector__XXX
 SG_ VCU_DepartSet1_Wed : 44|2@1+ (1,0) [0|0] "flag" Vector__XXX
 SG_ VCU_DepartSet1_Thu : 46|2@1+ (1,0) [0|0] "flag" Vector__XXX
 SG_ VCU_DepartSet1_EnSta : 48|2@1+ (1,0) [0|3] "" Vector__XXX
 SG_ VCU_DepartSet1_Fri : 50|2@1+ (1,0) [0|0] "flag" Vector__XXX
 SG_ VCU_DepartSet1_Sat : 52|2@1+ (1,0) [0|0] "flag" Vector__XXX
 SG_ VCU_DepartSet1_Sun : 54|2@1+ (1,0) [0|0] "flag" Vector__XXX
 SG_ VCU_DepartSet2_Mon : 56|2@1+ (1,0) [0|0] "flag" Vector__XXX
 SG_ VCU_DepartSet2_Tue : 58|2@1+ (1,0) [0|0] "flag" Vector__XXX
 SG_ VCU_DepartSet2_Wed : 60|2@1+ (1,0) [0|0] "flag" Vector__XXX
 SG_ VCU_DepartSet2_Thu : 62|2@1+ (1,0) [0|0] "flag" Vector__XXX
 SG_ VCU_DepartSet2_EnSta : 64|2@1+ (1,0) [0|3] "" Vector__XXX
 SG_ VCU_DepartSet2_Fri : 66|2@1+ (1,0) [0|0] "flag" Vector__XXX
 SG_ VCU_DepartSet2_Sat : 68|2@1+ (1,0) [0|0] "flag" Vector__XXX
 SG_ VCU_DepartSet2_Sun : 70|2@1+ (1,0) [0|0] "flag" Vector__XXX
 SG_ VCU_OffPeakTimeStHrVal : 72|5@1+ (1,0) [0|23] "hour" Vector__XXX
 SG_ VCU_OffPeakTimeStMinVal : 77|3@1+ (10,0) [0|50] "min" Vector__XXX
 SG_ VCU_OffPeakTimeEndHrVal : 80|5@1+ (1,0) [0|23] "hour" Vector__XXX
 SG_ VCU_OffPeakTimeEndMinVal : 85|3@1+ (10,0) [0|50] "min" Vector__XXX
 SG_ VCU_BattCondActStaDisp : 88|3@1+ (1,0) [0|0] "" Vector__XXX
 SG_ VCU_BattCondUsmSta : 91|2@1+ (1,0) [0|3] "" Vector__XXX
 SG_ VCU_FatcTempSetUnit : 94|2@1+ (1,0) [0|0] "" Vector__XXX
 SG_ VCU_FatcTempSetVal : 96|8@1+ (1,0) [0|0] "" Vector__XXX

BO_ 1216 HU_MON_01_2000ms: 16 CGW_CCU
 SG_ HU_MON_Crc1Val : 0|16@1+ (1,0) [0|0] "" Vector__XXX
 SG_ HU_NaviHandshakingSupport : 118|2@1+ (1,0) [0|0] "" Vector__XXX
 SG_ HU_AMP_EQVariant : 120|5@1+ (1,0) [0|0] "" Vector__XXX
 SG_ HU_AdasSupport : 125|3@1+ (1,0) [0|0] "" Vector__XXX
 SG_ HU_MON_AlvCnt1Val : 16|8@1+ (1,0) [0|0] "" Vector__XXX
 SG_ HU_Type : 64|8@1+ (1,0) [0|0] ""  BLTN_CAM_FD
 SG_ HU_Navi_RspADASMapMsg : 72|16@1+ (1,0) [0|0] "" Vector__XXX
 SG_ HU_DistributeInfo : 88|8@1+ (1,0) [0|0] ""  BLTN_CAM_FD
 SG_ HU_OptionInfo : 96|16@1+ (1,0) [0|0] ""  BLTN_CAM_FD,GW_PSU_DRV_FD,GW_SAU_DRV_FD,RCM_FD,RWPC_FD,SCM_FD,SGU_FD,WPC2_FD,WPC_FD

BO_ 955 BLTN_CAM_FD_HU_01_200ms: 16 BLTN_CAM_FD
 SG_ BLTN_CAM_FD_HU_Crc1Val : 0|16@1+ (1,0) [0|0] "" Vector__XXX
 SG_ BLTN_CAM_DEV_Count : 100|8@1+ (1,0) [0|0] ""  CGW_CCU
 SG_ HU_SSHFS_StrictHostKeyCheck1 : 110|2@1+ (1,0) [0|0] ""  CGW_CCU
 SG_ BLTN_CAM_Pollution_Rear : 112|2@1+ (1,0) [0|0] ""  CGW_CCU
 SG_ BLTN_CAM_Pollution_Left : 114|2@1+ (1,0) [0|0] ""  CGW_CCU
 SG_ BLTN_CAM_Pollution_Right : 116|2@1+ (1,0) [0|0] ""  CGW_CCU
 SG_ BLTN_CAM_FD_HU_AlvCnt1Val : 16|8@1+ (1,0) [0|0] "" Vector__XXX
 SG_ BLTN_CAM_PMD_Count : 24|8@1+ (1,0) [0|0] ""  CGW_CCU
 SG_ BLTN_CAM_I2CMasterSta_Left : 32|2@1+ (1,0) [0|0] ""  CGW_CCU
 SG_ BLTN_CAM_I2CMasterSta_Right : 34|2@1+ (1,0) [0|0] ""  CGW_CCU
 SG_ BLTN_CAM_CamSta_Left : 36|4@1+ (1,0) [0|0] ""  CGW_CCU
 SG_ BLTN_CAM_CamSta_Right : 40|4@1+ (1,0) [0|0] ""  CGW_CCU
 SG_ BLTN_CAM_Set_Rear_Flip : 44|2@1+ (1,0) [0|0] ""  CGW_CCU
 SG_ MAR_SoftKeyEnable : 48|4@1+ (1,0) [0|0] ""  CGW_CCU
 SG_ TML_SoftKeyEnable : 52|4@1+ (1,0) [0|0] ""  CGW_CCU
 SG_ MAR_SoftKeySystemFailStatus : 56|4@1+ (1,0) [0|0] ""  CGW_CCU
 SG_ TML_SoftKeySystemFailStatus : 60|4@1+ (1,0) [0|0] ""  CGW_CCU
 SG_ BLTN_CAM_HU_UI_Mode : 64|4@1+ (1,0) [0|0] ""  CGW_CCU
 SG_ BLTN_CAM_Display : 68|4@1+ (1,0) [0|0] ""  CGW_CCU
 SG_ BLTN_CAM_WiFi_State : 72|4@1+ (1,0) [0|0] ""  CGW_CCU
 SG_ BLTN_CAM_SD_Format_Op_State : 76|2@1+ (1,0) [0|0] ""  CGW_CCU
 SG_ BLTN_CAM_PEV_Recorded : 78|2@1+ (1,0) [0|0] ""  CGW_CCU
 SG_ BLTN_CAM_PEV_Count : 80|8@1+ (1,0) [0|0] ""  CGW_CCU
 SG_ BLTN_CAM_Ind_Req : 88|5@1+ (1,0) [0|0] ""  CGW_CCU
 SG_ BLTN_CAM_LVDS_Mode_State : 93|2@1+ (1,0) [0|0] ""  CGW_CCU
 SG_ BLTN_CAM_PrkOp_Termiate_Info : 95|3@1+ (1,0) [0|0] ""  CGW_CCU
 SG_ BLTN_CAM_DEV_Recorded : 98|2@1+ (1,0) [0|0] ""  CGW_CCU

BO_ 829 SBCM_RR_FD_01_200ms: 24 CGW_CCU
 SG_ SBCM_RR_FD_Crc1Val : 0|16@1+ (1,0) [0|0] "" Vector__XXX
 SG_ USM_RRGhostDoorSta : 100|2@1+ (1,0) [0|0] "" Vector__XXX
 SG_ DoorLock_PDSLkSwSta_RR : 104|2@1+ (1,0) [0|0] "" Vector__XXX
 SG_ PDS_TypeOption_RR : 106|2@1+ (1,0) [0|0] "" Vector__XXX
 SG_ RR_CrashMRActAlarm : 138|2@1+ (1,0) [0|0] "" Vector__XXX
 SG_ PwrDRBuzzerOut_RR : 140|2@1+ (1,0) [0|0] "" Vector__XXX
 SG_ PwrDRClosingRRDrSta : 144|3@1+ (1,0) [0|0] ""  ATS_FD
 SG_ AFH_RR_FldUnfldSta : 150|2@1+ (1,0) [0|0] "" Vector__XXX
 SG_ SBCM_RR_FD_AlvCnt1Val : 16|8@1+ (1,0) [0|0] "" Vector__XXX
 SG_ DoorLock_RrRtLkOutSta_SBCM : 166|2@1+ (1,0) [0|0] "" Vector__XXX
 SG_ RrRt_DrLkRetryFail_SBCM : 171|2@1+ (1,0) [0|0] "" Vector__XXX
 SG_ RR_DetectObj_warn : 24|2@1+ (1,0) [0|0] ""  ATS_FD
 SG_ RRRrDrCurtainPosition : 26|2@1+ (1,0) [0|0] ""  ATS_FD
 SG_ RRRrDrCurtainDownInitState : 28|2@1+ (1,0) [0|0] "" Vector__XXX
 SG_ PwrDrSta_RrRt : 30|2@1+ (1,0) [0|0] ""  ATS_FD
 SG_ PwrDRBuzzerOut_RR_New : 32|3@1+ (1,0) [0|0] "" Vector__XXX
 SG_ VAPI_RRDrLkUnLkInsdSwEn_Get : 36|2@1+ (1,0) [0|0] "" Vector__XXX
 SG_ SBCM_RR_SlidePosition : 40|8@1+ (1,0) [0|0] "%"  ATS_FD
 SG_ SBCM_RR_DoorAngle : 48|7@1+ (1,0) [0|0] "˚"  ATS_FD
 SG_ RRDoorPushAlarm : 72|2@1+ (1,0) [0|0] "" Vector__XXX
 SG_ RR_CrashUnlockCmd : 74|1@1+ (1,0) [0|0] ""  BLTN_CAM_FD
 SG_ Warn_RrRtDrSwSta_SBCM : 80|2@1+ (1,0) [0|0] ""  ATS_FD,BLTN_CAM_FD,DCM_FD,GW_PSU_AST_FD,GW_PSU_RR_FD,PSB_FD,RWPC_FD,WPC2_FD,WPC_FD
 SG_ DoorLock_RrRtDrUnLkSta_SBCM : 82|2@1+ (1,0) [0|0] ""  ATS_FD,FCS_FD
 SG_ RR_SEAActivated : 84|2@1+ (1,0) [0|0] ""  ATS_FD
 SG_ RR_SEAWarn : 86|2@1+ (1,0) [0|0] ""  ATS_FD
 SG_ RR_SEWWarn : 88|2@1+ (1,0) [0|0] "" Vector__XXX
 SG_ RR_ReleaseWarn : 90|2@1+ (1,0) [0|0] "" Vector__XXX
 SG_ RR_SWFailAlarm : 92|2@1+ (1,0) [0|0] ""  ATS_FD
 SG_ RR_ChildLock_ActnFlSta : 94|2@1+ (1,0) [0|0] "" Vector__XXX
 SG_ RR_MRActivationAlarm : 96|2@1+ (1,0) [0|0] "" Vector__XXX
 SG_ RR_ChildLock_Status : 98|2@1+ (1,0) [0|0] ""  ATS_FD

BO_ 129 HU_CNTL_01_00ms: 16 CGW_CCU
 SG_ HU_CNTL_Crc1Val : 0|16@1+ (1,0) [0|0] "" Vector__XXX
 SG_ C_GlassCmdAVN : 101|3@1+ (1,0) [0|0] ""  RCM_FD
 SG_ HU_CNTL_AlvCnt1Val : 16|8@1+ (1,0) [0|0] "" Vector__XXX
 SG_ HU_MasterProfile_ResetIndex : 24|4@1+ (1,0) [0|0] ""  BLTN_CAM_FD,GW_PSU_DRV_FD,GW_SAU_DRV_FD,RCM_FD,RWPC_FD,SCM_FD,SGU_FD,WPC2_FD,WPC_FD
 SG_ C_AstWindowCmdAVN : 64|4@1+ (1,0) [0|0] "" Vector__XXX
 SG_ C_DrvWindowCmdAVN : 68|4@1+ (1,0) [0|0] "" Vector__XXX
 SG_ C_PTGCNTLCmdAVN : 72|2@1+ (1,0) [0|0] "" Vector__XXX
 SG_ C_RrDefoggerCmdAVN : 78|2@1+ (1,0) [0|0] "" Vector__XXX
 SG_ C_RrBlindCmdAVN : 80|2@1+ (1,0) [0|0] ""  RCM_FD
 SG_ C_RrGlassCmdAVN : 82|2@1+ (1,0) [0|0] ""  RCM_FD
 SG_ C_RRWindowCmdAVN : 88|4@1+ (1,0) [0|0] "" Vector__XXX
 SG_ C_RLWindowCmdAVN : 92|4@1+ (1,0) [0|0] "" Vector__XXX
 SG_ C_BlindCmdAVN : 98|3@1+ (1,0) [0|0] ""  RCM_FD

BO_ 830 SBCM_RL_FD_01_200ms: 24 CGW_CCU
 SG_ SBCM_RL_FD_Crc1Val : 0|16@1+ (1,0) [0|0] "" Vector__XXX
 SG_ USM_RLGhostDoorSta : 100|2@1+ (1,0) [0|0] "" Vector__XXX
 SG_ DoorLock_PDSLkSwSta_RL : 104|2@1+ (1,0) [0|0] "" Vector__XXX
 SG_ PDS_TypeOption_RL : 106|2@1+ (1,0) [0|0] "" Vector__XXX
 SG_ RL_CrashMRActAlarm : 138|2@1+ (1,0) [0|0] "" Vector__XXX
 SG_ PwrDRBuzzerOut_RL : 140|2@1+ (1,0) [0|0] "" Vector__XXX
 SG_ PwrDRClosingRLDrSta : 144|3@1+ (1,0) [0|0] ""  ATS_FD
 SG_ AFH_RL_FldUnfldSta : 150|2@1+ (1,0) [0|0] "" Vector__XXX
 SG_ SBCM_RL_FD_AlvCnt1Val : 16|8@1+ (1,0) [0|0] "" Vector__XXX
 SG_ DoorLock_RrLtLkOutSta_SBCM : 166|2@1+ (1,0) [0|0] "" Vector__XXX
 SG_ RrLt_DrLkRetryFail_SBCM : 171|2@1+ (1,0) [0|0] "" Vector__XXX
 SG_ RL_DetectObj_warn : 24|2@1+ (1,0) [0|0] ""  ATS_FD
 SG_ RLRrDrCurtainPosition : 26|2@1+ (1,0) [0|0] ""  ATS_FD
 SG_ RDC_TypeOption : 28|2@1+ (1,0) [0|0] ""  ATS_FD
 SG_ RLRrDrCurtainDownInitState : 30|2@1+ (1,0) [0|0] "" Vector__XXX
 SG_ PwrDRBuzzerOut_RL_New : 32|3@1+ (1,0) [0|0] "" Vector__XXX
 SG_ VAPI_RLDrLkUnLkInsdSwEn_Get : 36|2@1+ (1,0) [0|0] "" Vector__XXX
 SG_ PwrDrSta_RrLt : 38|2@1+ (1,0) [0|0] ""  ATS_FD
 SG_ SBCM_RL_SlidePosition : 40|8@1+ (1,0) [0|0] "%"  ATS_FD
 SG_ SBCM_RL_DoorAngle : 48|7@1+ (1,0) [0|0] "˚"  ATS_FD
 SG_ RLDoorPushAlarm : 72|2@1+ (1,0) [0|0] "" Vector__XXX
 SG_ RL_CrashUnlockCmd : 74|1@1+ (1,0) [0|0] ""  BLTN_CAM_FD
 SG_ Warn_RrLftDrSwSta_SBCM : 80|2@1+ (1,0) [0|0] ""  ATS_FD,BLTN_CAM_FD,DCM_FD,GW_PSU_AST_FD,PSB_FD,RWPC_FD,WPC2_FD,WPC_FD
 SG_ DoorLock_RrLftDrUnLkSta_SBCM : 82|2@1+ (1,0) [0|0] ""  ATS_FD,FCS_FD
 SG_ RL_SEAActivated : 84|2@1+ (1,0) [0|0] ""  ATS_FD
 SG_ RL_SEAWarn : 86|2@1+ (1,0) [0|0] ""  ATS_FD
 SG_ RL_SEWWarn : 88|2@1+ (1,0) [0|0] "" Vector__XXX
 SG_ RL_ReleaseWarn : 90|2@1+ (1,0) [0|0] "" Vector__XXX
 SG_ RL_SWFailAlarm : 92|2@1+ (1,0) [0|0] ""  ATS_FD
 SG_ RL_ChildLock_ActnFlSta : 94|2@1+ (1,0) [0|0] "" Vector__XXX
 SG_ RL_MRActivationAlarm : 96|2@1+ (1,0) [0|0] "" Vector__XXX
 SG_ RL_ChildLock_Status : 98|2@1+ (1,0) [0|0] ""  ATS_FD

BO_ 676 HU_CLU_03_200ms: 32 CGW_CCU
 SG_ HU_CLU_Crc3Val : 0|16@1+ (1,0) [0|0] "" Vector__XXX
 SG_ AVNT_NModeSel2_Custom1SetVal : 101|2@1+ (1,0) [0|0] "" Vector__XXX
 SG_ AVNT_NModeSel2_Custom2SetVal : 103|2@1+ (1,0) [0|0] "" Vector__XXX
 SG_ AVNT_NHndlSel2_SportSetVal : 105|2@1+ (1,0) [0|0] "" Vector__XXX
 SG_ AVNT_NHndlSel2_TrackSetVal : 107|2@1+ (1,0) [0|0] "" Vector__XXX
 SG_ AVNT_NHndlSel2_DriftSetVal : 109|2@1+ (1,0) [0|0] "" Vector__XXX
 SG_ AVNT_NHndlSel2_WetSetVal : 111|2@1+ (1,0) [0|0] "" Vector__XXX
 SG_ HU_DispThmSetStaMem : 113|3@1+ (1,0) [0|0] "" Vector__XXX
 SG_ HU_DispThmMemSta : 120|8@1+ (1,0) [0|0] "" Vector__XXX
 SG_ AVNT_NModeSel_NSetVal : 128|2@1+ (1,0) [0|0] "" Vector__XXX
 SG_ AVNT_NModeSel_Custom1SetVal : 130|2@1+ (1,0) [0|0] "" Vector__XXX
 SG_ AVNT_NModeSel_Custom2SetVal : 132|2@1+ (1,0) [0|0] "" Vector__XXX
 SG_ AVNT_NHndlSel_SportSetVal : 134|2@1+ (1,0) [0|0] "" Vector__XXX
 SG_ HD_SPS_ChannelNo : 136|4@1+ (1,0) [0|0] "" Vector__XXX
 SG_ HU_CLU_BlueLightLvl : 140|4@1+ (1,0) [0|0] "" Vector__XXX
 SG_ HU_CLU_BlueLightSta : 154|2@1+ (1,0) [0|0] "" Vector__XXX
 SG_ SXM_ChannelNo : 158|10@1+ (1,0) [0|999] "" Vector__XXX
 SG_ HU_CLU_AlvCnt3Val : 16|8@1+ (1,0) [0|0] "" Vector__XXX
 SG_ AVNT_N1setVal : 173|5@1+ (1,0) [0|0] "" Vector__XXX
 SG_ AVNT_N2setVal : 178|5@1+ (1,0) [0|0] "" Vector__XXX
 SG_ AVNT_NHndlSel_TrackSetVal : 184|2@1+ (1,0) [0|0] "" Vector__XXX
 SG_ AVNT_NHndlSel_DriftSetVal : 186|2@1+ (1,0) [0|0] "" Vector__XXX
 SG_ AVNT_NHndlSel_WetSetVal : 188|2@1+ (1,0) [0|0] "" Vector__XXX
 SG_ LapTimer_LapNumber_HU : 192|7@1+ (1,0) [0|0] ""  BLTN_CAM_FD
 SG_ LapTimer_Hour_HU : 199|7@1+ (1,0) [0|0] "Hour"  BLTN_CAM_FD
 SG_ LapTimer_Minute_HU : 206|6@1+ (1,0) [0|0] "minute"  BLTN_CAM_FD
 SG_ LapTimer_Second_HU : 212|6@1+ (1,0) [0|0] "Sec"  BLTN_CAM_FD
 SG_ LapTimer_milisecond_HU : 225|7@1+ (1,0) [0|0] "ms"  BLTN_CAM_FD
 SG_ LapTimer_CountStart : 251|2@1+ (1,0) [0|0] ""  BLTN_CAM_FD
 SG_ AVNT_NModeSel2_NSetVal : 99|2@1+ (1,0) [0|0] "" Vector__XXX

CM_ BO_ 682 "[P] Periodic";
CM_ SG_ 682 VCU_Crc4Val "VCU_CyclicRedundancyCheck4Value";
CM_ SG_ 682 VCU_SchedChgSet_OpModeSta "VCU_ScheduledChargeSet_OperatingModeStatus ##2G##VCU - VCU18 - CF_Vcu_SchedChgMode";
CM_ SG_ 682 VCU_SchedChg_EnIndSta "VCU_ScheduledCharge_EnableIndicatorStatus ##2G##VCU - VCU20 - CF_Vcu_ProgCharInfo";
CM_ SG_ 682 VCU_SchedChg_WaitIndSta "VCU_ScheduledCharge_WaitingIndicatorStatus ##2G##VCU - VCU20 - CF_Vuc_ProgCharWaitForCharInd";
CM_ SG_ 682 VCU_AcChgInhSta "VCU_AcChargeInhibitStatus ##2G##VCU - VCU20 - CF_Vcu_CharInh";
CM_ SG_ 682 VCU_ChgCancelReq "VCU_ChargingCancelRequest ##2G##VCU - VCU20 - CF_Vcu_CharCancel";
CM_ SG_ 682 VCU_SchedRmtFcn_MainRlyOnReq "VCU_ScheduledRemoteFunction_MainRelayOnRequest ##2G##VCU - VCU20 - CF_Vcu_MainRelayOnReq";
CM_ SG_ 682 VCU_SchedRmtFcn_OpSta "VCU_ScheduledRemoteFunction_OperatingStatus ##2G##VCU - VCU20 - CF_Vcu_IG3RlyMd";
CM_ SG_ 682 VCU_SchedClimateSet_EnSta "VCU_ScheduledClimateSet_EnableStatus ##2G##VCU - VCU19 - CF_Vcu_SchedClimEn";
CM_ SG_ 682 VCU_SchedClimateSet_TempVal "VCU_ScheduledClimateSet_TemperatureValue ##2G##VCU - VCU19 - CR_Vcu_SchedClimTemp";
CM_ SG_ 682 VCU_SchedClimateSet_DefrostEnSta "VCU_ScheduledClimateSet_DefrostEnableStatus ##2G##VCU - VCU19 - CF_Vcu_SchedClimDefrostCtr";
CM_ SG_ 682 VCU_AirconCtrReq "VCU_AirconControlRequest ##2G##VCU - VCU20 - CF_Vcu_AirconCtr";
CM_ SG_ 682 VCU_SchedRmtClimate_OpSta "VCU_ScheduledRemoteClimate_OperatingStatus ##2G##VCU - VCU20 - CF_Vcu_NormalAirconCtr";
CM_ SG_ 682 VCU_FatcDefrostCtrReq "VCU_FatcDefrostControlRequest ##2G##VCU - VCU5 - CF_Vcu_DefrostCtr";
CM_ SG_ 682 VCU_AuxBattChgVehCondi "Aux Battery Charge Vehicle Condition";
CM_ SG_ 682 VCU_BattCondHeatReq "Battery heater operation for battery conditioning";
CM_ SG_ 682 VCU_BattCondIndSta "State for battery conditioning indicator";
CM_ SG_ 682 VCU_SchedClimate_EnIndSta "VCU_ScheduledClimate_EnableIndicatorStatus ##2G##VCU - VCU20 - CF_Vcu_ProgAirConInfo";
CM_ SG_ 682 VCU_GpsSched_OpSta "VCU_GpsScheduled_OperatingStatus ##2G##VCU - VCU18 - CF_Vcu_GpsSched_State";
CM_ SG_ 682 VCU_GpsSched_ChgClimateEnSta "VCU_GpsScheduled_ChargeClimateEnableStatus ##2G##VCU - VCU18 - CF_Vcu_GpsSched_ChgAir";
CM_ SG_ 682 VCU_GpsSched_UpdateReq "VCU_GpsScheduled_UpdateRequest ##2G##VCU - VCU18 - CF_Vcu_GpsSchedUpdateRq";
CM_ SG_ 682 VCU_ChgCycSta "VCU_ChargeCycleStatus ##2G##VCU - VCU1 - CF_Vcu_ChargeCycle";
CM_ SG_ 682 VCU_AvnWakeupReq "VCU_AvnWakeupRequest ##2G##VCU - VCU20 - CF_Vcu_AVN_Wakeup";
CM_ SG_ 682 VCU_SchedRmtFcn_FailCfmSta "VCU_ScheduledRemoteFunction_FailureConfirmedStatus ##2G##VCU - VCU20 - CF_Vcu_FailComfirmed";
CM_ SG_ 682 VCU_AirconFinishAlmSta "VCU_AirConditioningFinishAlarmStatus ##2G##VCU - VCU20 - CF_Vcu_Aircon_Finish";
CM_ SG_ 682 VCU_SchedClimateSet_TempUnitTyp "VCU_ScheduledClimateSet_TemperatureUnitType ##2G##VCU - VCU19 - CF_Vcu_SchedClimTempUnit";
CM_ SG_ 682 VCU_AlvCnt4Val "VCU_AliveCounter4Value";
CM_ SG_ 682 VCU_SchedChg_StDayDispSta "VCU_ScheduledCharge_StartDayDisplayStatus ##2G##VCU - VCU12 - CR_Vcu_SchedChgSt_Day";
CM_ SG_ 682 VCU_SchedChg_StHrDispVal "VCU_ScheduledCharge_StartHourDisplayValue ##2G##VCU - VCU12 - CR_Vcu_SchedChgSt_Hr";
CM_ SG_ 682 VCU_SchedChg_StMinDispVal "VCU_ScheduledCharge_StartMinuteDisplayValue ##2G##VCU - VCU12 - CR_Vcu_SchedChgSt_Min";
CM_ SG_ 682 VCU_SchedChg_EndDayDispSta "VCU_ScheduledCharge_EndDayDisplayStatus ##2G##VCU - VCU12 - CR_Vcu_SchedChgEnd_Day";
CM_ SG_ 682 VCU_SchedChg_EndHrDispVal "VCU_ScheduledCharge_EndHourDisplayValue ##2G##VCU - VCU12 - CR_Vcu_SchedChgEnd_Hr";
CM_ SG_ 682 VCU_SchedChg_EndMinDispVal "VCU_ScheduledCharge_EndMinuteDisplayValue ##2G##VCU - VCU12 - CR_Vcu_SchedChgEnd_Min";
CM_ SG_ 682 VCU_AuxBattSavUsmSta "VCU_AuxiliaryBatterySaverUsmStatus ##2G##VCU - VCU19 - CF_VCU_AuxBattChgUsmSts";
CM_ SG_ 682 VCU_AuxBattSavWakeupSta "VCU_AuxiliaryBatterySaverWakeupStatus ##2G##VCU - VCU19 - CF_Vcu_AuxBattChgWakeup";
CM_ SG_ 682 VCU_RsChgSeqSta "VCU_RemoteScheduleChargeSequenceStatus ##2G##VCU - VCU4 - CR_Vcu_fRsChgState";
CM_ SG_ 682 VCU_NCstmLaunchCtrlGripLvlMxVal "Launch Control Grip Level Max Value(for High Performance vehicle USM)";
CM_ SG_ 682 VCU_RsAirconSeqSta "VCU_RemoteScheduleAirconSequenceStatus ##2G##VCU - VCU4 - CR_Vcu_fRsAirconSq";
CM_ SG_ 682 VCU_ChargeInfo "Schedule Charge additory Information";
CM_ SG_ 682 VCU_RsRtcSchedDayVal "VCU_RemoteScheduleRtcScheduledDayValue ##2G##VCU - VCU4 - CR_Vcu_tRsRtcSchedDay";
CM_ SG_ 682 VCU_RsRtcSchedHrVal "VCU_RemoteScheduleRtcScheduledHourValue ##2G##VCU - VCU4 - CR_Vcu_tRsRtcSchedHr";
CM_ SG_ 682 VCU_RsRtcSchedMinVal "VCU_RemoteScheduleRtcScheduledMinuteValue ##2G##VCU - VCU4 - CR_Vcu_tRsRtcSchedMin";
CM_ SG_ 682 VCU_Ig3DrvSta "VCU_Ig3DriveStatus ##2G##VCU - VCU19 - CF_VCU_IG3DrvSts";
CM_ SG_ 682 VCU_UtilModeUsmSta "VCU_UtilityModeUsmStatus ##2G##VCU - VCU18 - CF_Vcu_RestModeRValueSet";
CM_ SG_ 682 VCU_UtilModeActSta "VCU_UtilityModeActivationStatus ##2G##VCU - VCU18 - CF_Vcu_RestModeVehCond";
CM_ SG_ 682 VCU_UtilModeWarnMsgSta "VCU_UtilityModeWarningMessageStatus ##2G##VCU - VCU18 - CF_Vcu_RestModeWarn";
CM_ SG_ 682 VCU_Ig3OnlySta "VCU_Ig3OnlyStatus ##2G##VCU - VCU20 - CF_Vcu_IG3Only";
CM_ SG_ 682 VCU_BattCondApply "Battery conditioning apply";
CM_ SG_ 682 VCU_NCstmLaunchCtrlGripLvlVal "Launch Control Grip Level(for High Performance vehicle USM)";
CM_ SG_ 682 VCU_VgsShfIndledSta "This signal indicates that an VCU requests cluster to turn on/off shift indicator LED.";
CM_ SG_ 682 VCU_DepartSet1_HrVal "VCU_DepartureSet1_HourValue ##2G##VCU - VCU19 - CR_Vcu_DepartSet1_Hour";
CM_ SG_ 682 VCU_MainRlyVehCondi "VCU Main Relay Vehicle Condition";
CM_ SG_ 682 VCU_NCstmNdurRaceSta "Ndurance Race Status(for High Performance vehicle USM)";
CM_ SG_ 682 VCU_NCstmDriftDfctvSta "Drift defective Status(for High Performance vehicle USM)";
CM_ SG_ 682 VCU_NCstmNpdlLvlVal "N pedal Level(for High Performance vehicle USM)";
CM_ SG_ 682 VCU_NCstmEKDUsmSta "Elctro kick dift state(for High Performance vehicle USM)";
CM_ SG_ 682 VCU_NCstmLaunchCtrlSta "Launch Control State Information(for High Performance vehicle USM)";
CM_ SG_ 682 VCU_DepartSet1_MinVal "VCU_DepartureSet1_MinuteValue ##2G##VCU - VCU19 - CR_Vcu_DepartSet1_Min";
CM_ SG_ 682 VCU_DepartSet2_HrVal "VCU_DepartureSet2_HourValue ##2G##VCU - VCU19 - CR_Vcu_DepartSet2_Hour";
CM_ SG_ 682 VCU_DepartSet2_MinVal "VCU_DepartureSet2_MinuteValue ##2G##VCU - VCU19 - CR_Vcu_DepartSet2_Min";
CM_ SG_ 682 VCU_DepartSet1_Mon "VCU_DepartureSet1_Monday ##2G##VCU - VCU19 - CF_Vcu_DepartSet1_Mon";
CM_ SG_ 682 VCU_DepartSet1_Tue "VCU_DepartureSet1_Tuesday ##2G##VCU - VCU19 - CF_Vcu_DepartSet1_Tue";
CM_ SG_ 682 VCU_DepartSet1_Wed "VCU_DepartureSet1_Wednesday ##2G##VCU - VCU19 - CF_Vcu_DepartSet1_Wed";
CM_ SG_ 682 VCU_DepartSet1_Thu "VCU_DepartureSet1_Thursday ##2G##VCU - VCU19 - CF_Vcu_DepartSet1_Thu";
CM_ SG_ 682 VCU_DepartSet1_EnSta "VCU_DepartureSet1_EnableStatus ##2G##VCU - VCU19 - CF_Vcu_DepartSet1_Enable";
CM_ SG_ 682 VCU_DepartSet1_Fri "VCU_DepartureSet1_Friday ##2G##VCU - VCU19 - CF_Vcu_DepartSet1_Fri";
CM_ SG_ 682 VCU_DepartSet1_Sat "VCU_DepartureSet1_Saturday ##2G##VCU - VCU19 - CF_Vcu_DepartSet1_Sat";
CM_ SG_ 682 VCU_DepartSet1_Sun "VCU_DepartureSet1_Sunday ##2G##VCU - VCU19 - CF_Vcu_DepartSet1_Sun";
CM_ SG_ 682 VCU_DepartSet2_Mon "VCU_DepartureSet2_Monday ##2G##VCU - VCU19 - CF_Vcu_DepartSet2_Mon";
CM_ SG_ 682 VCU_DepartSet2_Tue "VCU_DepartureSet2_Tuesday ##2G##VCU - VCU19 - CF_Vcu_DepartSet2_Tue";
CM_ SG_ 682 VCU_DepartSet2_Wed "VCU_DepartureSet2_Wednesday ##2G##VCU - VCU19 - CF_Vcu_DepartSet2_Wed";
CM_ SG_ 682 VCU_DepartSet2_Thu "VCU_DepartureSet2_Thursday ##2G##VCU - VCU19 - CF_Vcu_DepartSet2_Thu";
CM_ SG_ 682 VCU_DepartSet2_EnSta "VCU_DepartureSet2_EnableStatus ##2G##VCU - VCU19 - CF_Vcu_DepartSet2_Enable";
CM_ SG_ 682 VCU_DepartSet2_Fri "VCU_DepartureSet2_Friday ##2G##VCU - VCU19 - CF_Vcu_DepartSet2_Fri";
CM_ SG_ 682 VCU_DepartSet2_Sat "VCU_DepartureSet2_Saturday ##2G##VCU - VCU19 - CF_Vcu_DepartSet2_Sat";
CM_ SG_ 682 VCU_DepartSet2_Sun "VCU_DepartureSet2_Sunday ##2G##VCU - VCU19 - CF_Vcu_DepartSet2_Sun";
CM_ SG_ 682 VCU_OffPeakTimeStHrVal "VCU_OffPeakTimeStartHourValue ##2G##VCU - VCU18 - CR_Vcu_OffPeakTimeStHr";
CM_ SG_ 682 VCU_OffPeakTimeStMinVal "VCU_OffPeakTimeStartMinuteValue ##2G##VCU - VCU18 - CR_Vcu_OffPeakTimeStMin";
CM_ SG_ 682 VCU_OffPeakTimeEndHrVal "VCU_OffPeakTimeEndHourValue ##2G##VCU - VCU18 - CR_Vcu_OffPeakTimeEndHr";
CM_ SG_ 682 VCU_OffPeakTimeEndMinVal "VCU_OffPeakTimeEndMinuteValue ##2G##VCU - VCU18 - CR_Vcu_OffPeakTimeEndMin";
CM_ SG_ 682 VCU_BattCondActStaDisp "Battery heater operation information for display";
CM_ SG_ 682 VCU_BattCondUsmSta "Usm status for battery conditioning 2nd generation";
CM_ SG_ 682 VCU_FatcTempSetUnit "DATC temperature unit";
CM_ SG_ 682 VCU_FatcTempSetVal "VCU_FatcTemperatureSetValue ##2G##VCU - VCU20 - CR_Vcu_TempSet4FATC";
CM_ BO_ 1216 "[PE] Periodic and On Event";
CM_ SG_ 1216 HU_MON_Crc1Val "HU_MON_CyclicRedundancyCheck1Value";
CM_ SG_ 1216 HU_NaviHandshakingSupport "This is a signal to send whether handshaking logic is applied related to Navigation's 'Map based ADAS' specification";
CM_ SG_ 1216 HU_AMP_EQVariant "Set EQ Variant for various vehicle cases.
During the AMP initializing process, This signal should be sent before AMP unmute.
This signal is only needed for models that have variant EQ for vehicle types. (Hatchback, Wagon, Hybrid etc..)
Models that doesn’t have variant EQ for vehicle types shouldn’t have this signal.";
CM_ SG_ 1216 HU_AdasSupport "Information about ADAS support
-Classify between General Map and Precise Map Transmission Function
-AVN System Transmission Signal";
CM_ SG_ 1216 HU_MON_AlvCnt1Val "HU_MON_AliveCounter1Value";
CM_ SG_ 1216 HU_Type "Information for H/U Platform type
- Integrated AVN 1.0 use different value depends on development company (Mobis:0x68/LG:0x70)
- Integrated AVN 1.0 Mobis is developed based on Display Audio
- Integrated AVN 1.0 LG is developed based on Compact AVN

Information for China OPIO Platform
- 0xFC: China OPIO w/o CLU interface (most of phase1)
- 0xFD: China OPIO w/CLU interface (parts of phase1, phase2)

Information for Audio Platform Type
- 0x43 : Audio 4.0 Value";
CM_ SG_ 1216 HU_Navi_RspADASMapMsg "HU_ResponseADASMapMessage";
CM_ SG_ 1216 HU_DistributeInfo "Region :Europe/North America/
Vehicle Type : RHD/LHD
Positionning information";
CM_ SG_ 1216 HU_OptionInfo "Information of H/U functions";
CM_ BO_ 955 "[PE] Periodic and On Event";
CM_ SG_ 955 BLTN_CAM_FD_HU_Crc1Val "BLTN_CAM_FD_HU_CyclicRedundancyCheck1Value";
CM_ SG_ 955 BLTN_CAM_DEV_Count "This Signal is count of drive event record.";
CM_ SG_ 955 HU_SSHFS_StrictHostKeyCheck1 "0x0(Default), 0x1(One-Way), 0x2(Mutual), 0x3(Invalid)";
CM_ SG_ 955 BLTN_CAM_Pollution_Rear "0x0: Default, 0x1: No pollution, 0x2: Pollution detected, 0x3: Invalid";
CM_ SG_ 955 BLTN_CAM_Pollution_Left "0x0: Default, 0x1: No pollution, 0x2: Pollution detected, 0x3: Invalid";
CM_ SG_ 955 BLTN_CAM_Pollution_Right "0x0: Default, 0x1: No pollution, 0x2: Pollution detected, 0x3: Invalid";
CM_ SG_ 955 BLTN_CAM_FD_HU_AlvCnt1Val "BLTN_CAM_FD_HU_AliveCounter1Value";
CM_ SG_ 955 BLTN_CAM_PMD_Count "This Signal is count of park motion detetion.";
CM_ SG_ 955 BLTN_CAM_Set_Rear_Flip "Setting Information(On/Off) of Rear Video Left/Right Flipping";
CM_ SG_ 955 MAR_SoftKeyEnable "0x0:Enable/0x1:Disable/0x2~0xE:Reserved/0xF:Error Indicator";
CM_ SG_ 955 TML_SoftKeyEnable "0x0:Enable/0x1:Disable/0x2~0xE:Reserved/0xF:Error Indicator";
CM_ SG_ 955 MAR_SoftKeySystemFailStatus "0x0:Normal / 0x1: System Fail / 0x2~0xE:Reserved / 0xF:Invalid Error Indicator";
CM_ SG_ 955 TML_SoftKeySystemFailStatus "0x0:Normal / 0x1: System Fail / 0x2~0xE:Reserved / 0xF:Error Indicator";
CM_ SG_ 955 BLTN_CAM_HU_UI_Mode "Display control of Built-in Cam UI mode. This Signal for Ethernet Type Built-in Cam.";
CM_ SG_ 955 BLTN_CAM_Display "Display control of Built-in Cam UI mode. This Signal for CAN Type Built-in Cam.(with Standard 5th Wide AVNT)";
CM_ SG_ 955 BLTN_CAM_WiFi_State "BLTN_CAM WiFi Stattus";
CM_ SG_ 955 BLTN_CAM_SD_Format_Op_State "BLTN_CAM SD card format operation status.";
CM_ SG_ 955 BLTN_CAM_PEV_Recorded "This Signal is sent just after the park event recorded.";
CM_ SG_ 955 BLTN_CAM_PEV_Count "This Signal is count of park event record.";
CM_ SG_ 955 BLTN_CAM_Ind_Req "This Signal is for HU Display Built-in Cam Indicator.";
CM_ SG_ 955 BLTN_CAM_LVDS_Mode_State "This Signal is for LVDS output status";
CM_ SG_ 955 BLTN_CAM_PrkOp_Termiate_Info "0x0:Default/0x01: Park operation terminated earlier than user set because of Bat. SoC/0x2 : Park operation terminated earlier than user set because of SD Card Problem /0x3 : Park operation terminated earlier than user set because of Built-in Cam internal Error /0x04~0x6:Reserved/0x07 : Park operation terminate on time which user se";
CM_ SG_ 955 BLTN_CAM_DEV_Recorded "This Signal is sent just after the drive event recorded.";
CM_ BO_ 829 "[PE] Periodic and On Event";
CM_ SG_ 829 SBCM_RR_FD_Crc1Val "SBCM_RR_FD_CyclicRedundancyCheck1Value";
CM_ SG_ 829 SBCM_RR_FD_AlvCnt1Val "SBCM_RR_FD_AliveCounter1Value";
CM_ SG_ 829 RR_CrashUnlockCmd "Rear Right Crash Unlock Command";
CM_ SG_ 829 Warn_RrRtDrSwSta_SBCM "Warn_RearRightDoorSwitchStatus ##2G## -  - C_RRDrSw,CF_Gway_RRDrSw,Warn_RrRtDrSwSta";
CM_ SG_ 829 DoorLock_RrRtDrUnLkSta_SBCM "DoorLock_RearRightDoorUnLockStatus ##2G## -  - C_RRUnlockState,DoorLock_RrRtDrUnLkSta";
CM_ SG_ 829 RR_SEAActivated "Rear Right SEA Activated";
CM_ SG_ 829 RR_SEAWarn "Rear Righr SEA Warning";
CM_ BO_ 129 "[EC] On Event and On Change";
CM_ SG_ 129 HU_CNTL_Crc1Val "HU_CNTL_CyclicRedundancyCheck1Value";
CM_ SG_ 129 C_GlassCmdAVN "This signal indicates Sunroof Glass Open/Close Command";
CM_ SG_ 129 HU_CNTL_AlvCnt1Val "HU_CNTL_AliveCounter1Value";
CM_ SG_ 129 C_AstWindowCmdAVN "This signal indicates AST Window Open/Close Command";
CM_ SG_ 129 C_DrvWindowCmdAVN "This signal indicates DRV Window Open/Close Command";
CM_ SG_ 129 C_PTGCNTLCmdAVN "This signal indicates PowerTailgate Open/Close  Command";
CM_ SG_ 129 C_RrDefoggerCmdAVN "This signal indicates Rear Defogger Button Command";
CM_ SG_ 129 C_RRWindowCmdAVN "This signal indicates RR Window Open/Close Command";
CM_ SG_ 129 C_RLWindowCmdAVN "This signal indicates RL Window Open/Close Command";
CM_ SG_ 129 C_BlindCmdAVN "This signal indicates Sunroof Blind Open/Close Command";
CM_ BO_ 830 "[PE] Periodic and On Event";
CM_ SG_ 830 SBCM_RL_FD_Crc1Val "SBCM_RL_FD_CyclicRedundancyCheck1Value";
CM_ SG_ 830 SBCM_RL_FD_AlvCnt1Val "SBCM_RL_FD_AliveCounter1Value";
CM_ SG_ 830 RL_CrashUnlockCmd "Rear Lefr Crash Unlock Command";
CM_ SG_ 830 Warn_RrLftDrSwSta_SBCM "Warn_RearLeftDoorSwitchStatus ##2G## -  - C_RLDrSw,CF_Gway_RLDrSw,Warn_RrLftDrSwSta";
CM_ SG_ 830 DoorLock_RrLftDrUnLkSta_SBCM "DoorLock_RearLeftDoorUnLockStatus ##2G## -  - C_RLUnlockState,DoorLock_RrLftDrUnLkSta";
CM_ SG_ 830 RL_SEAActivated "RearLeftSEAActivated";
CM_ SG_ 830 RL_SEAWarn "Rear Left SEA Warning";
CM_ BO_ 676 "[PE] Periodic and On Event";
CM_ SG_ 676 HU_CLU_Crc3Val "HU_CLU_CyclicRedundancyCheck3Value";
CM_ SG_ 676 HD_SPS_ChannelNo "Information for SPS(Supplementary Program Service) Channel Number of HD Radio";
CM_ SG_ 676 HU_CLU_BlueLightSta "HU Bluelight state: On/Off";
CM_ SG_ 676 SXM_ChannelNo "Information for SXM Channel Number

Range : 0~999";
CM_ SG_ 676 HU_CLU_AlvCnt3Val "HU_CLU_AliveCounter3Value";
CM_ SG_ 676 LapTimer_CountStart "Lap Timer CountStart for H/unit";
BA_DEF_ BO_  "GenMsgEVName" STRING ;
BA_DEF_ BO_  "NmAsrMessage" ENUM  "No","Yes";
BA_DEF_ BO_  "DiagState" ENUM  "No","Yes";
BA_DEF_ BO_  "DiagRequest" ENUM  "No","Yes";
BA_DEF_ BO_  "TpMessage" ENUM  "No","Yes";
BA_DEF_ BO_  "UsrMsgIDSforwardDeviation" INT 0 100;
BA_DEF_ BO_  "UsrMsgIDSbackwardDeviation" INT 50 1000;
BA_DEF_ BO_  "GenMsgCycleTime" INT 0 2000;
BA_DEF_ BO_  "GenMsgStartDelayTime" INT 0 2000;
BA_DEF_ BO_  "GenMsgSendType" ENUM  "Cyclic","NoMsgSendType";
BA_DEF_ BO_  "GenMsgCycleTimeFast" INT 0 500;
BA_DEF_ BO_  "GenMsgDelayTime" INT 0 20;
BA_DEF_ BO_  "GenMsgILSupport" ENUM  "No","Yes";
BA_DEF_ BO_  "GenMsgNrOfRepetition" INT 0 3;
BA_DEF_ BO_  "VFrameFormat" ENUM  "StandardCAN","ExtendedCAN","reserved","reserved","reserved","reserved","reserved","reserved","reserved","reserved","reserved","reserved","reserved","reserved","StandardCAN_FD","ExtendedCAN_FD";
BA_DEF_ SG_  "UserSigValidity" ENUM  "B+","ACC","IG","IG1","IG2","IG3","IG1 or IG2","IG1 or IG3","Undef";
BA_DEF_ SG_  "TimeoutValue" STRING ;
BA_DEF_ SG_  "UsrSigPurpose" ENUM  "Undef","FN","DIAG","DIAG(Req)","DIAG(Res)","DIAG(Func)","DEV","CCP","NM","TP";
BA_DEF_ SG_  "GenSigStartValue" INT 0 1215752192;
BA_DEF_ SG_  "NetworkRequest" ENUM  "Yes","No";
BA_DEF_ SG_  "NetworkRequestHoldingTime" INT 0 65535;
BA_DEF_ SG_  "Description" STRING ;
BA_DEF_ SG_  "Version" STRING ;
BA_DEF_ SG_  "GenSigEnvVarType" ENUM  "Int","Float","Undef";
BA_DEF_ SG_  "GenSigSendType" ENUM  "Cyclic","OnWrite","OnWriteWithRepetition","OnChange","OnChangeWithRepetition","IfActive","IfActiveWithRepetition","NoSigSendType","OnChangeAndIfActive","OnChangeAndIfActiveWithRepetition";
BA_DEF_ SG_  "GwSigLatencyTime" INT 0 65536;
BA_DEF_ SG_  "GwSigMissingSourceType" ENUM  "Undef","OldValue","DefaultValue","InitialValue";
BA_DEF_ SG_  "NWM-WakeupAllowed" ENUM  "<n.a.>";
BA_DEF_ SG_  "RoutingFactor" INT 1 1215752192;
BA_DEF_ SG_  "SystemSignalLongSymbol" STRING ;
BA_DEF_REL_ BU_SG_REL_  "GenSigTimeoutTime" INT 0 7000;
BA_DEF_DEF_  "GenMsgEVName" "@Signame";
BA_DEF_DEF_  "NmAsrMessage" "No";
BA_DEF_DEF_  "DiagState" "No";
BA_DEF_DEF_  "DiagRequest" "No";
BA_DEF_DEF_  "TpMessage" "No";
BA_DEF_DEF_  "UsrMsgIDSforwardDeviation" 10;
BA_DEF_DEF_  "UsrMsgIDSbackwardDeviation" 100;
BA_DEF_DEF_  "GenMsgCycleTime" 200;
BA_DEF_DEF_  "GenMsgStartDelayTime" 0;
BA_DEF_DEF_  "GenMsgSendType" "NoMsgSendType";
BA_DEF_DEF_  "GenMsgCycleTimeFast" 40;
BA_DEF_DEF_  "GenMsgDelayTime" 20;
BA_DEF_DEF_  "GenMsgILSupport" "Yes";
BA_DEF_DEF_  "GenMsgNrOfRepetition" 3;
BA_DEF_DEF_  "VFrameFormat" "StandardCAN";
BA_DEF_DEF_  "UserSigValidity" "IG";
BA_DEF_DEF_  "TimeoutValue" "";
BA_DEF_DEF_  "UsrSigPurpose" "FN";
BA_DEF_DEF_  "GenSigStartValue" 0;
BA_DEF_DEF_  "NetworkRequest" "No";
BA_DEF_DEF_  "NetworkRequestHoldingTime" 0;
BA_DEF_DEF_  "Description" "";
BA_DEF_DEF_  "Version" "";
BA_DEF_DEF_  "GenSigEnvVarType" "Undef";
BA_DEF_DEF_  "GenSigSendType" "NoSigSendType";
BA_DEF_DEF_  "GwSigLatencyTime" 40;
BA_DEF_DEF_  "GwSigMissingSourceType" "Undef";
BA_DEF_DEF_  "NWM-WakeupAllowed" "<n.a.>";
BA_DEF_DEF_  "RoutingFactor" 1;
BA_DEF_DEF_REL_ "GenSigTimeoutTime" 500;
BA_DEF_DEF_  "SystemSignalLongSymbol" "";
BA_ "GenMsgSendType" BO_ 682 0;
BA_ "GenMsgCycleTimeFast" BO_ 682 0;
BA_ "GenMsgNrOfRepetition" BO_ 682 0;
BA_ "VFrameFormat" BO_ 682 14;
BA_ "GenMsgSendType" BO_ 1216 0;
BA_ "GenMsgCycleTime" BO_ 1216 2000;
BA_ "GenMsgStartDelayTime" BO_ 1216 70;
BA_ "VFrameFormat" BO_ 1216 14;
BA_ "GenMsgSendType" BO_ 955 0;
BA_ "VFrameFormat" BO_ 955 14;
BA_ "GenMsgSendType" BO_ 829 0;
BA_ "VFrameFormat" BO_ 829 14;
BA_ "GenMsgCycleTime" BO_ 129 0;
BA_ "VFrameFormat" BO_ 129 14;
BA_ "GenMsgSendType" BO_ 830 0;
BA_ "VFrameFormat" BO_ 830 14;
BA_ "GenMsgSendType" BO_ 676 0;
BA_ "GenMsgStartDelayTime" BO_ 676 40;
BA_ "VFrameFormat" BO_ 676 14;
BA_ "Description" SG_ 682 VCU_Crc4Val "The data area for CRC calculation is based on the data length (DLC) of the message DB.

The CRC shall be calculated over the entire data block (excluding the CRC bytes) including the user data, alive counter and Data ID

 

- CRC Polynomial (0x1021) , In";
BA_ "GenSigStartValue" SG_ 682 VCU_Crc4Val 65535;
BA_ "UserSigValidity" SG_ 682 VCU_Crc4Val 7;
BA_ "RoutingFactor" SG_ 682 VCU_Crc4Val 2;
BA_ "Version" SG_ 682 VCU_Crc4Val "20.07.05";
BA_ "Description" SG_ 682 VCU_SchedChgSet_OpModeSta "Scheduled Charge Mode";
BA_ "UserSigValidity" SG_ 682 VCU_SchedChgSet_OpModeSta 7;
BA_ "RoutingFactor" SG_ 682 VCU_SchedChgSet_OpModeSta 2;
BA_ "Version" SG_ 682 VCU_SchedChgSet_OpModeSta "19.03.03";
BA_ "Description" SG_ 682 VCU_SchedChg_EnIndSta "Actual State of Reservation Charge Setting with Revervation mode switch";
BA_ "UserSigValidity" SG_ 682 VCU_SchedChg_EnIndSta 7;
BA_ "RoutingFactor" SG_ 682 VCU_SchedChg_EnIndSta 2;
BA_ "Version" SG_ 682 VCU_SchedChg_EnIndSta "19.03.03";
BA_ "Description" SG_ 682 VCU_SchedChg_WaitIndSta "Reservation Charge Waiting mode for Charge Indicator";
BA_ "UserSigValidity" SG_ 682 VCU_SchedChg_WaitIndSta 7;
BA_ "RoutingFactor" SG_ 682 VCU_SchedChg_WaitIndSta 2;
BA_ "Version" SG_ 682 VCU_SchedChg_WaitIndSta "19.03.03";
BA_ "Description" SG_ 682 VCU_AcChgInhSta "Charge Inhibit";
BA_ "UserSigValidity" SG_ 682 VCU_AcChgInhSta 7;
BA_ "RoutingFactor" SG_ 682 VCU_AcChgInhSta 2;
BA_ "Version" SG_ 682 VCU_AcChgInhSta "19.03.03";
BA_ "Description" SG_ 682 VCU_ChgCancelReq "Immediately cancel charging control";
BA_ "UserSigValidity" SG_ 682 VCU_ChgCancelReq 7;
BA_ "RoutingFactor" SG_ 682 VCU_ChgCancelReq 2;
BA_ "Version" SG_ 682 VCU_ChgCancelReq "19.03.03";
BA_ "Description" SG_ 682 VCU_SchedRmtFcn_MainRlyOnReq "Main Relay On Request for Aux Battery Charging on IG-on";
BA_ "UserSigValidity" SG_ 682 VCU_SchedRmtFcn_MainRlyOnReq 7;
BA_ "RoutingFactor" SG_ 682 VCU_SchedRmtFcn_MainRlyOnReq 2;
BA_ "Version" SG_ 682 VCU_SchedRmtFcn_MainRlyOnReq "22.11.00";
BA_ "Description" SG_ 682 VCU_SchedRmtFcn_OpSta "Scheduled and Remote Function's operating status";
BA_ "UserSigValidity" SG_ 682 VCU_SchedRmtFcn_OpSta 7;
BA_ "RoutingFactor" SG_ 682 VCU_SchedRmtFcn_OpSta 2;
BA_ "Version" SG_ 682 VCU_SchedRmtFcn_OpSta "19.03.03";
BA_ "Description" SG_ 682 VCU_SchedClimateSet_EnSta "Enable of scheduled climate control";
BA_ "UserSigValidity" SG_ 682 VCU_SchedClimateSet_EnSta 7;
BA_ "RoutingFactor" SG_ 682 VCU_SchedClimateSet_EnSta 2;
BA_ "Version" SG_ 682 VCU_SchedClimateSet_EnSta "19.03.03";
BA_ "Description" SG_ 682 VCU_SchedClimateSet_TempVal "Set temperature of scheduled climate control";
BA_ "UserSigValidity" SG_ 682 VCU_SchedClimateSet_TempVal 7;
BA_ "RoutingFactor" SG_ 682 VCU_SchedClimateSet_TempVal 2;
BA_ "Version" SG_ 682 VCU_SchedClimateSet_TempVal "20.07.07";
BA_ "Description" SG_ 682 VCU_SchedClimateSet_DefrostEnSta "Defrost control of scheduled climate control";
BA_ "UserSigValidity" SG_ 682 VCU_SchedClimateSet_DefrostEnSta 7;
BA_ "RoutingFactor" SG_ 682 VCU_SchedClimateSet_DefrostEnSta 2;
BA_ "Version" SG_ 682 VCU_SchedClimateSet_DefrostEnSta "19.03.03";
BA_ "Description" SG_ 682 VCU_AirconCtrReq "Activation of air conditioner automatic control";
BA_ "UserSigValidity" SG_ 682 VCU_AirconCtrReq 7;
BA_ "RoutingFactor" SG_ 682 VCU_AirconCtrReq 2;
BA_ "Version" SG_ 682 VCU_AirconCtrReq "19.03.03";
BA_ "Description" SG_ 682 VCU_SchedRmtClimate_OpSta "Status of Airconditioner Control";
BA_ "UserSigValidity" SG_ 682 VCU_SchedRmtClimate_OpSta 7;
BA_ "RoutingFactor" SG_ 682 VCU_SchedRmtClimate_OpSta 2;
BA_ "Version" SG_ 682 VCU_SchedRmtClimate_OpSta "19.03.03";
BA_ "Description" SG_ 682 VCU_FatcDefrostCtrReq "Activation of air conditioner automatic control";
BA_ "UserSigValidity" SG_ 682 VCU_FatcDefrostCtrReq 7;
BA_ "RoutingFactor" SG_ 682 VCU_FatcDefrostCtrReq 2;
BA_ "Version" SG_ 682 VCU_FatcDefrostCtrReq "19.03.03";
BA_ "Description" SG_ 682 VCU_AuxBattChgVehCondi "Aux Battery Charge Vehicle Condition";
BA_ "UserSigValidity" SG_ 682 VCU_AuxBattChgVehCondi 7;
BA_ "RoutingFactor" SG_ 682 VCU_AuxBattChgVehCondi 2;
BA_ "Version" SG_ 682 VCU_AuxBattChgVehCondi "20.03.05";
BA_ "Description" SG_ 682 VCU_BattCondHeatReq "Battery heater operation for battery conditioning";
BA_ "UserSigValidity" SG_ 682 VCU_BattCondHeatReq 7;
BA_ "RoutingFactor" SG_ 682 VCU_BattCondHeatReq 2;
BA_ "Version" SG_ 682 VCU_BattCondHeatReq "21.04.07";
BA_ "Description" SG_ 682 VCU_BattCondIndSta "State for battery conditioning indicator";
BA_ "UserSigValidity" SG_ 682 VCU_BattCondIndSta 7;
BA_ "RoutingFactor" SG_ 682 VCU_BattCondIndSta 2;
BA_ "Version" SG_ 682 VCU_BattCondIndSta "23.02.02";
BA_ "Description" SG_ 682 VCU_SchedClimate_EnIndSta "Actual State of Reservation Airconditioner Control Setting with Revervation mode switch";
BA_ "UserSigValidity" SG_ 682 VCU_SchedClimate_EnIndSta 7;
BA_ "RoutingFactor" SG_ 682 VCU_SchedClimate_EnIndSta 2;
BA_ "Version" SG_ 682 VCU_SchedClimate_EnIndSta "19.03.03";
BA_ "Description" SG_ 682 VCU_GpsSched_OpSta "Status of GPS based Schedule Function";
BA_ "UserSigValidity" SG_ 682 VCU_GpsSched_OpSta 7;
BA_ "RoutingFactor" SG_ 682 VCU_GpsSched_OpSta 2;
BA_ "Version" SG_ 682 VCU_GpsSched_OpSta "19.03.03";
BA_ "Description" SG_ 682 VCU_GpsSched_ChgClimateEnSta "Charge & HVAC Enable through GPS";
BA_ "UserSigValidity" SG_ 682 VCU_GpsSched_ChgClimateEnSta 7;
BA_ "RoutingFactor" SG_ 682 VCU_GpsSched_ChgClimateEnSta 2;
BA_ "Version" SG_ 682 VCU_GpsSched_ChgClimateEnSta "19.03.03";
BA_ "Description" SG_ 682 VCU_GpsSched_UpdateReq "Location update request for GPS-based Scheduled functions (charge, climate, etc)";
BA_ "UserSigValidity" SG_ 682 VCU_GpsSched_UpdateReq 7;
BA_ "RoutingFactor" SG_ 682 VCU_GpsSched_UpdateReq 2;
BA_ "Version" SG_ 682 VCU_GpsSched_UpdateReq "19.03.03";
BA_ "Description" SG_ 682 VCU_ChgCycSta "Charge Cycle";
BA_ "UserSigValidity" SG_ 682 VCU_ChgCycSta 7;
BA_ "RoutingFactor" SG_ 682 VCU_ChgCycSta 2;
BA_ "Version" SG_ 682 VCU_ChgCycSta "19.03.03";
BA_ "Description" SG_ 682 VCU_AvnWakeupReq "Wake-up signal for AVN by CGW";
BA_ "UserSigValidity" SG_ 682 VCU_AvnWakeupReq 7;
BA_ "RoutingFactor" SG_ 682 VCU_AvnWakeupReq 2;
BA_ "Version" SG_ 682 VCU_AvnWakeupReq "19.03.03";
BA_ "Description" SG_ 682 VCU_SchedRmtFcn_FailCfmSta "Confirmed Prog/imme chage/air conditioning failure report";
BA_ "UserSigValidity" SG_ 682 VCU_SchedRmtFcn_FailCfmSta 7;
BA_ "RoutingFactor" SG_ 682 VCU_SchedRmtFcn_FailCfmSta 2;
BA_ "Version" SG_ 682 VCU_SchedRmtFcn_FailCfmSta "19.03.03";
BA_ "Description" SG_ 682 VCU_AirconFinishAlmSta "Air Conditioning Finish Before 5min";
BA_ "UserSigValidity" SG_ 682 VCU_AirconFinishAlmSta 7;
BA_ "RoutingFactor" SG_ 682 VCU_AirconFinishAlmSta 2;
BA_ "Version" SG_ 682 VCU_AirconFinishAlmSta "19.03.03";
BA_ "Description" SG_ 682 VCU_SchedClimateSet_TempUnitTyp "Temperature Unit of Scheduled Climate Control";
BA_ "UserSigValidity" SG_ 682 VCU_SchedClimateSet_TempUnitTyp 7;
BA_ "RoutingFactor" SG_ 682 VCU_SchedClimateSet_TempUnitTyp 2;
BA_ "Version" SG_ 682 VCU_SchedClimateSet_TempUnitTyp "19.08.08";
BA_ "Description" SG_ 682 VCU_AlvCnt4Val "For the first transmission request for a data element the counter shall be initialized with 0 and shall be incremented by 1 for every subsequent send request. 

When the counter reaches the maximum value(0xFF), then it shall restart with 0 for the next s";
BA_ "UserSigValidity" SG_ 682 VCU_AlvCnt4Val 7;
BA_ "RoutingFactor" SG_ 682 VCU_AlvCnt4Val 2;
BA_ "Version" SG_ 682 VCU_AlvCnt4Val "20.07.05";
BA_ "Description" SG_ 682 VCU_SchedChg_StDayDispSta "Start Day of Scheduled time (0~6)";
BA_ "GenSigStartValue" SG_ 682 VCU_SchedChg_StDayDispSta 7;
BA_ "UserSigValidity" SG_ 682 VCU_SchedChg_StDayDispSta 7;
BA_ "RoutingFactor" SG_ 682 VCU_SchedChg_StDayDispSta 2;
BA_ "Version" SG_ 682 VCU_SchedChg_StDayDispSta "20.03.00";
BA_ "Description" SG_ 682 VCU_SchedChg_StHrDispVal "Start Hour of Scheduled time (0~23)";
BA_ "GenSigStartValue" SG_ 682 VCU_SchedChg_StHrDispVal 31;
BA_ "UserSigValidity" SG_ 682 VCU_SchedChg_StHrDispVal 7;
BA_ "RoutingFactor" SG_ 682 VCU_SchedChg_StHrDispVal 2;
BA_ "Version" SG_ 682 VCU_SchedChg_StHrDispVal "20.03.00";
BA_ "Description" SG_ 682 VCU_SchedChg_StMinDispVal "Start Min of Scheduled time (0~59)";
BA_ "GenSigStartValue" SG_ 682 VCU_SchedChg_StMinDispVal 63;
BA_ "UserSigValidity" SG_ 682 VCU_SchedChg_StMinDispVal 7;
BA_ "RoutingFactor" SG_ 682 VCU_SchedChg_StMinDispVal 2;
BA_ "Version" SG_ 682 VCU_SchedChg_StMinDispVal "20.03.00";
BA_ "Description" SG_ 682 VCU_SchedChg_EndDayDispSta "End Day of Scheduled time (0~6)";
BA_ "GenSigStartValue" SG_ 682 VCU_SchedChg_EndDayDispSta 7;
BA_ "UserSigValidity" SG_ 682 VCU_SchedChg_EndDayDispSta 7;
BA_ "RoutingFactor" SG_ 682 VCU_SchedChg_EndDayDispSta 2;
BA_ "Version" SG_ 682 VCU_SchedChg_EndDayDispSta "20.03.00";
BA_ "Description" SG_ 682 VCU_SchedChg_EndHrDispVal "End Hour of Scheduled time (0~23)";
BA_ "GenSigStartValue" SG_ 682 VCU_SchedChg_EndHrDispVal 31;
BA_ "UserSigValidity" SG_ 682 VCU_SchedChg_EndHrDispVal 7;
BA_ "RoutingFactor" SG_ 682 VCU_SchedChg_EndHrDispVal 2;
BA_ "Version" SG_ 682 VCU_SchedChg_EndHrDispVal "20.03.00";
BA_ "Description" SG_ 682 VCU_SchedChg_EndMinDispVal "End Min of Scheduled time (0~59)";
BA_ "GenSigStartValue" SG_ 682 VCU_SchedChg_EndMinDispVal 63;
BA_ "UserSigValidity" SG_ 682 VCU_SchedChg_EndMinDispVal 7;
BA_ "RoutingFactor" SG_ 682 VCU_SchedChg_EndMinDispVal 2;
BA_ "Version" SG_ 682 VCU_SchedChg_EndMinDispVal "20.08.07";
BA_ "Description" SG_ 682 VCU_AuxBattSavUsmSta "USM status of Periodic Aux. Battery charge function";
BA_ "GenSigStartValue" SG_ 682 VCU_AuxBattSavUsmSta 2;
BA_ "UserSigValidity" SG_ 682 VCU_AuxBattSavUsmSta 7;
BA_ "RoutingFactor" SG_ 682 VCU_AuxBattSavUsmSta 2;
BA_ "Version" SG_ 682 VCU_AuxBattSavUsmSta "19.03.03";
BA_ "Description" SG_ 682 VCU_AuxBattSavWakeupSta "Wake-up by Periodic Aux Batt Charge function";
BA_ "UserSigValidity" SG_ 682 VCU_AuxBattSavWakeupSta 7;
BA_ "RoutingFactor" SG_ 682 VCU_AuxBattSavWakeupSta 2;
BA_ "Version" SG_ 682 VCU_AuxBattSavWakeupSta "19.03.03";
BA_ "Description" SG_ 682 VCU_RsChgSeqSta "Remote & Schedule Function: Chg Sequence";
BA_ "UserSigValidity" SG_ 682 VCU_RsChgSeqSta 7;
BA_ "RoutingFactor" SG_ 682 VCU_RsChgSeqSta 2;
BA_ "Version" SG_ 682 VCU_RsChgSeqSta "19.03.03";
BA_ "Description" SG_ 682 VCU_NCstmLaunchCtrlGripLvlMxVal "Launch Control Grip Level Max Value(for High Performance vehicle USM)";
BA_ "UserSigValidity" SG_ 682 VCU_NCstmLaunchCtrlGripLvlMxVal 7;
BA_ "RoutingFactor" SG_ 682 VCU_NCstmLaunchCtrlGripLvlMxVal 2;
BA_ "Version" SG_ 682 VCU_NCstmLaunchCtrlGripLvlMxVal "22.01.06";
BA_ "Description" SG_ 682 VCU_RsAirconSeqSta "Remote & Schedule Function: Aircon Sequence";
BA_ "UserSigValidity" SG_ 682 VCU_RsAirconSeqSta 7;
BA_ "RoutingFactor" SG_ 682 VCU_RsAirconSeqSta 2;
BA_ "Version" SG_ 682 VCU_RsAirconSeqSta "19.03.03";
BA_ "Description" SG_ 682 VCU_ChargeInfo "Charging State Information";
BA_ "UserSigValidity" SG_ 682 VCU_ChargeInfo 7;
BA_ "RoutingFactor" SG_ 682 VCU_ChargeInfo 2;
BA_ "Version" SG_ 682 VCU_ChargeInfo "20.01.01";
BA_ "Description" SG_ 682 VCU_RsRtcSchedDayVal "Remote & Schedule Function: Rtc Wakeup Day";
BA_ "GenSigStartValue" SG_ 682 VCU_RsRtcSchedDayVal 7;
BA_ "UserSigValidity" SG_ 682 VCU_RsRtcSchedDayVal 7;
BA_ "RoutingFactor" SG_ 682 VCU_RsRtcSchedDayVal 2;
BA_ "Version" SG_ 682 VCU_RsRtcSchedDayVal "20.03.00";
BA_ "Description" SG_ 682 VCU_RsRtcSchedHrVal "Remote & Schedule Function: Rtc Wakeup Hour";
BA_ "GenSigStartValue" SG_ 682 VCU_RsRtcSchedHrVal 31;
BA_ "UserSigValidity" SG_ 682 VCU_RsRtcSchedHrVal 7;
BA_ "RoutingFactor" SG_ 682 VCU_RsRtcSchedHrVal 2;
BA_ "Version" SG_ 682 VCU_RsRtcSchedHrVal "20.03.00";
BA_ "Description" SG_ 682 VCU_RsRtcSchedMinVal "Remote & Schedule Function: Rtc Wakeup Min";
BA_ "GenSigStartValue" SG_ 682 VCU_RsRtcSchedMinVal 63;
BA_ "UserSigValidity" SG_ 682 VCU_RsRtcSchedMinVal 7;
BA_ "RoutingFactor" SG_ 682 VCU_RsRtcSchedMinVal 2;
BA_ "Version" SG_ 682 VCU_RsRtcSchedMinVal "20.03.00";
BA_ "Description" SG_ 682 VCU_Ig3DrvSta "IG3 Drive status of VCU";
BA_ "UserSigValidity" SG_ 682 VCU_Ig3DrvSta 7;
BA_ "RoutingFactor" SG_ 682 VCU_Ig3DrvSta 2;
BA_ "Version" SG_ 682 VCU_Ig3DrvSta "19.03.03";
BA_ "Description" SG_ 682 VCU_UtilModeUsmSta "USM Status of Rest Mode function";
BA_ "UserSigValidity" SG_ 682 VCU_UtilModeUsmSta 7;
BA_ "RoutingFactor" SG_ 682 VCU_UtilModeUsmSta 2;
BA_ "Version" SG_ 682 VCU_UtilModeUsmSta "19.03.03";
BA_ "Description" SG_ 682 VCU_UtilModeActSta "Utility Mode Activation Status";
BA_ "UserSigValidity" SG_ 682 VCU_UtilModeActSta 7;
BA_ "RoutingFactor" SG_ 682 VCU_UtilModeActSta 2;
BA_ "Version" SG_ 682 VCU_UtilModeActSta "19.03.03";
BA_ "Description" SG_ 682 VCU_UtilModeWarnMsgSta "Rest Mode warning message";
BA_ "UserSigValidity" SG_ 682 VCU_UtilModeWarnMsgSta 7;
BA_ "RoutingFactor" SG_ 682 VCU_UtilModeWarnMsgSta 2;
BA_ "Version" SG_ 682 VCU_UtilModeWarnMsgSta "19.03.03";
BA_ "Description" SG_ 682 VCU_Ig3OnlySta "Status of IG3 Relay Only";
BA_ "UserSigValidity" SG_ 682 VCU_Ig3OnlySta 7;
BA_ "RoutingFactor" SG_ 682 VCU_Ig3OnlySta 2;
BA_ "Version" SG_ 682 VCU_Ig3OnlySta "19.03.03";
BA_ "Description" SG_ 682 VCU_BattCondApply "Battery conditioning apply";
BA_ "UserSigValidity" SG_ 682 VCU_BattCondApply 7;
BA_ "RoutingFactor" SG_ 682 VCU_BattCondApply 2;
BA_ "Version" SG_ 682 VCU_BattCondApply "22.07.04";
BA_ "Description" SG_ 682 VCU_NCstmLaunchCtrlGripLvlVal "Launch Control Grip Level(for High Performance vehicle USM)";
BA_ "UserSigValidity" SG_ 682 VCU_NCstmLaunchCtrlGripLvlVal 7;
BA_ "RoutingFactor" SG_ 682 VCU_NCstmLaunchCtrlGripLvlVal 2;
BA_ "Version" SG_ 682 VCU_NCstmLaunchCtrlGripLvlVal "22.01.06";
BA_ "Description" SG_ 682 VCU_VgsShfIndledSta "This signal indicates that an VCU requests cluster to turn on/off shift indicator LED.";
BA_ "UserSigValidity" SG_ 682 VCU_VgsShfIndledSta 7;
BA_ "RoutingFactor" SG_ 682 VCU_VgsShfIndledSta 2;
BA_ "Version" SG_ 682 VCU_VgsShfIndledSta "22.01.03";
BA_ "Description" SG_ 682 VCU_DepartSet1_HrVal "Hour of Departure Set1";
BA_ "UserSigValidity" SG_ 682 VCU_DepartSet1_HrVal 7;
BA_ "RoutingFactor" SG_ 682 VCU_DepartSet1_HrVal 2;
BA_ "Version" SG_ 682 VCU_DepartSet1_HrVal "20.03.00";
BA_ "Description" SG_ 682 VCU_MainRlyVehCondi "Availability of main relay control in terms of vehicle";
BA_ "TimeoutValue" SG_ 682 VCU_MainRlyVehCondi "0";
BA_ "UserSigValidity" SG_ 682 VCU_MainRlyVehCondi 7;
BA_ "RoutingFactor" SG_ 682 VCU_MainRlyVehCondi 2;
BA_ "Version" SG_ 682 VCU_MainRlyVehCondi "23.04.02";
BA_ "Description" SG_ 682 VCU_NCstmNdurRaceSta "Ndurance Race Status(for High Performance vehicle USM)";
BA_ "UserSigValidity" SG_ 682 VCU_NCstmNdurRaceSta 7;
BA_ "RoutingFactor" SG_ 682 VCU_NCstmNdurRaceSta 2;
BA_ "Version" SG_ 682 VCU_NCstmNdurRaceSta "23.02.02";
BA_ "Description" SG_ 682 VCU_NCstmDriftDfctvSta "Drift defective Status(for High Performance vehicle USM)";
BA_ "UserSigValidity" SG_ 682 VCU_NCstmDriftDfctvSta 7;
BA_ "RoutingFactor" SG_ 682 VCU_NCstmDriftDfctvSta 2;
BA_ "Version" SG_ 682 VCU_NCstmDriftDfctvSta "22.01.01";
BA_ "Description" SG_ 682 VCU_NCstmNpdlLvlVal "N pedal Level(for High Performance vehicle USM)";
BA_ "UserSigValidity" SG_ 682 VCU_NCstmNpdlLvlVal 7;
BA_ "RoutingFactor" SG_ 682 VCU_NCstmNpdlLvlVal 2;
BA_ "Version" SG_ 682 VCU_NCstmNpdlLvlVal "23.02.02";
BA_ "Description" SG_ 682 VCU_NCstmEKDUsmSta "Elctro kick dift state(for High Performance vehicle USM)";
BA_ "UserSigValidity" SG_ 682 VCU_NCstmEKDUsmSta 7;
BA_ "RoutingFactor" SG_ 682 VCU_NCstmEKDUsmSta 2;
BA_ "Version" SG_ 682 VCU_NCstmEKDUsmSta "22.01.01";
BA_ "Description" SG_ 682 VCU_NCstmLaunchCtrlSta "Launch Control State Information(for High Performance vehicle USM)";
BA_ "UserSigValidity" SG_ 682 VCU_NCstmLaunchCtrlSta 7;
BA_ "RoutingFactor" SG_ 682 VCU_NCstmLaunchCtrlSta 2;
BA_ "Version" SG_ 682 VCU_NCstmLaunchCtrlSta "22.01.01";
BA_ "Description" SG_ 682 VCU_DepartSet1_MinVal "Min of Departure Set1";
BA_ "UserSigValidity" SG_ 682 VCU_DepartSet1_MinVal 7;
BA_ "RoutingFactor" SG_ 682 VCU_DepartSet1_MinVal 2;
BA_ "Version" SG_ 682 VCU_DepartSet1_MinVal "20.03.00";
BA_ "Description" SG_ 682 VCU_DepartSet2_HrVal "Hour of Departure Set2";
BA_ "UserSigValidity" SG_ 682 VCU_DepartSet2_HrVal 7;
BA_ "RoutingFactor" SG_ 682 VCU_DepartSet2_HrVal 2;
BA_ "Version" SG_ 682 VCU_DepartSet2_HrVal "20.03.00";
BA_ "Description" SG_ 682 VCU_DepartSet2_MinVal "Min of Departure Set2";
BA_ "UserSigValidity" SG_ 682 VCU_DepartSet2_MinVal 7;
BA_ "RoutingFactor" SG_ 682 VCU_DepartSet2_MinVal 2;
BA_ "Version" SG_ 682 VCU_DepartSet2_MinVal "20.03.00";
BA_ "Description" SG_ 682 VCU_DepartSet1_Mon "Monday Enable of Departure Set1";
BA_ "UserSigValidity" SG_ 682 VCU_DepartSet1_Mon 7;
BA_ "RoutingFactor" SG_ 682 VCU_DepartSet1_Mon 2;
BA_ "Version" SG_ 682 VCU_DepartSet1_Mon "19.09.06";
BA_ "Description" SG_ 682 VCU_DepartSet1_Tue "Tuesday Enable of Departure Set1";
BA_ "UserSigValidity" SG_ 682 VCU_DepartSet1_Tue 7;
BA_ "RoutingFactor" SG_ 682 VCU_DepartSet1_Tue 2;
BA_ "Version" SG_ 682 VCU_DepartSet1_Tue "19.09.06";
BA_ "Description" SG_ 682 VCU_DepartSet1_Wed "Wednesday Enable of Departure Set1";
BA_ "UserSigValidity" SG_ 682 VCU_DepartSet1_Wed 7;
BA_ "RoutingFactor" SG_ 682 VCU_DepartSet1_Wed 2;
BA_ "Version" SG_ 682 VCU_DepartSet1_Wed "19.09.06";
BA_ "Description" SG_ 682 VCU_DepartSet1_Thu "Thursday Enable of Departure Set1";
BA_ "UserSigValidity" SG_ 682 VCU_DepartSet1_Thu 7;
BA_ "RoutingFactor" SG_ 682 VCU_DepartSet1_Thu 2;
BA_ "Version" SG_ 682 VCU_DepartSet1_Thu "19.09.06";
BA_ "Description" SG_ 682 VCU_DepartSet1_EnSta "Enable Status of Departure Set1";
BA_ "UserSigValidity" SG_ 682 VCU_DepartSet1_EnSta 7;
BA_ "RoutingFactor" SG_ 682 VCU_DepartSet1_EnSta 2;
BA_ "Version" SG_ 682 VCU_DepartSet1_EnSta "19.03.03";
BA_ "Description" SG_ 682 VCU_DepartSet1_Fri "Friday Enable of Departure Set1";
BA_ "UserSigValidity" SG_ 682 VCU_DepartSet1_Fri 7;
BA_ "RoutingFactor" SG_ 682 VCU_DepartSet1_Fri 2;
BA_ "Version" SG_ 682 VCU_DepartSet1_Fri "19.09.06";
BA_ "Description" SG_ 682 VCU_DepartSet1_Sat "Saturday Enable of Departure Set1";
BA_ "UserSigValidity" SG_ 682 VCU_DepartSet1_Sat 7;
BA_ "RoutingFactor" SG_ 682 VCU_DepartSet1_Sat 2;
BA_ "Version" SG_ 682 VCU_DepartSet1_Sat "19.09.06";
BA_ "Description" SG_ 682 VCU_DepartSet1_Sun "Sunday Enable of Departure Set1";
BA_ "UserSigValidity" SG_ 682 VCU_DepartSet1_Sun 7;
BA_ "RoutingFactor" SG_ 682 VCU_DepartSet1_Sun 2;
BA_ "Version" SG_ 682 VCU_DepartSet1_Sun "19.09.06";
BA_ "Description" SG_ 682 VCU_DepartSet2_Mon "Monday Enable of Departure Set2";
BA_ "UserSigValidity" SG_ 682 VCU_DepartSet2_Mon 7;
BA_ "RoutingFactor" SG_ 682 VCU_DepartSet2_Mon 2;
BA_ "Version" SG_ 682 VCU_DepartSet2_Mon "19.09.06";
BA_ "Description" SG_ 682 VCU_DepartSet2_Tue "Tuesday Enable of Departure Set2";
BA_ "UserSigValidity" SG_ 682 VCU_DepartSet2_Tue 7;
BA_ "RoutingFactor" SG_ 682 VCU_DepartSet2_Tue 2;
BA_ "Version" SG_ 682 VCU_DepartSet2_Tue "19.09.06";
BA_ "Description" SG_ 682 VCU_DepartSet2_Wed "Wednesday Enable of Departure Set2";
BA_ "UserSigValidity" SG_ 682 VCU_DepartSet2_Wed 7;
BA_ "RoutingFactor" SG_ 682 VCU_DepartSet2_Wed 2;
BA_ "Version" SG_ 682 VCU_DepartSet2_Wed "19.09.06";
BA_ "Description" SG_ 682 VCU_DepartSet2_Thu "Thursday Enable of Departure Set2";
BA_ "UserSigValidity" SG_ 682 VCU_DepartSet2_Thu 7;
BA_ "RoutingFactor" SG_ 682 VCU_DepartSet2_Thu 2;
BA_ "Version" SG_ 682 VCU_DepartSet2_Thu "19.09.06";
BA_ "Description" SG_ 682 VCU_DepartSet2_EnSta "Enable Status of Departure Set2";
BA_ "UserSigValidity" SG_ 682 VCU_DepartSet2_EnSta 7;
BA_ "RoutingFactor" SG_ 682 VCU_DepartSet2_EnSta 2;
BA_ "Version" SG_ 682 VCU_DepartSet2_EnSta "19.03.03";
BA_ "Description" SG_ 682 VCU_DepartSet2_Fri "Friday Enable of Departure Set2";
BA_ "UserSigValidity" SG_ 682 VCU_DepartSet2_Fri 7;
BA_ "RoutingFactor" SG_ 682 VCU_DepartSet2_Fri 2;
BA_ "Version" SG_ 682 VCU_DepartSet2_Fri "19.09.06";
BA_ "Description" SG_ 682 VCU_DepartSet2_Sat "Saturday Enable of Departure Set2";
BA_ "UserSigValidity" SG_ 682 VCU_DepartSet2_Sat 7;
BA_ "RoutingFactor" SG_ 682 VCU_DepartSet2_Sat 2;
BA_ "Version" SG_ 682 VCU_DepartSet2_Sat "19.09.06";
BA_ "Description" SG_ 682 VCU_DepartSet2_Sun "Sunday Enable of Departure Set2";
BA_ "UserSigValidity" SG_ 682 VCU_DepartSet2_Sun 7;
BA_ "RoutingFactor" SG_ 682 VCU_DepartSet2_Sun 2;
BA_ "Version" SG_ 682 VCU_DepartSet2_Sun "19.09.06";
BA_ "Description" SG_ 682 VCU_OffPeakTimeStHrVal "Start Hour of Off-Peak Time";
BA_ "UserSigValidity" SG_ 682 VCU_OffPeakTimeStHrVal 7;
BA_ "RoutingFactor" SG_ 682 VCU_OffPeakTimeStHrVal 2;
BA_ "Version" SG_ 682 VCU_OffPeakTimeStHrVal "20.03.00";
BA_ "Description" SG_ 682 VCU_OffPeakTimeStMinVal "Start Min of Off-Peak Time";
BA_ "UserSigValidity" SG_ 682 VCU_OffPeakTimeStMinVal 7;
BA_ "RoutingFactor" SG_ 682 VCU_OffPeakTimeStMinVal 2;
BA_ "Version" SG_ 682 VCU_OffPeakTimeStMinVal "20.03.00";
BA_ "Description" SG_ 682 VCU_OffPeakTimeEndHrVal "End Hour of Off-Peak Time";
BA_ "UserSigValidity" SG_ 682 VCU_OffPeakTimeEndHrVal 7;
BA_ "RoutingFactor" SG_ 682 VCU_OffPeakTimeEndHrVal 2;
BA_ "Version" SG_ 682 VCU_OffPeakTimeEndHrVal "20.03.00";
BA_ "Description" SG_ 682 VCU_OffPeakTimeEndMinVal "End Min of Off-Peak Time";
BA_ "UserSigValidity" SG_ 682 VCU_OffPeakTimeEndMinVal 7;
BA_ "RoutingFactor" SG_ 682 VCU_OffPeakTimeEndMinVal 2;
BA_ "Version" SG_ 682 VCU_OffPeakTimeEndMinVal "20.03.00";
BA_ "Description" SG_ 682 VCU_BattCondActStaDisp "Battery heater operation information for display";
BA_ "UserSigValidity" SG_ 682 VCU_BattCondActStaDisp 7;
BA_ "RoutingFactor" SG_ 682 VCU_BattCondActStaDisp 2;
BA_ "Version" SG_ 682 VCU_BattCondActStaDisp "21.04.07";
BA_ "Description" SG_ 682 VCU_BattCondUsmSta "Usm status for battery conditioning 2nd generation";
BA_ "UserSigValidity" SG_ 682 VCU_BattCondUsmSta 7;
BA_ "RoutingFactor" SG_ 682 VCU_BattCondUsmSta 2;
BA_ "Version" SG_ 682 VCU_BattCondUsmSta "21.11.04";
BA_ "Description" SG_ 682 VCU_FatcTempSetUnit "DATC temperature unit";
BA_ "UserSigValidity" SG_ 682 VCU_FatcTempSetUnit 7;
BA_ "RoutingFactor" SG_ 682 VCU_FatcTempSetUnit 2;
BA_ "Version" SG_ 682 VCU_FatcTempSetUnit "20.07.07";
BA_ "Description" SG_ 682 VCU_FatcTempSetVal "Temperature of air conditioner automatic control";
BA_ "UserSigValidity" SG_ 682 VCU_FatcTempSetVal 7;
BA_ "RoutingFactor" SG_ 682 VCU_FatcTempSetVal 2;
BA_ "Version" SG_ 682 VCU_FatcTempSetVal "20.07.07";
BA_ "Description" SG_ 1216 HU_MON_Crc1Val "The data area for CRC calculation is based on the data length (DLC) of the message DB.

The CRC shall be calculated over the entire data block (excluding the CRC bytes) including the user data, alive counter and Data ID



- CRC Polynomial (0x1021) , Ini";
BA_ "GenSigSendType" SG_ 1216 HU_MON_Crc1Val 4;
BA_ "GenSigStartValue" SG_ 1216 HU_MON_Crc1Val 65535;
BA_ "UserSigValidity" SG_ 1216 HU_MON_Crc1Val 3;
BA_ "Version" SG_ 1216 HU_MON_Crc1Val "22.10.20";
BA_ "Description" SG_ 1216 HU_NaviHandshakingSupport "This is a signal to send whether handshaking logic is applied related to Navigation's 'Map based ADAS' specification";
BA_ "GenSigSendType" SG_ 1216 HU_NaviHandshakingSupport 4;
BA_ "UserSigValidity" SG_ 1216 HU_NaviHandshakingSupport 1;
BA_ "Version" SG_ 1216 HU_NaviHandshakingSupport "20.05.02";
BA_ "GenSigSendType" SG_ 1216 HU_AMP_EQVariant 4;
BA_ "GenSigStartValue" SG_ 1216 HU_AMP_EQVariant 31;
BA_ "UserSigValidity" SG_ 1216 HU_AMP_EQVariant 1;
BA_ "Version" SG_ 1216 HU_AMP_EQVariant "20.08.06";
BA_ "Description" SG_ 1216 HU_AdasSupport "0x0 : Not Support

0x1 : ADAS Support (General Map) - Send map information based on General Map

0x2 : ADAS Support (Map based ADAS v1) - Send map information based on Map based ADAS v1 or v1.5

0x3 : ADAS Support (Map based ADAS v2) - Send map informati";
BA_ "GenSigSendType" SG_ 1216 HU_AdasSupport 4;
BA_ "GenSigStartValue" SG_ 1216 HU_AdasSupport 7;
BA_ "UserSigValidity" SG_ 1216 HU_AdasSupport 1;
BA_ "NetworkRequest" SG_ 1216 HU_AdasSupport 0;
BA_ "NetworkRequestHoldingTime" SG_ 1216 HU_AdasSupport 5000;
BA_ "Version" SG_ 1216 HU_AdasSupport "20.05.02";
BA_ "Description" SG_ 1216 HU_MON_AlvCnt1Val "For the first transmission request for a data element the counter shall be initialized with 0 and shall be incremented by 1 for every subsequent send request. 

When the counter reaches the maximum value(0xFF), then it shall restart with 0 for the next s";
BA_ "GenSigSendType" SG_ 1216 HU_MON_AlvCnt1Val 4;
BA_ "UserSigValidity" SG_ 1216 HU_MON_AlvCnt1Val 3;
BA_ "Version" SG_ 1216 HU_MON_AlvCnt1Val "22.10.20";
BA_ "GenSigSendType" SG_ 1216 HU_Type 4;
BA_ "GenSigStartValue" SG_ 1216 HU_Type 255;
BA_ "UserSigValidity" SG_ 1216 HU_Type 1;
BA_ "NetworkRequest" SG_ 1216 HU_Type 0;
BA_ "NetworkRequestHoldingTime" SG_ 1216 HU_Type 7000;
BA_ "Version" SG_ 1216 HU_Type "23.12.00";
BA_ "Description" SG_ 1216 HU_Navi_RspADASMapMsg "This signal indicates an ADAS map message response from H_U to ECU 

which is stored the  required Map based ADAS messages for each ECU



Each bit indicates the request messages as follows.

(1: Sending message / 0 : Doens't sending message)

- Bit 0 : ";
BA_ "GenSigSendType" SG_ 1216 HU_Navi_RspADASMapMsg 4;
BA_ "UserSigValidity" SG_ 1216 HU_Navi_RspADASMapMsg 3;
BA_ "Version" SG_ 1216 HU_Navi_RspADASMapMsg "21.11.04";
BA_ "GenSigSendType" SG_ 1216 HU_DistributeInfo 4;
BA_ "GenSigStartValue" SG_ 1216 HU_DistributeInfo 255;
BA_ "UserSigValidity" SG_ 1216 HU_DistributeInfo 1;
BA_ "NetworkRequest" SG_ 1216 HU_DistributeInfo 0;
BA_ "NetworkRequestHoldingTime" SG_ 1216 HU_DistributeInfo 7000;
BA_ "Version" SG_ 1216 HU_DistributeInfo "20.09.00";
BA_ "Description" SG_ 1216 HU_OptionInfo "Bit0 : Navi (0: Not Support / 1: Support)

Bit1 : USM (0: Not Support / 1: Support)

Bit2 : TMS (0: Not Support / 1: Support)

Bit3 : Multi Profile (0: Not Support(No Profile or Single Profile)  / 1: Support)

Bit4 : Camera Guideline (0: Displayed by Cam";
BA_ "GenSigSendType" SG_ 1216 HU_OptionInfo 4;
BA_ "GenSigStartValue" SG_ 1216 HU_OptionInfo 32768;
BA_ "UserSigValidity" SG_ 1216 HU_OptionInfo 0;
BA_ "Version" SG_ 1216 HU_OptionInfo "25.04.00";
BA_ "Description" SG_ 955 BLTN_CAM_FD_HU_Crc1Val "The data area for CRC calculation is based on the data length (DLC) of the message DB.

The CRC shall be calculated over the entire data block (excluding the CRC bytes) including the user data, alive counter and Data ID



- CRC Polynomial (0x1021) , Ini";
BA_ "GenSigSendType" SG_ 955 BLTN_CAM_FD_HU_Crc1Val 4;
BA_ "GenSigStartValue" SG_ 955 BLTN_CAM_FD_HU_Crc1Val 65535;
BA_ "UserSigValidity" SG_ 955 BLTN_CAM_FD_HU_Crc1Val 3;
BA_ "Version" SG_ 955 BLTN_CAM_FD_HU_Crc1Val "22.11.04";
BA_ "Description" SG_ 955 BLTN_CAM_DEV_Count "This Signal is count of drive event record.";
BA_ "GenSigSendType" SG_ 955 BLTN_CAM_DEV_Count 4;
BA_ "UserSigValidity" SG_ 955 BLTN_CAM_DEV_Count 1;
BA_ "NetworkRequest" SG_ 955 BLTN_CAM_DEV_Count 0;
BA_ "NetworkRequestHoldingTime" SG_ 955 BLTN_CAM_DEV_Count 1000;
BA_ "Version" SG_ 955 BLTN_CAM_DEV_Count "23.04.02";
BA_ "Description" SG_ 955 HU_SSHFS_StrictHostKeyCheck1 "A signal to distinguish between built-in cam and HU whether it is one-way or two-way security protocol (SSHFS, etc.) for HSCAN";
BA_ "GenSigSendType" SG_ 955 HU_SSHFS_StrictHostKeyCheck1 4;
BA_ "UserSigValidity" SG_ 955 HU_SSHFS_StrictHostKeyCheck1 0;
BA_ "Version" SG_ 955 HU_SSHFS_StrictHostKeyCheck1 "25.04.02";
BA_ "Description" SG_ 955 BLTN_CAM_Pollution_Rear "Whether built-in cam rear camera lens pollution is detected";
BA_ "GenSigSendType" SG_ 955 BLTN_CAM_Pollution_Rear 4;
BA_ "UserSigValidity" SG_ 955 BLTN_CAM_Pollution_Rear 0;
BA_ "Version" SG_ 955 BLTN_CAM_Pollution_Rear "25.07.04";
BA_ "Description" SG_ 955 BLTN_CAM_Pollution_Left "Whether built-in cam left camera lens pollution is detected";
BA_ "GenSigSendType" SG_ 955 BLTN_CAM_Pollution_Left 4;
BA_ "UserSigValidity" SG_ 955 BLTN_CAM_Pollution_Left 0;
BA_ "Version" SG_ 955 BLTN_CAM_Pollution_Left "25.07.04";
BA_ "Description" SG_ 955 BLTN_CAM_Pollution_Right "Whether built-in cam right camera lens pollution is detected";
BA_ "GenSigSendType" SG_ 955 BLTN_CAM_Pollution_Right 4;
BA_ "UserSigValidity" SG_ 955 BLTN_CAM_Pollution_Right 0;
BA_ "Version" SG_ 955 BLTN_CAM_Pollution_Right "25.07.04";
BA_ "Description" SG_ 955 BLTN_CAM_FD_HU_AlvCnt1Val "For the first transmission request for a data element the counter shall be initialized with 0 and shall be incremented by 1 for every subsequent send request. 

When the counter reaches the maximum value(0xFF), then it shall restart with 0 for the next s";
BA_ "GenSigSendType" SG_ 955 BLTN_CAM_FD_HU_AlvCnt1Val 4;
BA_ "UserSigValidity" SG_ 955 BLTN_CAM_FD_HU_AlvCnt1Val 3;
BA_ "Version" SG_ 955 BLTN_CAM_FD_HU_AlvCnt1Val "22.11.04";
BA_ "Description" SG_ 955 BLTN_CAM_PMD_Count "This Signal is count of park motion detetion.";
BA_ "GenSigSendType" SG_ 955 BLTN_CAM_PMD_Count 4;
BA_ "UserSigValidity" SG_ 955 BLTN_CAM_PMD_Count 0;
BA_ "Version" SG_ 955 BLTN_CAM_PMD_Count "24.02.00";
BA_ "Description" SG_ 955 BLTN_CAM_I2CMasterSta_Left "This signal indicates a I²C master device in order to control SVM LH camera.



0x0: Default

0x1: BLTN_CAM is a master device on I²C bus

0x2: ADAS_PRK is a master device on I²C bus

0x3: Invalid";
BA_ "GenSigSendType" SG_ 955 BLTN_CAM_I2CMasterSta_Left 4;
BA_ "UserSigValidity" SG_ 955 BLTN_CAM_I2CMasterSta_Left 0;
BA_ "Version" SG_ 955 BLTN_CAM_I2CMasterSta_Left "25.01.00";
BA_ "Description" SG_ 955 BLTN_CAM_I2CMasterSta_Right "This signal indicates a I²C master device in order to control SVM RH camera.



0x0: Default

0x1: BLTN_CAM is a master device on I²C bus

0x2: ADAS_PRK is a master device on I²C bus

0x3: Invalid";
BA_ "GenSigSendType" SG_ 955 BLTN_CAM_I2CMasterSta_Right 4;
BA_ "UserSigValidity" SG_ 955 BLTN_CAM_I2CMasterSta_Right 0;
BA_ "Version" SG_ 955 BLTN_CAM_I2CMasterSta_Right "25.01.00";
BA_ "Description" SG_ 955 BLTN_CAM_CamSta_Left "The signal indicates status of SVM LH camera.



0x0:Deafult & Reset

0x1:Normal (Recording)

0x2:Normal (Non-recording)

0x3:Not configured

0x4:SerDes config failed

0x5:Power Issue

0x6:V-sync Issue

0x7:Ser/Des Lock Issue

0x8~0xE:Reserved

0xF:Inval";
BA_ "GenSigSendType" SG_ 955 BLTN_CAM_CamSta_Left 4;
BA_ "UserSigValidity" SG_ 955 BLTN_CAM_CamSta_Left 0;
BA_ "Version" SG_ 955 BLTN_CAM_CamSta_Left "25.01.00";
BA_ "Description" SG_ 955 BLTN_CAM_CamSta_Right "The signal indicates status of SVM RH camera.



0x0:Deafult & Reset

0x1:Normal (Recording)

0x2:Normal (Non-recording)

0x3:Not configured

0x4:SerDes config failed

0x5:Power Issue

0x6:V-sync Issue

0x7:Ser/Des Lock Issue

0x8~0xE:Reserved

0xF:Inval";
BA_ "GenSigSendType" SG_ 955 BLTN_CAM_CamSta_Right 4;
BA_ "UserSigValidity" SG_ 955 BLTN_CAM_CamSta_Right 0;
BA_ "Version" SG_ 955 BLTN_CAM_CamSta_Right "25.01.00";
BA_ "Description" SG_ 955 BLTN_CAM_Set_Rear_Flip "Setting Information(On/Off) of Rear Video Left/Right Flipping";
BA_ "GenSigSendType" SG_ 955 BLTN_CAM_Set_Rear_Flip 4;
BA_ "UserSigValidity" SG_ 955 BLTN_CAM_Set_Rear_Flip 0;
BA_ "Version" SG_ 955 BLTN_CAM_Set_Rear_Flip "25.01.00";
BA_ "Description" SG_ 955 MAR_SoftKeyEnable "Manual Event Record Soft key on the AVN display Enable/Disable";
BA_ "GenSigSendType" SG_ 955 MAR_SoftKeyEnable 4;
BA_ "UserSigValidity" SG_ 955 MAR_SoftKeyEnable 0;
BA_ "Version" SG_ 955 MAR_SoftKeyEnable "25.04.01";
BA_ "Description" SG_ 955 TML_SoftKeyEnable "Time lapse Record Start/Stop Soft key on the AVN display Enable/Disable";
BA_ "GenSigSendType" SG_ 955 TML_SoftKeyEnable 4;
BA_ "UserSigValidity" SG_ 955 TML_SoftKeyEnable 0;
BA_ "Version" SG_ 955 TML_SoftKeyEnable "25.04.01";
BA_ "Description" SG_ 955 MAR_SoftKeySystemFailStatus "Manual Event Record Soft key System FailStatus on the AVN display";
BA_ "GenSigSendType" SG_ 955 MAR_SoftKeySystemFailStatus 4;
BA_ "UserSigValidity" SG_ 955 MAR_SoftKeySystemFailStatus 0;
BA_ "Version" SG_ 955 MAR_SoftKeySystemFailStatus "25.04.01";
BA_ "Description" SG_ 955 TML_SoftKeySystemFailStatus "Time lapse Record Start/Stop  Soft key System FailStatus on the AVN display";
BA_ "GenSigSendType" SG_ 955 TML_SoftKeySystemFailStatus 4;
BA_ "UserSigValidity" SG_ 955 TML_SoftKeySystemFailStatus 0;
BA_ "Version" SG_ 955 TML_SoftKeySystemFailStatus "25.04.01";
BA_ "Description" SG_ 955 BLTN_CAM_HU_UI_Mode "Display control of Built-in Cam UI mode. This Signal for Ethernet Type Built-in Cam.";
BA_ "GenSigSendType" SG_ 955 BLTN_CAM_HU_UI_Mode 4;
BA_ "UserSigValidity" SG_ 955 BLTN_CAM_HU_UI_Mode 0;
BA_ "Version" SG_ 955 BLTN_CAM_HU_UI_Mode "24.04.03";
BA_ "Description" SG_ 955 BLTN_CAM_Display "Display control of Built-in Cam UI mode. This Signal for CAN Type Built-in Cam.(with Standard 5th Wide AVNT)";
BA_ "GenSigSendType" SG_ 955 BLTN_CAM_Display 4;
BA_ "UserSigValidity" SG_ 955 BLTN_CAM_Display 1;
BA_ "Version" SG_ 955 BLTN_CAM_Display "21.07.04";
BA_ "Description" SG_ 955 BLTN_CAM_WiFi_State "BLTN_CAM WiFi Stattus";
BA_ "GenSigSendType" SG_ 955 BLTN_CAM_WiFi_State 4;
BA_ "UserSigValidity" SG_ 955 BLTN_CAM_WiFi_State 1;
BA_ "Version" SG_ 955 BLTN_CAM_WiFi_State "21.07.04";
BA_ "Description" SG_ 955 BLTN_CAM_SD_Format_Op_State "BLTN_CAM SD card format operation status.";
BA_ "GenSigSendType" SG_ 955 BLTN_CAM_SD_Format_Op_State 4;
BA_ "UserSigValidity" SG_ 955 BLTN_CAM_SD_Format_Op_State 1;
BA_ "Version" SG_ 955 BLTN_CAM_SD_Format_Op_State "21.07.04";
BA_ "Description" SG_ 955 BLTN_CAM_PEV_Recorded "This Signal is sent just after the park event recorded.";
BA_ "GenSigSendType" SG_ 955 BLTN_CAM_PEV_Recorded 4;
BA_ "UserSigValidity" SG_ 955 BLTN_CAM_PEV_Recorded 1;
BA_ "NetworkRequest" SG_ 955 BLTN_CAM_PEV_Recorded 0;
BA_ "NetworkRequestHoldingTime" SG_ 955 BLTN_CAM_PEV_Recorded 1000;
BA_ "Version" SG_ 955 BLTN_CAM_PEV_Recorded "21.12.00";
BA_ "Description" SG_ 955 BLTN_CAM_PEV_Count "This Signal is count of park event record.";
BA_ "GenSigSendType" SG_ 955 BLTN_CAM_PEV_Count 4;
BA_ "UserSigValidity" SG_ 955 BLTN_CAM_PEV_Count 1;
BA_ "NetworkRequest" SG_ 955 BLTN_CAM_PEV_Count 0;
BA_ "NetworkRequestHoldingTime" SG_ 955 BLTN_CAM_PEV_Count 1000;
BA_ "Version" SG_ 955 BLTN_CAM_PEV_Count "21.12.00";
BA_ "Description" SG_ 955 BLTN_CAM_Ind_Req "This Signal is for HU Display Built-in Cam Indicator.";
BA_ "GenSigSendType" SG_ 955 BLTN_CAM_Ind_Req 4;
BA_ "UserSigValidity" SG_ 955 BLTN_CAM_Ind_Req 1;
BA_ "Version" SG_ 955 BLTN_CAM_Ind_Req "24.04.03";
BA_ "Description" SG_ 955 BLTN_CAM_LVDS_Mode_State "This Signal is for LVDS output status";
BA_ "GenSigSendType" SG_ 955 BLTN_CAM_LVDS_Mode_State 4;
BA_ "UserSigValidity" SG_ 955 BLTN_CAM_LVDS_Mode_State 1;
BA_ "Version" SG_ 955 BLTN_CAM_LVDS_Mode_State "21.07.04";
BA_ "Description" SG_ 955 BLTN_CAM_PrkOp_Termiate_Info "The signal for CCS service related with Built-in Cam Park operation termination.";
BA_ "GenSigSendType" SG_ 955 BLTN_CAM_PrkOp_Termiate_Info 4;
BA_ "UserSigValidity" SG_ 955 BLTN_CAM_PrkOp_Termiate_Info 0;
BA_ "NetworkRequest" SG_ 955 BLTN_CAM_PrkOp_Termiate_Info 0;
BA_ "NetworkRequestHoldingTime" SG_ 955 BLTN_CAM_PrkOp_Termiate_Info 1000;
BA_ "Version" SG_ 955 BLTN_CAM_PrkOp_Termiate_Info "21.12.00";
BA_ "Description" SG_ 955 BLTN_CAM_DEV_Recorded "This Signal is sent just after the drive event recorded.";
BA_ "GenSigSendType" SG_ 955 BLTN_CAM_DEV_Recorded 4;
BA_ "UserSigValidity" SG_ 955 BLTN_CAM_DEV_Recorded 1;
BA_ "NetworkRequest" SG_ 955 BLTN_CAM_DEV_Recorded 0;
BA_ "NetworkRequestHoldingTime" SG_ 955 BLTN_CAM_DEV_Recorded 1000;
BA_ "Version" SG_ 955 BLTN_CAM_DEV_Recorded "23.04.02";
BA_ "Description" SG_ 829 SBCM_RR_FD_Crc1Val "The data area for CRC calculation is based on the data length (DLC) of the message DB.

The CRC shall be calculated over the entire data block (excluding the CRC bytes) including the user data, alive counter and Data ID



- CRC Polynomial (0x1021) , Ini";
BA_ "GenSigSendType" SG_ 829 SBCM_RR_FD_Crc1Val 4;
BA_ "GenSigStartValue" SG_ 829 SBCM_RR_FD_Crc1Val 65535;
BA_ "UserSigValidity" SG_ 829 SBCM_RR_FD_Crc1Val 3;
BA_ "Version" SG_ 829 SBCM_RR_FD_Crc1Val "22.10.20";
BA_ "GenSigSendType" SG_ 829 USM_RRGhostDoorSta 4;
BA_ "UserSigValidity" SG_ 829 USM_RRGhostDoorSta 0;
BA_ "NetworkRequest" SG_ 829 USM_RRGhostDoorSta 0;
BA_ "NetworkRequestHoldingTime" SG_ 829 USM_RRGhostDoorSta 5000;
BA_ "Version" SG_ 829 USM_RRGhostDoorSta "21.07.07";
BA_ "GenSigSendType" SG_ 829 DoorLock_PDSLkSwSta_RR 4;
BA_ "UserSigValidity" SG_ 829 DoorLock_PDSLkSwSta_RR 0;
BA_ "NetworkRequest" SG_ 829 DoorLock_PDSLkSwSta_RR 0;
BA_ "Version" SG_ 829 DoorLock_PDSLkSwSta_RR "21.09.05";
BA_ "GenSigSendType" SG_ 829 PDS_TypeOption_RR 4;
BA_ "UserSigValidity" SG_ 829 PDS_TypeOption_RR 0;
BA_ "NetworkRequest" SG_ 829 PDS_TypeOption_RR 0;
BA_ "Version" SG_ 829 PDS_TypeOption_RR "21.07.07";
BA_ "GenSigSendType" SG_ 829 RR_CrashMRActAlarm 4;
BA_ "UserSigValidity" SG_ 829 RR_CrashMRActAlarm 0;
BA_ "NetworkRequest" SG_ 829 RR_CrashMRActAlarm 0;
BA_ "NetworkRequestHoldingTime" SG_ 829 RR_CrashMRActAlarm 5000;
BA_ "Version" SG_ 829 RR_CrashMRActAlarm "21.07.07";
BA_ "GenSigSendType" SG_ 829 PwrDRBuzzerOut_RR 4;
BA_ "UserSigValidity" SG_ 829 PwrDRBuzzerOut_RR 0;
BA_ "NetworkRequest" SG_ 829 PwrDRBuzzerOut_RR 0;
BA_ "NetworkRequestHoldingTime" SG_ 829 PwrDRBuzzerOut_RR 5000;
BA_ "Version" SG_ 829 PwrDRBuzzerOut_RR "21.07.07";
BA_ "GenSigSendType" SG_ 829 PwrDRClosingRRDrSta 4;
BA_ "UserSigValidity" SG_ 829 PwrDRClosingRRDrSta 0;
BA_ "NetworkRequest" SG_ 829 PwrDRClosingRRDrSta 0;
BA_ "NetworkRequestHoldingTime" SG_ 829 PwrDRClosingRRDrSta 5000;
BA_ "Version" SG_ 829 PwrDRClosingRRDrSta "23.07.06";
BA_ "GenSigSendType" SG_ 829 AFH_RR_FldUnfldSta 4;
BA_ "UserSigValidity" SG_ 829 AFH_RR_FldUnfldSta 0;
BA_ "NetworkRequest" SG_ 829 AFH_RR_FldUnfldSta 0;
BA_ "NetworkRequestHoldingTime" SG_ 829 AFH_RR_FldUnfldSta 5000;
BA_ "Version" SG_ 829 AFH_RR_FldUnfldSta "24.07.06";
BA_ "Description" SG_ 829 SBCM_RR_FD_AlvCnt1Val "For the first transmission request for a data element the counter shall be initialized with 0 and shall be incremented by 1 for every subsequent send request. 

When the counter reaches the maximum value(0xFF), then it shall restart with 0 for the next s";
BA_ "GenSigSendType" SG_ 829 SBCM_RR_FD_AlvCnt1Val 4;
BA_ "UserSigValidity" SG_ 829 SBCM_RR_FD_AlvCnt1Val 3;
BA_ "Version" SG_ 829 SBCM_RR_FD_AlvCnt1Val "22.10.20";
BA_ "Description" SG_ 829 DoorLock_RrRtLkOutSta_SBCM "- Door Lock or Unlock Output State 

0x0 : Off (Door lock/unlock output Off state)

0x1 : On (Door lock/unlock output On state)";
BA_ "GenSigSendType" SG_ 829 DoorLock_RrRtLkOutSta_SBCM 4;
BA_ "UserSigValidity" SG_ 829 DoorLock_RrRtLkOutSta_SBCM 0;
BA_ "NetworkRequest" SG_ 829 DoorLock_RrRtLkOutSta_SBCM 0;
BA_ "NetworkRequestHoldingTime" SG_ 829 DoorLock_RrRtLkOutSta_SBCM 5000;
BA_ "Version" SG_ 829 DoorLock_RrRtLkOutSta_SBCM "23.02.09";
BA_ "GenSigSendType" SG_ 829 RrRt_DrLkRetryFail_SBCM 4;
BA_ "TimeoutValue" SG_ 829 RrRt_DrLkRetryFail_SBCM "0x0";
BA_ "UserSigValidity" SG_ 829 RrRt_DrLkRetryFail_SBCM 0;
BA_ "NetworkRequest" SG_ 829 RrRt_DrLkRetryFail_SBCM 0;
BA_ "NetworkRequestHoldingTime" SG_ 829 RrRt_DrLkRetryFail_SBCM 5000;
BA_ "Version" SG_ 829 RrRt_DrLkRetryFail_SBCM "23.03.00";
BA_ "GenSigSendType" SG_ 829 RR_DetectObj_warn 4;
BA_ "UserSigValidity" SG_ 829 RR_DetectObj_warn 0;
BA_ "NetworkRequest" SG_ 829 RR_DetectObj_warn 0;
BA_ "NetworkRequestHoldingTime" SG_ 829 RR_DetectObj_warn 5000;
BA_ "Version" SG_ 829 RR_DetectObj_warn "23.10.11";
BA_ "GenSigSendType" SG_ 829 RRRrDrCurtainPosition 4;
BA_ "UserSigValidity" SG_ 829 RRRrDrCurtainPosition 0;
BA_ "NetworkRequest" SG_ 829 RRRrDrCurtainPosition 0;
BA_ "NetworkRequestHoldingTime" SG_ 829 RRRrDrCurtainPosition 5000;
BA_ "Version" SG_ 829 RRRrDrCurtainPosition "23.08.00";
BA_ "GenSigSendType" SG_ 829 RRRrDrCurtainDownInitState 4;
BA_ "UserSigValidity" SG_ 829 RRRrDrCurtainDownInitState 0;
BA_ "NetworkRequest" SG_ 829 RRRrDrCurtainDownInitState 0;
BA_ "NetworkRequestHoldingTime" SG_ 829 RRRrDrCurtainDownInitState 5000;
BA_ "Version" SG_ 829 RRRrDrCurtainDownInitState "24.01.05";
BA_ "GenSigSendType" SG_ 829 PwrDrSta_RrRt 4;
BA_ "UserSigValidity" SG_ 829 PwrDrSta_RrRt 0;
BA_ "NetworkRequest" SG_ 829 PwrDrSta_RrRt 0;
BA_ "NetworkRequestHoldingTime" SG_ 829 PwrDrSta_RrRt 5000;
BA_ "Version" SG_ 829 PwrDrSta_RrRt "24.01.05";
BA_ "GenSigSendType" SG_ 829 PwrDRBuzzerOut_RR_New 4;
BA_ "UserSigValidity" SG_ 829 PwrDRBuzzerOut_RR_New 0;
BA_ "NetworkRequest" SG_ 829 PwrDRBuzzerOut_RR_New 0;
BA_ "NetworkRequestHoldingTime" SG_ 829 PwrDRBuzzerOut_RR_New 5000;
BA_ "Version" SG_ 829 PwrDRBuzzerOut_RR_New "24.01.05";
BA_ "GenSigSendType" SG_ 829 VAPI_RRDrLkUnLkInsdSwEn_Get 4;
BA_ "UserSigValidity" SG_ 829 VAPI_RRDrLkUnLkInsdSwEn_Get 0;
BA_ "Version" SG_ 829 VAPI_RRDrLkUnLkInsdSwEn_Get "25.01.00";
BA_ "Description" SG_ 829 SBCM_RR_SlidePosition "DHMC_RR_SlidePosition";
BA_ "GenSigSendType" SG_ 829 SBCM_RR_SlidePosition 4;
BA_ "GenSigStartValue" SG_ 829 SBCM_RR_SlidePosition 255;
BA_ "UserSigValidity" SG_ 829 SBCM_RR_SlidePosition 0;
BA_ "NetworkRequest" SG_ 829 SBCM_RR_SlidePosition 0;
BA_ "NetworkRequestHoldingTime" SG_ 829 SBCM_RR_SlidePosition 5000;
BA_ "Version" SG_ 829 SBCM_RR_SlidePosition "24.01.05";
BA_ "Description" SG_ 829 SBCM_RR_DoorAngle "PDSM_RR_DoorAngle";
BA_ "GenSigSendType" SG_ 829 SBCM_RR_DoorAngle 4;
BA_ "GenSigStartValue" SG_ 829 SBCM_RR_DoorAngle 100;
BA_ "UserSigValidity" SG_ 829 SBCM_RR_DoorAngle 0;
BA_ "NetworkRequest" SG_ 829 SBCM_RR_DoorAngle 0;
BA_ "NetworkRequestHoldingTime" SG_ 829 SBCM_RR_DoorAngle 5000;
BA_ "Version" SG_ 829 SBCM_RR_DoorAngle "24.01.05";
BA_ "GenSigSendType" SG_ 829 RRDoorPushAlarm 4;
BA_ "UserSigValidity" SG_ 829 RRDoorPushAlarm 0;
BA_ "NetworkRequest" SG_ 829 RRDoorPushAlarm 0;
BA_ "NetworkRequestHoldingTime" SG_ 829 RRDoorPushAlarm 5000;
BA_ "Version" SG_ 829 RRDoorPushAlarm "21.07.07";
BA_ "Description" SG_ 829 RR_CrashUnlockCmd "RearRightCrashUnlockCommand";
BA_ "GenSigSendType" SG_ 829 RR_CrashUnlockCmd 4;
BA_ "UserSigValidity" SG_ 829 RR_CrashUnlockCmd 0;
BA_ "NetworkRequest" SG_ 829 RR_CrashUnlockCmd 0;
BA_ "Version" SG_ 829 RR_CrashUnlockCmd "21.07.07";
BA_ "Description" SG_ 829 Warn_RrRtDrSwSta_SBCM "Warning Rear Right Door Switch Status";
BA_ "GenSigSendType" SG_ 829 Warn_RrRtDrSwSta_SBCM 4;
BA_ "UserSigValidity" SG_ 829 Warn_RrRtDrSwSta_SBCM 0;
BA_ "NetworkRequest" SG_ 829 Warn_RrRtDrSwSta_SBCM 0;
BA_ "Version" SG_ 829 Warn_RrRtDrSwSta_SBCM "21.09.05";
BA_ "Description" SG_ 829 DoorLock_RrRtDrUnLkSta_SBCM "Rear Right Door Unlock Status";
BA_ "GenSigSendType" SG_ 829 DoorLock_RrRtDrUnLkSta_SBCM 4;
BA_ "UserSigValidity" SG_ 829 DoorLock_RrRtDrUnLkSta_SBCM 0;
BA_ "NetworkRequest" SG_ 829 DoorLock_RrRtDrUnLkSta_SBCM 0;
BA_ "Version" SG_ 829 DoorLock_RrRtDrUnLkSta_SBCM "21.07.07";
BA_ "Description" SG_ 829 RR_SEAActivated "RearRightSEAActivated";
BA_ "GenSigSendType" SG_ 829 RR_SEAActivated 4;
BA_ "UserSigValidity" SG_ 829 RR_SEAActivated 0;
BA_ "NetworkRequest" SG_ 829 RR_SEAActivated 0;
BA_ "Version" SG_ 829 RR_SEAActivated "21.07.07";
BA_ "Description" SG_ 829 RR_SEAWarn "RearRighrSEAWarning";
BA_ "GenSigSendType" SG_ 829 RR_SEAWarn 4;
BA_ "UserSigValidity" SG_ 829 RR_SEAWarn 0;
BA_ "NetworkRequest" SG_ 829 RR_SEAWarn 0;
BA_ "Version" SG_ 829 RR_SEAWarn "21.07.07";
BA_ "GenSigSendType" SG_ 829 RR_SEWWarn 4;
BA_ "UserSigValidity" SG_ 829 RR_SEWWarn 0;
BA_ "NetworkRequest" SG_ 829 RR_SEWWarn 0;
BA_ "Version" SG_ 829 RR_SEWWarn "21.07.07";
BA_ "GenSigSendType" SG_ 829 RR_ReleaseWarn 4;
BA_ "UserSigValidity" SG_ 829 RR_ReleaseWarn 0;
BA_ "NetworkRequest" SG_ 829 RR_ReleaseWarn 0;
BA_ "NetworkRequestHoldingTime" SG_ 829 RR_ReleaseWarn 5000;
BA_ "Version" SG_ 829 RR_ReleaseWarn "21.09.05";
BA_ "GenSigSendType" SG_ 829 RR_SWFailAlarm 4;
BA_ "UserSigValidity" SG_ 829 RR_SWFailAlarm 0;
BA_ "NetworkRequest" SG_ 829 RR_SWFailAlarm 0;
BA_ "NetworkRequestHoldingTime" SG_ 829 RR_SWFailAlarm 5000;
BA_ "Version" SG_ 829 RR_SWFailAlarm "21.07.07";
BA_ "GenSigSendType" SG_ 829 RR_ChildLock_ActnFlSta 4;
BA_ "UserSigValidity" SG_ 829 RR_ChildLock_ActnFlSta 0;
BA_ "NetworkRequest" SG_ 829 RR_ChildLock_ActnFlSta 0;
BA_ "NetworkRequestHoldingTime" SG_ 829 RR_ChildLock_ActnFlSta 5000;
BA_ "Version" SG_ 829 RR_ChildLock_ActnFlSta "21.07.07";
BA_ "GenSigSendType" SG_ 829 RR_MRActivationAlarm 4;
BA_ "UserSigValidity" SG_ 829 RR_MRActivationAlarm 0;
BA_ "NetworkRequest" SG_ 829 RR_MRActivationAlarm 0;
BA_ "NetworkRequestHoldingTime" SG_ 829 RR_MRActivationAlarm 5000;
BA_ "Version" SG_ 829 RR_MRActivationAlarm "21.07.07";
BA_ "GenSigSendType" SG_ 829 RR_ChildLock_Status 4;
BA_ "UserSigValidity" SG_ 829 RR_ChildLock_Status 0;
BA_ "NetworkRequest" SG_ 829 RR_ChildLock_Status 0;
BA_ "NetworkRequestHoldingTime" SG_ 829 RR_ChildLock_Status 5000;
BA_ "Version" SG_ 829 RR_ChildLock_Status "21.07.07";
BA_ "Description" SG_ 129 HU_CNTL_Crc1Val "The data area for CRC calculation is based on the data length (DLC) of the message DB.

The CRC shall be calculated over the entire data block (excluding the CRC bytes) including the user data, alive counter and Data ID



- CRC Polynomial (0x1021) , Ini";
BA_ "GenSigSendType" SG_ 129 HU_CNTL_Crc1Val 4;
BA_ "GenSigStartValue" SG_ 129 HU_CNTL_Crc1Val 65535;
BA_ "UserSigValidity" SG_ 129 HU_CNTL_Crc1Val 3;
BA_ "Version" SG_ 129 HU_CNTL_Crc1Val "22.10.20";
BA_ "GenSigSendType" SG_ 129 C_GlassCmdAVN 4;
BA_ "GenSigStartValue" SG_ 129 C_GlassCmdAVN 7;
BA_ "UserSigValidity" SG_ 129 C_GlassCmdAVN 1;
BA_ "Version" SG_ 129 C_GlassCmdAVN "18.09.02";
BA_ "Description" SG_ 129 HU_CNTL_AlvCnt1Val "For the first transmission request for a data element the counter shall be initialized with 0 and shall be incremented by 1 for every subsequent send request. 

When the counter reaches the maximum value(0xFF), then it shall restart with 0 for the next s";
BA_ "GenSigSendType" SG_ 129 HU_CNTL_AlvCnt1Val 4;
BA_ "UserSigValidity" SG_ 129 HU_CNTL_AlvCnt1Val 3;
BA_ "Version" SG_ 129 HU_CNTL_AlvCnt1Val "22.10.20";
BA_ "Description" SG_ 129 HU_MasterProfile_ResetIndex "When a Master Profile deletes another profile, all ECU MUST refer to the value of this signal. 

(limited to regions/platforms with master profile)";
BA_ "GenSigSendType" SG_ 129 HU_MasterProfile_ResetIndex 4;
BA_ "UserSigValidity" SG_ 129 HU_MasterProfile_ResetIndex 0;
BA_ "Version" SG_ 129 HU_MasterProfile_ResetIndex "25.06.00";
BA_ "GenSigSendType" SG_ 129 C_AstWindowCmdAVN 4;
BA_ "GenSigStartValue" SG_ 129 C_AstWindowCmdAVN 15;
BA_ "UserSigValidity" SG_ 129 C_AstWindowCmdAVN 0;
BA_ "Version" SG_ 129 C_AstWindowCmdAVN "19.11.05";
BA_ "GenSigSendType" SG_ 129 C_DrvWindowCmdAVN 4;
BA_ "GenSigStartValue" SG_ 129 C_DrvWindowCmdAVN 15;
BA_ "UserSigValidity" SG_ 129 C_DrvWindowCmdAVN 0;
BA_ "Version" SG_ 129 C_DrvWindowCmdAVN "19.11.05";
BA_ "GenSigSendType" SG_ 129 C_PTGCNTLCmdAVN 4;
BA_ "GenSigStartValue" SG_ 129 C_PTGCNTLCmdAVN 3;
BA_ "UserSigValidity" SG_ 129 C_PTGCNTLCmdAVN 3;
BA_ "Version" SG_ 129 C_PTGCNTLCmdAVN "18.09.02";
BA_ "GenSigSendType" SG_ 129 C_RrDefoggerCmdAVN 4;
BA_ "GenSigStartValue" SG_ 129 C_RrDefoggerCmdAVN 3;
BA_ "UserSigValidity" SG_ 129 C_RrDefoggerCmdAVN 3;
BA_ "Version" SG_ 129 C_RrDefoggerCmdAVN "18.09.02";
BA_ "Description" SG_ 129 C_RrBlindCmdAVN "Rear sunroof control signal(blind)";
BA_ "GenSigSendType" SG_ 129 C_RrBlindCmdAVN 4;
BA_ "GenSigStartValue" SG_ 129 C_RrBlindCmdAVN 3;
BA_ "UserSigValidity" SG_ 129 C_RrBlindCmdAVN 3;
BA_ "Version" SG_ 129 C_RrBlindCmdAVN "22.02.04";
BA_ "Description" SG_ 129 C_RrGlassCmdAVN "Rear sunroof control signal(glass)";
BA_ "GenSigSendType" SG_ 129 C_RrGlassCmdAVN 4;
BA_ "GenSigStartValue" SG_ 129 C_RrGlassCmdAVN 3;
BA_ "UserSigValidity" SG_ 129 C_RrGlassCmdAVN 3;
BA_ "Version" SG_ 129 C_RrGlassCmdAVN "22.02.04";
BA_ "GenSigSendType" SG_ 129 C_RRWindowCmdAVN 4;
BA_ "GenSigStartValue" SG_ 129 C_RRWindowCmdAVN 15;
BA_ "UserSigValidity" SG_ 129 C_RRWindowCmdAVN 0;
BA_ "Version" SG_ 129 C_RRWindowCmdAVN "19.11.05";
BA_ "GenSigSendType" SG_ 129 C_RLWindowCmdAVN 4;
BA_ "GenSigStartValue" SG_ 129 C_RLWindowCmdAVN 15;
BA_ "UserSigValidity" SG_ 129 C_RLWindowCmdAVN 0;
BA_ "Version" SG_ 129 C_RLWindowCmdAVN "19.11.05";
BA_ "GenSigSendType" SG_ 129 C_BlindCmdAVN 4;
BA_ "GenSigStartValue" SG_ 129 C_BlindCmdAVN 7;
BA_ "UserSigValidity" SG_ 129 C_BlindCmdAVN 1;
BA_ "Version" SG_ 129 C_BlindCmdAVN "18.09.02";
BA_ "Description" SG_ 830 SBCM_RL_FD_Crc1Val "The data area for CRC calculation is based on the data length (DLC) of the message DB.

The CRC shall be calculated over the entire data block (excluding the CRC bytes) including the user data, alive counter and Data ID



- CRC Polynomial (0x1021) , Ini";
BA_ "GenSigSendType" SG_ 830 SBCM_RL_FD_Crc1Val 4;
BA_ "GenSigStartValue" SG_ 830 SBCM_RL_FD_Crc1Val 65535;
BA_ "UserSigValidity" SG_ 830 SBCM_RL_FD_Crc1Val 3;
BA_ "Version" SG_ 830 SBCM_RL_FD_Crc1Val "22.10.20";
BA_ "GenSigSendType" SG_ 830 USM_RLGhostDoorSta 4;
BA_ "UserSigValidity" SG_ 830 USM_RLGhostDoorSta 0;
BA_ "NetworkRequest" SG_ 830 USM_RLGhostDoorSta 0;
BA_ "NetworkRequestHoldingTime" SG_ 830 USM_RLGhostDoorSta 5000;
BA_ "Version" SG_ 830 USM_RLGhostDoorSta "21.07.07";
BA_ "GenSigSendType" SG_ 830 DoorLock_PDSLkSwSta_RL 4;
BA_ "UserSigValidity" SG_ 830 DoorLock_PDSLkSwSta_RL 0;
BA_ "NetworkRequest" SG_ 830 DoorLock_PDSLkSwSta_RL 0;
BA_ "Version" SG_ 830 DoorLock_PDSLkSwSta_RL "21.09.05";
BA_ "GenSigSendType" SG_ 830 PDS_TypeOption_RL 4;
BA_ "UserSigValidity" SG_ 830 PDS_TypeOption_RL 0;
BA_ "NetworkRequest" SG_ 830 PDS_TypeOption_RL 0;
BA_ "Version" SG_ 830 PDS_TypeOption_RL "21.07.07";
BA_ "GenSigSendType" SG_ 830 RL_CrashMRActAlarm 4;
BA_ "UserSigValidity" SG_ 830 RL_CrashMRActAlarm 0;
BA_ "NetworkRequest" SG_ 830 RL_CrashMRActAlarm 0;
BA_ "NetworkRequestHoldingTime" SG_ 830 RL_CrashMRActAlarm 5000;
BA_ "Version" SG_ 830 RL_CrashMRActAlarm "21.07.07";
BA_ "GenSigSendType" SG_ 830 PwrDRBuzzerOut_RL 4;
BA_ "UserSigValidity" SG_ 830 PwrDRBuzzerOut_RL 0;
BA_ "NetworkRequest" SG_ 830 PwrDRBuzzerOut_RL 0;
BA_ "NetworkRequestHoldingTime" SG_ 830 PwrDRBuzzerOut_RL 5000;
BA_ "Version" SG_ 830 PwrDRBuzzerOut_RL "21.07.07";
BA_ "GenSigSendType" SG_ 830 PwrDRClosingRLDrSta 4;
BA_ "UserSigValidity" SG_ 830 PwrDRClosingRLDrSta 0;
BA_ "NetworkRequest" SG_ 830 PwrDRClosingRLDrSta 0;
BA_ "NetworkRequestHoldingTime" SG_ 830 PwrDRClosingRLDrSta 5000;
BA_ "Version" SG_ 830 PwrDRClosingRLDrSta "23.07.06";
BA_ "GenSigSendType" SG_ 830 AFH_RL_FldUnfldSta 4;
BA_ "UserSigValidity" SG_ 830 AFH_RL_FldUnfldSta 0;
BA_ "NetworkRequest" SG_ 830 AFH_RL_FldUnfldSta 0;
BA_ "NetworkRequestHoldingTime" SG_ 830 AFH_RL_FldUnfldSta 5000;
BA_ "Version" SG_ 830 AFH_RL_FldUnfldSta "24.07.06";
BA_ "Description" SG_ 830 SBCM_RL_FD_AlvCnt1Val "For the first transmission request for a data element the counter shall be initialized with 0 and shall be incremented by 1 for every subsequent send request. 

When the counter reaches the maximum value(0xFF), then it shall restart with 0 for the next s";
BA_ "GenSigSendType" SG_ 830 SBCM_RL_FD_AlvCnt1Val 4;
BA_ "UserSigValidity" SG_ 830 SBCM_RL_FD_AlvCnt1Val 3;
BA_ "Version" SG_ 830 SBCM_RL_FD_AlvCnt1Val "22.10.20";
BA_ "Description" SG_ 830 DoorLock_RrLtLkOutSta_SBCM "- Door Lock or Unlock Output State 

0x0 : Off (Door lock/unlock output Off state)

0x1 : On (Door lock/unlock output On state)";
BA_ "GenSigSendType" SG_ 830 DoorLock_RrLtLkOutSta_SBCM 4;
BA_ "UserSigValidity" SG_ 830 DoorLock_RrLtLkOutSta_SBCM 0;
BA_ "NetworkRequest" SG_ 830 DoorLock_RrLtLkOutSta_SBCM 0;
BA_ "NetworkRequestHoldingTime" SG_ 830 DoorLock_RrLtLkOutSta_SBCM 5000;
BA_ "Version" SG_ 830 DoorLock_RrLtLkOutSta_SBCM "23.02.09";
BA_ "GenSigSendType" SG_ 830 RrLt_DrLkRetryFail_SBCM 4;
BA_ "TimeoutValue" SG_ 830 RrLt_DrLkRetryFail_SBCM "0x0";
BA_ "UserSigValidity" SG_ 830 RrLt_DrLkRetryFail_SBCM 0;
BA_ "NetworkRequest" SG_ 830 RrLt_DrLkRetryFail_SBCM 0;
BA_ "NetworkRequestHoldingTime" SG_ 830 RrLt_DrLkRetryFail_SBCM 5000;
BA_ "Version" SG_ 830 RrLt_DrLkRetryFail_SBCM "23.03.00";
BA_ "GenSigSendType" SG_ 830 RL_DetectObj_warn 4;
BA_ "UserSigValidity" SG_ 830 RL_DetectObj_warn 0;
BA_ "NetworkRequest" SG_ 830 RL_DetectObj_warn 0;
BA_ "NetworkRequestHoldingTime" SG_ 830 RL_DetectObj_warn 5000;
BA_ "Version" SG_ 830 RL_DetectObj_warn "23.10.11";
BA_ "GenSigSendType" SG_ 830 RLRrDrCurtainPosition 4;
BA_ "UserSigValidity" SG_ 830 RLRrDrCurtainPosition 0;
BA_ "NetworkRequest" SG_ 830 RLRrDrCurtainPosition 0;
BA_ "NetworkRequestHoldingTime" SG_ 830 RLRrDrCurtainPosition 5000;
BA_ "Version" SG_ 830 RLRrDrCurtainPosition "23.07.06";
BA_ "GenSigSendType" SG_ 830 RDC_TypeOption 4;
BA_ "UserSigValidity" SG_ 830 RDC_TypeOption 0;
BA_ "NetworkRequest" SG_ 830 RDC_TypeOption 0;
BA_ "NetworkRequestHoldingTime" SG_ 830 RDC_TypeOption 5000;
BA_ "Version" SG_ 830 RDC_TypeOption "23.07.06";
BA_ "GenSigSendType" SG_ 830 RLRrDrCurtainDownInitState 4;
BA_ "UserSigValidity" SG_ 830 RLRrDrCurtainDownInitState 0;
BA_ "NetworkRequest" SG_ 830 RLRrDrCurtainDownInitState 0;
BA_ "NetworkRequestHoldingTime" SG_ 830 RLRrDrCurtainDownInitState 5000;
BA_ "Version" SG_ 830 RLRrDrCurtainDownInitState "24.01.05";
BA_ "Description" SG_ 830 PwrDRBuzzerOut_RL_New "JG~";
BA_ "GenSigSendType" SG_ 830 PwrDRBuzzerOut_RL_New 4;
BA_ "UserSigValidity" SG_ 830 PwrDRBuzzerOut_RL_New 0;
BA_ "NetworkRequest" SG_ 830 PwrDRBuzzerOut_RL_New 0;
BA_ "NetworkRequestHoldingTime" SG_ 830 PwrDRBuzzerOut_RL_New 5000;
BA_ "Version" SG_ 830 PwrDRBuzzerOut_RL_New "24.01.05";
BA_ "GenSigSendType" SG_ 830 VAPI_RLDrLkUnLkInsdSwEn_Get 4;
BA_ "UserSigValidity" SG_ 830 VAPI_RLDrLkUnLkInsdSwEn_Get 0;
BA_ "Version" SG_ 830 VAPI_RLDrLkUnLkInsdSwEn_Get "25.01.00";
BA_ "Description" SG_ 830 PwrDrSta_RrLt "JG~";
BA_ "GenSigSendType" SG_ 830 PwrDrSta_RrLt 4;
BA_ "UserSigValidity" SG_ 830 PwrDrSta_RrLt 0;
BA_ "NetworkRequest" SG_ 830 PwrDrSta_RrLt 0;
BA_ "NetworkRequestHoldingTime" SG_ 830 PwrDrSta_RrLt 5000;
BA_ "Version" SG_ 830 PwrDrSta_RrLt "24.01.05";
BA_ "Description" SG_ 830 SBCM_RL_SlidePosition "DHMC_RL_SlidePosition";
BA_ "GenSigSendType" SG_ 830 SBCM_RL_SlidePosition 4;
BA_ "GenSigStartValue" SG_ 830 SBCM_RL_SlidePosition 255;
BA_ "UserSigValidity" SG_ 830 SBCM_RL_SlidePosition 0;
BA_ "NetworkRequest" SG_ 830 SBCM_RL_SlidePosition 0;
BA_ "NetworkRequestHoldingTime" SG_ 830 SBCM_RL_SlidePosition 5000;
BA_ "Version" SG_ 830 SBCM_RL_SlidePosition "24.01.05";
BA_ "Description" SG_ 830 SBCM_RL_DoorAngle "PDSM_RL_DoorAngle";
BA_ "GenSigSendType" SG_ 830 SBCM_RL_DoorAngle 4;
BA_ "GenSigStartValue" SG_ 830 SBCM_RL_DoorAngle 100;
BA_ "UserSigValidity" SG_ 830 SBCM_RL_DoorAngle 0;
BA_ "NetworkRequest" SG_ 830 SBCM_RL_DoorAngle 0;
BA_ "NetworkRequestHoldingTime" SG_ 830 SBCM_RL_DoorAngle 5000;
BA_ "Version" SG_ 830 SBCM_RL_DoorAngle "24.01.05";
BA_ "GenSigSendType" SG_ 830 RLDoorPushAlarm 4;
BA_ "UserSigValidity" SG_ 830 RLDoorPushAlarm 0;
BA_ "NetworkRequest" SG_ 830 RLDoorPushAlarm 0;
BA_ "NetworkRequestHoldingTime" SG_ 830 RLDoorPushAlarm 5000;
BA_ "Version" SG_ 830 RLDoorPushAlarm "21.07.07";
BA_ "Description" SG_ 830 RL_CrashUnlockCmd "RearLefrCrashUnlockCommand";
BA_ "GenSigSendType" SG_ 830 RL_CrashUnlockCmd 4;
BA_ "UserSigValidity" SG_ 830 RL_CrashUnlockCmd 0;
BA_ "NetworkRequest" SG_ 830 RL_CrashUnlockCmd 0;
BA_ "Version" SG_ 830 RL_CrashUnlockCmd "21.07.07";
BA_ "Description" SG_ 830 Warn_RrLftDrSwSta_SBCM "Warning Rear Left Door Switch Status";
BA_ "GenSigSendType" SG_ 830 Warn_RrLftDrSwSta_SBCM 4;
BA_ "UserSigValidity" SG_ 830 Warn_RrLftDrSwSta_SBCM 0;
BA_ "NetworkRequest" SG_ 830 Warn_RrLftDrSwSta_SBCM 0;
BA_ "Version" SG_ 830 Warn_RrLftDrSwSta_SBCM "21.09.05";
BA_ "Description" SG_ 830 DoorLock_RrLftDrUnLkSta_SBCM "Rear Left Door Unlock Status";
BA_ "GenSigSendType" SG_ 830 DoorLock_RrLftDrUnLkSta_SBCM 4;
BA_ "UserSigValidity" SG_ 830 DoorLock_RrLftDrUnLkSta_SBCM 0;
BA_ "NetworkRequest" SG_ 830 DoorLock_RrLftDrUnLkSta_SBCM 0;
BA_ "Version" SG_ 830 DoorLock_RrLftDrUnLkSta_SBCM "21.07.07";
BA_ "Description" SG_ 830 RL_SEAActivated "Rear Left SEA Activated";
BA_ "GenSigSendType" SG_ 830 RL_SEAActivated 4;
BA_ "UserSigValidity" SG_ 830 RL_SEAActivated 0;
BA_ "NetworkRequest" SG_ 830 RL_SEAActivated 0;
BA_ "Version" SG_ 830 RL_SEAActivated "21.07.07";
BA_ "Description" SG_ 830 RL_SEAWarn "RearLeftSEAWarning";
BA_ "GenSigSendType" SG_ 830 RL_SEAWarn 4;
BA_ "UserSigValidity" SG_ 830 RL_SEAWarn 0;
BA_ "NetworkRequest" SG_ 830 RL_SEAWarn 0;
BA_ "Version" SG_ 830 RL_SEAWarn "21.07.07";
BA_ "GenSigSendType" SG_ 830 RL_SEWWarn 4;
BA_ "UserSigValidity" SG_ 830 RL_SEWWarn 0;
BA_ "NetworkRequest" SG_ 830 RL_SEWWarn 0;
BA_ "Version" SG_ 830 RL_SEWWarn "21.07.07";
BA_ "GenSigSendType" SG_ 830 RL_ReleaseWarn 4;
BA_ "UserSigValidity" SG_ 830 RL_ReleaseWarn 0;
BA_ "NetworkRequest" SG_ 830 RL_ReleaseWarn 0;
BA_ "NetworkRequestHoldingTime" SG_ 830 RL_ReleaseWarn 5000;
BA_ "Version" SG_ 830 RL_ReleaseWarn "21.09.05";
BA_ "GenSigSendType" SG_ 830 RL_SWFailAlarm 4;
BA_ "UserSigValidity" SG_ 830 RL_SWFailAlarm 0;
BA_ "NetworkRequest" SG_ 830 RL_SWFailAlarm 0;
BA_ "NetworkRequestHoldingTime" SG_ 830 RL_SWFailAlarm 5000;
BA_ "Version" SG_ 830 RL_SWFailAlarm "21.07.07";
BA_ "GenSigSendType" SG_ 830 RL_ChildLock_ActnFlSta 4;
BA_ "UserSigValidity" SG_ 830 RL_ChildLock_ActnFlSta 0;
BA_ "NetworkRequest" SG_ 830 RL_ChildLock_ActnFlSta 0;
BA_ "NetworkRequestHoldingTime" SG_ 830 RL_ChildLock_ActnFlSta 5000;
BA_ "Version" SG_ 830 RL_ChildLock_ActnFlSta "21.07.07";
BA_ "GenSigSendType" SG_ 830 RL_MRActivationAlarm 4;
BA_ "UserSigValidity" SG_ 830 RL_MRActivationAlarm 0;
BA_ "NetworkRequest" SG_ 830 RL_MRActivationAlarm 0;
BA_ "NetworkRequestHoldingTime" SG_ 830 RL_MRActivationAlarm 5000;
BA_ "Version" SG_ 830 RL_MRActivationAlarm "21.07.07";
BA_ "GenSigSendType" SG_ 830 RL_ChildLock_Status 4;
BA_ "UserSigValidity" SG_ 830 RL_ChildLock_Status 0;
BA_ "NetworkRequest" SG_ 830 RL_ChildLock_Status 0;
BA_ "NetworkRequestHoldingTime" SG_ 830 RL_ChildLock_Status 5000;
BA_ "Version" SG_ 830 RL_ChildLock_Status "21.07.07";
BA_ "Description" SG_ 676 HU_CLU_Crc3Val "The data area for CRC calculation is based on the data length (DLC) of the message DB.

The CRC shall be calculated over the entire data block (excluding the CRC bytes) including the user data, alive counter and Data ID



- CRC Polynomial (0x1021) , Ini";
BA_ "GenSigSendType" SG_ 676 HU_CLU_Crc3Val 4;
BA_ "GenSigStartValue" SG_ 676 HU_CLU_Crc3Val 65535;
BA_ "UserSigValidity" SG_ 676 HU_CLU_Crc3Val 3;
BA_ "Version" SG_ 676 HU_CLU_Crc3Val "22.10.20";
BA_ "Description" SG_ 676 AVNT_NModeSel2_Custom1SetVal "Custom Mode 1 setting value in N Mode selection 2 of N1/N2";
BA_ "GenSigSendType" SG_ 676 AVNT_NModeSel2_Custom1SetVal 4;
BA_ "UserSigValidity" SG_ 676 AVNT_NModeSel2_Custom1SetVal 3;
BA_ "Version" SG_ 676 AVNT_NModeSel2_Custom1SetVal "22.08.01";
BA_ "Description" SG_ 676 AVNT_NModeSel2_Custom2SetVal "Custom Mode 2 setting value in N Mode selection2 of N1/N2";
BA_ "GenSigSendType" SG_ 676 AVNT_NModeSel2_Custom2SetVal 4;
BA_ "UserSigValidity" SG_ 676 AVNT_NModeSel2_Custom2SetVal 3;
BA_ "Version" SG_ 676 AVNT_NModeSel2_Custom2SetVal "22.08.01";
BA_ "Description" SG_ 676 AVNT_NHndlSel2_SportSetVal "Sport mode setting value in N Handling selection2 of N1/N2";
BA_ "GenSigSendType" SG_ 676 AVNT_NHndlSel2_SportSetVal 4;
BA_ "UserSigValidity" SG_ 676 AVNT_NHndlSel2_SportSetVal 3;
BA_ "Version" SG_ 676 AVNT_NHndlSel2_SportSetVal "22.08.01";
BA_ "Description" SG_ 676 AVNT_NHndlSel2_TrackSetVal "Track mode setting value in N Handling selection2 of N1/N2";
BA_ "GenSigSendType" SG_ 676 AVNT_NHndlSel2_TrackSetVal 4;
BA_ "UserSigValidity" SG_ 676 AVNT_NHndlSel2_TrackSetVal 3;
BA_ "Version" SG_ 676 AVNT_NHndlSel2_TrackSetVal "22.08.01";
BA_ "Description" SG_ 676 AVNT_NHndlSel2_DriftSetVal "Drift mode setting value in N Handling selection2 of N1/N2";
BA_ "GenSigSendType" SG_ 676 AVNT_NHndlSel2_DriftSetVal 4;
BA_ "UserSigValidity" SG_ 676 AVNT_NHndlSel2_DriftSetVal 3;
BA_ "Version" SG_ 676 AVNT_NHndlSel2_DriftSetVal "22.08.01";
BA_ "Description" SG_ 676 AVNT_NHndlSel2_WetSetVal "Wet mode setting value in N Handling selection 2 of N1/N2";
BA_ "GenSigSendType" SG_ 676 AVNT_NHndlSel2_WetSetVal 4;
BA_ "UserSigValidity" SG_ 676 AVNT_NHndlSel2_WetSetVal 3;
BA_ "Version" SG_ 676 AVNT_NHndlSel2_WetSetVal "22.08.01";
BA_ "Description" SG_ 676 HU_DispThmSetStaMem "Display theme setting request (Memory).";
BA_ "GenSigSendType" SG_ 676 HU_DispThmSetStaMem 4;
BA_ "UserSigValidity" SG_ 676 HU_DispThmSetStaMem 0;
BA_ "Version" SG_ 676 HU_DispThmSetStaMem "23.08.03";
BA_ "Description" SG_ 676 HU_DispThmMemSta "HU Display Theme memory saving status (Memory 1/2/3).";
BA_ "GenSigSendType" SG_ 676 HU_DispThmMemSta 4;
BA_ "UserSigValidity" SG_ 676 HU_DispThmMemSta 0;
BA_ "Version" SG_ 676 HU_DispThmMemSta "23.08.03";
BA_ "Description" SG_ 676 AVNT_NModeSel_NSetVal "N mode setting value in N Mode selection of N1/N2";
BA_ "GenSigSendType" SG_ 676 AVNT_NModeSel_NSetVal 4;
BA_ "UserSigValidity" SG_ 676 AVNT_NModeSel_NSetVal 3;
BA_ "Version" SG_ 676 AVNT_NModeSel_NSetVal "22.07.05";
BA_ "Description" SG_ 676 AVNT_NModeSel_Custom1SetVal "Custom Mode 1 setting value in N Mode selection of N1/N2";
BA_ "GenSigSendType" SG_ 676 AVNT_NModeSel_Custom1SetVal 4;
BA_ "UserSigValidity" SG_ 676 AVNT_NModeSel_Custom1SetVal 3;
BA_ "Version" SG_ 676 AVNT_NModeSel_Custom1SetVal "22.07.05";
BA_ "Description" SG_ 676 AVNT_NModeSel_Custom2SetVal "Custom Mode 2 setting value in N Mode selection of N1/N2";
BA_ "GenSigSendType" SG_ 676 AVNT_NModeSel_Custom2SetVal 4;
BA_ "UserSigValidity" SG_ 676 AVNT_NModeSel_Custom2SetVal 3;
BA_ "Version" SG_ 676 AVNT_NModeSel_Custom2SetVal "22.07.05";
BA_ "Description" SG_ 676 AVNT_NHndlSel_SportSetVal "Sport mode setting value in N Handling selection of N1/N2";
BA_ "GenSigSendType" SG_ 676 AVNT_NHndlSel_SportSetVal 4;
BA_ "UserSigValidity" SG_ 676 AVNT_NHndlSel_SportSetVal 3;
BA_ "Version" SG_ 676 AVNT_NHndlSel_SportSetVal "22.07.05";
BA_ "GenSigSendType" SG_ 676 HD_SPS_ChannelNo 4;
BA_ "GenSigStartValue" SG_ 676 HD_SPS_ChannelNo 15;
BA_ "UserSigValidity" SG_ 676 HD_SPS_ChannelNo 1;
BA_ "NetworkRequest" SG_ 676 HD_SPS_ChannelNo 0;
BA_ "Version" SG_ 676 HD_SPS_ChannelNo "22.07.05";
BA_ "Description" SG_ 676 HU_CLU_BlueLightLvl "HU Bluelight filter level state: 0~9level";
BA_ "GenSigSendType" SG_ 676 HU_CLU_BlueLightLvl 4;
BA_ "GenSigStartValue" SG_ 676 HU_CLU_BlueLightLvl 15;
BA_ "UserSigValidity" SG_ 676 HU_CLU_BlueLightLvl 0;
BA_ "Version" SG_ 676 HU_CLU_BlueLightLvl "22.07.05";
BA_ "Description" SG_ 676 HU_CLU_BlueLightSta "HU Bluelight state: On/Off";
BA_ "GenSigSendType" SG_ 676 HU_CLU_BlueLightSta 4;
BA_ "UserSigValidity" SG_ 676 HU_CLU_BlueLightSta 0;
BA_ "Version" SG_ 676 HU_CLU_BlueLightSta "22.07.05";
BA_ "GenSigSendType" SG_ 676 SXM_ChannelNo 4;
BA_ "GenSigStartValue" SG_ 676 SXM_ChannelNo 1023;
BA_ "UserSigValidity" SG_ 676 SXM_ChannelNo 1;
BA_ "NetworkRequest" SG_ 676 SXM_ChannelNo 0;
BA_ "Version" SG_ 676 SXM_ChannelNo "22.07.05";
BA_ "Description" SG_ 676 HU_CLU_AlvCnt3Val "For the first transmission request for a data element the counter shall be initialized with 0 and shall be incremented by 1 for every subsequent send request. 

When the counter reaches the maximum value(0xFF), then it shall restart with 0 for the next s";
BA_ "GenSigSendType" SG_ 676 HU_CLU_AlvCnt3Val 4;
BA_ "UserSigValidity" SG_ 676 HU_CLU_AlvCnt3Val 3;
BA_ "Version" SG_ 676 HU_CLU_AlvCnt3Val "22.10.20";
BA_ "Description" SG_ 676 AVNT_N1setVal "N1 button setting value for N vehicles";
BA_ "GenSigSendType" SG_ 676 AVNT_N1setVal 4;
BA_ "UserSigValidity" SG_ 676 AVNT_N1setVal 3;
BA_ "Version" SG_ 676 AVNT_N1setVal "22.11.00";
BA_ "Description" SG_ 676 AVNT_N2setVal "N2 button setting value N vehicles";
BA_ "GenSigSendType" SG_ 676 AVNT_N2setVal 4;
BA_ "UserSigValidity" SG_ 676 AVNT_N2setVal 3;
BA_ "Version" SG_ 676 AVNT_N2setVal "22.11.00";
BA_ "Description" SG_ 676 AVNT_NHndlSel_TrackSetVal "Track mode setting value in N Handling selection of N1/N2";
BA_ "GenSigSendType" SG_ 676 AVNT_NHndlSel_TrackSetVal 4;
BA_ "UserSigValidity" SG_ 676 AVNT_NHndlSel_TrackSetVal 3;
BA_ "Version" SG_ 676 AVNT_NHndlSel_TrackSetVal "22.07.05";
BA_ "Description" SG_ 676 AVNT_NHndlSel_DriftSetVal "Drift mode setting value in N Handling selection of N1/N2";
BA_ "GenSigSendType" SG_ 676 AVNT_NHndlSel_DriftSetVal 4;
BA_ "UserSigValidity" SG_ 676 AVNT_NHndlSel_DriftSetVal 3;
BA_ "Version" SG_ 676 AVNT_NHndlSel_DriftSetVal "22.07.05";
BA_ "Description" SG_ 676 AVNT_NHndlSel_WetSetVal "Wet mode setting value in N Handling selection of N1/N2";
BA_ "GenSigSendType" SG_ 676 AVNT_NHndlSel_WetSetVal 4;
BA_ "UserSigValidity" SG_ 676 AVNT_NHndlSel_WetSetVal 3;
BA_ "Version" SG_ 676 AVNT_NHndlSel_WetSetVal "22.07.05";
BA_ "Description" SG_ 676 LapTimer_LapNumber_HU "Lap Number measured by AVNT";
BA_ "GenSigSendType" SG_ 676 LapTimer_LapNumber_HU 4;
BA_ "GenSigStartValue" SG_ 676 LapTimer_LapNumber_HU 127;
BA_ "UserSigValidity" SG_ 676 LapTimer_LapNumber_HU 3;
BA_ "Version" SG_ 676 LapTimer_LapNumber_HU "22.06.01";
BA_ "Description" SG_ 676 LapTimer_Hour_HU "Hour of laptime measured by AVNT";
BA_ "GenSigSendType" SG_ 676 LapTimer_Hour_HU 4;
BA_ "GenSigStartValue" SG_ 676 LapTimer_Hour_HU 127;
BA_ "UserSigValidity" SG_ 676 LapTimer_Hour_HU 3;
BA_ "Version" SG_ 676 LapTimer_Hour_HU "22.06.01";
BA_ "Description" SG_ 676 LapTimer_Minute_HU "Minute of laptime measured by AVNT";
BA_ "GenSigSendType" SG_ 676 LapTimer_Minute_HU 4;
BA_ "GenSigStartValue" SG_ 676 LapTimer_Minute_HU 63;
BA_ "UserSigValidity" SG_ 676 LapTimer_Minute_HU 3;
BA_ "Version" SG_ 676 LapTimer_Minute_HU "22.06.01";
BA_ "Description" SG_ 676 LapTimer_Second_HU "Second of laptime mesured by AVNT";
BA_ "GenSigSendType" SG_ 676 LapTimer_Second_HU 4;
BA_ "GenSigStartValue" SG_ 676 LapTimer_Second_HU 63;
BA_ "UserSigValidity" SG_ 676 LapTimer_Second_HU 3;
BA_ "Version" SG_ 676 LapTimer_Second_HU "22.06.01";
BA_ "Description" SG_ 676 LapTimer_milisecond_HU "Milisecond of laptime measured by AVNT";
BA_ "GenSigSendType" SG_ 676 LapTimer_milisecond_HU 4;
BA_ "GenSigStartValue" SG_ 676 LapTimer_milisecond_HU 127;
BA_ "UserSigValidity" SG_ 676 LapTimer_milisecond_HU 3;
BA_ "Version" SG_ 676 LapTimer_milisecond_HU "22.06.01";
BA_ "GenSigSendType" SG_ 676 LapTimer_CountStart 4;
BA_ "GenSigStartValue" SG_ 676 LapTimer_CountStart 3;
BA_ "UserSigValidity" SG_ 676 LapTimer_CountStart 3;
BA_ "Version" SG_ 676 LapTimer_CountStart "22.11.02";
BA_ "Description" SG_ 676 AVNT_NModeSel2_NSetVal "N mode setting value in N Mode selection 2 of N1/N2";
BA_ "GenSigSendType" SG_ 676 AVNT_NModeSel2_NSetVal 4;
BA_ "UserSigValidity" SG_ 676 AVNT_NModeSel2_NSetVal 3;
BA_ "Version" SG_ 676 AVNT_NModeSel2_NSetVal "22.08.01";
BA_REL_ "GenSigTimeoutTime" BU_SG_REL_ GW_PSU_3RD_FD SG_ 682 VCU_AirconCtrReq 1500;
BA_REL_ "GenSigTimeoutTime" BU_SG_REL_ GW_PSU_AST_FD SG_ 682 VCU_AirconCtrReq 1500;
BA_REL_ "GenSigTimeoutTime" BU_SG_REL_ GW_PSU_DRV_FD SG_ 682 VCU_AirconCtrReq 1500;
BA_REL_ "GenSigTimeoutTime" BU_SG_REL_ GW_PSU_RL_FD SG_ 682 VCU_AirconCtrReq 1500;
BA_REL_ "GenSigTimeoutTime" BU_SG_REL_ GW_PSU_RR_FD SG_ 682 VCU_AirconCtrReq 1500;
BA_REL_ "GenSigTimeoutTime" BU_SG_REL_ SHVU_3RD_FD SG_ 682 VCU_AirconCtrReq 1500;
BA_REL_ "GenSigTimeoutTime" BU_SG_REL_ SHVU_FRNT_FD SG_ 682 VCU_AirconCtrReq 1500;
BA_REL_ "GenSigTimeoutTime" BU_SG_REL_ SHVU_REAR_FD SG_ 682 VCU_AirconCtrReq 1500;
BA_REL_ "GenSigTimeoutTime" BU_SG_REL_ SHVU_RL_FD SG_ 682 VCU_AirconCtrReq 1500;
BA_REL_ "GenSigTimeoutTime" BU_SG_REL_ SHVU_RR_FD SG_ 682 VCU_AirconCtrReq 1500;
BA_REL_ "GenSigTimeoutTime" BU_SG_REL_ ATS_FD SG_ 682 VCU_UtilModeUsmSta 1500;
BA_REL_ "GenSigTimeoutTime" BU_SG_REL_ DCM_FD SG_ 682 VCU_UtilModeUsmSta 1500;
BA_REL_ "GenSigTimeoutTime" BU_SG_REL_ FCS_FD SG_ 682 VCU_UtilModeActSta 1500;
BA_REL_ "GenSigTimeoutTime" BU_SG_REL_ SGU_FD SG_ 682 VCU_UtilModeActSta 1500;
BA_REL_ "GenSigTimeoutTime" BU_SG_REL_ ATS_FD SG_ 682 VCU_UtilModeWarnMsgSta 1500;
BA_REL_ "GenSigTimeoutTime" BU_SG_REL_ BLTN_CAM_FD SG_ 682 VCU_NCstmNpdlLvlVal 1500;
BA_REL_ "GenSigTimeoutTime" BU_SG_REL_ BLTN_CAM_FD SG_ 1216 HU_Type 5000;
BA_REL_ "GenSigTimeoutTime" BU_SG_REL_ BLTN_CAM_FD SG_ 1216 HU_DistributeInfo 5000;
BA_REL_ "GenSigTimeoutTime" BU_SG_REL_ BLTN_CAM_FD SG_ 1216 HU_OptionInfo 5000;
BA_REL_ "GenSigTimeoutTime" BU_SG_REL_ GW_PSU_DRV_FD SG_ 1216 HU_OptionInfo 5000;
BA_REL_ "GenSigTimeoutTime" BU_SG_REL_ GW_SAU_DRV_FD SG_ 1216 HU_OptionInfo 5000;
BA_REL_ "GenSigTimeoutTime" BU_SG_REL_ RCM_FD SG_ 1216 HU_OptionInfo 5000;
BA_REL_ "GenSigTimeoutTime" BU_SG_REL_ RWPC_FD SG_ 1216 HU_OptionInfo 5000;
BA_REL_ "GenSigTimeoutTime" BU_SG_REL_ SCM_FD SG_ 1216 HU_OptionInfo 5000;
BA_REL_ "GenSigTimeoutTime" BU_SG_REL_ SGU_FD SG_ 1216 HU_OptionInfo 5000;
BA_REL_ "GenSigTimeoutTime" BU_SG_REL_ WPC2_FD SG_ 1216 HU_OptionInfo 5000;
BA_REL_ "GenSigTimeoutTime" BU_SG_REL_ WPC_FD SG_ 1216 HU_OptionInfo 5000;
BA_REL_ "GenSigTimeoutTime" BU_SG_REL_ CGW_CCU SG_ 955 BLTN_CAM_DEV_Count 1500;
BA_REL_ "GenSigTimeoutTime" BU_SG_REL_ CGW_CCU SG_ 955 HU_SSHFS_StrictHostKeyCheck1 1500;
BA_REL_ "GenSigTimeoutTime" BU_SG_REL_ CGW_CCU SG_ 955 BLTN_CAM_Pollution_Rear 1500;
BA_REL_ "GenSigTimeoutTime" BU_SG_REL_ CGW_CCU SG_ 955 BLTN_CAM_Pollution_Left 1500;
BA_REL_ "GenSigTimeoutTime" BU_SG_REL_ CGW_CCU SG_ 955 BLTN_CAM_Pollution_Right 1500;
BA_REL_ "GenSigTimeoutTime" BU_SG_REL_ CGW_CCU SG_ 955 BLTN_CAM_PMD_Count 1500;
BA_REL_ "GenSigTimeoutTime" BU_SG_REL_ CGW_CCU SG_ 955 BLTN_CAM_I2CMasterSta_Left 1500;
BA_REL_ "GenSigTimeoutTime" BU_SG_REL_ CGW_CCU SG_ 955 BLTN_CAM_I2CMasterSta_Right 1500;
BA_REL_ "GenSigTimeoutTime" BU_SG_REL_ CGW_CCU SG_ 955 BLTN_CAM_CamSta_Left 1500;
BA_REL_ "GenSigTimeoutTime" BU_SG_REL_ CGW_CCU SG_ 955 BLTN_CAM_CamSta_Right 1500;
BA_REL_ "GenSigTimeoutTime" BU_SG_REL_ CGW_CCU SG_ 955 BLTN_CAM_Set_Rear_Flip 1500;
BA_REL_ "GenSigTimeoutTime" BU_SG_REL_ CGW_CCU SG_ 955 MAR_SoftKeyEnable 1500;
BA_REL_ "GenSigTimeoutTime" BU_SG_REL_ CGW_CCU SG_ 955 TML_SoftKeyEnable 1500;
BA_REL_ "GenSigTimeoutTime" BU_SG_REL_ CGW_CCU SG_ 955 MAR_SoftKeySystemFailStatus 1500;
BA_REL_ "GenSigTimeoutTime" BU_SG_REL_ CGW_CCU SG_ 955 TML_SoftKeySystemFailStatus 1500;
BA_REL_ "GenSigTimeoutTime" BU_SG_REL_ CGW_CCU SG_ 955 BLTN_CAM_HU_UI_Mode 1500;
BA_REL_ "GenSigTimeoutTime" BU_SG_REL_ CGW_CCU SG_ 955 BLTN_CAM_Display 1500;
BA_REL_ "GenSigTimeoutTime" BU_SG_REL_ CGW_CCU SG_ 955 BLTN_CAM_WiFi_State 1500;
BA_REL_ "GenSigTimeoutTime" BU_SG_REL_ CGW_CCU SG_ 955 BLTN_CAM_SD_Format_Op_State 1500;
BA_REL_ "GenSigTimeoutTime" BU_SG_REL_ CGW_CCU SG_ 955 BLTN_CAM_PEV_Recorded 1500;
BA_REL_ "GenSigTimeoutTime" BU_SG_REL_ CGW_CCU SG_ 955 BLTN_CAM_PEV_Count 1500;
BA_REL_ "GenSigTimeoutTime" BU_SG_REL_ CGW_CCU SG_ 955 BLTN_CAM_Ind_Req 1500;
BA_REL_ "GenSigTimeoutTime" BU_SG_REL_ CGW_CCU SG_ 955 BLTN_CAM_LVDS_Mode_State 1500;
BA_REL_ "GenSigTimeoutTime" BU_SG_REL_ CGW_CCU SG_ 955 BLTN_CAM_PrkOp_Termiate_Info 1500;
BA_REL_ "GenSigTimeoutTime" BU_SG_REL_ CGW_CCU SG_ 955 BLTN_CAM_DEV_Recorded 1500;
BA_REL_ "GenSigTimeoutTime" BU_SG_REL_ ATS_FD SG_ 829 PwrDRClosingRRDrSta 1500;
BA_REL_ "GenSigTimeoutTime" BU_SG_REL_ ATS_FD SG_ 829 RR_DetectObj_warn 1500;
BA_REL_ "GenSigTimeoutTime" BU_SG_REL_ ATS_FD SG_ 829 RRRrDrCurtainPosition 1500;
BA_REL_ "GenSigTimeoutTime" BU_SG_REL_ ATS_FD SG_ 829 PwrDrSta_RrRt 1500;
BA_REL_ "GenSigTimeoutTime" BU_SG_REL_ ATS_FD SG_ 829 SBCM_RR_SlidePosition 1500;
BA_REL_ "GenSigTimeoutTime" BU_SG_REL_ ATS_FD SG_ 829 SBCM_RR_DoorAngle 1500;
BA_REL_ "GenSigTimeoutTime" BU_SG_REL_ BLTN_CAM_FD SG_ 829 RR_CrashUnlockCmd 1500;
BA_REL_ "GenSigTimeoutTime" BU_SG_REL_ ATS_FD SG_ 829 Warn_RrRtDrSwSta_SBCM 1500;
BA_REL_ "GenSigTimeoutTime" BU_SG_REL_ BLTN_CAM_FD SG_ 829 Warn_RrRtDrSwSta_SBCM 1500;
BA_REL_ "GenSigTimeoutTime" BU_SG_REL_ DCM_FD SG_ 829 Warn_RrRtDrSwSta_SBCM 1500;
BA_REL_ "GenSigTimeoutTime" BU_SG_REL_ GW_PSU_AST_FD SG_ 829 Warn_RrRtDrSwSta_SBCM 1500;
BA_REL_ "GenSigTimeoutTime" BU_SG_REL_ GW_PSU_RR_FD SG_ 829 Warn_RrRtDrSwSta_SBCM 1500;
BA_REL_ "GenSigTimeoutTime" BU_SG_REL_ PSB_FD SG_ 829 Warn_RrRtDrSwSta_SBCM 1500;
BA_REL_ "GenSigTimeoutTime" BU_SG_REL_ RWPC_FD SG_ 829 Warn_RrRtDrSwSta_SBCM 1500;
BA_REL_ "GenSigTimeoutTime" BU_SG_REL_ WPC2_FD SG_ 829 Warn_RrRtDrSwSta_SBCM 1500;
BA_REL_ "GenSigTimeoutTime" BU_SG_REL_ WPC_FD SG_ 829 Warn_RrRtDrSwSta_SBCM 1500;
BA_REL_ "GenSigTimeoutTime" BU_SG_REL_ ATS_FD SG_ 829 DoorLock_RrRtDrUnLkSta_SBCM 1500;
BA_REL_ "GenSigTimeoutTime" BU_SG_REL_ FCS_FD SG_ 829 DoorLock_RrRtDrUnLkSta_SBCM 1500;
BA_REL_ "GenSigTimeoutTime" BU_SG_REL_ ATS_FD SG_ 829 RR_SEAActivated 1500;
BA_REL_ "GenSigTimeoutTime" BU_SG_REL_ ATS_FD SG_ 829 RR_SEAWarn 1500;
BA_REL_ "GenSigTimeoutTime" BU_SG_REL_ ATS_FD SG_ 829 RR_SWFailAlarm 1500;
BA_REL_ "GenSigTimeoutTime" BU_SG_REL_ ATS_FD SG_ 829 RR_ChildLock_Status 1500;
BA_REL_ "GenSigTimeoutTime" BU_SG_REL_ RCM_FD SG_ 129 C_GlassCmdAVN 0;
BA_REL_ "GenSigTimeoutTime" BU_SG_REL_ BLTN_CAM_FD SG_ 129 HU_MasterProfile_ResetIndex 0;
BA_REL_ "GenSigTimeoutTime" BU_SG_REL_ GW_PSU_DRV_FD SG_ 129 HU_MasterProfile_ResetIndex 0;
BA_REL_ "GenSigTimeoutTime" BU_SG_REL_ GW_SAU_DRV_FD SG_ 129 HU_MasterProfile_ResetIndex 0;
BA_REL_ "GenSigTimeoutTime" BU_SG_REL_ RCM_FD SG_ 129 HU_MasterProfile_ResetIndex 0;
BA_REL_ "GenSigTimeoutTime" BU_SG_REL_ RWPC_FD SG_ 129 HU_MasterProfile_ResetIndex 0;
BA_REL_ "GenSigTimeoutTime" BU_SG_REL_ SCM_FD SG_ 129 HU_MasterProfile_ResetIndex 0;
BA_REL_ "GenSigTimeoutTime" BU_SG_REL_ SGU_FD SG_ 129 HU_MasterProfile_ResetIndex 0;
BA_REL_ "GenSigTimeoutTime" BU_SG_REL_ WPC2_FD SG_ 129 HU_MasterProfile_ResetIndex 0;
BA_REL_ "GenSigTimeoutTime" BU_SG_REL_ WPC_FD SG_ 129 HU_MasterProfile_ResetIndex 0;
BA_REL_ "GenSigTimeoutTime" BU_SG_REL_ RCM_FD SG_ 129 C_RrBlindCmdAVN 0;
BA_REL_ "GenSigTimeoutTime" BU_SG_REL_ RCM_FD SG_ 129 C_RrGlassCmdAVN 0;
BA_REL_ "GenSigTimeoutTime" BU_SG_REL_ RCM_FD SG_ 129 C_BlindCmdAVN 0;
BA_REL_ "GenSigTimeoutTime" BU_SG_REL_ ATS_FD SG_ 830 PwrDRClosingRLDrSta 1500;
BA_REL_ "GenSigTimeoutTime" BU_SG_REL_ ATS_FD SG_ 830 RL_DetectObj_warn 1500;
BA_REL_ "GenSigTimeoutTime" BU_SG_REL_ ATS_FD SG_ 830 RLRrDrCurtainPosition 1500;
BA_REL_ "GenSigTimeoutTime" BU_SG_REL_ ATS_FD SG_ 830 RDC_TypeOption 1500;
BA_REL_ "GenSigTimeoutTime" BU_SG_REL_ ATS_FD SG_ 830 PwrDrSta_RrLt 1500;
BA_REL_ "GenSigTimeoutTime" BU_SG_REL_ ATS_FD SG_ 830 SBCM_RL_SlidePosition 1500;
BA_REL_ "GenSigTimeoutTime" BU_SG_REL_ ATS_FD SG_ 830 SBCM_RL_DoorAngle 1500;
BA_REL_ "GenSigTimeoutTime" BU_SG_REL_ BLTN_CAM_FD SG_ 830 RL_CrashUnlockCmd 1500;
BA_REL_ "GenSigTimeoutTime" BU_SG_REL_ ATS_FD SG_ 830 Warn_RrLftDrSwSta_SBCM 1500;
BA_REL_ "GenSigTimeoutTime" BU_SG_REL_ BLTN_CAM_FD SG_ 830 Warn_RrLftDrSwSta_SBCM 1500;
BA_REL_ "GenSigTimeoutTime" BU_SG_REL_ DCM_FD SG_ 830 Warn_RrLftDrSwSta_SBCM 1500;
BA_REL_ "GenSigTimeoutTime" BU_SG_REL_ GW_PSU_AST_FD SG_ 830 Warn_RrLftDrSwSta_SBCM 1500;
BA_REL_ "GenSigTimeoutTime" BU_SG_REL_ PSB_FD SG_ 830 Warn_RrLftDrSwSta_SBCM 1500;
BA_REL_ "GenSigTimeoutTime" BU_SG_REL_ RWPC_FD SG_ 830 Warn_RrLftDrSwSta_SBCM 1500;
BA_REL_ "GenSigTimeoutTime" BU_SG_REL_ WPC2_FD SG_ 830 Warn_RrLftDrSwSta_SBCM 1500;
BA_REL_ "GenSigTimeoutTime" BU_SG_REL_ WPC_FD SG_ 830 Warn_RrLftDrSwSta_SBCM 1500;
BA_REL_ "GenSigTimeoutTime" BU_SG_REL_ ATS_FD SG_ 830 DoorLock_RrLftDrUnLkSta_SBCM 1500;
BA_REL_ "GenSigTimeoutTime" BU_SG_REL_ FCS_FD SG_ 830 DoorLock_RrLftDrUnLkSta_SBCM 1500;
BA_REL_ "GenSigTimeoutTime" BU_SG_REL_ ATS_FD SG_ 830 RL_SEAActivated 1500;
BA_REL_ "GenSigTimeoutTime" BU_SG_REL_ ATS_FD SG_ 830 RL_SEAWarn 1500;
BA_REL_ "GenSigTimeoutTime" BU_SG_REL_ ATS_FD SG_ 830 RL_SWFailAlarm 1500;
BA_REL_ "GenSigTimeoutTime" BU_SG_REL_ ATS_FD SG_ 830 RL_ChildLock_Status 1500;
BA_REL_ "GenSigTimeoutTime" BU_SG_REL_ BLTN_CAM_FD SG_ 676 LapTimer_LapNumber_HU 1500;
BA_REL_ "GenSigTimeoutTime" BU_SG_REL_ BLTN_CAM_FD SG_ 676 LapTimer_Hour_HU 1500;
BA_REL_ "GenSigTimeoutTime" BU_SG_REL_ BLTN_CAM_FD SG_ 676 LapTimer_Minute_HU 1500;
BA_REL_ "GenSigTimeoutTime" BU_SG_REL_ BLTN_CAM_FD SG_ 676 LapTimer_Second_HU 1500;
BA_REL_ "GenSigTimeoutTime" BU_SG_REL_ BLTN_CAM_FD SG_ 676 LapTimer_milisecond_HU 1500;
BA_REL_ "GenSigTimeoutTime" BU_SG_REL_ BLTN_CAM_FD SG_ 676 LapTimer_CountStart 700;
VAL_ 682 VCU_SchedChgSet_OpModeSta 0 "Manual Chg" 1 "Undefined" 2 "SchedChgPeakTimeUse" 3 "SchedChgPeakTimeOnly" ;
VAL_ 682 VCU_SchedChg_EnIndSta 0 "Reservation Not Set" 1 "Reservation Set" 2 "Not used" 3 "Error Indicator" ;
VAL_ 682 VCU_SchedChg_WaitIndSta 0 "None" 1 "Set" 2 "Not used" 3 "Error Indicator" ;
VAL_ 682 VCU_AcChgInhSta 0 "None" 1 "Set" 2 "Not used" 3 "Error Indicator" ;
VAL_ 682 VCU_ChgCancelReq 0 "None" 1 "Charge Cancel" 2 "Not used" 3 "Error Indicator" ;
VAL_ 682 VCU_SchedRmtFcn_MainRlyOnReq 0 "None" 1 "Main Relay On Request" 2 "Main Relay Off Request" 3 "Error Indicator" ;
VAL_ 682 VCU_SchedRmtFcn_OpSta 0 "None" 1 "Monitoring Mode(by AVN)" 2 "Normal Charge Mode(by OBC)" 3 "Prog/Imme Charge Start Mode(by VCU/AVN)" 4 "Prog FATC Mode(by VCU)" 5 "Imme FATC Mode during Prog/Imme Charge Mode(by VCU/AVN)" 6 "Prog/Imme Charge Mode during Imme FATC Mode(by VCU/AVN)" 7 "Imme FATC Mode during nor charge(by AVN/OBC)" 8 "Imme FATC Mode(by AVN)" 9 "Aux battery Charge Mode(by VCU)" 10 "Abnormal Stop Mode during Prog/Imme Charge(by VCU)" 11 "Reserved" 12 "Reserved" 13 "Reserved" 14 "Reserved" 15 "Reserved" ;
VAL_ 682 VCU_SchedClimateSet_EnSta 0 "None" 1 "Set" 2 "Not used" 3 "Error Indicator" ;
VAL_ 682 VCU_SchedClimateSet_DefrostEnSta 0 "Deactivate Defrost Mode" 1 "Activate Defrost Mode" 2 "Not used" 3 "Error Indicator" ;
VAL_ 682 VCU_AirconCtrReq 0 "Deativatie Remote Air Conditioner Control" 1 "Activate Remote Air Condtioner Control" 2 "Not used" 3 "Error Indicator" ;
VAL_ 682 VCU_SchedRmtClimate_OpSta 0 "Normal" 1 "Abnormal Stop by FATC" 2 "Abnormal Stop by VCU" 3 "Abnormal Stop by Others" ;
VAL_ 682 VCU_FatcDefrostCtrReq 0 "Deactivate Defrost Mode" 1 "Activate Defrost Mode" 2 "Not used" 3 "Error Indicator" ;
VAL_ 682 VCU_AuxBattChgVehCondi 0 "Invalide" 1 "Not Ready" 2 "Ready" 3 "Reserve" ;
VAL_ 682 VCU_BattCondHeatReq 0 "Off" 1 "On" 2 "Reserved" 3 "Reserved" ;
VAL_ 682 VCU_BattCondIndSta 0 "Off" 1 "Heating" 2 "Cooling" 3 "RESERVED" ;
VAL_ 682 VCU_SchedClimate_EnIndSta 0 "Reservation Not Set" 1 "Reservation Set" 2 "Not used" 3 "Error Indicator" ;
VAL_ 682 VCU_GpsSched_OpSta 0 "Off" 1 "(Func On)&(Out of Setting Area)" 2 "(Func On)&(Setting Area)" 3 "Invalid" ;
VAL_ 682 VCU_GpsSched_ChgClimateEnSta 0 "Not Use" 1 "Use" 2 "Not used" 3 "Error Indicator" ;
VAL_ 682 VCU_GpsSched_UpdateReq 0 "None" 1 "Request" 2 "Not used" 3 "Error Indicator" ;
VAL_ 682 VCU_ChgCycSta 0 "None" 1 "Charge Cycle" 2 "Not used" 3 "Error Indicator" ;
VAL_ 682 VCU_AvnWakeupReq 0 "None" 1 "Wake up" 2 "Not used" 3 "Error Indicator" ;
VAL_ 682 VCU_SchedRmtFcn_FailCfmSta 0 "Not Confirmed Prog/Imme Charge Failure Report" 1 "Confirmed Prog/Imme Charge Failure Report" ;
VAL_ 682 VCU_AirconFinishAlmSta 0 "None" 1 "Set" 2 "Not used" 3 "Error Indicator" ;
VAL_ 682 VCU_SchedClimateSet_TempUnitTyp 0 "Centigrade Mode" 1 "Fahrenheit Mode" 2 "Not used" 3 "Error Indicator" ;
VAL_ 682 VCU_SchedChg_StDayDispSta 0 "Sun" 1 "Mon" 2 "Tue" 3 "Wed" 4 "Thu" 5 "Fri" 6 "Sat" 7 "Invalid" ;
VAL_ 682 VCU_SchedChg_StHrDispVal 0 "0~23" 1 "0~23" 2 "0~23" 3 "0~23" 4 "0~23" 5 "0~23" 6 "0~23" 7 "0~23" 8 "0~23" 9 "0~23" 10 "0~23" 11 "0~23" 12 "0~23" 13 "0~23" 14 "0~23" 15 "0~23" 16 "0~23" 17 "0~23" 18 "0~23" 19 "0~23" 20 "0~23" 21 "0~23" 22 "0~23" 23 "0~23" 24 "Reserved" 25 "Reserved" 26 "Reserved" 27 "Reserved" 28 "Reserved" 29 "Reserved" 30 "Reserved" 31 "Invalid" ;
VAL_ 682 VCU_SchedChg_StMinDispVal 0 "0~59" 1 "0~59" 2 "0~59" 3 "0~59" 4 "0~59" 5 "0~59" 6 "0~59" 7 "0~59" 8 "0~59" 9 "0~59" 10 "0~59" 11 "0~59" 12 "0~59" 13 "0~59" 14 "0~59" 15 "0~59" 16 "0~59" 17 "0~59" 18 "0~59" 19 "0~59" 20 "0~59" 21 "0~59" 22 "0~59" 23 "0~59" 24 "0~59" 25 "0~59" 26 "0~59" 27 "0~59" 28 "0~59" 29 "0~59" 30 "0~59" 31 "0~59" 32 "0~59" 33 "0~59" 34 "0~59" 35 "0~59" 36 "0~59" 37 "0~59" 38 "0~59" 39 "0~59" 40 "0~59" 41 "0~59" 42 "0~59" 43 "0~59" 44 "0~59" 45 "0~59" 46 "0~59" 47 "0~59" 48 "0~59" 49 "0~59" 50 "0~59" 51 "0~59" 52 "0~59" 53 "0~59" 54 "0~59" 55 "0~59" 56 "0~59" 57 "0~59" 58 "0~59" 59 "0~59" 60 "Reserved" 61 "Reserved" 62 "Reserved" 63 "Invalid" ;
VAL_ 682 VCU_SchedChg_EndDayDispSta 0 "Sun" 1 "Mon" 2 "Tue" 3 "Wed" 4 "Thu" 5 "Fri" 6 "Sat" 7 "Invalid" ;
VAL_ 682 VCU_SchedChg_EndHrDispVal 0 "0~23" 1 "0~23" 2 "0~23" 3 "0~23" 4 "0~23" 5 "0~23" 6 "0~23" 7 "0~23" 8 "0~23" 9 "0~23" 10 "0~23" 11 "0~23" 12 "0~23" 13 "0~23" 14 "0~23" 15 "0~23" 16 "0~23" 17 "0~23" 18 "0~23" 19 "0~23" 20 "0~23" 21 "0~23" 22 "0~23" 23 "0~23" 24 "Reserved" 25 "Reserved" 26 "Reserved" 27 "Reserved" 28 "Reserved" 29 "Reserved" 30 "Reserved" 31 "Invalid" ;
VAL_ 682 VCU_SchedChg_EndMinDispVal 0 "0~59" 1 "0~59" 2 "0~59" 3 "0~59" 4 "0~59" 5 "0~59" 6 "0~59" 7 "0~59" 8 "0~59" 9 "0~59" 10 "0~59" 11 "0~59" 12 "0~59" 13 "0~59" 14 "0~59" 15 "0~59" 16 "0~59" 17 "0~59" 18 "0~59" 19 "0~59" 20 "0~59" 21 "0~59" 22 "0~59" 23 "0~59" 24 "0~59" 25 "0~59" 26 "0~59" 27 "0~59" 28 "0~59" 29 "0~59" 30 "0~59" 31 "0~59" 32 "0~59" 33 "0~59" 34 "0~59" 35 "0~59" 36 "0~59" 37 "0~59" 38 "0~59" 39 "0~59" 40 "0~59" 41 "0~59" 42 "0~59" 43 "0~59" 44 "0~59" 45 "0~59" 46 "0~59" 47 "0~59" 48 "0~59" 49 "0~59" 50 "0~59" 51 "0~59" 52 "0~59" 53 "0~59" 54 "0~59" 55 "0~59" 56 "0~59" 57 "0~59" 58 "0~59" 59 "0~59" 60 "Reserved" 61 "Reserved" 62 "Reserved" 63 "Inavlid" ;
VAL_ 682 VCU_AuxBattSavUsmSta 0 "Default" 1 "Disable" 2 "Enable" 3 "Invalid" ;
VAL_ 682 VCU_AuxBattSavWakeupSta 0 "None" 1 "Wake-up by Aux. Battery Charge" 2 "Not used" 3 "Error Indicator" ;
VAL_ 682 VCU_NCstmLaunchCtrlGripLvlMxVal 0 "Default" 1 "Level 1" 2 "Level 2" 3 "Level 3" 4 "Level 4" 5 "Level 5" 6 "Level 6" 7 "Invalid" ;
VAL_ 682 VCU_ChargeInfo 0 "None" 1 "ChargeCancelByChargeScheduleFinish" 2 "Reserved" 3 "ChargeCancelByTMUChargeCancel" 4 "ChargeCancelByBMSNormalChargeFinish" 5 "ChargeCancelByAirconParticleChargeStop" 6 "Invalid" 7 "Invalid" 8 "Invalid" 9 "Invalid" 10 "Invalid" 11 "Invalid" 12 "Invalid" 13 "Invalid" 14 "Invalid" 15 "Invalid" ;
VAL_ 682 VCU_RsRtcSchedDayVal 0 "Sun" 1 "Mon" 2 "Tue" 3 "Wed" 4 "Thu" 5 "Fri" 6 "Sat" 7 "Invalid" ;
VAL_ 682 VCU_RsRtcSchedHrVal 0 "0~23" 1 "0~23" 2 "0~23" 3 "0~23" 4 "0~23" 5 "0~23" 6 "0~23" 7 "0~23" 8 "0~23" 9 "0~23" 10 "0~23" 11 "0~23" 12 "0~23" 13 "0~23" 14 "0~23" 15 "0~23" 16 "0~23" 17 "0~23" 18 "0~23" 19 "0~23" 20 "0~23" 21 "0~23" 22 "0~23" 23 "0~23" 24 "Reserved" 25 "Reserved" 26 "Reserved" 27 "Reserved" 28 "Reserved" 29 "Reserved" 30 "Reserved" 31 "Invalid" ;
VAL_ 682 VCU_RsRtcSchedMinVal 0 "0~59" 1 "0~59" 2 "0~59" 3 "0~59" 4 "0~59" 5 "0~59" 6 "0~59" 7 "0~59" 8 "0~59" 9 "0~59" 10 "0~59" 11 "0~59" 12 "0~59" 13 "0~59" 14 "0~59" 15 "0~59" 16 "0~59" 17 "0~59" 18 "0~59" 19 "0~59" 20 "0~59" 21 "0~59" 22 "0~59" 23 "0~59" 24 "0~59" 25 "0~59" 26 "0~59" 27 "0~59" 28 "0~59" 29 "0~59" 30 "0~59" 31 "0~59" 32 "0~59" 33 "0~59" 34 "0~59" 35 "0~59" 36 "0~59" 37 "0~59" 38 "0~59" 39 "0~59" 40 "0~59" 41 "0~59" 42 "0~59" 43 "0~59" 44 "0~59" 45 "0~59" 46 "0~59" 47 "0~59" 48 "0~59" 49 "0~59" 50 "0~59" 51 "0~59" 52 "0~59" 53 "0~59" 54 "0~59" 55 "0~59" 56 "0~59" 57 "0~59" 58 "0~59" 59 "0~59" 60 "Reserved" 61 "Reserved" 62 "Reserved" 63 "Invalid" ;
VAL_ 682 VCU_Ig3DrvSta 0 "Off" 1 "On" 2 "Not used" 3 "Error Indicator" ;
VAL_ 682 VCU_UtilModeUsmSta 0 "Disable" 1 "Rest Mode Off" 2 "Rest Mode On" 3 "Invalid" ;
VAL_ 682 VCU_UtilModeActSta 0 "Off" 1 "On" 2 "Not used" 3 "Error Indicator" ;
VAL_ 682 VCU_UtilModeWarnMsgSta 0 "Default" 1 "Warn" 2 "Fail" 3 "Reserved" ;
VAL_ 682 VCU_Ig3OnlySta 0 "None" 1 "IG3 Only" 2 "Not used" 3 "Error Indicator" ;
VAL_ 682 VCU_BattCondApply 0 "Off" 1 "BatCond1G" 2 "BatCond2G" 3 "Invalid" ;
VAL_ 682 VCU_NCstmLaunchCtrlGripLvlVal 0 "Default" 1 "Road grip level 1" 2 "Road grip level 2" 3 "Road grip level 3" 4 "Road grip level 4" 5 "Road grip level 5" 6 "Road grip level 6" 7 "Invalid" ;
VAL_ 682 VCU_VgsShfIndledSta 0 "LED OFF" 1 "1st LED ON" 2 "1st, 2nd LEDs ON" 3 "1st~3rd LEDs ON" 4 "1st~4th LEDs ON" 5 "1st~5th LEDs ON" 6 "All LED blinking" 7 "Invalid" ;
VAL_ 682 VCU_DepartSet1_HrVal 0 "0~23" 1 "0~23" 2 "0~23" 3 "0~23" 4 "0~23" 5 "0~23" 6 "0~23" 7 "0~23" 8 "0~23" 9 "0~23" 10 "0~23" 11 "0~23" 12 "0~23" 13 "0~23" 14 "0~23" 15 "0~23" 16 "0~23" 17 "0~23" 18 "0~23" 19 "0~23" 20 "0~23" 21 "0~23" 22 "0~23" 23 "0~23" 24 "Reserved" 25 "Reserved" 26 "Reserved" 27 "Reserved" 28 "Reserved" 29 "Reserved" 30 "Reserved" 31 "Reserved" ;
VAL_ 682 VCU_MainRlyVehCondi 0 "Default" 1 "Ready" 2 "CAN timeout or Fault(VCMS, BMS, LDC, MCU)" 3 "High Voltage Interlock(MCU, BMS, DATC, OBC, VCMS, SDC)" 4 "Main relay off request from MCU(RMCU, FMCU)" 5 "not P" 6 "Hood Open" 7 "EV ready or start sequence" 8 "RESERVED" 9 "RESERVED" 10 "RESERVED" 11 "RESERVED" 12 "RESERVED" 13 "RESERVED" 14 "RESERVED" 15 "Invalid" ;
VAL_ 682 VCU_NCstmNdurRaceSta 0 "Default" 1 "Ndurance Race OFF" 2 "Ndurance Race ON" 3 "Invaild" ;
VAL_ 682 VCU_NCstmDriftDfctvSta 0 "Default" 1 "Drift Not Defective" 2 "Drift Defective" 3 "Invalid" ;
VAL_ 682 VCU_NCstmNpdlLvlVal 0 "Default" 1 "N pedal level 1" 2 "N pedal level 2" 3 "N pedal level 3" 4 "Invalid" ;
VAL_ 682 VCU_NCstmEKDUsmSta 0 "Default" 1 "EKD Ready" 2 "EKD Activation" 3 "Invalid" ;
VAL_ 682 VCU_NCstmLaunchCtrlSta 0 "Launch Control Unavailable" 1 "Launch Control Available" 2 "Launch Control Preparation" 3 "Launch Active" 4 "RESERVED" 5 "RESERVED" 6 "Fault" 7 "Invalid" ;
VAL_ 682 VCU_DepartSet1_MinVal 0 "Refer to Fomula" 1 "Refer to Fomula" 2 "Refer to Fomula" 3 "Refer to Fomula" 4 "Refer to Fomula" 5 "Refer to Fomula" 6 "Refer to Fomula" 7 "Refer to Fomula" ;
VAL_ 682 VCU_DepartSet2_HrVal 0 "0~23" 1 "0~23" 2 "0~23" 3 "0~23" 4 "0~23" 5 "0~23" 6 "0~23" 7 "0~23" 8 "0~23" 9 "0~23" 10 "0~23" 11 "0~23" 12 "0~23" 13 "0~23" 14 "0~23" 15 "0~23" 16 "0~23" 17 "0~23" 18 "0~23" 19 "0~23" 20 "0~23" 21 "0~23" 22 "0~23" 23 "0~23" 24 "Reserved" 25 "Reserved" 26 "Reserved" 27 "Reserved" 28 "Reserved" 29 "Reserved" 30 "Reserved" 31 "Reserved" ;
VAL_ 682 VCU_DepartSet2_MinVal 0 "Refer to Fomula" 1 "Refer to Fomula" 2 "Refer to Fomula" 3 "Refer to Fomula" 4 "Refer to Fomula" 5 "Refer to Fomula" 6 "Refer to Fomula" 7 "Refer to Fomula" ;
VAL_ 682 VCU_DepartSet1_Mon 0 "None" 1 "Set" 2 "Not used" 3 "Error Indicator" ;
VAL_ 682 VCU_DepartSet1_Tue 0 "None" 1 "Set" 2 "Not used" 3 "Error Indicator" ;
VAL_ 682 VCU_DepartSet1_Wed 0 "None" 1 "Set" 2 "Not used" 3 "Error Indicator" ;
VAL_ 682 VCU_DepartSet1_Thu 0 "None" 1 "Set" 2 "Not used" 3 "Error Indicator" ;
VAL_ 682 VCU_DepartSet1_EnSta 0 "None" 1 "Set" 2 "Not used" 3 "Error Indicator" ;
VAL_ 682 VCU_DepartSet1_Fri 0 "None" 1 "Set" 2 "Not used" 3 "Error Indicator" ;
VAL_ 682 VCU_DepartSet1_Sat 0 "None" 1 "Set" 2 "Not used" 3 "Error Indicator" ;
VAL_ 682 VCU_DepartSet1_Sun 0 "None" 1 "Set" 2 "Not used" 3 "Error Indicator" ;
VAL_ 682 VCU_DepartSet2_Mon 0 "None" 1 "Set" 2 "Not used" 3 "Error Indicator" ;
VAL_ 682 VCU_DepartSet2_Tue 0 "None" 1 "Set" 2 "Not used" 3 "Error Indicator" ;
VAL_ 682 VCU_DepartSet2_Wed 0 "None" 1 "Set" 2 "Not used" 3 "Error Indicator" ;
VAL_ 682 VCU_DepartSet2_Thu 0 "None" 1 "Set" 2 "Not used" 3 "Error Indicator" ;
VAL_ 682 VCU_DepartSet2_EnSta 0 "None" 1 "Set" 2 "Not used" 3 "Error Indicator" ;
VAL_ 682 VCU_DepartSet2_Fri 0 "None" 1 "Set" 2 "Not used" 3 "Error Indicator" ;
VAL_ 682 VCU_DepartSet2_Sat 0 "None" 1 "Set" 2 "Not used" 3 "Error Indicator" ;
VAL_ 682 VCU_DepartSet2_Sun 0 "None" 1 "Set" 2 "Not used" 3 "Error Indicator" ;
VAL_ 682 VCU_OffPeakTimeStHrVal 0 "0~23" 1 "0~23" 2 "0~23" 3 "0~23" 4 "0~23" 5 "0~23" 6 "0~23" 7 "0~23" 8 "0~23" 9 "0~23" 10 "0~23" 11 "0~23" 12 "0~23" 13 "0~23" 14 "0~23" 15 "0~23" 16 "0~23" 17 "0~23" 18 "0~23" 19 "0~23" 20 "0~23" 21 "0~23" 22 "0~23" 23 "0~23" 24 "Reserved" 25 "Reserved" 26 "Reserved" 27 "Reserved" 28 "Reserved" 29 "Reserved" 30 "Reserved" 31 "Reserved" ;
VAL_ 682 VCU_OffPeakTimeStMinVal 0 "Refer to Fomula" 1 "Refer to Fomula" 2 "Refer to Fomula" 3 "Refer to Fomula" 4 "Refer to Fomula" 5 "Refer to Fomula" 6 "Refer to Fomula" 7 "Refer to Fomula" ;
VAL_ 682 VCU_OffPeakTimeEndHrVal 0 "0~23" 1 "0~23" 2 "0~23" 3 "0~23" 4 "0~23" 5 "0~23" 6 "0~23" 7 "0~23" 8 "0~23" 9 "0~23" 10 "0~23" 11 "0~23" 12 "0~23" 13 "0~23" 14 "0~23" 15 "0~23" 16 "0~23" 17 "0~23" 18 "0~23" 19 "0~23" 20 "0~23" 21 "0~23" 22 "0~23" 23 "0~23" 24 "Reserved" 25 "Reserved" 26 "Reserved" 27 "Reserved" 28 "Reserved" 29 "Reserved" 30 "Reserved" 31 "Reserved" ;
VAL_ 682 VCU_OffPeakTimeEndMinVal 0 "Refer to Fomula" 1 "Refer to Fomula" 2 "Refer to Fomula" 3 "Refer to Fomula" 4 "Refer to Fomula" 5 "Refer to Fomula" 6 "Refer to Fomula" 7 "Refer to Fomula" ;
VAL_ 682 VCU_BattCondActStaDisp 0 "Default" 1 "WinterMode Activating" 2 "Preconditioning Activating" 3 "Activating Completed" 4 "Reserved" 5 "Reserved" 6 "Reserved" 7 "Invalid" ;
VAL_ 682 VCU_BattCondUsmSta 0 "Off" 1 "BatCond1G" 2 "BatCond2G" 3 "RESERVED" ;
VAL_ 682 VCU_FatcTempSetUnit 0 "Centigrade mode" 1 "Fahrenheit mode" 2 "Not used" 3 "Error indicator" ;
VAL_ 1216 HU_MON_Crc1Val 0 "0x0~0xFFFF:CRCValue" 65535 "0x0~0xFFFF:CRCValue" ;
VAL_ 1216 HU_NaviHandshakingSupport 0 "Not Support" 1 "Support" 2 "Unknown" 3 "Invalid" ;
VAL_ 1216 HU_AMP_EQVariant 0 "Default" 1 "WGN" 2 "WGN PHEV" 3 "5DR" 4 "SB" 5 "CUV" 6 "HEV" 7 "PHEV" 8 "EV" 9 "Reserved" 10 "Reserved" 11 "Reserved" 12 "Reserved" 13 "Reserved" 14 "Reserved" 15 "Reserved" 16 "Reserved" 17 "Reserved" 18 "Reserved" 19 "Reserved" 20 "Reserved" 21 "Reserved" 22 "Reserved" 23 "Reserved" 24 "Reserved" 25 "Reserved" 26 "Reserved" 27 "Reserved" 28 "Reserved" 29 "Reserved" 30 "Reserved" ;
VAL_ 1216 HU_AdasSupport 0 "Not Support" 1 "ADAS Support(General Map)" 2 "ADAS Support(Map based ADAS v1)" 3 "ADAS Support(Map based ADAS v2)" 4 "ADAS Support(Map based ADAS v2 & Handshaking)" 5 "ADAS Support(Map based ADAS v2_3)" 6 "RESERVED" 7 "Invalid" ;
VAL_ 1216 HU_MON_AlvCnt1Val 0 "0x0~0xFF:AlvCntValue" 255 "0x0~0xFF:AlvCntValue" ;
VAL_ 1216 HU_Type 0 "RESERVED" 1 "RESERVED" 2 "RESERVED" 3 "RESERVED" 4 "RESERVED" 5 "RESERVED" 6 "RESERVED" 7 "RESERVED" 8 "RESERVED" 9 "RESERVED" 10 "RESERVED" 11 "RESERVED" 12 "RESERVED" 13 "RESERVED" 14 "RESERVED" 15 "RESERVED" 16 "AVN(Tuner DVD KOR)" 17 "AVN(Tuner DVD EUR)" 18 "AVN(Tuner DVD China)" 19 "AVN(Tuner DVD Japan)" 20 "AVN(Tuner DVD EUR)" 21 "AVN(Tuner CDP KOR)" 22 "AVN(Tuner CDP EUR)" 23 "AVN(Tuner CDP China)" 24 "AVN(Tuner CDP Japan)" 25 "AVN(Tuner CDP EUR)" 26 "RESERVED" 27 "RESERVED" 28 "RESERVED" 29 "RESERVED" 30 "RESERVED" 31 "RESERVED" 32 "AVNT (Open)" 33 "AVNT (Not open)" 34 "RESERVED" 35 "RESERVED" 36 "RESERVED" 37 "RESERVED" 38 "RESERVED" 39 "RESERVED" 40 "RESERVED" 41 "RESERVED" 42 "RESERVED" 43 "RESERVED" 44 "RESERVED" 45 "RESERVED" 46 "RESERVED" 47 "RESERVED" 48 "Economic Audio" 49 "RESERVED" 50 "RESERVED" 51 "RESERVED" 52 "RESERVED" 53 "RESERVED" 54 "RESERVED" 55 "RESERVED" 56 "RESERVED" 57 "RESERVED" 58 "RESERVED" 59 "RESERVED" 60 "RESERVED" 61 "RESERVED" 62 "RESERVED" 63 "RESERVED" 64 "Standard Audio (3.0 below)" 65 "Standard Audio 4.0" 66 "STD Audio-3.0Below,No interwork" 67 "Audio 4.0 Value" 68 "RESERVED" 69 "RESERVED" 70 "RESERVED" 71 "RESERVED" 72 "RESERVED" 73 "RESERVED" 74 "RESERVED" 75 "RESERVED" 76 "RESERVED" 77 "RESERVED" 78 "RESERVED" 79 "RESERVED" 80 "AV(Tuner DVD KOR)" 81 "AV(Tuner DVD EUR)" 82 "AV(Tuner DVD China)" 83 "AV(Tuner DVD Japan)" 84 "AV(Tuner DVD EUR)" 85 "AV(Tuner CDP KOR)" 86 "AV(Tuner CDP EUR)" 87 "AV(Tuner CDP China)" 88 "AV(Tuner CDP Japan)" 89 "AV(Tuner CDP EUR)" 90 "RESERVED" 91 "RESERVED" 92 "RESERVED" 93 "RESERVED" 94 "RESERVED" 95 "RESERVED" 96 "AVN 4.0" 97 "Premium AVN2.0" 98 "EU AVN 2.0" 99 "Super Premium w Navi" 100 "Super Premium w_o Navi" 101 "Premium w Navi" 102 "Premium w_o Navi" 103 "Display Audio w_o Navi" 104 "Integrated AVN 1.0 Mobis" 105 "Gen5 Standard Nav Wide" 106 "RESERVED" 107 "RESERVED" 108 "RESERVED" 109 "RESERVED" 110 "RESERVED" 111 "RESERVED" 112 "Compact AVN & Integrated AVN 1.0 LG" 113 "RESERVED" 114 "RESERVED" 115 "RESERVED" 116 "RESERVED" 117 "RESERVED" 118 "RESERVED" 119 "RESERVED" 120 "RESERVED" 121 "RESERVED" 122 "RESERVED" 123 "RESERVED" 124 "RESERVED" 125 "RESERVED" 126 "RESERVED" 127 "RESERVED" 128 "Premium Navi 5th Gen(w_Navi)" 129 "Premium Navi 5th Gen(w_o Navi)" 130 "Premium Navi 6th Gen(w_Navi)" 131 "Premium Navi 6th Gen(w_o Navi)" 132 "ccNC(w Navi)" 133 "ccNC(w_o Navi)" 134 "ccIC(w Navi)" 135 "ccIC(w_o Navi)" 136 "RESERVED" 137 "RESERVED" 138 "RESERVED" 139 "RESERVED" 140 "RESERVED" 141 "RESERVED" 142 "RESERVED" 143 "RESERVED" 144 "P-OIP (w_Navi)" 145 "P-OIP (w_o Navi)" 146 "S-OIP (w_Navi)" 147 "S-OIP (w_o Navi)" 148 "PBV IVI (w_Navi)" 149 "PBV IVI (w_o Navi)" 150 "RESERVED" 151 "RESERVED" 152 "RESERVED" 153 "RESERVED" 154 "RESERVED" 155 "RESERVED" 156 "RESERVED" 157 "RESERVED" 158 "RESERVED" 159 "RESERVED" 160 "RESERVED" 161 "RESERVED" 162 "RESERVED" 163 "RESERVED" 164 "RESERVED" 165 "RESERVED" 166 "RESERVED" 167 "RESERVED" 168 "RESERVED" 169 "RESERVED" 170 "RESERVED" 171 "RESERVED" 172 "RESERVED" 173 "RESERVED" 174 "RESERVED" 175 "RESERVED" 176 "RESERVED" 177 "RESERVED" 178 "RESERVED" 179 "RESERVED" 180 "RESERVED" 181 "RESERVED" 182 "RESERVED" 183 "RESERVED" 184 "RESERVED" 185 "RESERVED" 186 "RESERVED" 187 "RESERVED" 188 "RESERVED" 189 "RESERVED" 190 "RESERVED" 191 "RESERVED" 192 "RESERVED" 193 "RESERVED" 194 "RESERVED" 195 "RESERVED" 196 "RESERVED" 197 "RESERVED" 198 "RESERVED" 199 "RESERVED" 200 "RESERVED" 201 "RESERVED" 202 "RESERVED" 203 "RESERVED" 204 "RESERVED" 205 "RESERVED" 206 "RESERVED" 207 "RESERVED" 208 "RESERVED" 209 "RESERVED" 210 "RESERVED" 211 "RESERVED" 212 "RESERVED" 213 "RESERVED" 214 "RESERVED" 215 "RESERVED" 216 "RESERVED" 217 "RESERVED" 218 "RESERVED" 219 "RESERVED" 220 "RESERVED" 221 "RESERVED" 222 "RESERVED" 223 "RESERVED" 224 "RESERVED" 225 "RESERVED" 226 "RESERVED" 227 "RESERVED" 228 "RESERVED" 229 "RESERVED" 230 "RESERVED" 231 "RESERVED" 232 "RESERVED" 233 "RESERVED" 234 "RESERVED" 235 "RESERVED" 236 "RESERVED" 237 "RESERVED" 238 "India PIO w_o CLU interface" 239 "India PIO w_CLU interface" 240 "RESERVED" 241 "Gen 1 China OEM Navigation" 242 "RESERVED" 243 "RESERVED" 244 "RESERVED" 245 "RESERVED" 246 "RESERVED" 247 "RESERVED" 248 "RESERVED" 249 "RESERVED" 250 "PIO AVN" 251 "China  Local OEM Display Audio" 252 "China OPIO w_o CLU interface" 253 "China OPIO w_CLU interface" 254 "China Local OEM AVNT" 255 "Invalid" ;
VAL_ 1216 HU_Navi_RspADASMapMsg 0 "0x0~0xFFFF:Refer to Signal Description" 65535 "0x0~0xFFFF:Refer to Signal Description" ;
VAL_ 1216 HU_DistributeInfo 0 "Default (Korea)" 1 "Korea" 2 "North America" 3 "Canada" 4 "East Europe" 5 "West Europe" 6 "China" 7 "India" 8 "Australia" 9 "Middle East" 10 "Africa" 11 "South America" 12 "Russia" 13 "Japan" 14 "General" 15 "0F~0xFE:RESERVED" 254 "0F~0xFE:RESERVED" 255 "Invalid" ;
VAL_ 1216 HU_OptionInfo 0 "0x0000~0x0FFF:Bit allocation" 4095 "0x0000~0x0FFF:Bit allocation" 4096 "1000~0x7FFF:RESERVED" 32767 "1000~0x7FFF:RESERVED" 32768 "Invalid" 32769 "8001~0xFFFF:Not used" 65535 "8001~0xFFFF:Not used" ;
VAL_ 955 BLTN_CAM_FD_HU_Crc1Val 0 "0x0~0xFFFF:CRCValue" 65535 "0x0~0xFFFF:CRCValue" ;
VAL_ 955 BLTN_CAM_DEV_Count 0 "0x0~0xC8:the number of the Drive Event Record(0~200)" 200 "0x0~0xC8:the number of the Drive Event Record(0~200)" 201 "RESERVED" 202 "RESERVED" 203 "RESERVED" 204 "RESERVED" 205 "RESERVED" 206 "RESERVED" 207 "RESERVED" 208 "RESERVED" 209 "RESERVED" 210 "RESERVED" 211 "RESERVED" 212 "RESERVED" 213 "RESERVED" 214 "RESERVED" 215 "RESERVED" 216 "RESERVED" 217 "RESERVED" 218 "RESERVED" 219 "RESERVED" 220 "RESERVED" 221 "RESERVED" 222 "RESERVED" 223 "RESERVED" 224 "RESERVED" 225 "RESERVED" 226 "RESERVED" 227 "RESERVED" 228 "RESERVED" 229 "RESERVED" 230 "RESERVED" 231 "RESERVED" 232 "RESERVED" 233 "RESERVED" 234 "RESERVED" 235 "RESERVED" 236 "RESERVED" 237 "RESERVED" 238 "RESERVED" 239 "RESERVED" 240 "RESERVED" 241 "RESERVED" 242 "RESERVED" 243 "RESERVED" 244 "RESERVED" 245 "RESERVED" 246 "RESERVED" 247 "RESERVED" 248 "RESERVED" 249 "RESERVED" 250 "RESERVED" 251 "RESERVED" 252 "RESERVED" 254 "the drive event record is not recordable" 255 "Invalid" ;
VAL_ 955 HU_SSHFS_StrictHostKeyCheck1 0 "Default(None)" 1 "One-Way" 2 "Mutual" 3 "Invalid" ;
VAL_ 955 BLTN_CAM_Pollution_Rear 0 "Default" 1 "No pollution" 2 "Pollution detected" 3 "Invalid" ;
VAL_ 955 BLTN_CAM_Pollution_Left 0 "Default" 1 "No pollution" 2 "Pollution detected" 3 "Invalid" ;
VAL_ 955 BLTN_CAM_Pollution_Right 0 "Default" 1 "No pollution" 2 "Pollution detected" 3 "Invalid" ;
VAL_ 955 BLTN_CAM_FD_HU_AlvCnt1Val 0 "0x0~0xFF:AlvCntValue" 255 "0x0~0xFF:AlvCntValue" ;
VAL_ 955 BLTN_CAM_PMD_Count 0 "0x0~0xC8:the number of the Park Event Record(0~200) in condition of set to PMD On" 200 "0x0~0xC8:the number of the Park Event Record(0~200) in condition of set to PMD On" 201 "RESERVED" 202 "RESERVED" 203 "RESERVED" 204 "RESERVED" 205 "RESERVED" 206 "RESERVED" 207 "RESERVED" 208 "RESERVED" 209 "RESERVED" 210 "RESERVED" 211 "RESERVED" 212 "RESERVED" 213 "RESERVED" 214 "RESERVED" 215 "RESERVED" 216 "RESERVED" 217 "RESERVED" 218 "RESERVED" 219 "RESERVED" 220 "RESERVED" 221 "RESERVED" 222 "RESERVED" 223 "RESERVED" 224 "RESERVED" 225 "RESERVED" 226 "RESERVED" 227 "RESERVED" 228 "RESERVED" 229 "RESERVED" 230 "RESERVED" 231 "RESERVED" 232 "RESERVED" 233 "RESERVED" 234 "RESERVED" 235 "RESERVED" 236 "RESERVED" 237 "RESERVED" 238 "RESERVED" 239 "RESERVED" 240 "RESERVED" 241 "RESERVED" 242 "RESERVED" 243 "RESERVED" 244 "RESERVED" 245 "RESERVED" 246 "RESERVED" 247 "RESERVED" 248 "RESERVED" 249 "RESERVED" 250 "RESERVED" 251 "RESERVED" 252 "RESERVED" 253 "Over than 200 count" 254 "PMD is not set" 255 "Invalid" ;
VAL_ 955 BLTN_CAM_I2CMasterSta_Left 0 "Default" 1 "BLTN_CAM has control over I2C channel" 2 "ADAS_PRK has control over I2C channel" 3 "Invalid" ;
VAL_ 955 BLTN_CAM_I2CMasterSta_Right 0 "Default" 1 "BLTN_CAM has control over I2C channel" 2 "ADAS_PRK has control over I2C channel" 3 "Invalid" ;
VAL_ 955 BLTN_CAM_CamSta_Left 0 "Default & Reset" 1 "Normal (Recording)" 2 "Normal (Non-recording)" 3 "Not configured" 4 "SerDes config failed" 5 "Power issue" 6 "V-sync issue" 7 "SerDes lock issue" 8 "RESERVED" 9 "RESERVED" 10 "RESERVED" 11 "RESERVED" 12 "RESERVED" 13 "RESERVED" 14 "RESERVED" 15 "Invalid" ;
VAL_ 955 BLTN_CAM_CamSta_Right 0 "Default & Reset" 1 "Normal (Recording)" 2 "Normal (Non-recording)" 3 "Not configured" 4 "SerDes config failed" 5 "Power issue" 6 "V-sync issue" 7 "SerDes lock issue" 8 "RESERVED" 9 "RESERVED" 10 "RESERVED" 11 "RESERVED" 12 "RESERVED" 13 "RESERVED" 14 "RESERVED" 15 "Invalid" ;
VAL_ 955 BLTN_CAM_Set_Rear_Flip 0 "Default" 1 "Off" 2 "On" 3 "Invalid" ;
VAL_ 955 MAR_SoftKeyEnable 0 "Enable" 1 "Disable" 2 "RESERVED" 3 "RESERVED" 4 "RESERVED" 5 "RESERVED" 6 "RESERVED" 7 "RESERVED" 8 "RESERVED" 9 "RESERVED" 10 "RESERVED" 11 "RESERVED" 12 "RESERVED" 13 "RESERVED" 14 "RESERVED" 15 "Error Indicator" ;
VAL_ 955 TML_SoftKeyEnable 0 "Enable" 1 "Disable" 2 "RESERVED" 3 "RESERVED" 4 "RESERVED" 5 "RESERVED" 6 "RESERVED" 7 "RESERVED" 8 "RESERVED" 9 "RESERVED" 10 "RESERVED" 11 "RESERVED" 12 "RESERVED" 13 "RESERVED" 14 "RESERVED" 15 "Error Indicator" ;
VAL_ 955 MAR_SoftKeySystemFailStatus 0 "Normal" 1 "System Fail" 2 "RESERVED" 3 "RESERVED" 4 "RESERVED" 5 "RESERVED" 6 "RESERVED" 7 "RESERVED" 8 "RESERVED" 9 "RESERVED" 10 "RESERVED" 11 "RESERVED" 12 "RESERVED" 13 "RESERVED" 14 "RESERVED" 15 "Invalid Error Indicator" ;
VAL_ 955 TML_SoftKeySystemFailStatus 0 "Normal" 1 "System Fail" 2 "RESERVED" 3 "RESERVED" 4 "RESERVED" 5 "RESERVED" 6 "RESERVED" 7 "RESERVED" 8 "RESERVED" 9 "RESERVED" 10 "RESERVED" 11 "RESERVED" 12 "RESERVED" 13 "RESERVED" 14 "RESERVED" 15 "Error Indicator" ;
VAL_ 955 BLTN_CAM_HU_UI_Mode 0 "HU UI mode." 1 "BLTN_CAM mode" 2 "Preparing BLTN_CAM Mode" 3 "BLTN_CAM Setting Mode" 4 "BLTN_CAM Performance Recorder Mode" 5 "RESERVED" 6 "RESERVED" 7 "RESERVED" 8 "RESERVED" 9 "RESERVED" 10 "RESERVED" 11 "RESERVED" 12 "RESERVED" 13 "BLTN_CAM Not Ready to be HU UI Mode" 14 "BLTN_CAM is in Error mode." 15 "Invalid" ;
VAL_ 955 BLTN_CAM_Display 0 "HU mode" 1 "Built-in Cam mode" 2 "popup mode" 3 "Built-in Cam mode Terminate Request by Home-button" 4 "Built-in Cam mode Terminate Request by Back-button" 5 "Built-in Cam update mode" 6 "Ready to update" 7 "Update complete" 8 "USB removed" 9 "Update fail (USB error)" 10 "Reserved" 11 "Reserved" 12 "Reserved" 13 "Reserved" 14 "Built-in Cam is in error mode" 15 "Invalid" ;
VAL_ 955 BLTN_CAM_WiFi_State 0 "Off" 1 "On, Ready to Connect Mobile Phone." 2 "On, Mobile Phone Connected." 3 "Off - Password is not Set." 4 "Reserved" 5 "Reserved" 6 "Reserved" 7 "Reserved" 8 "Reserved" 9 "Reserved" 10 "Reserved" 11 "Reserved" 12 "Reserved" 13 "Reserved" 14 "Reserved" 15 "invalid" ;
VAL_ 955 BLTN_CAM_SD_Format_Op_State 0 "Default" 1 "Formatting" 2 "Format Complete." 3 "invalid" ;
VAL_ 955 BLTN_CAM_PEV_Recorded 0 "Default" 1 "Off" 2 "Park Event Recorded" 3 "invalid" ;
VAL_ 955 BLTN_CAM_PEV_Count 0 "0x0~0xC8:the number of the Park Event Record(0~200)" 200 "0x0~0xC8:the number of the Park Event Record(0~200)" 201 "Reserved" 202 "Reserved" 203 "Reserved" 204 "Reserved" 205 "Reserved" 206 "Reserved" 207 "Reserved" 208 "Reserved" 209 "Reserved" 210 "Reserved" 211 "Reserved" 212 "Reserved" 213 "Reserved" 214 "Reserved" 215 "Reserved" 216 "Reserved" 217 "Reserved" 218 "Reserved" 219 "Reserved" 220 "Reserved" 221 "Reserved" 222 "Reserved" 223 "Reserved" 224 "Reserved" 225 "Reserved" 226 "Reserved" 227 "Reserved" 228 "Reserved" 229 "Reserved" 230 "Reserved" 231 "Reserved" 232 "Reserved" 233 "Reserved" 234 "Reserved" 235 "Reserved" 236 "Reserved" 237 "Reserved" 238 "Reserved" 239 "Reserved" 240 "Reserved" 241 "Reserved" 242 "Reserved" 243 "Reserved" 244 "Reserved" 245 "Reserved" 246 "Reserved" 247 "Reserved" 248 "Reserved" 249 "Reserved" 250 "Reserved" 251 "Reserved" 252 "Reserved" 253 "Over than 200 count" 254 "the park event record is not recorded" 255 "invalid" ;
VAL_ 955 BLTN_CAM_Ind_Req 0 "Default" 1 "Built-in Cam System or Camera Error" 2 "Manual Recording or Event Recording" 3 "Time-lapse Recording" 4 "Built-in Cam SD Card Replace Warning or SD Card Error" 5 "On while Driving Recording" 6 "On while Parked Recording" 7 "Smartphone Connected" 9 "RESERVED" 10 "RESERVED" 11 "RESERVED" 12 "RESERVED" 13 "RESERVED" 14 "RESERVED" 15 "RESERVED" 16 "RESERVED" 17 "RESERVED" 18 "RESERVED" 19 "RESERVED" 20 "RESERVED" 21 "RESERVED" 22 "RESERVED" 23 "RESERVED" 24 "RESERVED" 25 "RESERVED" 26 "RESERVED" 27 "RESERVED" 28 "RESERVED" 29 "RESERVED" 30 "RESERVED" 31 "Invalid" 8 "Built-inCAM Performance Recording" ;
VAL_ 955 BLTN_CAM_LVDS_Mode_State 0 "Front and Rear Camera" 1 "Front Camera for AR Navi." 2 "Built-In Cam Engineer Mode" 3 "Reserved" ;
VAL_ 955 BLTN_CAM_PrkOp_Termiate_Info 0 "Default" 1 "Park operation terminated earlier than user set because of Bat. SoC" 2 "Park operation terminated earlier than user set because of SD Card Problem" 3 "Park operation terminated earlier than user set because of Built-in Cam internal Error" 4 "Park operation terminated earlier than user set because of SD Card removed or not detected" 5 "Park operation started because of SD Card inserted" 6 "Park operation terminate on time which user set." 7 "Invalid" ;
VAL_ 955 BLTN_CAM_DEV_Recorded 0 "Default" 1 "Off" 2 "Drive Event Recorded" 3 "Invalid" ;
VAL_ 829 SBCM_RR_FD_Crc1Val 0 "0x0~0xFFFF:CRCValue" 65535 "0x0~0xFFFF:CRCValue" ;
VAL_ 829 USM_RRGhostDoorSta 0 "Default" 1 "Off" 2 "On" 3 "RESERVED" ;
VAL_ 829 DoorLock_PDSLkSwSta_RR 0 "Lock" 1 "Unlock" 2 "RESERVED" 3 "Error Indicator" ;
VAL_ 829 PDS_TypeOption_RR 0 "Off" 1 "On" 2 "RESERVED" 3 "Error Indicator" ;
VAL_ 829 RR_CrashMRActAlarm 0 "Off" 1 "On" 2 "RESERVED" 3 "Error Indicator" ;
VAL_ 829 PwrDRBuzzerOut_RR 0 "OFF" 1 "Open" 2 "Close" 3 "Warning" ;
VAL_ 829 PwrDRClosingRRDrSta 0 "Default" 1 "Close" 2 "Open" 3 "Stop(during Close)" 4 "Stop(during Open)" 5 "RESERVED" 6 "RESERVED" 7 "Invalid" ;
VAL_ 829 AFH_RR_FldUnfldSta 0 "Invalid" 1 "Fold" 2 "Unfold" 3 "Inprogress" ;
VAL_ 829 SBCM_RR_FD_AlvCnt1Val 0 "0x0~0xFF:AlvCntValue" 255 "0x0~0xFF:AlvCntValue" ;
VAL_ 829 DoorLock_RrRtLkOutSta_SBCM 0 "Off" 1 "On" 2 "Not Used" 3 "Error Indicator" ;
VAL_ 829 RrRt_DrLkRetryFail_SBCM 0 "Normal" 1 "Fail" 2 "RESERVED" 3 "RESERVED" ;
VAL_ 829 RR_DetectObj_warn 0 "Detect Warning OFF" 1 "Detect Warning ON" 2 "RESERVED" 3 "RESERVED" ;
VAL_ 829 RRRrDrCurtainPosition 0 "Unkown" 1 "Bottom" 2 "Mid" 3 "Top" ;
VAL_ 829 RRRrDrCurtainDownInitState 0 "Decalibrated" 1 "Calibrated" 2 "RESERVED" 3 "Error Indicator" ;
VAL_ 829 PwrDrSta_RrRt 0 "Unavailable" 1 "Available" 2 "RESERVED" 3 "Error Indicator" ;
VAL_ 829 PwrDRBuzzerOut_RR_New 0 "OFF" 1 "Open" 2 "Close" 3 "Warning1" 4 "Warning2" ;
VAL_ 829 VAPI_RRDrLkUnLkInsdSwEn_Get 0 "Default" 1 "Disable" 2 "Enable" ;
VAL_ 829 SBCM_RR_SlidePosition 0 "0x0~0x64:0% - 100%" 100 "0x0~0x64:0% - 100%" 101 "65~0xFE:RESERVED" 254 "65~0xFE:RESERVED" 255 "Unknown" ;
VAL_ 829 SBCM_RR_DoorAngle 0 "0° - 90°" 1 "0° - 90°" 2 "0° - 90°" 3 "0° - 90°" 4 "0° - 90°" 5 "0° - 90°" 6 "0° - 90°" 7 "0° - 90°" 8 "0° - 90°" 9 "0° - 90°" 10 "0° - 90°" 11 "0° - 90°" 12 "0° - 90°" 13 "0° - 90°" 14 "0° - 90°" 15 "0° - 90°" 16 "0° - 90°" 17 "0° - 90°" 18 "0° - 90°" 19 "0° - 90°" 20 "0° - 90°" 21 "0° - 90°" 22 "0° - 90°" 23 "0° - 90°" 24 "0° - 90°" 25 "0° - 90°" 26 "0° - 90°" 27 "0° - 90°" 28 "0° - 90°" 29 "0° - 90°" 30 "0° - 90°" 31 "0° - 90°" 32 "0° - 90°" 33 "0° - 90°" 34 "0° - 90°" 35 "0° - 90°" 36 "0° - 90°" 37 "0° - 90°" 38 "0° - 90°" 39 "0° - 90°" 40 "0° - 90°" 41 "0° - 90°" 42 "0° - 90°" 43 "0° - 90°" 44 "0° - 90°" 45 "0° - 90°" 46 "0° - 90°" 47 "0° - 90°" 48 "0° - 90°" 49 "0° - 90°" 50 "0° - 90°" 51 "0° - 90°" 52 "0° - 90°" 53 "0° - 90°" 54 "0° - 90°" 55 "0° - 90°" 56 "0° - 90°" 57 "0° - 90°" 58 "0° - 90°" 59 "0° - 90°" 60 "0° - 90°" 61 "0° - 90°" 62 "0° - 90°" 63 "0° - 90°" 64 "0° - 90°" 65 "0° - 90°" 66 "0° - 90°" 67 "0° - 90°" 68 "0° - 90°" 69 "0° - 90°" 70 "0° - 90°" 71 "0° - 90°" 72 "0° - 90°" 73 "0° - 90°" 74 "0° - 90°" 75 "0° - 90°" 76 "0° - 90°" 77 "0° - 90°" 78 "0° - 90°" 79 "0° - 90°" 80 "0° - 90°" 81 "0° - 90°" 82 "0° - 90°" 83 "0° - 90°" 84 "0° - 90°" 85 "0° - 90°" 86 "0° - 90°" 87 "0° - 90°" 88 "0° - 90°" 89 "0° - 90°" 90 "0° - 90°" 91 "Invalid" 92 "Invalid" 93 "Invalid" 94 "Invalid" 95 "Invalid" 96 "Invalid" 97 "Invalid" 98 "Invalid" 99 "Invalid" 100 "Unknown" 101 "Invalid" 102 "Invalid" 103 "Invalid" 104 "Invalid" 105 "Invalid" 106 "Invalid" 107 "Invalid" 108 "Invalid" 109 "Invalid" 110 "Invalid" 111 "Invalid" 112 "Invalid" 113 "Invalid" 114 "Invalid" 115 "Invalid" 116 "Invalid" 117 "Invalid" 118 "Invalid" 119 "Invalid" 120 "Invalid" 121 "Invalid" 122 "Invalid" 123 "Invalid" 124 "Invalid" 125 "Invalid" 126 "Invalid" 127 "Invalid" ;
VAL_ 829 RRDoorPushAlarm 0 "Off" 1 "On" 2 "RESERVED" 3 "Error Indicator" ;
VAL_ 829 RR_CrashUnlockCmd 0 "Off" 1 "Unlock (Crash)" ;
VAL_ 829 Warn_RrRtDrSwSta_SBCM 0 "Close" 1 "Open" 2 "RESERVED" 3 "Error Indicator" ;
VAL_ 829 DoorLock_RrRtDrUnLkSta_SBCM 0 "Lock" 1 "Unlock" 2 "RESERVED" 3 "Error Indicator" ;
VAL_ 829 RR_SEAActivated 0 "InActivated" 1 "Activated" 2 "RESERVED" 3 "Error Indicator" ;
VAL_ 829 RR_SEAWarn 0 "SEA Right Warning OFF" 1 "SEA Right Warning ON" 2 "RESERVED" 3 "RESERVED" ;
VAL_ 829 RR_SEWWarn 0 "SEW Right Warning OFF" 1 "SEW Right Warning ON" 2 "RESERVED" 3 "RESERVED" ;
VAL_ 829 RR_ReleaseWarn 0 "Release Warning OFF" 1 "Release Warning ON" 2 "RESERVED" 3 "RESERVED" ;
VAL_ 829 RR_SWFailAlarm 0 "Off" 1 "On" 2 "RESERVED" 3 "Error Indicator" ;
VAL_ 829 RR_ChildLock_ActnFlSta 0 "OK" 1 "Failed" 2 "RESERVED" 3 "Error Indicator" ;
VAL_ 829 RR_MRActivationAlarm 0 "Off" 1 "On" 2 "RESERVED" 3 "Error Indicator" ;
VAL_ 829 RR_ChildLock_Status 0 "ChildLock On" 1 "ChildLock Off" 2 "RESERVED" 3 "RESERVED" ;
VAL_ 129 HU_CNTL_Crc1Val 0 "0x0~0xFFFF:CRCValue" 65535 "0x0~0xFFFF:CRCValue" ;
VAL_ 129 C_GlassCmdAVN 0 "No Action" 1 "Glass Auto Open" 2 "Glass Auto Close" 3 "Glass Auto Tilt Up" 4 "Stop" 5 "reserved" 6 "reserved" 7 "Invalid" ;
VAL_ 129 HU_CNTL_AlvCnt1Val 0 "0x0~0xFF:AlvCntValue" 255 "0x0~0xFF:AlvCntValue" ;
VAL_ 129 HU_MasterProfile_ResetIndex 0 "Default" 1 "Guest" 2 "Profile 1" 3 "Profile 2" 4 "Profile 3" 5 "Profile 4" 6 "Profile 5" 7 "Profile 6" 8 "Profile 7" 9 "Profile 8" 10 "Profile 9" 11 "RESERVED" 12 "RESERVED" 13 "RESERVED" 14 "RESERVED" 15 "Invalid" ;
VAL_ 129 C_AstWindowCmdAVN 0 "No action" 1 "Manual Down" 2 "Manual Up" 3 "25% Open" 4 "50%Open" 5 "Auto Down" 6 "Auto Up" 7 "15% Open" 8 "Unused" 9 "Unused" 10 "Unused" 11 "Unused" 12 "Unused" 13 "Unused" 14 "Unused" 15 "Invalid" ;
VAL_ 129 C_DrvWindowCmdAVN 0 "No action" 1 "Manual Down" 2 "Manual Up" 3 "25% Open" 4 "50% Open" 5 "Auto Down" 6 "Auto Up" 7 "15% Open" 8 "Unused" 9 "Unused" 10 "Unused" 11 "Unused" 12 "Unused" 13 "Unused" 14 "Unused" 15 "Invalid" ;
VAL_ 129 C_PTGCNTLCmdAVN 0 "Close" 1 "Open" 2 "Reserved" 3 "Invalid" ;
VAL_ 129 C_RrDefoggerCmdAVN 0 "Off" 1 "On" 2 "Reserved" 3 "Invalid" ;
VAL_ 129 C_RrBlindCmdAVN 0 "No Action" 1 "Blind Auto Open" 2 "Blind Auto Close" 3 "Invalid" ;
VAL_ 129 C_RrGlassCmdAVN 0 "No Action" 1 "Glass Auto Open" 2 "Glass Auto Close" 3 "Invalid" ;
VAL_ 129 C_RRWindowCmdAVN 0 "No action" 1 "Manual Down" 2 "Manual Up" 3 "25% Open" 4 "50% Open" 5 "Auto Down" 6 "Auto Up" 7 "15% Open" 8 "Unused" 9 "Unused" 10 "Unused" 11 "Unused" 12 "Unused" 13 "Unused" 14 "Unused" 15 "Invalid" ;
VAL_ 129 C_RLWindowCmdAVN 0 "No action" 1 "Manual Down" 2 "Manual Up" 3 "25% Open" 4 "50% Open" 5 "Auto Down" 6 "Auto UP" 7 "15% Open" 8 "Unused" 9 "Unused" 10 "Unused" 11 "Unused" 12 "Unused" 13 "Unused" 14 "Unused" 15 "Invalid" ;
VAL_ 129 C_BlindCmdAVN 0 "No Action" 1 "R_Blind Auto Open" 2 "R_Blind Auto Close" 3 "Stop" 4 "reserved" 5 "reserved" 6 "reserved" 7 "Invalid" ;
VAL_ 830 SBCM_RL_FD_Crc1Val 0 "0x0~0xFFFF:CRCValue" 65535 "0x0~0xFFFF:CRCValue" ;
VAL_ 830 USM_RLGhostDoorSta 0 "Default" 1 "Off" 2 "On" 3 "RESERVED" ;
VAL_ 830 DoorLock_PDSLkSwSta_RL 0 "Lock" 1 "Unlock" 2 "RESERVED" 3 "Error Indicator" ;
VAL_ 830 PDS_TypeOption_RL 0 "Off" 1 "On" 2 "RESERVED" 3 "Error Indicator" ;
VAL_ 830 RL_CrashMRActAlarm 0 "Off" 1 "On" 2 "RESERVED" 3 "Error Indicator" ;
VAL_ 830 PwrDRBuzzerOut_RL 0 "OFF" 1 "Open" 2 "Close" 3 "Warning" ;
VAL_ 830 PwrDRClosingRLDrSta 0 "Default" 1 "Close" 2 "Open" 3 "Stop(during Close)" 4 "Stop(during Open)" 5 "RESERVED" 6 "RESERVED" 7 "Invalid" ;
VAL_ 830 AFH_RL_FldUnfldSta 0 "Invalid" 1 "Fold" 2 "Unfold" 3 "Inprogress" ;
VAL_ 830 SBCM_RL_FD_AlvCnt1Val 0 "0x0~0xFF:AlvCntValue" 255 "0x0~0xFF:AlvCntValue" ;
VAL_ 830 DoorLock_RrLtLkOutSta_SBCM 0 "Off" 1 "On" 2 "Not Used" 3 "Error Indicator" ;
VAL_ 830 RrLt_DrLkRetryFail_SBCM 0 "Normal" 1 "Fail" 2 "RESERVED" 3 "RESERVED" ;
VAL_ 830 RL_DetectObj_warn 0 "Detect Warning OFF" 1 "Detect Warning ON" 2 "RESERVED" 3 "RESERVED" ;
VAL_ 830 RLRrDrCurtainPosition 0 "Unkown" 1 "Bottom" 2 "Mid" 3 "Top" ;
VAL_ 830 RDC_TypeOption 0 "Off" 1 "On" 2 "RESERVED" 3 "Error Indicator" ;
VAL_ 830 RLRrDrCurtainDownInitState 0 "Decalibrated" 1 "Calibrated" 2 "RESERVED" 3 "Error Indicator" ;
VAL_ 830 PwrDRBuzzerOut_RL_New 0 "OFF" 1 "Open" 2 "Close" 3 "Warning1" 4 "Warning2" ;
VAL_ 830 VAPI_RLDrLkUnLkInsdSwEn_Get 0 "Default" 1 "Disable" 2 "Enable" ;
VAL_ 830 PwrDrSta_RrLt 0 "Unavailable" 1 "Available" 2 "RESERVED" 3 "Error Indicator" ;
VAL_ 830 SBCM_RL_SlidePosition 0 "0x0~0x64:0% - 100%" 100 "0x0~0x64:0% - 100%" 101 "65~0xFE:RESERVED" 254 "65~0xFE:RESERVED" 255 "Unknown" ;
VAL_ 830 SBCM_RL_DoorAngle 0 "0° - 90°" 1 "0° - 90°" 2 "0° - 90°" 3 "0° - 90°" 4 "0° - 90°" 5 "0° - 90°" 6 "0° - 90°" 7 "0° - 90°" 8 "0° - 90°" 9 "0° - 90°" 10 "0° - 90°" 11 "0° - 90°" 12 "0° - 90°" 13 "0° - 90°" 14 "0° - 90°" 15 "0° - 90°" 16 "0° - 90°" 17 "0° - 90°" 18 "0° - 90°" 19 "0° - 90°" 20 "0° - 90°" 21 "0° - 90°" 22 "0° - 90°" 23 "0° - 90°" 24 "0° - 90°" 25 "0° - 90°" 26 "0° - 90°" 27 "0° - 90°" 28 "0° - 90°" 29 "0° - 90°" 30 "0° - 90°" 31 "0° - 90°" 32 "0° - 90°" 33 "0° - 90°" 34 "0° - 90°" 35 "0° - 90°" 36 "0° - 90°" 37 "0° - 90°" 38 "0° - 90°" 39 "0° - 90°" 40 "0° - 90°" 41 "0° - 90°" 42 "0° - 90°" 43 "0° - 90°" 44 "0° - 90°" 45 "0° - 90°" 46 "0° - 90°" 47 "0° - 90°" 48 "0° - 90°" 49 "0° - 90°" 50 "0° - 90°" 51 "0° - 90°" 52 "0° - 90°" 53 "0° - 90°" 54 "0° - 90°" 55 "0° - 90°" 56 "0° - 90°" 57 "0° - 90°" 58 "0° - 90°" 59 "0° - 90°" 60 "0° - 90°" 61 "0° - 90°" 62 "0° - 90°" 63 "0° - 90°" 64 "0° - 90°" 65 "0° - 90°" 66 "0° - 90°" 67 "0° - 90°" 68 "0° - 90°" 69 "0° - 90°" 70 "0° - 90°" 71 "0° - 90°" 72 "0° - 90°" 73 "0° - 90°" 74 "0° - 90°" 75 "0° - 90°" 76 "0° - 90°" 77 "0° - 90°" 78 "0° - 90°" 79 "0° - 90°" 80 "0° - 90°" 81 "0° - 90°" 82 "0° - 90°" 83 "0° - 90°" 84 "0° - 90°" 85 "0° - 90°" 86 "0° - 90°" 87 "0° - 90°" 88 "0° - 90°" 89 "0° - 90°" 90 "0° - 90°" 91 "Invalid" 92 "Invalid" 93 "Invalid" 94 "Invalid" 95 "Invalid" 96 "Invalid" 97 "Invalid" 98 "Invalid" 99 "Invalid" 100 "Unknown" 101 "Invalid" 102 "Invalid" 103 "Invalid" 104 "Invalid" 105 "Invalid" 106 "Invalid" 107 "Invalid" 108 "Invalid" 109 "Invalid" 110 "Invalid" 111 "Invalid" 112 "Invalid" 113 "Invalid" 114 "Invalid" 115 "Invalid" 116 "Invalid" 117 "Invalid" 118 "Invalid" 119 "Invalid" 120 "Invalid" 121 "Invalid" 122 "Invalid" 123 "Invalid" 124 "Invalid" 125 "Invalid" 126 "Invalid" 127 "Invalid" ;
VAL_ 830 RLDoorPushAlarm 0 "Off" 1 "On" 2 "RESERVED" 3 "Error Indicator" ;
VAL_ 830 RL_CrashUnlockCmd 0 "Off" 1 "Unlock(Crash)" ;
VAL_ 830 Warn_RrLftDrSwSta_SBCM 0 "Close" 1 "Open" 2 "RESERVED" 3 "Error Indicator" ;
VAL_ 830 DoorLock_RrLftDrUnLkSta_SBCM 0 "Lock" 1 "Unlock" 2 "RESERVED" 3 "Error Indicator" ;
VAL_ 830 RL_SEAActivated 0 "InActivated" 1 "Activated" 2 "RESERVED" 3 "Error Indicator" ;
VAL_ 830 RL_SEAWarn 0 "SEA Left Warning OFF" 1 "SEA Left Warning ON" 2 "RESERVED" 3 "RESERVED" ;
VAL_ 830 RL_SEWWarn 0 "SEW Left Warning OFF" 1 "SEW Left Warning ON" 2 "RESERVED" 3 "RESERVED" ;
VAL_ 830 RL_ReleaseWarn 0 "Release Warning OFF" 1 "Release Warning ON" 2 "RESERVED" 3 "RESERVED" ;
VAL_ 830 RL_SWFailAlarm 0 "Off" 1 "On" 2 "RESERVED" 3 "Error Indicator" ;
VAL_ 830 RL_ChildLock_ActnFlSta 0 "OK" 1 "Failed" 2 "RESERVED" 3 "Error Indicator" ;
VAL_ 830 RL_MRActivationAlarm 0 "Off" 1 "On" 2 "RESERVED" 3 "Error Indicator" ;
VAL_ 830 RL_ChildLock_Status 0 "ChildLock On" 1 "ChildLock Off" 2 "RESERVED" 3 "RESERVED" ;
VAL_ 676 HU_CLU_Crc3Val 0 "0x0~0xFFFF:CRCValue" 65535 "0x0~0xFFFF:CRCValue" ;
VAL_ 676 AVNT_NModeSel2_Custom1SetVal 0 "Default" 1 "Off" 2 "On" 3 "Invalid" ;
VAL_ 676 AVNT_NModeSel2_Custom2SetVal 0 "Default" 1 "Off" 2 "On" 3 "Invalid" ;
VAL_ 676 AVNT_NHndlSel2_SportSetVal 0 "Default" 1 "Off" 2 "On" 3 "Invalid" ;
VAL_ 676 AVNT_NHndlSel2_TrackSetVal 0 "Default" 1 "Off" 2 "On" 3 "Invalid" ;
VAL_ 676 AVNT_NHndlSel2_DriftSetVal 0 "Default" 1 "Off" 2 "On" 3 "Invalid" ;
VAL_ 676 AVNT_NHndlSel2_WetSetVal 0 "Default" 1 "Off" 2 "On" 3 "Invalid" ;
VAL_ 676 HU_DispThmSetStaMem 0 "Default" 1 "Original" 2 "Memory 1" 3 "Memory 2" 4 "Memory 3" 5 "RESERVED" 6 "RESERVED" 7 "Invalid" ;
VAL_ 676 HU_DispThmMemSta 0 "Valid (See the description)" 1 "Valid (See the description)" 2 "Valid (See the description)" 3 "Valid (See the description)" 4 "Valid (See the description)" 5 "Valid (See the description)" 6 "Valid (See the description)" 7 "Valid (See the description)" ;
VAL_ 676 AVNT_NModeSel_NSetVal 0 "Default" 1 "Off" 2 "On" 3 "Invalid" ;
VAL_ 676 AVNT_NModeSel_Custom1SetVal 0 "Default" 1 "Off" 2 "On" 3 "Invalid" ;
VAL_ 676 AVNT_NModeSel_Custom2SetVal 0 "Default" 1 "Off" 2 "On" 3 "Invalid" ;
VAL_ 676 AVNT_NHndlSel_SportSetVal 0 "Default" 1 "Off" 2 "On" 3 "Invalid" ;
VAL_ 676 HD_SPS_ChannelNo 0 "Off" 1 "HD" 2 "HD1" 3 "HD2" 4 "HD3" 5 "HD4" 6 "HD5" 7 "HD6" 8 "HD7" 9 "HD8" 10 "RESERVED" 11 "RESERVED" 12 "RESERVED" 13 "RESERVED" 14 "RESERVED" 15 "Invalid" ;
VAL_ 676 HU_CLU_BlueLightLvl 0 "Bluelight Filter level" 1 "Bluelight Filter level" 2 "Bluelight Filter level" 3 "Bluelight Filter level" 4 "Bluelight Filter level" 5 "Bluelight Filter level" 6 "Bluelight Filter level" 7 "Bluelight Filter level" 8 "Bluelight Filter level" 9 "Bluelight Filter level" 10 "RESERVED" 11 "RESERVED" 12 "RESERVED" 13 "RESERVED" 14 "RESERVED" 15 "Invalid" ;
VAL_ 676 HU_CLU_BlueLightSta 0 "Default" 1 "Off" 2 "On" 3 "Invalid" ;
VAL_ 676 SXM_ChannelNo 1023 "Invalid" ;
VAL_ 676 HU_CLU_AlvCnt3Val 0 "0x0~0xFF:AlvCntValue" 255 "0x0~0xFF:AlvCntValue" ;
VAL_ 676 AVNT_N1setVal 0 "Default" 1 "N Mode selection" 2 "NTC" 3 "Persistance Mode" 4 "Drift Optimizer" 5 "Lap Timer - Start/Lap" 6 "Lap Timer - Stop/Reset" 7 "e-ASD N" 8 "VGS" 9 "Launch Control" 10 "N pedal" 11 "RESERVED" 12 "RESERVED" 13 "RESERVED" 14 "RESERVED" 15 "RESERVED" 16 "RESERVED" 17 "RESERVED" 18 "RESERVED" 19 "RESERVED" 20 "RESERVED" 21 "RESERVED" 22 "RESERVED" 23 "RESERVED" 24 "RESERVED" 25 "RESERVED" 26 "RESERVED" 27 "RESERVED" 28 "RESERVED" 29 "RESERVED" 30 "RESERVED" 31 "Invalid" ;
VAL_ 676 AVNT_N2setVal 0 "Default" 1 "N Mode Selection" 2 "NTC" 3 "Persistance mode" 4 "Drift Optimizer" 5 "Lap Timer - Start/Lap" 6 "Lap Timer - Stop/Reset" 7 "e-ASD N" 8 "VGS" 9 "Launch Control" 10 "N Pedal" 11 "Rerseved" 12 "Rerseved" 13 "Rerseved" 14 "Rerseved" 15 "Rerseved" 16 "Rerseved" 17 "Rerseved" 18 "Rerseved" 19 "Rerseved" 20 "Rerseved" 21 "Rerseved" 22 "Rerseved" 23 "Rerseved" 24 "Rerseved" 25 "Rerseved" 26 "Rerseved" 27 "Rerseved" 28 "Rerseved" 29 "Rerseved" 30 "Rerseved" 31 "Invalid" ;
VAL_ 676 AVNT_NHndlSel_TrackSetVal 0 "Default" 1 "Off" 2 "On" 3 "Invalid" ;
VAL_ 676 AVNT_NHndlSel_DriftSetVal 0 "Default" 1 "Off" 2 "On" 3 "Invalid" ;
VAL_ 676 AVNT_NHndlSel_WetSetVal 0 "Default" 1 "Off" 2 "On" 3 "Invalid" ;
VAL_ 676 LapTimer_LapNumber_HU 0 "RESERVED" 1 "Lap Number" 2 "Lap Number" 3 "Lap Number" 4 "Lap Number" 5 "Lap Number" 6 "Lap Number" 7 "Lap Number" 8 "Lap Number" 9 "Lap Number" 10 "Lap Number" 11 "Lap Number" 12 "Lap Number" 13 "Lap Number" 14 "Lap Number" 15 "Lap Number" 16 "Lap Number" 17 "Lap Number" 18 "Lap Number" 19 "Lap Number" 20 "Lap Number" 21 "Lap Number" 22 "Lap Number" 23 "Lap Number" 24 "Lap Number" 25 "Lap Number" 26 "Lap Number" 27 "Lap Number" 28 "Lap Number" 29 "Lap Number" 30 "Lap Number" 31 "Lap Number" 32 "Lap Number" 33 "Lap Number" 34 "Lap Number" 35 "Lap Number" 36 "Lap Number" 37 "Lap Number" 38 "Lap Number" 39 "Lap Number" 40 "Lap Number" 41 "Lap Number" 42 "Lap Number" 43 "Lap Number" 44 "Lap Number" 45 "Lap Number" 46 "Lap Number" 47 "Lap Number" 48 "Lap Number" 49 "Lap Number" 50 "Lap Number" 51 "Lap Number" 52 "Lap Number" 53 "Lap Number" 54 "Lap Number" 55 "Lap Number" 56 "Lap Number" 57 "Lap Number" 58 "Lap Number" 59 "Lap Number" 60 "Lap Number" 61 "Lap Number" 62 "Lap Number" 63 "Lap Number" 64 "Lap Number" 65 "Lap Number" 66 "Lap Number" 67 "Lap Number" 68 "Lap Number" 69 "Lap Number" 70 "Lap Number" 71 "Lap Number" 72 "Lap Number" 73 "Lap Number" 74 "Lap Number" 75 "Lap Number" 76 "Lap Number" 77 "Lap Number" 78 "Lap Number" 79 "Lap Number" 80 "Lap Number" 81 "Lap Number" 82 "Lap Number" 83 "Lap Number" 84 "Lap Number" 85 "Lap Number" 86 "Lap Number" 87 "Lap Number" 88 "Lap Number" 89 "Lap Number" 90 "Lap Number" 91 "Lap Number" 92 "Lap Number" 93 "Lap Number" 94 "Lap Number" 95 "Lap Number" 96 "Lap Number" 97 "Lap Number" 98 "Lap Number" 99 "Lap Number" 100 "RESERVED" 101 "RESERVED" 102 "RESERVED" 103 "RESERVED" 104 "RESERVED" 105 "RESERVED" 106 "RESERVED" 107 "RESERVED" 108 "RESERVED" 109 "RESERVED" 110 "RESERVED" 111 "RESERVED" 112 "RESERVED" 113 "RESERVED" 114 "RESERVED" 115 "RESERVED" 116 "RESERVED" 117 "RESERVED" 118 "RESERVED" 119 "RESERVED" 120 "RESERVED" 121 "RESERVED" 122 "RESERVED" 123 "RESERVED" 124 "RESERVED" 125 "RESERVED" 126 "RESERVED" 127 "invalid" ;
VAL_ 676 LapTimer_Hour_HU 0 "refer to signal description" 1 "refer to signal description" 2 "refer to signal description" 3 "refer to signal description" 4 "refer to signal description" 5 "refer to signal description" 6 "refer to signal description" 7 "refer to signal description" 8 "refer to signal description" 9 "refer to signal description" 10 "refer to signal description" 11 "refer to signal description" 12 "refer to signal description" 13 "refer to signal description" 14 "refer to signal description" 15 "refer to signal description" 16 "refer to signal description" 17 "refer to signal description" 18 "refer to signal description" 19 "refer to signal description" 20 "refer to signal description" 21 "refer to signal description" 22 "refer to signal description" 23 "refer to signal description" 24 "refer to signal description" 25 "refer to signal description" 26 "refer to signal description" 27 "refer to signal description" 28 "refer to signal description" 29 "refer to signal description" 30 "refer to signal description" 31 "refer to signal description" 32 "refer to signal description" 33 "refer to signal description" 34 "refer to signal description" 35 "refer to signal description" 36 "refer to signal description" 37 "refer to signal description" 38 "refer to signal description" 39 "refer to signal description" 40 "refer to signal description" 41 "refer to signal description" 42 "refer to signal description" 43 "refer to signal description" 44 "refer to signal description" 45 "refer to signal description" 46 "refer to signal description" 47 "refer to signal description" 48 "refer to signal description" 49 "refer to signal description" 50 "refer to signal description" 51 "refer to signal description" 52 "refer to signal description" 53 "refer to signal description" 54 "refer to signal description" 55 "refer to signal description" 56 "refer to signal description" 57 "refer to signal description" 58 "refer to signal description" 59 "refer to signal description" 60 "refer to signal description" 61 "refer to signal description" 62 "refer to signal description" 63 "refer to signal description" 64 "refer to signal description" 65 "refer to signal description" 66 "refer to signal description" 67 "refer to signal description" 68 "refer to signal description" 69 "refer to signal description" 70 "refer to signal description" 71 "refer to signal description" 72 "refer to signal description" 73 "refer to signal description" 74 "refer to signal description" 75 "refer to signal description" 76 "refer to signal description" 77 "refer to signal description" 78 "refer to signal description" 79 "refer to signal description" 80 "refer to signal description" 81 "refer to signal description" 82 "refer to signal description" 83 "refer to signal description" 84 "refer to signal description" 85 "refer to signal description" 86 "refer to signal description" 87 "refer to signal description" 88 "refer to signal description" 89 "refer to signal description" 90 "refer to signal description" 91 "refer to signal description" 92 "refer to signal description" 93 "refer to signal description" 94 "refer to signal description" 95 "refer to signal description" 96 "refer to signal description" 97 "refer to signal description" 98 "refer to signal description" 99 "refer to signal description" 100 "RESERVED" 101 "RESERVED" 102 "RESERVED" 103 "RESERVED" 104 "RESERVED" 105 "RESERVED" 106 "RESERVED" 107 "RESERVED" 108 "RESERVED" 109 "RESERVED" 110 "RESERVED" 111 "RESERVED" 112 "RESERVED" 113 "RESERVED" 114 "RESERVED" 115 "RESERVED" 116 "RESERVED" 117 "RESERVED" 118 "RESERVED" 119 "RESERVED" 120 "RESERVED" 121 "RESERVED" 122 "RESERVED" 123 "RESERVED" 124 "RESERVED" 125 "RESERVED" 126 "RESERVED" 127 "invalid" ;
VAL_ 676 LapTimer_Minute_HU 0 "refer to signal description" 1 "refer to signal description" 2 "refer to signal description" 3 "refer to signal description" 4 "refer to signal description" 5 "refer to signal description" 6 "refer to signal description" 7 "refer to signal description" 8 "refer to signal description" 9 "refer to signal description" 10 "refer to signal description" 11 "refer to signal description" 12 "refer to signal description" 13 "refer to signal description" 14 "refer to signal description" 15 "refer to signal description" 16 "refer to signal description" 17 "refer to signal description" 18 "refer to signal description" 19 "refer to signal description" 20 "refer to signal description" 21 "refer to signal description" 22 "refer to signal description" 23 "refer to signal description" 24 "refer to signal description" 25 "refer to signal description" 26 "refer to signal description" 27 "refer to signal description" 28 "refer to signal description" 29 "refer to signal description" 30 "refer to signal description" 31 "refer to signal description" 32 "refer to signal description" 33 "refer to signal description" 34 "refer to signal description" 35 "refer to signal description" 36 "refer to signal description" 37 "refer to signal description" 38 "refer to signal description" 39 "refer to signal description" 40 "refer to signal description" 41 "refer to signal description" 42 "refer to signal description" 43 "refer to signal description" 44 "refer to signal description" 45 "refer to signal description" 46 "refer to signal description" 47 "refer to signal description" 48 "refer to signal description" 49 "refer to signal description" 50 "refer to signal description" 51 "refer to signal description" 52 "refer to signal description" 53 "refer to signal description" 54 "refer to signal description" 55 "refer to signal description" 56 "refer to signal description" 57 "refer to signal description" 58 "refer to signal description" 59 "refer to signal description" 60 "RESERVED" 61 "RESERVED" 62 "RESERVED" 63 "invalid" ;
VAL_ 676 LapTimer_Second_HU 0 "refer to signal description" 1 "refer to signal description" 2 "refer to signal description" 3 "refer to signal description" 4 "refer to signal description" 5 "refer to signal description" 6 "refer to signal description" 7 "refer to signal description" 8 "refer to signal description" 9 "refer to signal description" 10 "refer to signal description" 11 "refer to signal description" 12 "refer to signal description" 13 "refer to signal description" 14 "refer to signal description" 15 "refer to signal description" 16 "refer to signal description" 17 "refer to signal description" 18 "refer to signal description" 19 "refer to signal description" 20 "refer to signal description" 21 "refer to signal description" 22 "refer to signal description" 23 "refer to signal description" 24 "refer to signal description" 25 "refer to signal description" 26 "refer to signal description" 27 "refer to signal description" 28 "refer to signal description" 29 "refer to signal description" 30 "refer to signal description" 31 "refer to signal description" 32 "refer to signal description" 33 "refer to signal description" 34 "refer to signal description" 35 "refer to signal description" 36 "refer to signal description" 37 "refer to signal description" 38 "refer to signal description" 39 "refer to signal description" 40 "refer to signal description" 41 "refer to signal description" 42 "refer to signal description" 43 "refer to signal description" 44 "refer to signal description" 45 "refer to signal description" 46 "refer to signal description" 47 "refer to signal description" 48 "refer to signal description" 49 "refer to signal description" 50 "refer to signal description" 51 "refer to signal description" 52 "refer to signal description" 53 "refer to signal description" 54 "refer to signal description" 55 "refer to signal description" 56 "refer to signal description" 57 "refer to signal description" 58 "refer to signal description" 59 "refer to signal description" 60 "RESERVED" 61 "RESERVED" 62 "RESERVED" 63 "invalid" ;
VAL_ 676 LapTimer_milisecond_HU 0 "refer to signal description" 1 "refer to signal description" 2 "refer to signal description" 3 "refer to signal description" 4 "refer to signal description" 5 "refer to signal description" 6 "refer to signal description" 7 "refer to signal description" 8 "refer to signal description" 9 "refer to signal description" 10 "refer to signal description" 11 "refer to signal description" 12 "refer to signal description" 13 "refer to signal description" 14 "refer to signal description" 15 "refer to signal description" 16 "refer to signal description" 17 "refer to signal description" 18 "refer to signal description" 19 "refer to signal description" 20 "refer to signal description" 21 "refer to signal description" 22 "refer to signal description" 23 "refer to signal description" 24 "refer to signal description" 25 "refer to signal description" 26 "refer to signal description" 27 "refer to signal description" 28 "refer to signal description" 29 "refer to signal description" 30 "refer to signal description" 31 "refer to signal description" 32 "refer to signal description" 33 "refer to signal description" 34 "refer to signal description" 35 "refer to signal description" 36 "refer to signal description" 37 "refer to signal description" 38 "refer to signal description" 39 "refer to signal description" 40 "refer to signal description" 41 "refer to signal description" 42 "refer to signal description" 43 "refer to signal description" 44 "refer to signal description" 45 "refer to signal description" 46 "refer to signal description" 47 "refer to signal description" 48 "refer to signal description" 49 "refer to signal description" 50 "refer to signal description" 51 "refer to signal description" 52 "refer to signal description" 53 "refer to signal description" 54 "refer to signal description" 55 "refer to signal description" 56 "refer to signal description" 57 "refer to signal description" 58 "refer to signal description" 59 "refer to signal description" 60 "refer to signal description" 61 "refer to signal description" 62 "refer to signal description" 63 "refer to signal description" 64 "refer to signal description" 65 "refer to signal description" 66 "refer to signal description" 67 "refer to signal description" 68 "refer to signal description" 69 "refer to signal description" 70 "refer to signal description" 71 "refer to signal description" 72 "refer to signal description" 73 "refer to signal description" 74 "refer to signal description" 75 "refer to signal description" 76 "refer to signal description" 77 "refer to signal description" 78 "refer to signal description" 79 "refer to signal description" 80 "refer to signal description" 81 "refer to signal description" 82 "refer to signal description" 83 "refer to signal description" 84 "refer to signal description" 85 "refer to signal description" 86 "refer to signal description" 87 "refer to signal description" 88 "refer to signal description" 89 "refer to signal description" 90 "refer to signal description" 91 "refer to signal description" 92 "refer to signal description" 93 "refer to signal description" 94 "refer to signal description" 95 "refer to signal description" 96 "refer to signal description" 97 "refer to signal description" 98 "refer to signal description" 99 "refer to signal description" 100 "RESERVED" 101 "RESERVED" 102 "RESERVED" 103 "RESERVED" 104 "RESERVED" 105 "RESERVED" 106 "RESERVED" 107 "RESERVED" 108 "RESERVED" 109 "RESERVED" 110 "RESERVED" 111 "RESERVED" 112 "RESERVED" 113 "RESERVED" 114 "RESERVED" 115 "RESERVED" 116 "RESERVED" 117 "RESERVED" 118 "RESERVED" 119 "RESERVED" 120 "RESERVED" 121 "RESERVED" 122 "RESERVED" 123 "RESERVED" 124 "RESERVED" 125 "RESERVED" 126 "RESERVED" 127 "invalid" ;
VAL_ 676 LapTimer_CountStart 0 "Stop_HU_Lap Timer" 1 "Start_HU_Lap Timer" 2 "Ready_HU_Lap_Timer" 3 "Invalid" ;
VAL_ 676 AVNT_NModeSel2_NSetVal 0 "Default" 1 "Off" 2 "On" 3 "Invalid" ;
